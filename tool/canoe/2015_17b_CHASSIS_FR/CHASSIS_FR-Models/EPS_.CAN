includes
{
	#include "ASR_FR_NM_IL.CIN"
}

/*
|==========================================================================================|
|                                                                                          |
|                                                                                          |
|                                         COPYRIGHT                                        |
|                                                                                          |
|                   Copyright (c) by Daimler AG Abt. RD/EEV 2015                           |
|                                                                                          |
|                                                                                          |
|==========================================================================================|
|                                                                                          |
|                                   CAPL AUTHOR IDENTITY                                   |
|                                   --------------------                                   |
|                                                                                          |
| Initials   | Name                 | Company                                              |
| -----------+----------------------+----------------------------------------------------- |
| BH         | Björn Haßelkus       | Firma TZM (EXTERN im Auftrag der Daimler AG)         |
| RS         | Rainer Schulte       | Firma TZM (EXTERN im Auftrag der Daimler AG)         |
|            |                      |                                                      |
|                                                                                          |
|==========================================================================================|
|                                                                                          |
|                                     REVISION HISTORY                                     |
|                                     ----------------                                     |
|                                                                                          |
| Date       | Ver   | Author       | Description                                          |
| -----------+-------+--------------+----------------------------------------------------- |
| 27.04.15   | 1.0   | RS           | creation                                             |
|            |       |              |                                                      |
|                                                                                          |
|------------------------------------------------------------------------------------------|
*/

variables
{
	long ret_Register;
	// global variable for getting (showing) results auf dll-Functions
	long result;

	int CRC_DTQ_Rs_Pr2;
	dword CounterValForCRC_DTQ_Rs_Pr2;
	int SQC_VAL_DTQ_Rs_Pr2;
	int SQC_DTQ_Rs_Pr2;
	int CRC_EPS_CtrlLmp_Disp_Rq_Pr2;
	dword CounterValForCRC_EPS_CtrlLmp_Disp_Rq_Pr2;
	int SQC_VAL_EPS_CtrlLmp_Disp_Rq_Pr2;
	int SQC_EPS_CtrlLmp_Disp_Rq_Pr2;
	int CRC_PARK_St_Rs_Pr2;
	dword CounterValForCRC_PARK_St_Rs_Pr2;
	int SQC_VAL_PARK_St_Rs_Pr2;
	int SQC_PARK_St_Rs_Pr2;
	int CRC_STA_Rs1_Pr2;
	dword CounterValForCRC_STA_Rs1_Pr2;
	int SQC_VAL_STA_Rs1_Pr2;
	int SQC_STA_Rs1_Pr2;
	int CRC_TBCSC_Rs_EPS_Pr2;
	dword CounterValForCRC_TBCSC_Rs_EPS_Pr2;
	int SQC_VAL_TBCSC_Rs_EPS_Pr2;
	int SQC_TBCSC_Rs_EPS_Pr2;

	msTimer Timer_EPS_DTQ_Rs_AR2;
	msTimer Timer_EPS_EPS_Stat_Disp_Rq_AR2;
	msTimer Timer_EPS_PARK_St_Rs_AR2;
	msTimer Timer_EPS_ROE_EPS;
	msTimer Timer_EPS_STA_Rs1_AR2;
	msTimer Timer_EPS_TBCSC_EPS_DAC_AR2;
	msTimer Timer_EPS_TBCSC_Rs_EPS_AR2;
	msTimer Timer_EPS_WUDOP_EPS_FR;

   byte  crctable[256] = {
      0x00, 0x1D, 0x3A, 0x27, 0x74, 0x69, 0x4E, 0x53,
      0xE8, 0xF5, 0xD2, 0xCF, 0x9C, 0x81, 0xA6, 0xBB,
      0xCD, 0xD0, 0xF7, 0xEA, 0xB9, 0xA4, 0x83, 0x9E,
      0x25, 0x38, 0x1F, 0x02, 0x51, 0x4C, 0x6B, 0x76,
      0x87, 0x9A, 0xBD, 0xA0, 0xF3, 0xEE, 0xC9, 0xD4,
      0x6F, 0x72, 0x55, 0x48, 0x1B, 0x06, 0x21, 0x3C,
      0x4A, 0x57, 0x70, 0x6D, 0x3E, 0x23, 0x04, 0x19,
      0xA2, 0xBF, 0x98, 0x85, 0xD6, 0xCB, 0xEC, 0xF1,
      0x13, 0x0E, 0x29, 0x34, 0x67, 0x7A, 0x5D, 0x40,
      0xFB, 0xE6, 0xC1, 0xDC, 0x8F, 0x92, 0xB5, 0xA8,
      0xDE, 0xC3, 0xE4, 0xF9, 0xAA, 0xB7, 0x90, 0x8D,
      0x36, 0x2B, 0x0C, 0x11, 0x42, 0x5F, 0x78, 0x65,
      0x94, 0x89, 0xAE, 0xB3, 0xE0, 0xFD, 0xDA, 0xC7,
      0x7C, 0x61, 0x46, 0x5B, 0x08, 0x15, 0x32, 0x2F,
      0x59, 0x44, 0x63, 0x7E, 0x2D, 0x30, 0x17, 0x0A,
      0xB1, 0xAC, 0x8B, 0x96, 0xC5, 0xD8, 0xFF, 0xE2,
      0x26, 0x3B, 0x1C, 0x01, 0x52, 0x4F, 0x68, 0x75,
      0xCE, 0xD3, 0xF4, 0xE9, 0xBA, 0xA7, 0x80, 0x9D,
      0xEB, 0xF6, 0xD1, 0xCC, 0x9F, 0x82, 0xA5, 0xB8,
      0x03, 0x1E, 0x39, 0x24, 0x77, 0x6A, 0x4D, 0x50,
      0xA1, 0xBC, 0x9B, 0x86, 0xD5, 0xC8, 0xEF, 0xF2,
      0x49, 0x54, 0x73, 0x6E, 0x3D, 0x20, 0x07, 0x1A,
      0x6C, 0x71, 0x56, 0x4B, 0x18, 0x05, 0x22, 0x3F,
      0x84, 0x99, 0xBE, 0xA3, 0xF0, 0xED, 0xCA, 0xD7,
      0x35, 0x28, 0x0F, 0x12, 0x41, 0x5C, 0x7B, 0x66,
      0xDD, 0xC0, 0xE7, 0xFA, 0xA9, 0xB4, 0x93, 0x8E,
      0xF8, 0xE5, 0xC2, 0xDF, 0x8C, 0x91, 0xB6, 0xAB,
      0x10, 0x0D, 0x2A, 0x37, 0x64, 0x79, 0x5E, 0x43,
      0xB2, 0xAF, 0x88, 0x95, 0xC6, 0xDB, 0xFC, 0xE1,
      0x5A, 0x47, 0x60, 0x7D, 0x2E, 0x33, 0x14, 0x09,
      0x7F, 0x62, 0x45, 0x58, 0x0B, 0x16, 0x31, 0x2C,
      0x97, 0x8A, 0xAD, 0xB0, 0xE3, 0xFE, 0xD9, 0xC4
   };

   byte  crctableProfTwo[256] = {
			0x00, 0x2F, 0x5E, 0x71, 0xBC, 0x93, 0xE2, 0xCD,
			0x57, 0x78, 0x09, 0x26, 0xEB, 0xC4, 0xB5, 0x9A,
			0xAE, 0x81, 0xF0, 0xDF, 0x12, 0x3D, 0x4C, 0x63,
			0xF9, 0xD6, 0xA7, 0x88, 0x45, 0x6A, 0x1B, 0x34,
			0x73, 0x5C, 0x2D, 0x02, 0xCF, 0xE0, 0x91, 0xBE,
			0x24, 0x0B, 0x7A, 0x55, 0x98, 0xB7, 0xC6, 0xE9,
			0xDD, 0xF2, 0x83, 0xAC, 0x61, 0x4E, 0x3F, 0x10,
			0x8A, 0xA5, 0xD4, 0xFB, 0x36, 0x19, 0x68, 0x47,
			0xE6, 0xC9, 0xB8, 0x97, 0x5A, 0x75, 0x04, 0x2B,
			0xB1, 0x9E, 0xEF, 0xC0, 0x0D, 0x22, 0x53, 0x7C,
			0x48, 0x67, 0x16, 0x39, 0xF4, 0xDB, 0xAA, 0x85,
			0x1F, 0x30, 0x41, 0x6E, 0xA3, 0x8C, 0xFD, 0xD2,
			0x95, 0xBA, 0xCB, 0xE4, 0x29, 0x06, 0x77, 0x58,
			0xC2, 0xED, 0x9C, 0xB3, 0x7E, 0x51, 0x20, 0x0F,
			0x3B, 0x14, 0x65, 0x4A, 0x87, 0xA8, 0xD9, 0xF6,
			0x6C, 0x43, 0x32, 0x1D, 0xD0, 0xFF, 0x8E, 0xA1,
			0xE3, 0xCC, 0xBD, 0x92, 0x5F, 0x70, 0x01, 0x2E,
			0xB4, 0x9B, 0xEA, 0xC5, 0x08, 0x27, 0x56, 0x79,
			0x4D, 0x62, 0x13, 0x3C, 0xF1, 0xDE, 0xAF, 0x80,
			0x1A, 0x35, 0x44, 0x6B, 0xA6, 0x89, 0xF8, 0xD7,
			0x90, 0xBF, 0xCE, 0xE1, 0x2C, 0x03, 0x72, 0x5D,
			0xC7, 0xE8, 0x99, 0xB6, 0x7B, 0x54, 0x25, 0x0A,
			0x3E, 0x11, 0x60, 0x4F, 0x82, 0xAD, 0xDC, 0xF3,
			0x69, 0x46, 0x37, 0x18, 0xD5, 0xFA, 0x8B, 0xA4,
			0x05, 0x2A, 0x5B, 0x74, 0xB9, 0x96, 0xE7, 0xC8,
			0x52, 0x7D, 0x0C, 0x23, 0xEE, 0xC1, 0xB0, 0x9F,
			0xAB, 0x84, 0xF5, 0xDA, 0x17, 0x38, 0x49, 0x66,
			0xFC, 0xD3, 0xA2, 0x8D, 0x40, 0x6F, 0x1E, 0x31,
			0x76, 0x59, 0x28, 0x07, 0xCA, 0xE5, 0x94, 0xBB,
			0x21, 0x0E, 0x7F, 0x50, 0x9D, 0xB2, 0xC3, 0xEC,
			0xD8, 0xF7, 0x86, 0xA9, 0x64, 0x4B, 0x3A, 0x15,
			0x8F, 0xA0, 0xD1, 0xFE, 0x33, 0x1C, 0x6D, 0x42
   };
}

on start
{
	result = EnableCRC("", 0); // 1 = on, 0 = off
	result = EnableTGL("", 0); // 1 = on, 0 = off 
	result = EnableSQC("", 0); // 1 = on, 0 = off 
	result = EnableMC("", 0); // 1 = on, 0 = off 

	if (@sysvar::CH_Nodes::CH_EPSCRC_DTQ_Rs_Pr2DTQ_Rs__AUTO == 0)
	{
		//Automatisch
		enableControl("DTQ_Rs_AR2", "CH_EPSCRC_DTQ_Rs_Pr2DTQ_Rs_AR2_", 0); //1: enable; 0: disable
	}
	else
	{
		//Manuel
		enableControl("DTQ_Rs_AR2", "CH_EPSCRC_DTQ_Rs_Pr2DTQ_Rs_AR2_", 1); //1: enable; 0: disable
	}
	if (@sysvar::CH_Nodes::CH_EPSSQC_DTQ_Rs_Pr2DTQ_Rs__AUTO == 0)
	{
		//Automatisch
		enableControl("DTQ_Rs_AR2", "CH_EPSSQC_DTQ_Rs_Pr2DTQ_Rs_AR2_", 0); //1: enable; 0: disable
	}
	else
	{
		//Manuel
		enableControl("DTQ_Rs_AR2", "CH_EPSSQC_DTQ_Rs_Pr2DTQ_Rs_AR2_", 1); //1: enable; 0: disable
	}
	@sysvar::CH_Nodes::CH__PDURECEIPT_SIM_EPS_DTQ_Rs_AR2 = 1;
	if (@sysvar::CH_Nodes::CH_EPSCRC_EPS_CtrlLmp_Disp__AUTO == 0)
	{
		//Automatisch
		enableControl("EPS_Stat_Disp_Rq_AR2", "CH_EPSCRC_EPS_CtrlLmp_Disp_Rq_P_", 0); //1: enable; 0: disable
	}
	else
	{
		//Manuel
		enableControl("EPS_Stat_Disp_Rq_AR2", "CH_EPSCRC_EPS_CtrlLmp_Disp_Rq_P_", 1); //1: enable; 0: disable
	}
	if (@sysvar::CH_Nodes::CH_EPSSQC_EPS_CtrlLmp_Disp__AUTO == 0)
	{
		//Automatisch
		enableControl("EPS_Stat_Disp_Rq_AR2", "CH_EPSSQC_EPS_CtrlLmp_Disp_Rq_P_", 0); //1: enable; 0: disable
	}
	else
	{
		//Manuel
		enableControl("EPS_Stat_Disp_Rq_AR2", "CH_EPSSQC_EPS_CtrlLmp_Disp_Rq_P_", 1); //1: enable; 0: disable
	}
	@sysvar::CH_Nodes::CH__PDURECEIPT_SIM_EPS_EPS_Stat_Disp_Rq_AR2 = 1;
	if (@sysvar::CH_Nodes::CH_EPSCRC_PARK_St_Rs_Pr2PAR_AUTO == 0)
	{
		//Automatisch
		enableControl("PARK_St_Rs_AR2", "CH_EPSCRC_PARK_St_Rs_Pr2PARK_St_", 0); //1: enable; 0: disable
	}
	else
	{
		//Manuel
		enableControl("PARK_St_Rs_AR2", "CH_EPSCRC_PARK_St_Rs_Pr2PARK_St_", 1); //1: enable; 0: disable
	}
	if (@sysvar::CH_Nodes::CH_EPSSQC_PARK_St_Rs_Pr2PAR_AUTO == 0)
	{
		//Automatisch
		enableControl("PARK_St_Rs_AR2", "CH_EPSSQC_PARK_St_Rs_Pr2PARK_St_", 0); //1: enable; 0: disable
	}
	else
	{
		//Manuel
		enableControl("PARK_St_Rs_AR2", "CH_EPSSQC_PARK_St_Rs_Pr2PARK_St_", 1); //1: enable; 0: disable
	}
	@sysvar::CH_Nodes::CH__PDURECEIPT_SIM_EPS_PARK_St_Rs_AR2 = 1;
	@sysvar::CH_Nodes::CH__PDURECEIPT_SIM_EPS_ROE_EPS = 1;
	if (@sysvar::CH_Nodes::CH_EPSCRC_STA_Rs1_Pr2STA_Rs_AUTO == 0)
	{
		//Automatisch
		enableControl("STA_Rs1_AR2", "CH_EPSCRC_STA_Rs1_Pr2STA_Rs1_AR_", 0); //1: enable; 0: disable
	}
	else
	{
		//Manuel
		enableControl("STA_Rs1_AR2", "CH_EPSCRC_STA_Rs1_Pr2STA_Rs1_AR_", 1); //1: enable; 0: disable
	}
	if (@sysvar::CH_Nodes::CH_EPSSQC_STA_Rs1_Pr2STA_Rs_AUTO == 0)
	{
		//Automatisch
		enableControl("STA_Rs1_AR2", "CH_EPSSQC_STA_Rs1_Pr2STA_Rs1_AR_", 0); //1: enable; 0: disable
	}
	else
	{
		//Manuel
		enableControl("STA_Rs1_AR2", "CH_EPSSQC_STA_Rs1_Pr2STA_Rs1_AR_", 1); //1: enable; 0: disable
	}
	@sysvar::CH_Nodes::CH__PDURECEIPT_SIM_EPS_STA_Rs1_AR2 = 1;
	@sysvar::CH_Nodes::CH__PDURECEIPT_SIM_EPS_TBCSC_EPS_DAC_AR2 = 1;
	if (@sysvar::CH_Nodes::CH_EPSCRC_TBCSC_Rs_EPS_Pr2T_AUTO == 0)
	{
		//Automatisch
		enableControl("TBCSC_Rs_EPS_AR2", "CH_EPSCRC_TBCSC_Rs_EPS_Pr2TBCSC_", 0); //1: enable; 0: disable
	}
	else
	{
		//Manuel
		enableControl("TBCSC_Rs_EPS_AR2", "CH_EPSCRC_TBCSC_Rs_EPS_Pr2TBCSC_", 1); //1: enable; 0: disable
	}
	if (@sysvar::CH_Nodes::CH_EPSSQC_TBCSC_Rs_EPS_Pr2T_AUTO == 0)
	{
		//Automatisch
		enableControl("TBCSC_Rs_EPS_AR2", "CH_EPSSQC_TBCSC_Rs_EPS_Pr2TBCSC_", 0); //1: enable; 0: disable
	}
	else
	{
		//Manuel
		enableControl("TBCSC_Rs_EPS_AR2", "CH_EPSSQC_TBCSC_Rs_EPS_Pr2TBCSC_", 1); //1: enable; 0: disable
	}
	@sysvar::CH_Nodes::CH__PDURECEIPT_SIM_EPS_TBCSC_Rs_EPS_AR2 = 1;
	@sysvar::CH_Nodes::CH__PDURECEIPT_SIM_EPS_WUDOP_EPS_FR = 1;
	// netzwerk management

	enableControl("CHASSIS_FR Netzmanagement", "CH__NMActive_EPS", 1);
}

on preStart
{


}

on timer Timer_EPS_DTQ_Rs_AR2
{
	@sysvar::CH_Nodes::CH__STPDU_EPS_DTQ_Rs_AR2 = 0;
}

on timer Timer_EPS_EPS_Stat_Disp_Rq_AR2
{
	@sysvar::CH_Nodes::CH__STPDU_EPS_EPS_Stat_Disp_Rq_AR2 = 0;
}

on timer Timer_EPS_PARK_St_Rs_AR2
{
	@sysvar::CH_Nodes::CH__STPDU_EPS_PARK_St_Rs_AR2 = 0;
}

on timer Timer_EPS_ROE_EPS
{
	@sysvar::CH_Nodes::CH__STPDU_EPS_ROE_EPS = 0;
}

on timer Timer_EPS_STA_Rs1_AR2
{
	@sysvar::CH_Nodes::CH__STPDU_EPS_STA_Rs1_AR2 = 0;
}

on timer Timer_EPS_TBCSC_EPS_DAC_AR2
{
	@sysvar::CH_Nodes::CH__STPDU_EPS_TBCSC_EPS_DAC_AR2 = 0;
}

on timer Timer_EPS_TBCSC_Rs_EPS_AR2
{
	@sysvar::CH_Nodes::CH__STPDU_EPS_TBCSC_Rs_EPS_AR2 = 0;
}

on timer Timer_EPS_WUDOP_EPS_FR
{
	@sysvar::CH_Nodes::CH__STPDU_EPS_WUDOP_EPS_FR = 0;
}



on sysvar sysvar::CH_Nodes::CH__STPDU_EPS_DTQ_Rs_AR2
{
	long res;
	long tDelay;
	switch (@this)
	{
		case (0):
			res = ResetTimingCyclic("DTQ_Rs_AR2");
			res = ResetTimingEvtTrg("DTQ_Rs_AR2");
			res = EnableTimingCyclic("DTQ_Rs_AR2", 1);
			res = EnableTimingEvtTrg("DTQ_Rs_AR2", 1);
			break;
		case (1):
			tDelay = @sysvar::CH_Nodes::CH__STPDU_T_EPS_DTQ_Rs_AR2;
			if (tDelay > 0)
			{
				if (isTimerActive(Timer_EPS_DTQ_Rs_AR2) == 0)
				{
					res = SetTimingCyclic("DTQ_Rs_AR2", 1, tDelay, 1);
					setTimer (Timer_EPS_DTQ_Rs_AR2, tDelay);
					@sysvar::CH_Nodes::CH__STPDU_EPS_DTQ_Rs_AR2 = 2;
				}
			}
			else if (tDelay == 0)
			{
				if (isTimerActive(Timer_EPS_DTQ_Rs_AR2) == 0)
				{
					res = EnableTimingCyclic("DTQ_Rs_AR2", 0);
					res = EnableTimingEvtTrg("DTQ_Rs_AR2", 0);
				}
			}
			break;
		case (2):
			break;
		default:
			Write("error: wrong parameter (%d)", @this);
			stop();
			break;
	}
}

on sysvar sysvar::CH_Nodes::CH__STPDU_EPS_EPS_Stat_Disp_Rq_AR2
{
	long res;
	long tDelay;
	switch (@this)
	{
		case (0):
			res = ResetTimingCyclic("EPS_Stat_Disp_Rq_AR2");
			res = ResetTimingEvtTrg("EPS_Stat_Disp_Rq_AR2");
			res = EnableTimingCyclic("EPS_Stat_Disp_Rq_AR2", 1);
			res = EnableTimingEvtTrg("EPS_Stat_Disp_Rq_AR2", 1);
			break;
		case (1):
			tDelay = @sysvar::CH_Nodes::CH__STPDU_T_EPS_EPS_Stat_Disp_Rq_AR2;
			if (tDelay > 0)
			{
				if (isTimerActive(Timer_EPS_EPS_Stat_Disp_Rq_AR2) == 0)
				{
					res = SetTimingCyclic("EPS_Stat_Disp_Rq_AR2", 1, tDelay, 1);
					setTimer (Timer_EPS_EPS_Stat_Disp_Rq_AR2, tDelay);
					@sysvar::CH_Nodes::CH__STPDU_EPS_EPS_Stat_Disp_Rq_AR2 = 2;
				}
			}
			else if (tDelay == 0)
			{
				if (isTimerActive(Timer_EPS_EPS_Stat_Disp_Rq_AR2) == 0)
				{
					res = EnableTimingCyclic("EPS_Stat_Disp_Rq_AR2", 0);
					res = EnableTimingEvtTrg("EPS_Stat_Disp_Rq_AR2", 0);
				}
			}
			break;
		case (2):
			break;
		default:
			Write("error: wrong parameter (%d)", @this);
			stop();
			break;
	}
}

on sysvar sysvar::CH_Nodes::CH__STPDU_EPS_PARK_St_Rs_AR2
{
	long res;
	long tDelay;
	switch (@this)
	{
		case (0):
			res = ResetTimingCyclic("PARK_St_Rs_AR2");
			res = ResetTimingEvtTrg("PARK_St_Rs_AR2");
			res = EnableTimingCyclic("PARK_St_Rs_AR2", 1);
			res = EnableTimingEvtTrg("PARK_St_Rs_AR2", 1);
			break;
		case (1):
			tDelay = @sysvar::CH_Nodes::CH__STPDU_T_EPS_PARK_St_Rs_AR2;
			if (tDelay > 0)
			{
				if (isTimerActive(Timer_EPS_PARK_St_Rs_AR2) == 0)
				{
					res = SetTimingCyclic("PARK_St_Rs_AR2", 1, tDelay, 1);
					setTimer (Timer_EPS_PARK_St_Rs_AR2, tDelay);
					@sysvar::CH_Nodes::CH__STPDU_EPS_PARK_St_Rs_AR2 = 2;
				}
			}
			else if (tDelay == 0)
			{
				if (isTimerActive(Timer_EPS_PARK_St_Rs_AR2) == 0)
				{
					res = EnableTimingCyclic("PARK_St_Rs_AR2", 0);
					res = EnableTimingEvtTrg("PARK_St_Rs_AR2", 0);
				}
			}
			break;
		case (2):
			break;
		default:
			Write("error: wrong parameter (%d)", @this);
			stop();
			break;
	}
}

on sysvar sysvar::CH_Nodes::CH__STPDU_EPS_ROE_EPS
{
	long res;
	long tDelay;
	switch (@this)
	{
		case (0):
			res = ResetTimingCyclic("ROE_EPS");
			res = ResetTimingEvtTrg("ROE_EPS");
			res = EnableTimingCyclic("ROE_EPS", 1);
			res = EnableTimingEvtTrg("ROE_EPS", 1);
			break;
		case (1):
			tDelay = @sysvar::CH_Nodes::CH__STPDU_T_EPS_ROE_EPS;
			if (tDelay > 0)
			{
				if (isTimerActive(Timer_EPS_ROE_EPS) == 0)
				{
					res = SetTimingCyclic("ROE_EPS", 1, tDelay, 1);
					setTimer (Timer_EPS_ROE_EPS, tDelay);
					@sysvar::CH_Nodes::CH__STPDU_EPS_ROE_EPS = 2;
				}
			}
			else if (tDelay == 0)
			{
				if (isTimerActive(Timer_EPS_ROE_EPS) == 0)
				{
					res = EnableTimingCyclic("ROE_EPS", 0);
					res = EnableTimingEvtTrg("ROE_EPS", 0);
				}
			}
			break;
		case (2):
			break;
		default:
			Write("error: wrong parameter (%d)", @this);
			stop();
			break;
	}
}

on sysvar sysvar::CH_Nodes::CH__STPDU_EPS_STA_Rs1_AR2
{
	long res;
	long tDelay;
	switch (@this)
	{
		case (0):
			res = ResetTimingCyclic("STA_Rs1_AR2");
			res = ResetTimingEvtTrg("STA_Rs1_AR2");
			res = EnableTimingCyclic("STA_Rs1_AR2", 1);
			res = EnableTimingEvtTrg("STA_Rs1_AR2", 1);
			break;
		case (1):
			tDelay = @sysvar::CH_Nodes::CH__STPDU_T_EPS_STA_Rs1_AR2;
			if (tDelay > 0)
			{
				if (isTimerActive(Timer_EPS_STA_Rs1_AR2) == 0)
				{
					res = SetTimingCyclic("STA_Rs1_AR2", 1, tDelay, 1);
					setTimer (Timer_EPS_STA_Rs1_AR2, tDelay);
					@sysvar::CH_Nodes::CH__STPDU_EPS_STA_Rs1_AR2 = 2;
				}
			}
			else if (tDelay == 0)
			{
				if (isTimerActive(Timer_EPS_STA_Rs1_AR2) == 0)
				{
					res = EnableTimingCyclic("STA_Rs1_AR2", 0);
					res = EnableTimingEvtTrg("STA_Rs1_AR2", 0);
				}
			}
			break;
		case (2):
			break;
		default:
			Write("error: wrong parameter (%d)", @this);
			stop();
			break;
	}
}

on sysvar sysvar::CH_Nodes::CH__STPDU_EPS_TBCSC_EPS_DAC_AR2
{
	long res;
	long tDelay;
	switch (@this)
	{
		case (0):
			res = ResetTimingCyclic("TBCSC_EPS_DAC_AR2");
			res = ResetTimingEvtTrg("TBCSC_EPS_DAC_AR2");
			res = EnableTimingCyclic("TBCSC_EPS_DAC_AR2", 1);
			res = EnableTimingEvtTrg("TBCSC_EPS_DAC_AR2", 1);
			break;
		case (1):
			tDelay = @sysvar::CH_Nodes::CH__STPDU_T_EPS_TBCSC_EPS_DAC_AR2;
			if (tDelay > 0)
			{
				if (isTimerActive(Timer_EPS_TBCSC_EPS_DAC_AR2) == 0)
				{
					res = SetTimingCyclic("TBCSC_EPS_DAC_AR2", 1, tDelay, 1);
					setTimer (Timer_EPS_TBCSC_EPS_DAC_AR2, tDelay);
					@sysvar::CH_Nodes::CH__STPDU_EPS_TBCSC_EPS_DAC_AR2 = 2;
				}
			}
			else if (tDelay == 0)
			{
				if (isTimerActive(Timer_EPS_TBCSC_EPS_DAC_AR2) == 0)
				{
					res = EnableTimingCyclic("TBCSC_EPS_DAC_AR2", 0);
					res = EnableTimingEvtTrg("TBCSC_EPS_DAC_AR2", 0);
				}
			}
			break;
		case (2):
			break;
		default:
			Write("error: wrong parameter (%d)", @this);
			stop();
			break;
	}
}

on sysvar sysvar::CH_Nodes::CH__STPDU_EPS_TBCSC_Rs_EPS_AR2
{
	long res;
	long tDelay;
	switch (@this)
	{
		case (0):
			res = ResetTimingCyclic("TBCSC_Rs_EPS_AR2");
			res = ResetTimingEvtTrg("TBCSC_Rs_EPS_AR2");
			res = EnableTimingCyclic("TBCSC_Rs_EPS_AR2", 1);
			res = EnableTimingEvtTrg("TBCSC_Rs_EPS_AR2", 1);
			break;
		case (1):
			tDelay = @sysvar::CH_Nodes::CH__STPDU_T_EPS_TBCSC_Rs_EPS_AR2;
			if (tDelay > 0)
			{
				if (isTimerActive(Timer_EPS_TBCSC_Rs_EPS_AR2) == 0)
				{
					res = SetTimingCyclic("TBCSC_Rs_EPS_AR2", 1, tDelay, 1);
					setTimer (Timer_EPS_TBCSC_Rs_EPS_AR2, tDelay);
					@sysvar::CH_Nodes::CH__STPDU_EPS_TBCSC_Rs_EPS_AR2 = 2;
				}
			}
			else if (tDelay == 0)
			{
				if (isTimerActive(Timer_EPS_TBCSC_Rs_EPS_AR2) == 0)
				{
					res = EnableTimingCyclic("TBCSC_Rs_EPS_AR2", 0);
					res = EnableTimingEvtTrg("TBCSC_Rs_EPS_AR2", 0);
				}
			}
			break;
		case (2):
			break;
		default:
			Write("error: wrong parameter (%d)", @this);
			stop();
			break;
	}
}

on sysvar sysvar::CH_Nodes::CH__STPDU_EPS_WUDOP_EPS_FR
{
	long res;
	long tDelay;
	switch (@this)
	{
		case (0):
			res = ResetTimingCyclic("WUDOP_EPS_FR");
			res = ResetTimingEvtTrg("WUDOP_EPS_FR");
			res = EnableTimingCyclic("WUDOP_EPS_FR", 1);
			res = EnableTimingEvtTrg("WUDOP_EPS_FR", 1);
			break;
		case (1):
			tDelay = @sysvar::CH_Nodes::CH__STPDU_T_EPS_WUDOP_EPS_FR;
			if (tDelay > 0)
			{
				if (isTimerActive(Timer_EPS_WUDOP_EPS_FR) == 0)
				{
					res = SetTimingCyclic("WUDOP_EPS_FR", 1, tDelay, 1);
					setTimer (Timer_EPS_WUDOP_EPS_FR, tDelay);
					@sysvar::CH_Nodes::CH__STPDU_EPS_WUDOP_EPS_FR = 2;
				}
			}
			else if (tDelay == 0)
			{
				if (isTimerActive(Timer_EPS_WUDOP_EPS_FR) == 0)
				{
					res = EnableTimingCyclic("WUDOP_EPS_FR", 0);
					res = EnableTimingEvtTrg("WUDOP_EPS_FR", 0);
				}
			}
			break;
		case (2):
			break;
		default:
			Write("error: wrong parameter (%d)", @this);
			stop();
			break;
	}
}


on sysvar sysvar::CH_Nodes::CH_EPSDTQ_Rs_AR2_UB_AUTO_01
{
	switch (@sysvar::CH_Nodes::CH_EPSDTQ_Rs_AR2_UB_AUTO_01)
	{
		case (0):
			enableControl("DTQ_Rs_AR2", "CH_EPSDTQ_Rs_AR2_UB__01", 0); //1: enable; 0: disable
			@sysvar::CH_Nodes::CH_EPSDTQ_Rs_AR2_UB__01 = 1;
			break;
		case (1):
			enableControl("DTQ_Rs_AR2", "CH_EPSDTQ_Rs_AR2_UB__01", 1); //1: enable; 0: disable
			break;
		case (2):
			enableControl("DTQ_Rs_AR2", "CH_EPSDTQ_Rs_AR2_UB__01", 0); //1: enable; 0: disable
			@sysvar::CH_Nodes::CH_EPSDTQ_Rs_AR2_UB__01 = 1;
			break;
		case (3):
			enableControl("DTQ_Rs_AR2", "CH_EPSDTQ_Rs_AR2_UB__01", 0); //1: enable; 0: disable
			@sysvar::CH_Nodes::CH_EPSDTQ_Rs_AR2_UB__01 = 0;
			break;
	}
}

on sysvar sysvar::CH_Nodes::CH_EPSCRC_DTQ_Rs_Pr2DTQ_Rs__AUTO
{
//	EnableCRC("DTQ_Rs_AR2",  "DTQ_Rs_Pr2", !@this); // 1 = on, 0 = off 
	enableControl("DTQ_Rs_AR2", "CH_EPSCRC_DTQ_Rs_Pr2DTQ_Rs_AR2_", @this); //1: enable; 0: disable
	CRC_DTQ_Rs_Pr2 = @sysvar::CH_Nodes::CH_EPSCRC_DTQ_Rs_Pr2DTQ_Rs__AUTO;
}

on sysvar sysvar::CH_Nodes::CH_EPSSQC_DTQ_Rs_Pr2DTQ_Rs__AUTO
{
//	EnableSQC("DTQ_Rs_AR2",  "DTQ_Rs_Pr2", !@this); // 1 = on, 0 = off 
	enableControl("DTQ_Rs_AR2", "CH_EPSSQC_DTQ_Rs_Pr2DTQ_Rs_AR2_", @this); //1: enable; 0: disable
	SQC_DTQ_Rs_Pr2 = @sysvar::CH_Nodes::CH_EPSSQC_DTQ_Rs_Pr2DTQ_Rs__AUTO;
}

on sysvar sysvar::CH_Nodes::CH_EPSEPS_Stat_Disp_Rq_A_UB_A_01
{
	switch (@sysvar::CH_Nodes::CH_EPSEPS_Stat_Disp_Rq_A_UB_A_01)
	{
		case (0):
			enableControl("EPS_Stat_Disp_Rq_AR2", "CH_EPSEPS_Stat_Disp_Rq_AR2_UB_01", 0); //1: enable; 0: disable
			@sysvar::CH_Nodes::CH_EPSEPS_Stat_Disp_Rq_AR2_UB_01 = 1;
			break;
		case (1):
			enableControl("EPS_Stat_Disp_Rq_AR2", "CH_EPSEPS_Stat_Disp_Rq_AR2_UB_01", 1); //1: enable; 0: disable
			break;
		case (2):
			enableControl("EPS_Stat_Disp_Rq_AR2", "CH_EPSEPS_Stat_Disp_Rq_AR2_UB_01", 0); //1: enable; 0: disable
			@sysvar::CH_Nodes::CH_EPSEPS_Stat_Disp_Rq_AR2_UB_01 = 1;
			break;
		case (3):
			enableControl("EPS_Stat_Disp_Rq_AR2", "CH_EPSEPS_Stat_Disp_Rq_AR2_UB_01", 0); //1: enable; 0: disable
			@sysvar::CH_Nodes::CH_EPSEPS_Stat_Disp_Rq_AR2_UB_01 = 0;
			break;
	}
}

on sysvar sysvar::CH_Nodes::CH_EPSCRC_EPS_CtrlLmp_Disp__AUTO
{
//	EnableCRC("EPS_Stat_Disp_Rq_AR2",  "EPS_CtrlLmp_Disp_Rq_Pr2", !@this); // 1 = on, 0 = off 
	enableControl("EPS_Stat_Disp_Rq_AR2", "CH_EPSCRC_EPS_CtrlLmp_Disp_Rq_P_", @this); //1: enable; 0: disable
	CRC_EPS_CtrlLmp_Disp_Rq_Pr2 = @sysvar::CH_Nodes::CH_EPSCRC_EPS_CtrlLmp_Disp__AUTO;
}

on sysvar sysvar::CH_Nodes::CH_EPSSQC_EPS_CtrlLmp_Disp__AUTO
{
//	EnableSQC("EPS_Stat_Disp_Rq_AR2",  "EPS_CtrlLmp_Disp_Rq_Pr2", !@this); // 1 = on, 0 = off 
	enableControl("EPS_Stat_Disp_Rq_AR2", "CH_EPSSQC_EPS_CtrlLmp_Disp_Rq_P_", @this); //1: enable; 0: disable
	SQC_EPS_CtrlLmp_Disp_Rq_Pr2 = @sysvar::CH_Nodes::CH_EPSSQC_EPS_CtrlLmp_Disp__AUTO;
}

on sysvar sysvar::CH_Nodes::CH_EPSPARK_St_Rs_AR2_UB_AUTO_01
{
	switch (@sysvar::CH_Nodes::CH_EPSPARK_St_Rs_AR2_UB_AUTO_01)
	{
		case (0):
			enableControl("PARK_St_Rs_AR2", "CH_EPSPARK_St_Rs_AR2_UB__01", 0); //1: enable; 0: disable
			@sysvar::CH_Nodes::CH_EPSPARK_St_Rs_AR2_UB__01 = 1;
			break;
		case (1):
			enableControl("PARK_St_Rs_AR2", "CH_EPSPARK_St_Rs_AR2_UB__01", 1); //1: enable; 0: disable
			break;
		case (2):
			enableControl("PARK_St_Rs_AR2", "CH_EPSPARK_St_Rs_AR2_UB__01", 0); //1: enable; 0: disable
			@sysvar::CH_Nodes::CH_EPSPARK_St_Rs_AR2_UB__01 = 1;
			break;
		case (3):
			enableControl("PARK_St_Rs_AR2", "CH_EPSPARK_St_Rs_AR2_UB__01", 0); //1: enable; 0: disable
			@sysvar::CH_Nodes::CH_EPSPARK_St_Rs_AR2_UB__01 = 0;
			break;
	}
}

on sysvar sysvar::CH_Nodes::CH_EPSCRC_PARK_St_Rs_Pr2PAR_AUTO
{
//	EnableCRC("PARK_St_Rs_AR2",  "PARK_St_Rs_Pr2", !@this); // 1 = on, 0 = off 
	enableControl("PARK_St_Rs_AR2", "CH_EPSCRC_PARK_St_Rs_Pr2PARK_St_", @this); //1: enable; 0: disable
	CRC_PARK_St_Rs_Pr2 = @sysvar::CH_Nodes::CH_EPSCRC_PARK_St_Rs_Pr2PAR_AUTO;
}

on sysvar sysvar::CH_Nodes::CH_EPSSQC_PARK_St_Rs_Pr2PAR_AUTO
{
//	EnableSQC("PARK_St_Rs_AR2",  "PARK_St_Rs_Pr2", !@this); // 1 = on, 0 = off 
	enableControl("PARK_St_Rs_AR2", "CH_EPSSQC_PARK_St_Rs_Pr2PARK_St_", @this); //1: enable; 0: disable
	SQC_PARK_St_Rs_Pr2 = @sysvar::CH_Nodes::CH_EPSSQC_PARK_St_Rs_Pr2PAR_AUTO;
}

on sysvar sysvar::CH_Nodes::CH_EPSSTA_Rs1_AR2_UB_AUTO_01
{
	switch (@sysvar::CH_Nodes::CH_EPSSTA_Rs1_AR2_UB_AUTO_01)
	{
		case (0):
			enableControl("STA_Rs1_AR2", "CH_EPSSTA_Rs1_AR2_UB__01", 0); //1: enable; 0: disable
			@sysvar::CH_Nodes::CH_EPSSTA_Rs1_AR2_UB__01 = 1;
			break;
		case (1):
			enableControl("STA_Rs1_AR2", "CH_EPSSTA_Rs1_AR2_UB__01", 1); //1: enable; 0: disable
			break;
		case (2):
			enableControl("STA_Rs1_AR2", "CH_EPSSTA_Rs1_AR2_UB__01", 0); //1: enable; 0: disable
			@sysvar::CH_Nodes::CH_EPSSTA_Rs1_AR2_UB__01 = 1;
			break;
		case (3):
			enableControl("STA_Rs1_AR2", "CH_EPSSTA_Rs1_AR2_UB__01", 0); //1: enable; 0: disable
			@sysvar::CH_Nodes::CH_EPSSTA_Rs1_AR2_UB__01 = 0;
			break;
	}
}

on sysvar sysvar::CH_Nodes::CH_EPSCRC_STA_Rs1_Pr2STA_Rs_AUTO
{
//	EnableCRC("STA_Rs1_AR2",  "STA_Rs1_Pr2", !@this); // 1 = on, 0 = off 
	enableControl("STA_Rs1_AR2", "CH_EPSCRC_STA_Rs1_Pr2STA_Rs1_AR_", @this); //1: enable; 0: disable
	CRC_STA_Rs1_Pr2 = @sysvar::CH_Nodes::CH_EPSCRC_STA_Rs1_Pr2STA_Rs_AUTO;
}

on sysvar sysvar::CH_Nodes::CH_EPSSQC_STA_Rs1_Pr2STA_Rs_AUTO
{
//	EnableSQC("STA_Rs1_AR2",  "STA_Rs1_Pr2", !@this); // 1 = on, 0 = off 
	enableControl("STA_Rs1_AR2", "CH_EPSSQC_STA_Rs1_Pr2STA_Rs1_AR_", @this); //1: enable; 0: disable
	SQC_STA_Rs1_Pr2 = @sysvar::CH_Nodes::CH_EPSSQC_STA_Rs1_Pr2STA_Rs_AUTO;
}

on sysvar sysvar::CH_Nodes::CH_EPSCRC_TBCSC_Rs_EPS_Pr2T_AUTO
{
//	EnableCRC("TBCSC_Rs_EPS_AR2",  "TBCSC_Rs_EPS_Pr2", !@this); // 1 = on, 0 = off 
	enableControl("TBCSC_Rs_EPS_AR2", "CH_EPSCRC_TBCSC_Rs_EPS_Pr2TBCSC_", @this); //1: enable; 0: disable
	CRC_TBCSC_Rs_EPS_Pr2 = @sysvar::CH_Nodes::CH_EPSCRC_TBCSC_Rs_EPS_Pr2T_AUTO;
}

on sysvar sysvar::CH_Nodes::CH_EPSSQC_TBCSC_Rs_EPS_Pr2T_AUTO
{
//	EnableSQC("TBCSC_Rs_EPS_AR2",  "TBCSC_Rs_EPS_Pr2", !@this); // 1 = on, 0 = off 
	enableControl("TBCSC_Rs_EPS_AR2", "CH_EPSSQC_TBCSC_Rs_EPS_Pr2TBCSC_", @this); //1: enable; 0: disable
	SQC_TBCSC_Rs_EPS_Pr2 = @sysvar::CH_Nodes::CH_EPSSQC_TBCSC_Rs_EPS_Pr2T_AUTO;
}

CH_EPSDTQ_Rs_AR2()
{
	switch (@sysvar::CH_Nodes::CH_EPSDTQ_Rs_AR2_UB_AUTO_01)
	{
		case (0):
			//Updatebit wird mit 1 gesendet; entspricht Standard
			break;
		case (1):
			//nur wenn manueller Wert gleich 0 ist, muss was gemacht werden
			if (@sysvar::CH_Nodes::CH_EPSDTQ_Rs_AR2_UB_AUTO_01 == 0)
				DisturbPDUUB("DTQ_Rs_AR2", 1, 0); //Updatebit wird einmal auf Null gesetzt
			break;
		case (2):
			//Updatebit wird mit 1 gesendet; entspricht Standard
			break;
		case (3):
			DisturbPDUUB("DTQ_Rs_AR2", 1, 0); //Updatebit wird einmal auf Null gesetzt
			break;
	}
}

CH_EPSEPS_Stat_Disp_Rq_AR2()
{
	switch (@sysvar::CH_Nodes::CH_EPSEPS_Stat_Disp_Rq_A_UB_A_01)
	{
		case (0):
			//Updatebit wird mit 1 gesendet; entspricht Standard
			break;
		case (1):
			//nur wenn manueller Wert gleich 0 ist, muss was gemacht werden
			if (@sysvar::CH_Nodes::CH_EPSEPS_Stat_Disp_Rq_A_UB_A_01 == 0)
				DisturbPDUUB("EPS_Stat_Disp_Rq_AR2", 1, 0); //Updatebit wird einmal auf Null gesetzt
			break;
		case (2):
			//Updatebit wird mit 1 gesendet; entspricht Standard
			break;
		case (3):
			DisturbPDUUB("EPS_Stat_Disp_Rq_AR2", 1, 0); //Updatebit wird einmal auf Null gesetzt
			break;
	}
}

CH_EPSPARK_St_Rs_AR2()
{
	switch (@sysvar::CH_Nodes::CH_EPSPARK_St_Rs_AR2_UB_AUTO_01)
	{
		case (0):
			//Updatebit wird mit 1 gesendet; entspricht Standard
			break;
		case (1):
			//nur wenn manueller Wert gleich 0 ist, muss was gemacht werden
			if (@sysvar::CH_Nodes::CH_EPSPARK_St_Rs_AR2_UB_AUTO_01 == 0)
				DisturbPDUUB("PARK_St_Rs_AR2", 1, 0); //Updatebit wird einmal auf Null gesetzt
			break;
		case (2):
			//Updatebit wird mit 1 gesendet; entspricht Standard
			break;
		case (3):
			DisturbPDUUB("PARK_St_Rs_AR2", 1, 0); //Updatebit wird einmal auf Null gesetzt
			break;
	}
}

CH_EPSSTA_Rs1_AR2()
{
	switch (@sysvar::CH_Nodes::CH_EPSSTA_Rs1_AR2_UB_AUTO_01)
	{
		case (0):
			//Updatebit wird mit 1 gesendet; entspricht Standard
			break;
		case (1):
			//nur wenn manueller Wert gleich 0 ist, muss was gemacht werden
			if (@sysvar::CH_Nodes::CH_EPSSTA_Rs1_AR2_UB_AUTO_01 == 0)
				DisturbPDUUB("STA_Rs1_AR2", 1, 0); //Updatebit wird einmal auf Null gesetzt
			break;
		case (2):
			//Updatebit wird mit 1 gesendet; entspricht Standard
			break;
		case (3):
			DisturbPDUUB("STA_Rs1_AR2", 1, 0); //Updatebit wird einmal auf Null gesetzt
			break;
	}
}

void FrILTxPending(char pduName[], long len, byte payload[], long TxAck)
{
	byte crc;
	dword SQC;
	dword MC;
	dword Tgl;
	dword i;

	if (strncmp (pduName, "DTQ_Rs_AR2", strLen(pduName)+strLen("DTQ_Rs_AR2")) == 0)
	{
		if (TxAck == 1)
		{
			if (@sysvar::CH_Nodes::CH_EPSSQC_DTQ_Rs_Pr2DTQ_Rs__AUTO == 0)
			{
				//SQC automatisch ändern
				SQC_VAL_DTQ_Rs_Pr2 = (SQC_VAL_DTQ_Rs_Pr2 + 1) % 16;
			}
			else
			{
				//SQC manuel veränderbar
			}

		}
		else
		{
			if (@sysvar::CH_Nodes::CH_EPSSQC_DTQ_Rs_Pr2DTQ_Rs__AUTO == 0)
			{
				//SQC automatisch ändern
				//SQC für CRC speichern
				CounterValForCRC_DTQ_Rs_Pr2 = SQC_VAL_DTQ_Rs_Pr2;
				//SQC in Byte schreiben
				payload[1] = (payload[1] & ~0x0F) |  SQC_VAL_DTQ_Rs_Pr2;
			}
			else
			{
				//SQC manuel veränderbar
			}

			if (@sysvar::CH_Nodes::CH_EPSCRC_DTQ_Rs_Pr2DTQ_Rs__AUTO == 0)
			{
				//CRC automatisch berechnen
				crc = 0xFF;
				crc = crctableProfTwo[crc ^ payload[1]];
				crc = crctableProfTwo[crc ^ payload[2]];
				crc = crctableProfTwo[crc ^ payload[3]];
				crc = crctableProfTwo[crc ^ payload[4]];
				crc = crctableProfTwo[crc ^ payload[5]];
				crc = crctableProfTwo[crc ^ payload[6]];
				crc = crctableProfTwo[crc ^ payload[7]];
				switch (CounterValForCRC_DTQ_Rs_Pr2)
				{
					case(0) :
						crc = crctableProfTwo[crc ^ 58];
						break;
					case(1) :
						crc = crctableProfTwo[crc ^ 213];
						break;
					case(2) :
						crc = crctableProfTwo[crc ^ 117];
						break;
					case(3) :
						crc = crctableProfTwo[crc ^ 21];
						break;
					case(4) :
						crc = crctableProfTwo[crc ^ 176];
						break;
					case(5) :
						crc = crctableProfTwo[crc ^ 80];
						break;
					case(6) :
						crc = crctableProfTwo[crc ^ 235];
						break;
					case(7) :
						crc = crctableProfTwo[crc ^ 139];
						break;
					case(8) :
						crc = crctableProfTwo[crc ^ 43];
						break;
					case(9) :
						crc = crctableProfTwo[crc ^ 198];
						break;
					case(10) :
						crc = crctableProfTwo[crc ^ 102];
						break;
					case(11) :
						crc = crctableProfTwo[crc ^ 6];
						break;
					case(12) :
						crc = crctableProfTwo[crc ^ 161];
						break;
					case(13) :
						crc = crctableProfTwo[crc ^ 65];
						break;
					case(14) :
						crc = crctableProfTwo[crc ^ 220];
						break;
					case(15) :
						crc = crctableProfTwo[crc ^ 124];
						break;
					default :
//						write("error: wrong parameter (%d)",CounterValForCRC_DTQ_Rs_Pr2); stop();
						break;
				}
				crc = (crc ^ 0xFF);
				payload[0] = crc;
			}
			else
			{
				//CRC manuel veränderbar
			}

			CH_EPSSTA_Rs1_AR2();
			CH_EPSDTQ_Rs_AR2();
		}
	}
	if (strncmp (pduName, "EPS_Stat_Disp_Rq_AR2", strLen(pduName)+strLen("EPS_Stat_Disp_Rq_AR2")) == 0)
	{
		if (TxAck == 1)
		{
			if (@sysvar::CH_Nodes::CH_EPSSQC_EPS_CtrlLmp_Disp__AUTO == 0)
			{
				//SQC automatisch ändern
				SQC_VAL_EPS_CtrlLmp_Disp_Rq_Pr2 = (SQC_VAL_EPS_CtrlLmp_Disp_Rq_Pr2 + 1) % 16;
			}
			else
			{
				//SQC manuel veränderbar
			}

		}
		else
		{
			if (@sysvar::CH_Nodes::CH_EPSSQC_EPS_CtrlLmp_Disp__AUTO == 0)
			{
				//SQC automatisch ändern
				//SQC für CRC speichern
				CounterValForCRC_EPS_CtrlLmp_Disp_Rq_Pr2 = SQC_VAL_EPS_CtrlLmp_Disp_Rq_Pr2;
				//SQC in Byte schreiben
				payload[3] = (payload[3] & ~0x0F) |  SQC_VAL_EPS_CtrlLmp_Disp_Rq_Pr2;
			}
			else
			{
				//SQC manuel veränderbar
			}

			if (@sysvar::CH_Nodes::CH_EPSCRC_EPS_CtrlLmp_Disp__AUTO == 0)
			{
				//CRC automatisch berechnen
				crc = 0xFF;
				crc = crctableProfTwo[crc ^ payload[3]];
				crc = crctableProfTwo[crc ^ payload[4]];
				crc = crctableProfTwo[crc ^ payload[5]];
				switch (CounterValForCRC_EPS_CtrlLmp_Disp_Rq_Pr2)
				{
					case(0) :
						crc = crctableProfTwo[crc ^ 156];
						break;
					case(1) :
						crc = crctableProfTwo[crc ^ 188];
						break;
					case(2) :
						crc = crctableProfTwo[crc ^ 220];
						break;
					case(3) :
						crc = crctableProfTwo[crc ^ 252];
						break;
					case(4) :
						crc = crctableProfTwo[crc ^ 33];
						break;
					case(5) :
						crc = crctableProfTwo[crc ^ 65];
						break;
					case(6) :
						crc = crctableProfTwo[crc ^ 97];
						break;
					case(7) :
						crc = crctableProfTwo[crc ^ 129];
						break;
					case(8) :
						crc = crctableProfTwo[crc ^ 161];
						break;
					case(9) :
						crc = crctableProfTwo[crc ^ 193];
						break;
					case(10) :
						crc = crctableProfTwo[crc ^ 225];
						break;
					case(11) :
						crc = crctableProfTwo[crc ^ 6];
						break;
					case(12) :
						crc = crctableProfTwo[crc ^ 38];
						break;
					case(13) :
						crc = crctableProfTwo[crc ^ 70];
						break;
					case(14) :
						crc = crctableProfTwo[crc ^ 102];
						break;
					case(15) :
						crc = crctableProfTwo[crc ^ 134];
						break;
					default :
//						write("error: wrong parameter (%d)",CounterValForCRC_EPS_CtrlLmp_Disp_Rq_Pr2); stop();
						break;
				}
				crc = (crc ^ 0xFF);
				payload[2] = crc;
			}
			else
			{
				//CRC manuel veränderbar
			}

			CH_EPSPARK_St_Rs_AR2();
			CH_EPSEPS_Stat_Disp_Rq_AR2();
		}
	}
	if (strncmp (pduName, "PARK_St_Rs_AR2", strLen(pduName)+strLen("PARK_St_Rs_AR2")) == 0)
	{
		if (TxAck == 1)
		{
			if (@sysvar::CH_Nodes::CH_EPSSQC_PARK_St_Rs_Pr2PAR_AUTO == 0)
			{
				//SQC automatisch ändern
				SQC_VAL_PARK_St_Rs_Pr2 = (SQC_VAL_PARK_St_Rs_Pr2 + getValue(VSys_SQC_Jump_PARK_St_Rs)) % 16;
			}
			else
			{
				//SQC manuel veränderbar
			}

		}
		else
		{
			if (@sysvar::CH_Nodes::CH_EPSSQC_PARK_St_Rs_Pr2PAR_AUTO == 0)
			{
				//SQC automatisch ändern
				//SQC für CRC speichern
				CounterValForCRC_PARK_St_Rs_Pr2 = SQC_VAL_PARK_St_Rs_Pr2;
				//SQC in Byte schreiben
				payload[1] = (payload[1] & ~0x0F) |  SQC_VAL_PARK_St_Rs_Pr2;
			}
			else
			{
				//SQC manuel veränderbar
			}

			if (@sysvar::CH_Nodes::CH_EPSCRC_PARK_St_Rs_Pr2PAR_AUTO == 0)
			{
				//CRC automatisch berechnen
				crc = 0xFF;
				crc = crctableProfTwo[crc ^ payload[1]];
				crc = crctableProfTwo[crc ^ payload[2]];
				crc = crctableProfTwo[crc ^ payload[3]];
				crc = crctableProfTwo[crc ^ payload[4]];
				crc = crctableProfTwo[crc ^ payload[5]];
				crc = crctableProfTwo[crc ^ payload[6]];
				crc = crctableProfTwo[crc ^ payload[7]];
				switch (CounterValForCRC_PARK_St_Rs_Pr2)
				{
					case(0) :
						crc = crctableProfTwo[crc ^ 241];
						break;
					case(1) :
						crc = crctableProfTwo[crc ^ 227];
						break;
					case(2) :
						crc = crctableProfTwo[crc ^ 213];
						break;
					case(3) :
						crc = crctableProfTwo[crc ^ 199];
						break;
					case(4) :
						crc = crctableProfTwo[crc ^ 185];
						break;
					case(5) :
						crc = crctableProfTwo[crc ^ 171];
						break;
					case(6) :
						crc = crctableProfTwo[crc ^ 157];
						break;
					case(7) :
						crc = crctableProfTwo[crc ^ 143];
						break;
					case(8) :
						crc = crctableProfTwo[crc ^ 129];
						break;
					case(9) :
						crc = crctableProfTwo[crc ^ 115];
						break;
					case(10) :
						crc = crctableProfTwo[crc ^ 101];
						break;
					case(11) :
						crc = crctableProfTwo[crc ^ 87];
						break;
					case(12) :
						crc = crctableProfTwo[crc ^ 73];
						break;
					case(13) :
						crc = crctableProfTwo[crc ^ 59];
						break;
					case(14) :
						crc = crctableProfTwo[crc ^ 45];
						break;
					case(15) :
						crc = crctableProfTwo[crc ^ 31];
						break;
					default :
//						write("error: wrong parameter (%d)",CounterValForCRC_PARK_St_Rs_Pr2); stop();
						break;
				}
				crc = (crc ^ 0xFF);
				payload[0] = crc;
			}
			else
			{
				//CRC manuel veränderbar
			}

			CH_EPSPARK_St_Rs_AR2();
			CH_EPSEPS_Stat_Disp_Rq_AR2();
		}
	}
	if (strncmp (pduName, "ROE_EPS", strLen(pduName)+strLen("ROE_EPS")) == 0)
	{
		if (TxAck == 1)
		{
		}
		else
		{
		}
	}
	if (strncmp (pduName, "STA_Rs1_AR2", strLen(pduName)+strLen("STA_Rs1_AR2")) == 0)
	{
		if (TxAck == 1)
		{
			if (@sysvar::CH_Nodes::CH_EPSSQC_STA_Rs1_Pr2STA_Rs_AUTO == 0)
			{
				//SQC automatisch ändern
				SQC_VAL_STA_Rs1_Pr2 = (SQC_VAL_STA_Rs1_Pr2 + getValue(VSys_SQC_Jump_STA_Rs1_Pr2)) % 16;
			}
			else
			{
				//SQC manuel veränderbar
			}

		}
		else
		{
			if (@sysvar::CH_Nodes::CH_EPSSQC_STA_Rs1_Pr2STA_Rs_AUTO == 0)
			{
				//SQC automatisch ändern
				//SQC für CRC speichern
				CounterValForCRC_STA_Rs1_Pr2 = SQC_VAL_STA_Rs1_Pr2;
				//SQC in Byte schreiben
				payload[1] = (payload[1] & ~0x0F) |  SQC_VAL_STA_Rs1_Pr2;
			}
			else
			{
				//SQC manuel veränderbar
			}

			if (@sysvar::CH_Nodes::CH_EPSCRC_STA_Rs1_Pr2STA_Rs_AUTO == 0)
			{
				//CRC automatisch berechnen
				crc = 0xFF;
				crc = crctableProfTwo[crc ^ payload[1]];
				crc = crctableProfTwo[crc ^ payload[2]];
				crc = crctableProfTwo[crc ^ payload[3]];
				crc = crctableProfTwo[crc ^ payload[4]];
				crc = crctableProfTwo[crc ^ payload[5]];
				crc = crctableProfTwo[crc ^ payload[6]];
				crc = crctableProfTwo[crc ^ payload[7]];
				switch (CounterValForCRC_STA_Rs1_Pr2)
				{
					case(0) :
						crc = crctableProfTwo[crc ^ 38];
						break;
					case(1) :
						crc = crctableProfTwo[crc ^ 40];
						break;
					case(2) :
						crc = crctableProfTwo[crc ^ 42];
						break;
					case(3) :
						crc = crctableProfTwo[crc ^ 44];
						break;
					case(4) :
						crc = crctableProfTwo[crc ^ 46];
						break;
					case(5) :
						crc = crctableProfTwo[crc ^ 48];
						break;
					case(6) :
						crc = crctableProfTwo[crc ^ 50];
						break;
					case(7) :
						crc = crctableProfTwo[crc ^ 52];
						break;
					case(8) :
						crc = crctableProfTwo[crc ^ 54];
						break;
					case(9) :
						crc = crctableProfTwo[crc ^ 56];
						break;
					case(10) :
						crc = crctableProfTwo[crc ^ 58];
						break;
					case(11) :
						crc = crctableProfTwo[crc ^ 60];
						break;
					case(12) :
						crc = crctableProfTwo[crc ^ 62];
						break;
					case(13) :
						crc = crctableProfTwo[crc ^ 64];
						break;
					case(14) :
						crc = crctableProfTwo[crc ^ 66];
						break;
					case(15) :
						crc = crctableProfTwo[crc ^ 68];
						break;
					default :
//						write("error: wrong parameter (%d)",CounterValForCRC_STA_Rs1_Pr2); stop();
						break;
				}
				crc = (crc ^ 0xFF);
				payload[0] = crc;
			}
			else
			{
				//CRC manuel veränderbar
			}

			CH_EPSSTA_Rs1_AR2();
			CH_EPSDTQ_Rs_AR2();
		}
	}
	if (strncmp (pduName, "TBCSC_EPS_DAC_AR2", strLen(pduName)+strLen("TBCSC_EPS_DAC_AR2")) == 0)
	{
		if (TxAck == 1)
		{
		}
		else
		{
		}
	}
	if (strncmp (pduName, "TBCSC_Rs_EPS_AR2", strLen(pduName)+strLen("TBCSC_Rs_EPS_AR2")) == 0)
	{
		if (TxAck == 1)
		{
			if (@sysvar::CH_Nodes::CH_EPSSQC_TBCSC_Rs_EPS_Pr2T_AUTO == 0)
			{
				//SQC automatisch ändern
				SQC_VAL_TBCSC_Rs_EPS_Pr2 = (SQC_VAL_TBCSC_Rs_EPS_Pr2 + 1) % 16;
			}
			else
			{
				//SQC manuel veränderbar
			}

		}
		else
		{
			if (@sysvar::CH_Nodes::CH_EPSSQC_TBCSC_Rs_EPS_Pr2T_AUTO == 0)
			{
				//SQC automatisch ändern
				//SQC für CRC speichern
				CounterValForCRC_TBCSC_Rs_EPS_Pr2 = SQC_VAL_TBCSC_Rs_EPS_Pr2;
				//SQC in Byte schreiben
				payload[1] = (payload[1] & ~0x0F) |  SQC_VAL_TBCSC_Rs_EPS_Pr2;
			}
			else
			{
				//SQC manuel veränderbar
			}

			if (@sysvar::CH_Nodes::CH_EPSCRC_TBCSC_Rs_EPS_Pr2T_AUTO == 0)
			{
				//CRC automatisch berechnen
				crc = 0xFF;
				crc = crctableProfTwo[crc ^ payload[1]];
				crc = crctableProfTwo[crc ^ payload[2]];
				crc = crctableProfTwo[crc ^ payload[3]];
				crc = crctableProfTwo[crc ^ payload[4]];
				crc = crctableProfTwo[crc ^ payload[5]];
				crc = crctableProfTwo[crc ^ payload[6]];
				crc = crctableProfTwo[crc ^ payload[7]];
				switch (CounterValForCRC_TBCSC_Rs_EPS_Pr2)
				{
					case(0) :
						crc = crctableProfTwo[crc ^ 191];
						break;
					case(1) :
						crc = crctableProfTwo[crc ^ 150];
						break;
					case(2) :
						crc = crctableProfTwo[crc ^ 109];
						break;
					case(3) :
						crc = crctableProfTwo[crc ^ 68];
						break;
					case(4) :
						crc = crctableProfTwo[crc ^ 27];
						break;
					case(5) :
						crc = crctableProfTwo[crc ^ 237];
						break;
					case(6) :
						crc = crctableProfTwo[crc ^ 196];
						break;
					case(7) :
						crc = crctableProfTwo[crc ^ 155];
						break;
					case(8) :
						crc = crctableProfTwo[crc ^ 114];
						break;
					case(9) :
						crc = crctableProfTwo[crc ^ 73];
						break;
					case(10) :
						crc = crctableProfTwo[crc ^ 32];
						break;
					case(11) :
						crc = crctableProfTwo[crc ^ 242];
						break;
					case(12) :
						crc = crctableProfTwo[crc ^ 201];
						break;
					case(13) :
						crc = crctableProfTwo[crc ^ 160];
						break;
					case(14) :
						crc = crctableProfTwo[crc ^ 119];
						break;
					case(15) :
						crc = crctableProfTwo[crc ^ 78];
						break;
					default :
//						write("error: wrong parameter (%d)",CounterValForCRC_TBCSC_Rs_EPS_Pr2); stop();
						break;
				}
				crc = (crc ^ 0xFF);
				payload[0] = crc;
			}
			else
			{
				//CRC manuel veränderbar
			}

		}
	}
	if (strncmp (pduName, "WUDOP_EPS_FR", strLen(pduName)+strLen("WUDOP_EPS_FR")) == 0)
	{
		if (TxAck == 1)
		{
		}
		else
		{
		}
	}
}

StartSim(int BusAktiv)
{
	result = EnableCRC("", 0); // 1 = on, 0 = off
	result = EnableTGL("", 0); // 1 = on, 0 = off 
	result = EnableSQC("", 0); // 1 = on, 0 = off 
	result = EnableMC("", 0); // 1 = on, 0 = off 
	switch (@sysvar::CH_Nodes::CH_EPSDTQ_Rs_AR2_UB_AUTO_01)
	{
		case (0):
			enableControl("DTQ_Rs_AR2", "CH_EPSDTQ_Rs_AR2_UB__01", 0); //1: enable; 0: disable
			@sysvar::CH_Nodes::CH_EPSDTQ_Rs_AR2_UB__01 = 1;
			break;
		case (1):
			enableControl("DTQ_Rs_AR2", "CH_EPSDTQ_Rs_AR2_UB__01", 1); //1: enable; 0: disable
			break;
		case (2):
			enableControl("DTQ_Rs_AR2", "CH_EPSDTQ_Rs_AR2_UB__01", 0); //1: enable; 0: disable
			@sysvar::CH_Nodes::CH_EPSDTQ_Rs_AR2_UB__01 = 1;
			break;
		case (3):
			enableControl("DTQ_Rs_AR2", "CH_EPSDTQ_Rs_AR2_UB__01", 0); //1: enable; 0: disable
			@sysvar::CH_Nodes::CH_EPSDTQ_Rs_AR2_UB__01 = 0;
			break;
	}

	CRC_DTQ_Rs_Pr2 = 0;
	SQC_VAL_DTQ_Rs_Pr2 = 0;
	SQC_DTQ_Rs_Pr2 = 0;
	switch (@sysvar::CH_Nodes::CH_EPSEPS_Stat_Disp_Rq_A_UB_A_01)
	{
		case (0):
			enableControl("EPS_Stat_Disp_Rq_AR2", "CH_EPSEPS_Stat_Disp_Rq_AR2_UB_01", 0); //1: enable; 0: disable
			@sysvar::CH_Nodes::CH_EPSEPS_Stat_Disp_Rq_AR2_UB_01 = 1;
			break;
		case (1):
			enableControl("EPS_Stat_Disp_Rq_AR2", "CH_EPSEPS_Stat_Disp_Rq_AR2_UB_01", 1); //1: enable; 0: disable
			break;
		case (2):
			enableControl("EPS_Stat_Disp_Rq_AR2", "CH_EPSEPS_Stat_Disp_Rq_AR2_UB_01", 0); //1: enable; 0: disable
			@sysvar::CH_Nodes::CH_EPSEPS_Stat_Disp_Rq_AR2_UB_01 = 1;
			break;
		case (3):
			enableControl("EPS_Stat_Disp_Rq_AR2", "CH_EPSEPS_Stat_Disp_Rq_AR2_UB_01", 0); //1: enable; 0: disable
			@sysvar::CH_Nodes::CH_EPSEPS_Stat_Disp_Rq_AR2_UB_01 = 0;
			break;
	}

	CRC_EPS_CtrlLmp_Disp_Rq_Pr2 = 0;
	SQC_VAL_EPS_CtrlLmp_Disp_Rq_Pr2 = 0;
	SQC_EPS_CtrlLmp_Disp_Rq_Pr2 = 0;
	switch (@sysvar::CH_Nodes::CH_EPSPARK_St_Rs_AR2_UB_AUTO_01)
	{
		case (0):
			enableControl("PARK_St_Rs_AR2", "CH_EPSPARK_St_Rs_AR2_UB__01", 0); //1: enable; 0: disable
			@sysvar::CH_Nodes::CH_EPSPARK_St_Rs_AR2_UB__01 = 1;
			break;
		case (1):
			enableControl("PARK_St_Rs_AR2", "CH_EPSPARK_St_Rs_AR2_UB__01", 1); //1: enable; 0: disable
			break;
		case (2):
			enableControl("PARK_St_Rs_AR2", "CH_EPSPARK_St_Rs_AR2_UB__01", 0); //1: enable; 0: disable
			@sysvar::CH_Nodes::CH_EPSPARK_St_Rs_AR2_UB__01 = 1;
			break;
		case (3):
			enableControl("PARK_St_Rs_AR2", "CH_EPSPARK_St_Rs_AR2_UB__01", 0); //1: enable; 0: disable
			@sysvar::CH_Nodes::CH_EPSPARK_St_Rs_AR2_UB__01 = 0;
			break;
	}

	CRC_PARK_St_Rs_Pr2 = 0;
	SQC_VAL_PARK_St_Rs_Pr2 = 0;
	SQC_PARK_St_Rs_Pr2 = 0;
	switch (@sysvar::CH_Nodes::CH_EPSSTA_Rs1_AR2_UB_AUTO_01)
	{
		case (0):
			enableControl("STA_Rs1_AR2", "CH_EPSSTA_Rs1_AR2_UB__01", 0); //1: enable; 0: disable
			@sysvar::CH_Nodes::CH_EPSSTA_Rs1_AR2_UB__01 = 1;
			break;
		case (1):
			enableControl("STA_Rs1_AR2", "CH_EPSSTA_Rs1_AR2_UB__01", 1); //1: enable; 0: disable
			break;
		case (2):
			enableControl("STA_Rs1_AR2", "CH_EPSSTA_Rs1_AR2_UB__01", 0); //1: enable; 0: disable
			@sysvar::CH_Nodes::CH_EPSSTA_Rs1_AR2_UB__01 = 1;
			break;
		case (3):
			enableControl("STA_Rs1_AR2", "CH_EPSSTA_Rs1_AR2_UB__01", 0); //1: enable; 0: disable
			@sysvar::CH_Nodes::CH_EPSSTA_Rs1_AR2_UB__01 = 0;
			break;
	}

	CRC_STA_Rs1_Pr2 = 0;
	SQC_VAL_STA_Rs1_Pr2 = 0;
	SQC_STA_Rs1_Pr2 = 0;
	CRC_TBCSC_Rs_EPS_Pr2 = 0;
	SQC_VAL_TBCSC_Rs_EPS_Pr2 = 0;
	SQC_TBCSC_Rs_EPS_Pr2 = 0;
}

StopSim()
{
}

on frPDU MsgChannel1.CHASSIS::DTQ_Rs_AR2
{
}

on frPDU MsgChannel1.CHASSIS::EPS_Stat_Disp_Rq_AR2
{
}

on frPDU MsgChannel1.CHASSIS::PARK_St_Rs_AR2
{
}

on frPDU MsgChannel1.CHASSIS::ROE_EPS
{
}

on frPDU MsgChannel1.CHASSIS::STA_Rs1_AR2
{
}

on frPDU MsgChannel1.CHASSIS::TBCSC_EPS_DAC_AR2
{
}

on frPDU MsgChannel1.CHASSIS::TBCSC_Rs_EPS_AR2
{
}

on frPDU MsgChannel1.CHASSIS::WUDOP_EPS_FR
{
}

