/*@@includes:*/
includes
{
	#include "ASR_FR_NM_IL.CIN"
}
/*@@end*/

/*@@var:*/
/*
|==========================================================================================|
|                                                                                          |
|                                                                                          |
|                                         COPYRIGHT                                        |
|                                                                                          |
|                   Copyright (c) by Daimler AG Abt. RD/EEV 2015                           |
|                                                                                          |
|                                                                                          |
|==========================================================================================|
|                                                                                          |
|                                   CAPL AUTHOR IDENTITY                                   |
|                                   --------------------                                   |
|                                                                                          |
| Initials   | Name                 | Company                                              |
| -----------+----------------------+----------------------------------------------------- |
| BH         | Björn Haßelkus       | Firma TZM (EXTERN im Auftrag der Daimler AG)         |
| RS         | Rainer Schulte       | Firma TZM (EXTERN im Auftrag der Daimler AG)         |
|            |                      |                                                      |
|                                                                                          |
|==========================================================================================|
|                                                                                          |
|                                     REVISION HISTORY                                     |
|                                     ----------------                                     |
|                                                                                          |
| Date       | Ver   | Author       | Description                                          |
| -----------+-------+--------------+----------------------------------------------------- |
| 27.04.15   | 1.0   | RS           | creation                                             |
|            |       |              |                                                      |
|                                                                                          |
|------------------------------------------------------------------------------------------|
*/

variables
{
	long ret_Register;
	// global variable for getting (showing) results auf dll-Functions
	long result;

	int CRC_Eng_Rq_ABC_Pr2;
	dword CounterValForCRC_Eng_Rq_ABC_Pr2;
	int SQC_VAL_Eng_Rq_ABC_Pr2;
	int SQC_Eng_Rq_ABC_Pr2;
	int CRC_SPC_Msg_Rq_Pr2;
	dword CounterValForCRC_SPC_Msg_Rq_Pr2;
	int SQC_VAL_SPC_Msg_Rq_Pr2;
	int SQC_SPC_Msg_Rq_Pr2;
	int CRC_VehLvl_Stat_Pr2;
	dword CounterValForCRC_VehLvl_Stat_Pr2;
	int SQC_VAL_VehLvl_Stat_Pr2;
	int SQC_VehLvl_Stat_Pr2;

	msTimer Timer_SPC_Eng_Rq_ABC_AR2;
	msTimer Timer_SPC_OffRoad_Disp_Rq_AR;
	msTimer Timer_SPC_Preview_Data_SPC_AR;
	msTimer Timer_SPC_ROE_MPU_FL;
	msTimer Timer_SPC_ROE_MPU_FR;
	msTimer Timer_SPC_ROE_MPU_RL;
	msTimer Timer_SPC_ROE_MPU_RR;
	msTimer Timer_SPC_ROE_SPC;
	msTimer Timer_SPC_SPC_Disp_Rq_AR;
	msTimer Timer_SPC_SPC_SwLED_Msg_Rq_AR2;
	msTimer Timer_SPC_SpringVlv_Rq_AR;
	msTimer Timer_SPC_VehCarv_Stat_AR;
	msTimer Timer_SPC_VehLvl_Stat_AR2;

   byte  crctable[256] = {
      0x00, 0x1D, 0x3A, 0x27, 0x74, 0x69, 0x4E, 0x53,
      0xE8, 0xF5, 0xD2, 0xCF, 0x9C, 0x81, 0xA6, 0xBB,
      0xCD, 0xD0, 0xF7, 0xEA, 0xB9, 0xA4, 0x83, 0x9E,
      0x25, 0x38, 0x1F, 0x02, 0x51, 0x4C, 0x6B, 0x76,
      0x87, 0x9A, 0xBD, 0xA0, 0xF3, 0xEE, 0xC9, 0xD4,
      0x6F, 0x72, 0x55, 0x48, 0x1B, 0x06, 0x21, 0x3C,
      0x4A, 0x57, 0x70, 0x6D, 0x3E, 0x23, 0x04, 0x19,
      0xA2, 0xBF, 0x98, 0x85, 0xD6, 0xCB, 0xEC, 0xF1,
      0x13, 0x0E, 0x29, 0x34, 0x67, 0x7A, 0x5D, 0x40,
      0xFB, 0xE6, 0xC1, 0xDC, 0x8F, 0x92, 0xB5, 0xA8,
      0xDE, 0xC3, 0xE4, 0xF9, 0xAA, 0xB7, 0x90, 0x8D,
      0x36, 0x2B, 0x0C, 0x11, 0x42, 0x5F, 0x78, 0x65,
      0x94, 0x89, 0xAE, 0xB3, 0xE0, 0xFD, 0xDA, 0xC7,
      0x7C, 0x61, 0x46, 0x5B, 0x08, 0x15, 0x32, 0x2F,
      0x59, 0x44, 0x63, 0x7E, 0x2D, 0x30, 0x17, 0x0A,
      0xB1, 0xAC, 0x8B, 0x96, 0xC5, 0xD8, 0xFF, 0xE2,
      0x26, 0x3B, 0x1C, 0x01, 0x52, 0x4F, 0x68, 0x75,
      0xCE, 0xD3, 0xF4, 0xE9, 0xBA, 0xA7, 0x80, 0x9D,
      0xEB, 0xF6, 0xD1, 0xCC, 0x9F, 0x82, 0xA5, 0xB8,
      0x03, 0x1E, 0x39, 0x24, 0x77, 0x6A, 0x4D, 0x50,
      0xA1, 0xBC, 0x9B, 0x86, 0xD5, 0xC8, 0xEF, 0xF2,
      0x49, 0x54, 0x73, 0x6E, 0x3D, 0x20, 0x07, 0x1A,
      0x6C, 0x71, 0x56, 0x4B, 0x18, 0x05, 0x22, 0x3F,
      0x84, 0x99, 0xBE, 0xA3, 0xF0, 0xED, 0xCA, 0xD7,
      0x35, 0x28, 0x0F, 0x12, 0x41, 0x5C, 0x7B, 0x66,
      0xDD, 0xC0, 0xE7, 0xFA, 0xA9, 0xB4, 0x93, 0x8E,
      0xF8, 0xE5, 0xC2, 0xDF, 0x8C, 0x91, 0xB6, 0xAB,
      0x10, 0x0D, 0x2A, 0x37, 0x64, 0x79, 0x5E, 0x43,
      0xB2, 0xAF, 0x88, 0x95, 0xC6, 0xDB, 0xFC, 0xE1,
      0x5A, 0x47, 0x60, 0x7D, 0x2E, 0x33, 0x14, 0x09,
      0x7F, 0x62, 0x45, 0x58, 0x0B, 0x16, 0x31, 0x2C,
      0x97, 0x8A, 0xAD, 0xB0, 0xE3, 0xFE, 0xD9, 0xC4
   };

   byte  crctableProfTwo[256] = {
			0x00, 0x2F, 0x5E, 0x71, 0xBC, 0x93, 0xE2, 0xCD,
			0x57, 0x78, 0x09, 0x26, 0xEB, 0xC4, 0xB5, 0x9A,
			0xAE, 0x81, 0xF0, 0xDF, 0x12, 0x3D, 0x4C, 0x63,
			0xF9, 0xD6, 0xA7, 0x88, 0x45, 0x6A, 0x1B, 0x34,
			0x73, 0x5C, 0x2D, 0x02, 0xCF, 0xE0, 0x91, 0xBE,
			0x24, 0x0B, 0x7A, 0x55, 0x98, 0xB7, 0xC6, 0xE9,
			0xDD, 0xF2, 0x83, 0xAC, 0x61, 0x4E, 0x3F, 0x10,
			0x8A, 0xA5, 0xD4, 0xFB, 0x36, 0x19, 0x68, 0x47,
			0xE6, 0xC9, 0xB8, 0x97, 0x5A, 0x75, 0x04, 0x2B,
			0xB1, 0x9E, 0xEF, 0xC0, 0x0D, 0x22, 0x53, 0x7C,
			0x48, 0x67, 0x16, 0x39, 0xF4, 0xDB, 0xAA, 0x85,
			0x1F, 0x30, 0x41, 0x6E, 0xA3, 0x8C, 0xFD, 0xD2,
			0x95, 0xBA, 0xCB, 0xE4, 0x29, 0x06, 0x77, 0x58,
			0xC2, 0xED, 0x9C, 0xB3, 0x7E, 0x51, 0x20, 0x0F,
			0x3B, 0x14, 0x65, 0x4A, 0x87, 0xA8, 0xD9, 0xF6,
			0x6C, 0x43, 0x32, 0x1D, 0xD0, 0xFF, 0x8E, 0xA1,
			0xE3, 0xCC, 0xBD, 0x92, 0x5F, 0x70, 0x01, 0x2E,
			0xB4, 0x9B, 0xEA, 0xC5, 0x08, 0x27, 0x56, 0x79,
			0x4D, 0x62, 0x13, 0x3C, 0xF1, 0xDE, 0xAF, 0x80,
			0x1A, 0x35, 0x44, 0x6B, 0xA6, 0x89, 0xF8, 0xD7,
			0x90, 0xBF, 0xCE, 0xE1, 0x2C, 0x03, 0x72, 0x5D,
			0xC7, 0xE8, 0x99, 0xB6, 0x7B, 0x54, 0x25, 0x0A,
			0x3E, 0x11, 0x60, 0x4F, 0x82, 0xAD, 0xDC, 0xF3,
			0x69, 0x46, 0x37, 0x18, 0xD5, 0xFA, 0x8B, 0xA4,
			0x05, 0x2A, 0x5B, 0x74, 0xB9, 0x96, 0xE7, 0xC8,
			0x52, 0x7D, 0x0C, 0x23, 0xEE, 0xC1, 0xB0, 0x9F,
			0xAB, 0x84, 0xF5, 0xDA, 0x17, 0x38, 0x49, 0x66,
			0xFC, 0xD3, 0xA2, 0x8D, 0x40, 0x6F, 0x1E, 0x31,
			0x76, 0x59, 0x28, 0x07, 0xCA, 0xE5, 0x94, 0xBB,
			0x21, 0x0E, 0x7F, 0x50, 0x9D, 0xB2, 0xC3, 0xEC,
			0xD8, 0xF7, 0x86, 0xA9, 0x64, 0x4B, 0x3A, 0x15,
			0x8F, 0xA0, 0xD1, 0xFE, 0x33, 0x1C, 0x6D, 0x42
   };
}
/*@@end*/

/*@@startStart:Start:*/
on start
{
	result = EnableCRC("", 0); // 1 = on, 0 = off
	result = EnableTGL("", 0); // 1 = on, 0 = off 
	result = EnableSQC("", 0); // 1 = on, 0 = off 
	result = EnableMC("", 0); // 1 = on, 0 = off 

	if (@sysvar::CH_Nodes::CH_SPCCRC_Eng_Rq_ABC_Pr2Eng_AUTO == 0)
	{
		//Automatisch
		enableControl("Eng_Rq_ABC_AR2", "CH_SPCCRC_Eng_Rq_ABC_Pr2Eng_Rq__", 0); //1: enable; 0: disable
	}
	else
	{
		//Manuel
		enableControl("Eng_Rq_ABC_AR2", "CH_SPCCRC_Eng_Rq_ABC_Pr2Eng_Rq__", 1); //1: enable; 0: disable
	}
	if (@sysvar::CH_Nodes::CH_SPCSQC_Eng_Rq_ABC_Pr2Eng_AUTO == 0)
	{
		//Automatisch
		enableControl("Eng_Rq_ABC_AR2", "CH_SPCSQC_Eng_Rq_ABC_Pr2Eng_Rq__", 0); //1: enable; 0: disable
	}
	else
	{
		//Manuel
		enableControl("Eng_Rq_ABC_AR2", "CH_SPCSQC_Eng_Rq_ABC_Pr2Eng_Rq__", 1); //1: enable; 0: disable
	}
	@sysvar::CH_Nodes::CH__PDURECEIPT_SIM_SPC_Eng_Rq_ABC_AR2 = 1;
	@sysvar::CH_Nodes::CH__PDURECEIPT_SIM_SPC_OffRoad_Disp_Rq_AR = 1;
	@sysvar::CH_Nodes::CH__PDURECEIPT_SIM_SPC_Preview_Data_SPC_AR = 1;
	@sysvar::CH_Nodes::CH__PDURECEIPT_SIM_SPC_ROE_MPU_FL = 1;
	@sysvar::CH_Nodes::CH__PDURECEIPT_SIM_SPC_ROE_MPU_FR = 1;
	@sysvar::CH_Nodes::CH__PDURECEIPT_SIM_SPC_ROE_MPU_RL = 1;
	@sysvar::CH_Nodes::CH__PDURECEIPT_SIM_SPC_ROE_MPU_RR = 1;
	@sysvar::CH_Nodes::CH__PDURECEIPT_SIM_SPC_ROE_SPC = 1;
	@sysvar::CH_Nodes::CH__PDURECEIPT_SIM_SPC_SPC_Disp_Rq_AR = 1;
	if (@sysvar::CH_Nodes::CH_SPCCRC_SPC_Msg_Rq_Pr2SPC_AUTO == 0)
	{
		//Automatisch
		enableControl("SPC_SwLED_Msg_Rq_AR2", "CH_SPCCRC_SPC_Msg_Rq_Pr2SPC_SwL_", 0); //1: enable; 0: disable
	}
	else
	{
		//Manuel
		enableControl("SPC_SwLED_Msg_Rq_AR2", "CH_SPCCRC_SPC_Msg_Rq_Pr2SPC_SwL_", 1); //1: enable; 0: disable
	}
	if (@sysvar::CH_Nodes::CH_SPCSQC_SPC_Msg_Rq_Pr2SPC_AUTO == 0)
	{
		//Automatisch
		enableControl("SPC_SwLED_Msg_Rq_AR2", "CH_SPCSQC_SPC_Msg_Rq_Pr2SPC_SwL_", 0); //1: enable; 0: disable
	}
	else
	{
		//Manuel
		enableControl("SPC_SwLED_Msg_Rq_AR2", "CH_SPCSQC_SPC_Msg_Rq_Pr2SPC_SwL_", 1); //1: enable; 0: disable
	}
	@sysvar::CH_Nodes::CH__PDURECEIPT_SIM_SPC_SPC_SwLED_Msg_Rq_AR2 = 1;
	@sysvar::CH_Nodes::CH__PDURECEIPT_SIM_SPC_SpringVlv_Rq_AR = 1;
	@sysvar::CH_Nodes::CH__PDURECEIPT_SIM_SPC_VehCarv_Stat_AR = 1;
	if (@sysvar::CH_Nodes::CH_SPCCRC_VehLvl_Stat_Pr2Ve_AUTO == 0)
	{
		//Automatisch
		enableControl("VehLvl_Stat_AR2", "CH_SPCCRC_VehLvl_Stat_Pr2VehLvl_", 0); //1: enable; 0: disable
	}
	else
	{
		//Manuel
		enableControl("VehLvl_Stat_AR2", "CH_SPCCRC_VehLvl_Stat_Pr2VehLvl_", 1); //1: enable; 0: disable
	}
	if (@sysvar::CH_Nodes::CH_SPCSQC_VehLvl_Stat_Pr2Ve_AUTO == 0)
	{
		//Automatisch
		enableControl("VehLvl_Stat_AR2", "CH_SPCSQC_VehLvl_Stat_Pr2VehLvl_", 0); //1: enable; 0: disable
	}
	else
	{
		//Manuel
		enableControl("VehLvl_Stat_AR2", "CH_SPCSQC_VehLvl_Stat_Pr2VehLvl_", 1); //1: enable; 0: disable
	}
	@sysvar::CH_Nodes::CH__PDURECEIPT_SIM_SPC_VehLvl_Stat_AR2 = 1;
	// netzwerk management

	enableControl("CHASSIS_FR Netzmanagement", "CH__NMActive_SPC", 1);
}
/*@@end*/

/*@@preStart:PreStart:*/
on preStart
{


}
/*@@end*/

/*@@timer:Timer_SPC_Eng_Rq_ABC_AR2:*/
on timer Timer_SPC_Eng_Rq_ABC_AR2
{
	@sysvar::CH_Nodes::CH__STPDU_SPC_Eng_Rq_ABC_AR2 = 0;
}
/*@@end*/

/*@@timer:Timer_SPC_OffRoad_Disp_Rq_AR:*/
on timer Timer_SPC_OffRoad_Disp_Rq_AR
{
	@sysvar::CH_Nodes::CH__STPDU_SPC_OffRoad_Disp_Rq_AR = 0;
}
/*@@end*/

/*@@timer:Timer_SPC_Preview_Data_SPC_AR:*/
on timer Timer_SPC_Preview_Data_SPC_AR
{
	@sysvar::CH_Nodes::CH__STPDU_SPC_Preview_Data_SPC_AR = 0;
}
/*@@end*/

/*@@timer:Timer_SPC_ROE_MPU_FL:*/
on timer Timer_SPC_ROE_MPU_FL
{
	@sysvar::CH_Nodes::CH__STPDU_SPC_ROE_MPU_FL = 0;
}
/*@@end*/

/*@@timer:Timer_SPC_ROE_MPU_FR:*/
on timer Timer_SPC_ROE_MPU_FR
{
	@sysvar::CH_Nodes::CH__STPDU_SPC_ROE_MPU_FR = 0;
}
/*@@end*/

/*@@timer:Timer_SPC_ROE_MPU_RL:*/
on timer Timer_SPC_ROE_MPU_RL
{
	@sysvar::CH_Nodes::CH__STPDU_SPC_ROE_MPU_RL = 0;
}
/*@@end*/

/*@@timer:Timer_SPC_ROE_MPU_RR:*/
on timer Timer_SPC_ROE_MPU_RR
{
	@sysvar::CH_Nodes::CH__STPDU_SPC_ROE_MPU_RR = 0;
}
/*@@end*/

/*@@timer:Timer_SPC_ROE_SPC:*/
on timer Timer_SPC_ROE_SPC
{
	@sysvar::CH_Nodes::CH__STPDU_SPC_ROE_SPC = 0;
}
/*@@end*/

/*@@timer:Timer_SPC_SPC_Disp_Rq_AR:*/
on timer Timer_SPC_SPC_Disp_Rq_AR
{
	@sysvar::CH_Nodes::CH__STPDU_SPC_SPC_Disp_Rq_AR = 0;
}
/*@@end*/

/*@@timer:Timer_SPC_SPC_SwLED_Msg_Rq_AR2:*/
on timer Timer_SPC_SPC_SwLED_Msg_Rq_AR2
{
	@sysvar::CH_Nodes::CH__STPDU_SPC_SPC_SwLED_Msg_Rq_AR2 = 0;
}
/*@@end*/

/*@@timer:Timer_SPC_SpringVlv_Rq_AR:*/
on timer Timer_SPC_SpringVlv_Rq_AR
{
	@sysvar::CH_Nodes::CH__STPDU_SPC_SpringVlv_Rq_AR = 0;
}
/*@@end*/

/*@@timer:Timer_SPC_VehCarv_Stat_AR:*/
on timer Timer_SPC_VehCarv_Stat_AR
{
	@sysvar::CH_Nodes::CH__STPDU_SPC_VehCarv_Stat_AR = 0;
}
/*@@end*/

/*@@timer:Timer_SPC_VehLvl_Stat_AR2:*/
on timer Timer_SPC_VehLvl_Stat_AR2
{
	@sysvar::CH_Nodes::CH__STPDU_SPC_VehLvl_Stat_AR2 = 0;
}
/*@@end*/



/*@@sysvarChange:CH_Nodes::CH__STPDU_SPC_Eng_Rq_ABC_AR2:*/
on sysvar sysvar::CH_Nodes::CH__STPDU_SPC_Eng_Rq_ABC_AR2
{
	long res;
	long tDelay;
	switch (@this)
	{
		case (0):
			res = ResetTimingCyclic("Eng_Rq_ABC_AR2");
			res = ResetTimingEvtTrg("Eng_Rq_ABC_AR2");
			res = EnableTimingCyclic("Eng_Rq_ABC_AR2", 1);
			res = EnableTimingEvtTrg("Eng_Rq_ABC_AR2", 1);
			break;
		case (1):
			tDelay = @sysvar::CH_Nodes::CH__STPDU_T_SPC_Eng_Rq_ABC_AR2;
			if (tDelay > 0)
			{
				if (isTimerActive(Timer_SPC_Eng_Rq_ABC_AR2) == 0)
				{
					res = SetTimingCyclic("Eng_Rq_ABC_AR2", 1, tDelay, 1);
					setTimer (Timer_SPC_Eng_Rq_ABC_AR2, tDelay);
					@sysvar::CH_Nodes::CH__STPDU_SPC_Eng_Rq_ABC_AR2 = 2;
				}
			}
			else if (tDelay == 0)
			{
				if (isTimerActive(Timer_SPC_Eng_Rq_ABC_AR2) == 0)
				{
					res = EnableTimingCyclic("Eng_Rq_ABC_AR2", 0);
					res = EnableTimingEvtTrg("Eng_Rq_ABC_AR2", 0);
				}
			}
			break;
		case (2):
			break;
		default:
			Write("error: wrong parameter (%d)", @this);
			stop();
			break;
	}
}
/*@@end*/

/*@@sysvarChange:CH_Nodes::CH__STPDU_SPC_OffRoad_Disp_Rq_AR:*/
on sysvar sysvar::CH_Nodes::CH__STPDU_SPC_OffRoad_Disp_Rq_AR
{
	long res;
	long tDelay;
	switch (@this)
	{
		case (0):
			res = ResetTimingCyclic("OffRoad_Disp_Rq_AR");
			res = ResetTimingEvtTrg("OffRoad_Disp_Rq_AR");
			res = EnableTimingCyclic("OffRoad_Disp_Rq_AR", 1);
			res = EnableTimingEvtTrg("OffRoad_Disp_Rq_AR", 1);
			break;
		case (1):
			tDelay = @sysvar::CH_Nodes::CH__STPDU_T_SPC_OffRoad_Disp_Rq_AR;
			if (tDelay > 0)
			{
				if (isTimerActive(Timer_SPC_OffRoad_Disp_Rq_AR) == 0)
				{
					res = SetTimingCyclic("OffRoad_Disp_Rq_AR", 1, tDelay, 1);
					setTimer (Timer_SPC_OffRoad_Disp_Rq_AR, tDelay);
					@sysvar::CH_Nodes::CH__STPDU_SPC_OffRoad_Disp_Rq_AR = 2;
				}
			}
			else if (tDelay == 0)
			{
				if (isTimerActive(Timer_SPC_OffRoad_Disp_Rq_AR) == 0)
				{
					res = EnableTimingCyclic("OffRoad_Disp_Rq_AR", 0);
					res = EnableTimingEvtTrg("OffRoad_Disp_Rq_AR", 0);
				}
			}
			break;
		case (2):
			break;
		default:
			Write("error: wrong parameter (%d)", @this);
			stop();
			break;
	}
}
/*@@end*/

/*@@sysvarChange:CH_Nodes::CH__STPDU_SPC_Preview_Data_SPC_AR:*/
on sysvar sysvar::CH_Nodes::CH__STPDU_SPC_Preview_Data_SPC_AR
{
	long res;
	long tDelay;
	switch (@this)
	{
		case (0):
			res = ResetTimingCyclic("Preview_Data_SPC_AR");
			res = ResetTimingEvtTrg("Preview_Data_SPC_AR");
			res = EnableTimingCyclic("Preview_Data_SPC_AR", 1);
			res = EnableTimingEvtTrg("Preview_Data_SPC_AR", 1);
			break;
		case (1):
			tDelay = @sysvar::CH_Nodes::CH__STPDU_T_SPC_Preview_Data_SPC_AR;
			if (tDelay > 0)
			{
				if (isTimerActive(Timer_SPC_Preview_Data_SPC_AR) == 0)
				{
					res = SetTimingCyclic("Preview_Data_SPC_AR", 1, tDelay, 1);
					setTimer (Timer_SPC_Preview_Data_SPC_AR, tDelay);
					@sysvar::CH_Nodes::CH__STPDU_SPC_Preview_Data_SPC_AR = 2;
				}
			}
			else if (tDelay == 0)
			{
				if (isTimerActive(Timer_SPC_Preview_Data_SPC_AR) == 0)
				{
					res = EnableTimingCyclic("Preview_Data_SPC_AR", 0);
					res = EnableTimingEvtTrg("Preview_Data_SPC_AR", 0);
				}
			}
			break;
		case (2):
			break;
		default:
			Write("error: wrong parameter (%d)", @this);
			stop();
			break;
	}
}
/*@@end*/

/*@@sysvarChange:CH_Nodes::CH__STPDU_SPC_ROE_MPU_FL:*/
on sysvar sysvar::CH_Nodes::CH__STPDU_SPC_ROE_MPU_FL
{
	long res;
	long tDelay;
	switch (@this)
	{
		case (0):
			res = ResetTimingCyclic("ROE_MPU_FL");
			res = ResetTimingEvtTrg("ROE_MPU_FL");
			res = EnableTimingCyclic("ROE_MPU_FL", 1);
			res = EnableTimingEvtTrg("ROE_MPU_FL", 1);
			break;
		case (1):
			tDelay = @sysvar::CH_Nodes::CH__STPDU_T_SPC_ROE_MPU_FL;
			if (tDelay > 0)
			{
				if (isTimerActive(Timer_SPC_ROE_MPU_FL) == 0)
				{
					res = SetTimingCyclic("ROE_MPU_FL", 1, tDelay, 1);
					setTimer (Timer_SPC_ROE_MPU_FL, tDelay);
					@sysvar::CH_Nodes::CH__STPDU_SPC_ROE_MPU_FL = 2;
				}
			}
			else if (tDelay == 0)
			{
				if (isTimerActive(Timer_SPC_ROE_MPU_FL) == 0)
				{
					res = EnableTimingCyclic("ROE_MPU_FL", 0);
					res = EnableTimingEvtTrg("ROE_MPU_FL", 0);
				}
			}
			break;
		case (2):
			break;
		default:
			Write("error: wrong parameter (%d)", @this);
			stop();
			break;
	}
}
/*@@end*/

/*@@sysvarChange:CH_Nodes::CH__STPDU_SPC_ROE_MPU_FR:*/
on sysvar sysvar::CH_Nodes::CH__STPDU_SPC_ROE_MPU_FR
{
	long res;
	long tDelay;
	switch (@this)
	{
		case (0):
			res = ResetTimingCyclic("ROE_MPU_FR");
			res = ResetTimingEvtTrg("ROE_MPU_FR");
			res = EnableTimingCyclic("ROE_MPU_FR", 1);
			res = EnableTimingEvtTrg("ROE_MPU_FR", 1);
			break;
		case (1):
			tDelay = @sysvar::CH_Nodes::CH__STPDU_T_SPC_ROE_MPU_FR;
			if (tDelay > 0)
			{
				if (isTimerActive(Timer_SPC_ROE_MPU_FR) == 0)
				{
					res = SetTimingCyclic("ROE_MPU_FR", 1, tDelay, 1);
					setTimer (Timer_SPC_ROE_MPU_FR, tDelay);
					@sysvar::CH_Nodes::CH__STPDU_SPC_ROE_MPU_FR = 2;
				}
			}
			else if (tDelay == 0)
			{
				if (isTimerActive(Timer_SPC_ROE_MPU_FR) == 0)
				{
					res = EnableTimingCyclic("ROE_MPU_FR", 0);
					res = EnableTimingEvtTrg("ROE_MPU_FR", 0);
				}
			}
			break;
		case (2):
			break;
		default:
			Write("error: wrong parameter (%d)", @this);
			stop();
			break;
	}
}
/*@@end*/

/*@@sysvarChange:CH_Nodes::CH__STPDU_SPC_ROE_MPU_RL:*/
on sysvar sysvar::CH_Nodes::CH__STPDU_SPC_ROE_MPU_RL
{
	long res;
	long tDelay;
	switch (@this)
	{
		case (0):
			res = ResetTimingCyclic("ROE_MPU_RL");
			res = ResetTimingEvtTrg("ROE_MPU_RL");
			res = EnableTimingCyclic("ROE_MPU_RL", 1);
			res = EnableTimingEvtTrg("ROE_MPU_RL", 1);
			break;
		case (1):
			tDelay = @sysvar::CH_Nodes::CH__STPDU_T_SPC_ROE_MPU_RL;
			if (tDelay > 0)
			{
				if (isTimerActive(Timer_SPC_ROE_MPU_RL) == 0)
				{
					res = SetTimingCyclic("ROE_MPU_RL", 1, tDelay, 1);
					setTimer (Timer_SPC_ROE_MPU_RL, tDelay);
					@sysvar::CH_Nodes::CH__STPDU_SPC_ROE_MPU_RL = 2;
				}
			}
			else if (tDelay == 0)
			{
				if (isTimerActive(Timer_SPC_ROE_MPU_RL) == 0)
				{
					res = EnableTimingCyclic("ROE_MPU_RL", 0);
					res = EnableTimingEvtTrg("ROE_MPU_RL", 0);
				}
			}
			break;
		case (2):
			break;
		default:
			Write("error: wrong parameter (%d)", @this);
			stop();
			break;
	}
}
/*@@end*/

/*@@sysvarChange:CH_Nodes::CH__STPDU_SPC_ROE_MPU_RR:*/
on sysvar sysvar::CH_Nodes::CH__STPDU_SPC_ROE_MPU_RR
{
	long res;
	long tDelay;
	switch (@this)
	{
		case (0):
			res = ResetTimingCyclic("ROE_MPU_RR");
			res = ResetTimingEvtTrg("ROE_MPU_RR");
			res = EnableTimingCyclic("ROE_MPU_RR", 1);
			res = EnableTimingEvtTrg("ROE_MPU_RR", 1);
			break;
		case (1):
			tDelay = @sysvar::CH_Nodes::CH__STPDU_T_SPC_ROE_MPU_RR;
			if (tDelay > 0)
			{
				if (isTimerActive(Timer_SPC_ROE_MPU_RR) == 0)
				{
					res = SetTimingCyclic("ROE_MPU_RR", 1, tDelay, 1);
					setTimer (Timer_SPC_ROE_MPU_RR, tDelay);
					@sysvar::CH_Nodes::CH__STPDU_SPC_ROE_MPU_RR = 2;
				}
			}
			else if (tDelay == 0)
			{
				if (isTimerActive(Timer_SPC_ROE_MPU_RR) == 0)
				{
					res = EnableTimingCyclic("ROE_MPU_RR", 0);
					res = EnableTimingEvtTrg("ROE_MPU_RR", 0);
				}
			}
			break;
		case (2):
			break;
		default:
			Write("error: wrong parameter (%d)", @this);
			stop();
			break;
	}
}
/*@@end*/

/*@@sysvarChange:CH_Nodes::CH__STPDU_SPC_ROE_SPC:*/
on sysvar sysvar::CH_Nodes::CH__STPDU_SPC_ROE_SPC
{
	long res;
	long tDelay;
	switch (@this)
	{
		case (0):
			res = ResetTimingCyclic("ROE_SPC");
			res = ResetTimingEvtTrg("ROE_SPC");
			res = EnableTimingCyclic("ROE_SPC", 1);
			res = EnableTimingEvtTrg("ROE_SPC", 1);
			break;
		case (1):
			tDelay = @sysvar::CH_Nodes::CH__STPDU_T_SPC_ROE_SPC;
			if (tDelay > 0)
			{
				if (isTimerActive(Timer_SPC_ROE_SPC) == 0)
				{
					res = SetTimingCyclic("ROE_SPC", 1, tDelay, 1);
					setTimer (Timer_SPC_ROE_SPC, tDelay);
					@sysvar::CH_Nodes::CH__STPDU_SPC_ROE_SPC = 2;
				}
			}
			else if (tDelay == 0)
			{
				if (isTimerActive(Timer_SPC_ROE_SPC) == 0)
				{
					res = EnableTimingCyclic("ROE_SPC", 0);
					res = EnableTimingEvtTrg("ROE_SPC", 0);
				}
			}
			break;
		case (2):
			break;
		default:
			Write("error: wrong parameter (%d)", @this);
			stop();
			break;
	}
}
/*@@end*/

/*@@sysvarChange:CH_Nodes::CH__STPDU_SPC_SPC_Disp_Rq_AR:*/
on sysvar sysvar::CH_Nodes::CH__STPDU_SPC_SPC_Disp_Rq_AR
{
	long res;
	long tDelay;
	switch (@this)
	{
		case (0):
			res = ResetTimingCyclic("SPC_Disp_Rq_AR");
			res = ResetTimingEvtTrg("SPC_Disp_Rq_AR");
			res = EnableTimingCyclic("SPC_Disp_Rq_AR", 1);
			res = EnableTimingEvtTrg("SPC_Disp_Rq_AR", 1);
			break;
		case (1):
			tDelay = @sysvar::CH_Nodes::CH__STPDU_T_SPC_SPC_Disp_Rq_AR;
			if (tDelay > 0)
			{
				if (isTimerActive(Timer_SPC_SPC_Disp_Rq_AR) == 0)
				{
					res = SetTimingCyclic("SPC_Disp_Rq_AR", 1, tDelay, 1);
					setTimer (Timer_SPC_SPC_Disp_Rq_AR, tDelay);
					@sysvar::CH_Nodes::CH__STPDU_SPC_SPC_Disp_Rq_AR = 2;
				}
			}
			else if (tDelay == 0)
			{
				if (isTimerActive(Timer_SPC_SPC_Disp_Rq_AR) == 0)
				{
					res = EnableTimingCyclic("SPC_Disp_Rq_AR", 0);
					res = EnableTimingEvtTrg("SPC_Disp_Rq_AR", 0);
				}
			}
			break;
		case (2):
			break;
		default:
			Write("error: wrong parameter (%d)", @this);
			stop();
			break;
	}
}
/*@@end*/

/*@@sysvarChange:CH_Nodes::CH__STPDU_SPC_SPC_SwLED_Msg_Rq_AR2:*/
on sysvar sysvar::CH_Nodes::CH__STPDU_SPC_SPC_SwLED_Msg_Rq_AR2
{
	long res;
	long tDelay;
	switch (@this)
	{
		case (0):
			res = ResetTimingCyclic("SPC_SwLED_Msg_Rq_AR2");
			res = ResetTimingEvtTrg("SPC_SwLED_Msg_Rq_AR2");
			res = EnableTimingCyclic("SPC_SwLED_Msg_Rq_AR2", 1);
			res = EnableTimingEvtTrg("SPC_SwLED_Msg_Rq_AR2", 1);
			break;
		case (1):
			tDelay = @sysvar::CH_Nodes::CH__STPDU_T_SPC_SPC_SwLED_Msg_Rq_AR2;
			if (tDelay > 0)
			{
				if (isTimerActive(Timer_SPC_SPC_SwLED_Msg_Rq_AR2) == 0)
				{
					res = SetTimingCyclic("SPC_SwLED_Msg_Rq_AR2", 1, tDelay, 1);
					setTimer (Timer_SPC_SPC_SwLED_Msg_Rq_AR2, tDelay);
					@sysvar::CH_Nodes::CH__STPDU_SPC_SPC_SwLED_Msg_Rq_AR2 = 2;
				}
			}
			else if (tDelay == 0)
			{
				if (isTimerActive(Timer_SPC_SPC_SwLED_Msg_Rq_AR2) == 0)
				{
					res = EnableTimingCyclic("SPC_SwLED_Msg_Rq_AR2", 0);
					res = EnableTimingEvtTrg("SPC_SwLED_Msg_Rq_AR2", 0);
				}
			}
			break;
		case (2):
			break;
		default:
			Write("error: wrong parameter (%d)", @this);
			stop();
			break;
	}
}
/*@@end*/

/*@@sysvarChange:CH_Nodes::CH__STPDU_SPC_SpringVlv_Rq_AR:*/
on sysvar sysvar::CH_Nodes::CH__STPDU_SPC_SpringVlv_Rq_AR
{
	long res;
	long tDelay;
	switch (@this)
	{
		case (0):
			res = ResetTimingCyclic("SpringVlv_Rq_AR");
			res = ResetTimingEvtTrg("SpringVlv_Rq_AR");
			res = EnableTimingCyclic("SpringVlv_Rq_AR", 1);
			res = EnableTimingEvtTrg("SpringVlv_Rq_AR", 1);
			break;
		case (1):
			tDelay = @sysvar::CH_Nodes::CH__STPDU_T_SPC_SpringVlv_Rq_AR;
			if (tDelay > 0)
			{
				if (isTimerActive(Timer_SPC_SpringVlv_Rq_AR) == 0)
				{
					res = SetTimingCyclic("SpringVlv_Rq_AR", 1, tDelay, 1);
					setTimer (Timer_SPC_SpringVlv_Rq_AR, tDelay);
					@sysvar::CH_Nodes::CH__STPDU_SPC_SpringVlv_Rq_AR = 2;
				}
			}
			else if (tDelay == 0)
			{
				if (isTimerActive(Timer_SPC_SpringVlv_Rq_AR) == 0)
				{
					res = EnableTimingCyclic("SpringVlv_Rq_AR", 0);
					res = EnableTimingEvtTrg("SpringVlv_Rq_AR", 0);
				}
			}
			break;
		case (2):
			break;
		default:
			Write("error: wrong parameter (%d)", @this);
			stop();
			break;
	}
}
/*@@end*/

/*@@sysvarChange:CH_Nodes::CH__STPDU_SPC_VehCarv_Stat_AR:*/
on sysvar sysvar::CH_Nodes::CH__STPDU_SPC_VehCarv_Stat_AR
{
	long res;
	long tDelay;
	switch (@this)
	{
		case (0):
			res = ResetTimingCyclic("VehCarv_Stat_AR");
			res = ResetTimingEvtTrg("VehCarv_Stat_AR");
			res = EnableTimingCyclic("VehCarv_Stat_AR", 1);
			res = EnableTimingEvtTrg("VehCarv_Stat_AR", 1);
			break;
		case (1):
			tDelay = @sysvar::CH_Nodes::CH__STPDU_T_SPC_VehCarv_Stat_AR;
			if (tDelay > 0)
			{
				if (isTimerActive(Timer_SPC_VehCarv_Stat_AR) == 0)
				{
					res = SetTimingCyclic("VehCarv_Stat_AR", 1, tDelay, 1);
					setTimer (Timer_SPC_VehCarv_Stat_AR, tDelay);
					@sysvar::CH_Nodes::CH__STPDU_SPC_VehCarv_Stat_AR = 2;
				}
			}
			else if (tDelay == 0)
			{
				if (isTimerActive(Timer_SPC_VehCarv_Stat_AR) == 0)
				{
					res = EnableTimingCyclic("VehCarv_Stat_AR", 0);
					res = EnableTimingEvtTrg("VehCarv_Stat_AR", 0);
				}
			}
			break;
		case (2):
			break;
		default:
			Write("error: wrong parameter (%d)", @this);
			stop();
			break;
	}
}
/*@@end*/

/*@@sysvarChange:CH_Nodes::CH__STPDU_SPC_VehLvl_Stat_AR2:*/
on sysvar sysvar::CH_Nodes::CH__STPDU_SPC_VehLvl_Stat_AR2
{
	long res;
	long tDelay;
	switch (@this)
	{
		case (0):
			res = ResetTimingCyclic("VehLvl_Stat_AR2");
			res = ResetTimingEvtTrg("VehLvl_Stat_AR2");
			res = EnableTimingCyclic("VehLvl_Stat_AR2", 1);
			res = EnableTimingEvtTrg("VehLvl_Stat_AR2", 1);
			break;
		case (1):
			tDelay = @sysvar::CH_Nodes::CH__STPDU_T_SPC_VehLvl_Stat_AR2;
			if (tDelay > 0)
			{
				if (isTimerActive(Timer_SPC_VehLvl_Stat_AR2) == 0)
				{
					res = SetTimingCyclic("VehLvl_Stat_AR2", 1, tDelay, 1);
					setTimer (Timer_SPC_VehLvl_Stat_AR2, tDelay);
					@sysvar::CH_Nodes::CH__STPDU_SPC_VehLvl_Stat_AR2 = 2;
				}
			}
			else if (tDelay == 0)
			{
				if (isTimerActive(Timer_SPC_VehLvl_Stat_AR2) == 0)
				{
					res = EnableTimingCyclic("VehLvl_Stat_AR2", 0);
					res = EnableTimingEvtTrg("VehLvl_Stat_AR2", 0);
				}
			}
			break;
		case (2):
			break;
		default:
			Write("error: wrong parameter (%d)", @this);
			stop();
			break;
	}
}
/*@@end*/


/*@@sysvarChange:CH_Nodes::CH_SPCEng_Rq_ABC_AR2_UB_AUTO_01:*/
on sysvar sysvar::CH_Nodes::CH_SPCEng_Rq_ABC_AR2_UB_AUTO_01
{
	switch (@sysvar::CH_Nodes::CH_SPCEng_Rq_ABC_AR2_UB_AUTO_01)
	{
		case (0):
			enableControl("Eng_Rq_ABC_AR2", "CH_SPCEng_Rq_ABC_AR2_UB__01", 0); //1: enable; 0: disable
			@sysvar::CH_Nodes::CH_SPCEng_Rq_ABC_AR2_UB__01 = 1;
			break;
		case (1):
			enableControl("Eng_Rq_ABC_AR2", "CH_SPCEng_Rq_ABC_AR2_UB__01", 1); //1: enable; 0: disable
			break;
		case (2):
			enableControl("Eng_Rq_ABC_AR2", "CH_SPCEng_Rq_ABC_AR2_UB__01", 0); //1: enable; 0: disable
			@sysvar::CH_Nodes::CH_SPCEng_Rq_ABC_AR2_UB__01 = 1;
			break;
		case (3):
			enableControl("Eng_Rq_ABC_AR2", "CH_SPCEng_Rq_ABC_AR2_UB__01", 0); //1: enable; 0: disable
			@sysvar::CH_Nodes::CH_SPCEng_Rq_ABC_AR2_UB__01 = 0;
			break;
	}
}
/*@@end*/

/*@@sysvarChange:CH_Nodes::CH_SPCCRC_Eng_Rq_ABC_Pr2Eng_AUTO:*/
on sysvar sysvar::CH_Nodes::CH_SPCCRC_Eng_Rq_ABC_Pr2Eng_AUTO
{
//	EnableCRC("Eng_Rq_ABC_AR2",  "Eng_Rq_ABC_Pr2", !@this); // 1 = on, 0 = off 
	enableControl("Eng_Rq_ABC_AR2", "CH_SPCCRC_Eng_Rq_ABC_Pr2Eng_Rq__", @this); //1: enable; 0: disable
	CRC_Eng_Rq_ABC_Pr2 = @sysvar::CH_Nodes::CH_SPCCRC_Eng_Rq_ABC_Pr2Eng_AUTO;
}
/*@@end*/

/*@@sysvarChange:CH_Nodes::CH_SPCSQC_Eng_Rq_ABC_Pr2Eng_AUTO:*/
on sysvar sysvar::CH_Nodes::CH_SPCSQC_Eng_Rq_ABC_Pr2Eng_AUTO
{
//	EnableSQC("Eng_Rq_ABC_AR2",  "Eng_Rq_ABC_Pr2", !@this); // 1 = on, 0 = off 
	enableControl("Eng_Rq_ABC_AR2", "CH_SPCSQC_Eng_Rq_ABC_Pr2Eng_Rq__", @this); //1: enable; 0: disable
	SQC_Eng_Rq_ABC_Pr2 = @sysvar::CH_Nodes::CH_SPCSQC_Eng_Rq_ABC_Pr2Eng_AUTO;
}
/*@@end*/

/*@@sysvarChange:CH_Nodes::CH_SPCOffRoad_Disp_Rq_AR_UB_A_01:*/
on sysvar sysvar::CH_Nodes::CH_SPCOffRoad_Disp_Rq_AR_UB_A_01
{
	switch (@sysvar::CH_Nodes::CH_SPCOffRoad_Disp_Rq_AR_UB_A_01)
	{
		case (0):
			enableControl("OffRoad_Disp_Rq_AR", "CH_SPCOffRoad_Disp_Rq_AR_UB__01", 0); //1: enable; 0: disable
			@sysvar::CH_Nodes::CH_SPCOffRoad_Disp_Rq_AR_UB__01 = 1;
			break;
		case (1):
			enableControl("OffRoad_Disp_Rq_AR", "CH_SPCOffRoad_Disp_Rq_AR_UB__01", 1); //1: enable; 0: disable
			break;
		case (2):
			enableControl("OffRoad_Disp_Rq_AR", "CH_SPCOffRoad_Disp_Rq_AR_UB__01", 0); //1: enable; 0: disable
			@sysvar::CH_Nodes::CH_SPCOffRoad_Disp_Rq_AR_UB__01 = 1;
			break;
		case (3):
			enableControl("OffRoad_Disp_Rq_AR", "CH_SPCOffRoad_Disp_Rq_AR_UB__01", 0); //1: enable; 0: disable
			@sysvar::CH_Nodes::CH_SPCOffRoad_Disp_Rq_AR_UB__01 = 0;
			break;
	}
}
/*@@end*/

/*@@sysvarChange:CH_Nodes::CH_SPCPreview_Data_SPC_A_UB_A_01:*/
on sysvar sysvar::CH_Nodes::CH_SPCPreview_Data_SPC_A_UB_A_01
{
	switch (@sysvar::CH_Nodes::CH_SPCPreview_Data_SPC_A_UB_A_01)
	{
		case (0):
			enableControl("Preview_Data_SPC_AR", "CH_SPCPreview_Data_SPC_AR_UB__01", 0); //1: enable; 0: disable
			@sysvar::CH_Nodes::CH_SPCPreview_Data_SPC_AR_UB__01 = 1;
			break;
		case (1):
			enableControl("Preview_Data_SPC_AR", "CH_SPCPreview_Data_SPC_AR_UB__01", 1); //1: enable; 0: disable
			break;
		case (2):
			enableControl("Preview_Data_SPC_AR", "CH_SPCPreview_Data_SPC_AR_UB__01", 0); //1: enable; 0: disable
			@sysvar::CH_Nodes::CH_SPCPreview_Data_SPC_AR_UB__01 = 1;
			break;
		case (3):
			enableControl("Preview_Data_SPC_AR", "CH_SPCPreview_Data_SPC_AR_UB__01", 0); //1: enable; 0: disable
			@sysvar::CH_Nodes::CH_SPCPreview_Data_SPC_AR_UB__01 = 0;
			break;
	}
}
/*@@end*/

/*@@sysvarChange:CH_Nodes::CH_SPCSPC_SwLED_Msg_Rq_A_UB_A_01:*/
on sysvar sysvar::CH_Nodes::CH_SPCSPC_SwLED_Msg_Rq_A_UB_A_01
{
	switch (@sysvar::CH_Nodes::CH_SPCSPC_SwLED_Msg_Rq_A_UB_A_01)
	{
		case (0):
			enableControl("SPC_SwLED_Msg_Rq_AR2", "CH_SPCSPC_SwLED_Msg_Rq_AR2_UB_01", 0); //1: enable; 0: disable
			@sysvar::CH_Nodes::CH_SPCSPC_SwLED_Msg_Rq_AR2_UB_01 = 1;
			break;
		case (1):
			enableControl("SPC_SwLED_Msg_Rq_AR2", "CH_SPCSPC_SwLED_Msg_Rq_AR2_UB_01", 1); //1: enable; 0: disable
			break;
		case (2):
			enableControl("SPC_SwLED_Msg_Rq_AR2", "CH_SPCSPC_SwLED_Msg_Rq_AR2_UB_01", 0); //1: enable; 0: disable
			@sysvar::CH_Nodes::CH_SPCSPC_SwLED_Msg_Rq_AR2_UB_01 = 1;
			break;
		case (3):
			enableControl("SPC_SwLED_Msg_Rq_AR2", "CH_SPCSPC_SwLED_Msg_Rq_AR2_UB_01", 0); //1: enable; 0: disable
			@sysvar::CH_Nodes::CH_SPCSPC_SwLED_Msg_Rq_AR2_UB_01 = 0;
			break;
	}
}
/*@@end*/

/*@@sysvarChange:CH_Nodes::CH_SPCCRC_SPC_Msg_Rq_Pr2SPC_AUTO:*/
on sysvar sysvar::CH_Nodes::CH_SPCCRC_SPC_Msg_Rq_Pr2SPC_AUTO
{
//	EnableCRC("SPC_SwLED_Msg_Rq_AR2",  "SPC_Msg_Rq_Pr2", !@this); // 1 = on, 0 = off 
	enableControl("SPC_SwLED_Msg_Rq_AR2", "CH_SPCCRC_SPC_Msg_Rq_Pr2SPC_SwL_", @this); //1: enable; 0: disable
	CRC_SPC_Msg_Rq_Pr2 = @sysvar::CH_Nodes::CH_SPCCRC_SPC_Msg_Rq_Pr2SPC_AUTO;
}
/*@@end*/

/*@@sysvarChange:CH_Nodes::CH_SPCSQC_SPC_Msg_Rq_Pr2SPC_AUTO:*/
on sysvar sysvar::CH_Nodes::CH_SPCSQC_SPC_Msg_Rq_Pr2SPC_AUTO
{
//	EnableSQC("SPC_SwLED_Msg_Rq_AR2",  "SPC_Msg_Rq_Pr2", !@this); // 1 = on, 0 = off 
	enableControl("SPC_SwLED_Msg_Rq_AR2", "CH_SPCSQC_SPC_Msg_Rq_Pr2SPC_SwL_", @this); //1: enable; 0: disable
	SQC_SPC_Msg_Rq_Pr2 = @sysvar::CH_Nodes::CH_SPCSQC_SPC_Msg_Rq_Pr2SPC_AUTO;
}
/*@@end*/

/*@@sysvarChange:CH_Nodes::CH_SPCSpringVlv_Rq_AR_UB_AUTO_01:*/
on sysvar sysvar::CH_Nodes::CH_SPCSpringVlv_Rq_AR_UB_AUTO_01
{
	switch (@sysvar::CH_Nodes::CH_SPCSpringVlv_Rq_AR_UB_AUTO_01)
	{
		case (0):
			enableControl("SpringVlv_Rq_AR", "CH_SPCSpringVlv_Rq_AR_UB__01", 0); //1: enable; 0: disable
			@sysvar::CH_Nodes::CH_SPCSpringVlv_Rq_AR_UB__01 = 1;
			break;
		case (1):
			enableControl("SpringVlv_Rq_AR", "CH_SPCSpringVlv_Rq_AR_UB__01", 1); //1: enable; 0: disable
			break;
		case (2):
			enableControl("SpringVlv_Rq_AR", "CH_SPCSpringVlv_Rq_AR_UB__01", 0); //1: enable; 0: disable
			@sysvar::CH_Nodes::CH_SPCSpringVlv_Rq_AR_UB__01 = 1;
			break;
		case (3):
			enableControl("SpringVlv_Rq_AR", "CH_SPCSpringVlv_Rq_AR_UB__01", 0); //1: enable; 0: disable
			@sysvar::CH_Nodes::CH_SPCSpringVlv_Rq_AR_UB__01 = 0;
			break;
	}
}
/*@@end*/

/*@@sysvarChange:CH_Nodes::CH_SPCVehCarv_Stat_AR_UB_AUTO_01:*/
on sysvar sysvar::CH_Nodes::CH_SPCVehCarv_Stat_AR_UB_AUTO_01
{
	switch (@sysvar::CH_Nodes::CH_SPCVehCarv_Stat_AR_UB_AUTO_01)
	{
		case (0):
			enableControl("VehCarv_Stat_AR", "CH_SPCVehCarv_Stat_AR_UB__01", 0); //1: enable; 0: disable
			@sysvar::CH_Nodes::CH_SPCVehCarv_Stat_AR_UB__01 = 1;
			break;
		case (1):
			enableControl("VehCarv_Stat_AR", "CH_SPCVehCarv_Stat_AR_UB__01", 1); //1: enable; 0: disable
			break;
		case (2):
			enableControl("VehCarv_Stat_AR", "CH_SPCVehCarv_Stat_AR_UB__01", 0); //1: enable; 0: disable
			@sysvar::CH_Nodes::CH_SPCVehCarv_Stat_AR_UB__01 = 1;
			break;
		case (3):
			enableControl("VehCarv_Stat_AR", "CH_SPCVehCarv_Stat_AR_UB__01", 0); //1: enable; 0: disable
			@sysvar::CH_Nodes::CH_SPCVehCarv_Stat_AR_UB__01 = 0;
			break;
	}
}
/*@@end*/

/*@@sysvarChange:CH_Nodes::CH_SPCVehLvl_Stat_AR2_UB_AUTO_01:*/
on sysvar sysvar::CH_Nodes::CH_SPCVehLvl_Stat_AR2_UB_AUTO_01
{
	switch (@sysvar::CH_Nodes::CH_SPCVehLvl_Stat_AR2_UB_AUTO_01)
	{
		case (0):
			enableControl("VehLvl_Stat_AR2", "CH_SPCVehLvl_Stat_AR2_UB__01", 0); //1: enable; 0: disable
			@sysvar::CH_Nodes::CH_SPCVehLvl_Stat_AR2_UB__01 = 1;
			break;
		case (1):
			enableControl("VehLvl_Stat_AR2", "CH_SPCVehLvl_Stat_AR2_UB__01", 1); //1: enable; 0: disable
			break;
		case (2):
			enableControl("VehLvl_Stat_AR2", "CH_SPCVehLvl_Stat_AR2_UB__01", 0); //1: enable; 0: disable
			@sysvar::CH_Nodes::CH_SPCVehLvl_Stat_AR2_UB__01 = 1;
			break;
		case (3):
			enableControl("VehLvl_Stat_AR2", "CH_SPCVehLvl_Stat_AR2_UB__01", 0); //1: enable; 0: disable
			@sysvar::CH_Nodes::CH_SPCVehLvl_Stat_AR2_UB__01 = 0;
			break;
	}
}
/*@@end*/

/*@@sysvarChange:CH_Nodes::CH_SPCCRC_VehLvl_Stat_Pr2Ve_AUTO:*/
on sysvar sysvar::CH_Nodes::CH_SPCCRC_VehLvl_Stat_Pr2Ve_AUTO
{
//	EnableCRC("VehLvl_Stat_AR2",  "VehLvl_Stat_Pr2", !@this); // 1 = on, 0 = off 
	enableControl("VehLvl_Stat_AR2", "CH_SPCCRC_VehLvl_Stat_Pr2VehLvl_", @this); //1: enable; 0: disable
	CRC_VehLvl_Stat_Pr2 = @sysvar::CH_Nodes::CH_SPCCRC_VehLvl_Stat_Pr2Ve_AUTO;
}
/*@@end*/

/*@@sysvarChange:CH_Nodes::CH_SPCSQC_VehLvl_Stat_Pr2Ve_AUTO:*/
on sysvar sysvar::CH_Nodes::CH_SPCSQC_VehLvl_Stat_Pr2Ve_AUTO
{
//	EnableSQC("VehLvl_Stat_AR2",  "VehLvl_Stat_Pr2", !@this); // 1 = on, 0 = off 
	enableControl("VehLvl_Stat_AR2", "CH_SPCSQC_VehLvl_Stat_Pr2VehLvl_", @this); //1: enable; 0: disable
	SQC_VehLvl_Stat_Pr2 = @sysvar::CH_Nodes::CH_SPCSQC_VehLvl_Stat_Pr2Ve_AUTO;
}
/*@@end*/

/*@@caplFunc:CH_SPCEng_Rq_ABC_AR2():*///function
CH_SPCEng_Rq_ABC_AR2()
{
	switch (@sysvar::CH_Nodes::CH_SPCEng_Rq_ABC_AR2_UB_AUTO_01)
	{
		case (0):
			//Updatebit wird mit 1 gesendet; entspricht Standard
			break;
		case (1):
			//nur wenn manueller Wert gleich 0 ist, muss was gemacht werden
			if (@sysvar::CH_Nodes::CH_SPCEng_Rq_ABC_AR2_UB_AUTO_01 == 0)
				DisturbPDUUB("Eng_Rq_ABC_AR2", 1, 0); //Updatebit wird einmal auf Null gesetzt
			break;
		case (2):
			//Updatebit wird mit 1 gesendet; entspricht Standard
			break;
		case (3):
			DisturbPDUUB("Eng_Rq_ABC_AR2", 1, 0); //Updatebit wird einmal auf Null gesetzt
			break;
	}
}
/*@@end*/

/*@@caplFunc:CH_SPCOffRoad_Disp_Rq_AR():*///function
CH_SPCOffRoad_Disp_Rq_AR()
{
	switch (@sysvar::CH_Nodes::CH_SPCOffRoad_Disp_Rq_AR_UB_A_01)
	{
		case (0):
			//Updatebit wird mit 1 gesendet; entspricht Standard
			break;
		case (1):
			//nur wenn manueller Wert gleich 0 ist, muss was gemacht werden
			if (@sysvar::CH_Nodes::CH_SPCOffRoad_Disp_Rq_AR_UB_A_01 == 0)
				DisturbPDUUB("OffRoad_Disp_Rq_AR", 1, 0); //Updatebit wird einmal auf Null gesetzt
			break;
		case (2):
			//Updatebit wird mit 1 gesendet; entspricht Standard
			break;
		case (3):
			DisturbPDUUB("OffRoad_Disp_Rq_AR", 1, 0); //Updatebit wird einmal auf Null gesetzt
			break;
	}
}
/*@@end*/

/*@@caplFunc:CH_SPCPreview_Data_SPC_AR():*///function
CH_SPCPreview_Data_SPC_AR()
{
	switch (@sysvar::CH_Nodes::CH_SPCPreview_Data_SPC_A_UB_A_01)
	{
		case (0):
			//Updatebit wird mit 1 gesendet; entspricht Standard
			break;
		case (1):
			//nur wenn manueller Wert gleich 0 ist, muss was gemacht werden
			if (@sysvar::CH_Nodes::CH_SPCPreview_Data_SPC_A_UB_A_01 == 0)
				DisturbPDUUB("Preview_Data_SPC_AR", 1, 0); //Updatebit wird einmal auf Null gesetzt
			break;
		case (2):
			//Updatebit wird mit 1 gesendet; entspricht Standard
			break;
		case (3):
			DisturbPDUUB("Preview_Data_SPC_AR", 1, 0); //Updatebit wird einmal auf Null gesetzt
			break;
	}
}
/*@@end*/

/*@@caplFunc:CH_SPCSPC_SwLED_Msg_Rq_AR2():*///function
CH_SPCSPC_SwLED_Msg_Rq_AR2()
{
	switch (@sysvar::CH_Nodes::CH_SPCSPC_SwLED_Msg_Rq_A_UB_A_01)
	{
		case (0):
			//Updatebit wird mit 1 gesendet; entspricht Standard
			break;
		case (1):
			//nur wenn manueller Wert gleich 0 ist, muss was gemacht werden
			if (@sysvar::CH_Nodes::CH_SPCSPC_SwLED_Msg_Rq_A_UB_A_01 == 0)
				DisturbPDUUB("SPC_SwLED_Msg_Rq_AR2", 1, 0); //Updatebit wird einmal auf Null gesetzt
			break;
		case (2):
			//Updatebit wird mit 1 gesendet; entspricht Standard
			break;
		case (3):
			DisturbPDUUB("SPC_SwLED_Msg_Rq_AR2", 1, 0); //Updatebit wird einmal auf Null gesetzt
			break;
	}
}
/*@@end*/

/*@@caplFunc:CH_SPCSpringVlv_Rq_AR():*///function
CH_SPCSpringVlv_Rq_AR()
{
	switch (@sysvar::CH_Nodes::CH_SPCSpringVlv_Rq_AR_UB_AUTO_01)
	{
		case (0):
			//Updatebit wird mit 1 gesendet; entspricht Standard
			break;
		case (1):
			//nur wenn manueller Wert gleich 0 ist, muss was gemacht werden
			if (@sysvar::CH_Nodes::CH_SPCSpringVlv_Rq_AR_UB_AUTO_01 == 0)
				DisturbPDUUB("SpringVlv_Rq_AR", 1, 0); //Updatebit wird einmal auf Null gesetzt
			break;
		case (2):
			//Updatebit wird mit 1 gesendet; entspricht Standard
			break;
		case (3):
			DisturbPDUUB("SpringVlv_Rq_AR", 1, 0); //Updatebit wird einmal auf Null gesetzt
			break;
	}
}
/*@@end*/

/*@@caplFunc:CH_SPCVehCarv_Stat_AR():*///function
CH_SPCVehCarv_Stat_AR()
{
	switch (@sysvar::CH_Nodes::CH_SPCVehCarv_Stat_AR_UB_AUTO_01)
	{
		case (0):
			//Updatebit wird mit 1 gesendet; entspricht Standard
			break;
		case (1):
			//nur wenn manueller Wert gleich 0 ist, muss was gemacht werden
			if (@sysvar::CH_Nodes::CH_SPCVehCarv_Stat_AR_UB_AUTO_01 == 0)
				DisturbPDUUB("VehCarv_Stat_AR", 1, 0); //Updatebit wird einmal auf Null gesetzt
			break;
		case (2):
			//Updatebit wird mit 1 gesendet; entspricht Standard
			break;
		case (3):
			DisturbPDUUB("VehCarv_Stat_AR", 1, 0); //Updatebit wird einmal auf Null gesetzt
			break;
	}
}
/*@@end*/

/*@@caplFunc:CH_SPCVehLvl_Stat_AR2():*///function
CH_SPCVehLvl_Stat_AR2()
{
	switch (@sysvar::CH_Nodes::CH_SPCVehLvl_Stat_AR2_UB_AUTO_01)
	{
		case (0):
			//Updatebit wird mit 1 gesendet; entspricht Standard
			break;
		case (1):
			//nur wenn manueller Wert gleich 0 ist, muss was gemacht werden
			if (@sysvar::CH_Nodes::CH_SPCVehLvl_Stat_AR2_UB_AUTO_01 == 0)
				DisturbPDUUB("VehLvl_Stat_AR2", 1, 0); //Updatebit wird einmal auf Null gesetzt
			break;
		case (2):
			//Updatebit wird mit 1 gesendet; entspricht Standard
			break;
		case (3):
			DisturbPDUUB("VehLvl_Stat_AR2", 1, 0); //Updatebit wird einmal auf Null gesetzt
			break;
	}
}
/*@@end*/

/*@@caplFunc:FrILTxPending(char[],long,byte[],long):*///callback
void FrILTxPending(char pduName[], long len, byte payload[], long TxAck)
{
	byte crc;
	dword SQC;
	dword MC;
	dword Tgl;
	dword i;

	if (strncmp (pduName, "Eng_Rq_ABC_AR2", strLen(pduName)+strLen("Eng_Rq_ABC_AR2")) == 0)
	{
		if (TxAck == 1)
		{
			if (@sysvar::CH_Nodes::CH_SPCSQC_Eng_Rq_ABC_Pr2Eng_AUTO == 0)
			{
				//SQC automatisch ändern
				SQC_VAL_Eng_Rq_ABC_Pr2 = (SQC_VAL_Eng_Rq_ABC_Pr2 + 1) % 16;
			}
			else
			{
				//SQC manuel veränderbar
			}

		}
		else
		{
			if (@sysvar::CH_Nodes::CH_SPCSQC_Eng_Rq_ABC_Pr2Eng_AUTO == 0)
			{
				//SQC automatisch ändern
				//SQC für CRC speichern
				CounterValForCRC_Eng_Rq_ABC_Pr2 = SQC_VAL_Eng_Rq_ABC_Pr2;
				//SQC in Byte schreiben
				payload[1] = (payload[1] & ~0x0F) |  SQC_VAL_Eng_Rq_ABC_Pr2;
			}
			else
			{
				//SQC manuel veränderbar
			}

			if (@sysvar::CH_Nodes::CH_SPCCRC_Eng_Rq_ABC_Pr2Eng_AUTO == 0)
			{
				//CRC automatisch berechnen
				crc = 0xFF;
				crc = crctableProfTwo[crc ^ payload[1]];
				crc = crctableProfTwo[crc ^ payload[2]];
				crc = crctableProfTwo[crc ^ payload[3]];
				crc = crctableProfTwo[crc ^ payload[4]];
				switch (CounterValForCRC_Eng_Rq_ABC_Pr2)
				{
					case(0) :
						crc = crctableProfTwo[crc ^ 244];
						break;
					case(1) :
						crc = crctableProfTwo[crc ^ 139];
						break;
					case(2) :
						crc = crctableProfTwo[crc ^ 34];
						break;
					case(3) :
						crc = crctableProfTwo[crc ^ 180];
						break;
					case(4) :
						crc = crctableProfTwo[crc ^ 75];
						break;
					case(5) :
						crc = crctableProfTwo[crc ^ 221];
						break;
					case(6) :
						crc = crctableProfTwo[crc ^ 116];
						break;
					case(7) :
						crc = crctableProfTwo[crc ^ 11];
						break;
					case(8) :
						crc = crctableProfTwo[crc ^ 157];
						break;
					case(9) :
						crc = crctableProfTwo[crc ^ 52];
						break;
					case(10) :
						crc = crctableProfTwo[crc ^ 198];
						break;
					case(11) :
						crc = crctableProfTwo[crc ^ 93];
						break;
					case(12) :
						crc = crctableProfTwo[crc ^ 239];
						break;
					case(13) :
						crc = crctableProfTwo[crc ^ 134];
						break;
					case(14) :
						crc = crctableProfTwo[crc ^ 29];
						break;
					case(15) :
						crc = crctableProfTwo[crc ^ 175];
						break;
					default :
//						write("error: wrong parameter (%d)",CounterValForCRC_Eng_Rq_ABC_Pr2); stop();
						break;
				}
				crc = (crc ^ 0xFF);
				payload[0] = crc;
			}
			else
			{
				//CRC manuel veränderbar
			}

			CH_SPCVehLvl_Stat_AR2();
			CH_SPCEng_Rq_ABC_AR2();
		}
	}
	if (strncmp (pduName, "OffRoad_Disp_Rq_AR", strLen(pduName)+strLen("OffRoad_Disp_Rq_AR")) == 0)
	{
		if (TxAck == 1)
		{
		}
		else
		{
			CH_SPCOffRoad_Disp_Rq_AR();
		}
	}
	if (strncmp (pduName, "Preview_Data_SPC_AR", strLen(pduName)+strLen("Preview_Data_SPC_AR")) == 0)
	{
		if (TxAck == 1)
		{
		}
		else
		{
			CH_SPCPreview_Data_SPC_AR();
			CH_SPCVehCarv_Stat_AR();
		}
	}
	if (strncmp (pduName, "ROE_MPU_FL", strLen(pduName)+strLen("ROE_MPU_FL")) == 0)
	{
		if (TxAck == 1)
		{
		}
		else
		{
		}
	}
	if (strncmp (pduName, "ROE_MPU_FR", strLen(pduName)+strLen("ROE_MPU_FR")) == 0)
	{
		if (TxAck == 1)
		{
		}
		else
		{
		}
	}
	if (strncmp (pduName, "ROE_MPU_RL", strLen(pduName)+strLen("ROE_MPU_RL")) == 0)
	{
		if (TxAck == 1)
		{
		}
		else
		{
		}
	}
	if (strncmp (pduName, "ROE_MPU_RR", strLen(pduName)+strLen("ROE_MPU_RR")) == 0)
	{
		if (TxAck == 1)
		{
		}
		else
		{
		}
	}
	if (strncmp (pduName, "ROE_SPC", strLen(pduName)+strLen("ROE_SPC")) == 0)
	{
		if (TxAck == 1)
		{
		}
		else
		{
		}
	}
	if (strncmp (pduName, "SPC_Disp_Rq_AR", strLen(pduName)+strLen("SPC_Disp_Rq_AR")) == 0)
	{
		if (TxAck == 1)
		{
		}
		else
		{
		}
	}
	if (strncmp (pduName, "SPC_SwLED_Msg_Rq_AR2", strLen(pduName)+strLen("SPC_SwLED_Msg_Rq_AR2")) == 0)
	{
		if (TxAck == 1)
		{
			if (@sysvar::CH_Nodes::CH_SPCSQC_SPC_Msg_Rq_Pr2SPC_AUTO == 0)
			{
				//SQC automatisch ändern
				SQC_VAL_SPC_Msg_Rq_Pr2 = (SQC_VAL_SPC_Msg_Rq_Pr2 + 1) % 16;
			}
			else
			{
				//SQC manuel veränderbar
			}

		}
		else
		{
			if (@sysvar::CH_Nodes::CH_SPCSQC_SPC_Msg_Rq_Pr2SPC_AUTO == 0)
			{
				//SQC automatisch ändern
				//SQC für CRC speichern
				CounterValForCRC_SPC_Msg_Rq_Pr2 = SQC_VAL_SPC_Msg_Rq_Pr2;
				//SQC in Byte schreiben
				payload[1] = (payload[1] & ~0x0F) |  SQC_VAL_SPC_Msg_Rq_Pr2;
			}
			else
			{
				//SQC manuel veränderbar
			}

			if (@sysvar::CH_Nodes::CH_SPCCRC_SPC_Msg_Rq_Pr2SPC_AUTO == 0)
			{
				//CRC automatisch berechnen
				crc = 0xFF;
				crc = crctableProfTwo[crc ^ payload[1]];
				crc = crctableProfTwo[crc ^ payload[2]];
				crc = crctableProfTwo[crc ^ payload[3]];
				switch (CounterValForCRC_SPC_Msg_Rq_Pr2)
				{
					case(0) :
						crc = crctableProfTwo[crc ^ 94];
						break;
					case(1) :
						crc = crctableProfTwo[crc ^ 113];
						break;
					case(2) :
						crc = crctableProfTwo[crc ^ 132];
						break;
					case(3) :
						crc = crctableProfTwo[crc ^ 151];
						break;
					case(4) :
						crc = crctableProfTwo[crc ^ 170];
						break;
					case(5) :
						crc = crctableProfTwo[crc ^ 189];
						break;
					case(6) :
						crc = crctableProfTwo[crc ^ 208];
						break;
					case(7) :
						crc = crctableProfTwo[crc ^ 227];
						break;
					case(8) :
						crc = crctableProfTwo[crc ^ 246];
						break;
					case(9) :
						crc = crctableProfTwo[crc ^ 14];
						break;
					case(10) :
						crc = crctableProfTwo[crc ^ 33];
						break;
					case(11) :
						crc = crctableProfTwo[crc ^ 52];
						break;
					case(12) :
						crc = crctableProfTwo[crc ^ 71];
						break;
					case(13) :
						crc = crctableProfTwo[crc ^ 90];
						break;
					case(14) :
						crc = crctableProfTwo[crc ^ 109];
						break;
					case(15) :
						crc = crctableProfTwo[crc ^ 128];
						break;
					default :
//						write("error: wrong parameter (%d)",CounterValForCRC_SPC_Msg_Rq_Pr2); stop();
						break;
				}
				crc = (crc ^ 0xFF);
				payload[0] = crc;
			}
			else
			{
				//CRC manuel veränderbar
			}

			CH_SPCSPC_SwLED_Msg_Rq_AR2();
		}
	}
	if (strncmp (pduName, "SpringVlv_Rq_AR", strLen(pduName)+strLen("SpringVlv_Rq_AR")) == 0)
	{
		if (TxAck == 1)
		{
		}
		else
		{
			CH_SPCSpringVlv_Rq_AR();
		}
	}
	if (strncmp (pduName, "VehCarv_Stat_AR", strLen(pduName)+strLen("VehCarv_Stat_AR")) == 0)
	{
		if (TxAck == 1)
		{
		}
		else
		{
			CH_SPCPreview_Data_SPC_AR();
			CH_SPCVehCarv_Stat_AR();
		}
	}
	if (strncmp (pduName, "VehLvl_Stat_AR2", strLen(pduName)+strLen("VehLvl_Stat_AR2")) == 0)
	{
		if (TxAck == 1)
		{
			if (@sysvar::CH_Nodes::CH_SPCSQC_VehLvl_Stat_Pr2Ve_AUTO == 0)
			{
				//SQC automatisch ändern
				SQC_VAL_VehLvl_Stat_Pr2 = (SQC_VAL_VehLvl_Stat_Pr2 + 1) % 16;
			}
			else
			{
				//SQC manuel veränderbar
			}

		}
		else
		{
			if (@sysvar::CH_Nodes::CH_SPCSQC_VehLvl_Stat_Pr2Ve_AUTO == 0)
			{
				//SQC automatisch ändern
				//SQC für CRC speichern
				CounterValForCRC_VehLvl_Stat_Pr2 = SQC_VAL_VehLvl_Stat_Pr2;
				//SQC in Byte schreiben
				payload[1] = (payload[1] & ~0x0F) |  SQC_VAL_VehLvl_Stat_Pr2;
			}
			else
			{
				//SQC manuel veränderbar
			}

			if (@sysvar::CH_Nodes::CH_SPCCRC_VehLvl_Stat_Pr2Ve_AUTO == 0)
			{
				//CRC automatisch berechnen
				crc = 0xFF;
				crc = crctableProfTwo[crc ^ payload[1]];
				crc = crctableProfTwo[crc ^ payload[2]];
				crc = crctableProfTwo[crc ^ payload[3]];
				crc = crctableProfTwo[crc ^ payload[4]];
				crc = crctableProfTwo[crc ^ payload[5]];
				crc = crctableProfTwo[crc ^ payload[6]];
				crc = crctableProfTwo[crc ^ payload[7]];
				switch (CounterValForCRC_VehLvl_Stat_Pr2)
				{
					case(0) :
						crc = crctableProfTwo[crc ^ 114];
						break;
					case(1) :
						crc = crctableProfTwo[crc ^ 51];
						break;
					case(2) :
						crc = crctableProfTwo[crc ^ 239];
						break;
					case(3) :
						crc = crctableProfTwo[crc ^ 176];
						break;
					case(4) :
						crc = crctableProfTwo[crc ^ 113];
						break;
					case(5) :
						crc = crctableProfTwo[crc ^ 50];
						break;
					case(6) :
						crc = crctableProfTwo[crc ^ 238];
						break;
					case(7) :
						crc = crctableProfTwo[crc ^ 175];
						break;
					case(8) :
						crc = crctableProfTwo[crc ^ 112];
						break;
					case(9) :
						crc = crctableProfTwo[crc ^ 49];
						break;
					case(10) :
						crc = crctableProfTwo[crc ^ 237];
						break;
					case(11) :
						crc = crctableProfTwo[crc ^ 174];
						break;
					case(12) :
						crc = crctableProfTwo[crc ^ 111];
						break;
					case(13) :
						crc = crctableProfTwo[crc ^ 48];
						break;
					case(14) :
						crc = crctableProfTwo[crc ^ 236];
						break;
					case(15) :
						crc = crctableProfTwo[crc ^ 173];
						break;
					default :
//						write("error: wrong parameter (%d)",CounterValForCRC_VehLvl_Stat_Pr2); stop();
						break;
				}
				crc = (crc ^ 0xFF);
				payload[0] = crc;
			}
			else
			{
				//CRC manuel veränderbar
			}

			CH_SPCVehLvl_Stat_AR2();
			CH_SPCEng_Rq_ABC_AR2();
		}
	}
}
/*@@end*/

/*@@caplFunc:StartSim(int):*/
StartSim(int BusAktiv)
{
	result = EnableCRC("", 0); // 1 = on, 0 = off
	result = EnableTGL("", 0); // 1 = on, 0 = off 
	result = EnableSQC("", 0); // 1 = on, 0 = off 
	result = EnableMC("", 0); // 1 = on, 0 = off 
	switch (@sysvar::CH_Nodes::CH_SPCEng_Rq_ABC_AR2_UB_AUTO_01)
	{
		case (0):
			enableControl("Eng_Rq_ABC_AR2", "CH_SPCEng_Rq_ABC_AR2_UB__01", 0); //1: enable; 0: disable
			@sysvar::CH_Nodes::CH_SPCEng_Rq_ABC_AR2_UB__01 = 1;
			break;
		case (1):
			enableControl("Eng_Rq_ABC_AR2", "CH_SPCEng_Rq_ABC_AR2_UB__01", 1); //1: enable; 0: disable
			break;
		case (2):
			enableControl("Eng_Rq_ABC_AR2", "CH_SPCEng_Rq_ABC_AR2_UB__01", 0); //1: enable; 0: disable
			@sysvar::CH_Nodes::CH_SPCEng_Rq_ABC_AR2_UB__01 = 1;
			break;
		case (3):
			enableControl("Eng_Rq_ABC_AR2", "CH_SPCEng_Rq_ABC_AR2_UB__01", 0); //1: enable; 0: disable
			@sysvar::CH_Nodes::CH_SPCEng_Rq_ABC_AR2_UB__01 = 0;
			break;
	}

	CRC_Eng_Rq_ABC_Pr2 = 0;
	SQC_VAL_Eng_Rq_ABC_Pr2 = 0;
	SQC_Eng_Rq_ABC_Pr2 = 0;
	switch (@sysvar::CH_Nodes::CH_SPCOffRoad_Disp_Rq_AR_UB_A_01)
	{
		case (0):
			enableControl("OffRoad_Disp_Rq_AR", "CH_SPCOffRoad_Disp_Rq_AR_UB__01", 0); //1: enable; 0: disable
			@sysvar::CH_Nodes::CH_SPCOffRoad_Disp_Rq_AR_UB__01 = 1;
			break;
		case (1):
			enableControl("OffRoad_Disp_Rq_AR", "CH_SPCOffRoad_Disp_Rq_AR_UB__01", 1); //1: enable; 0: disable
			break;
		case (2):
			enableControl("OffRoad_Disp_Rq_AR", "CH_SPCOffRoad_Disp_Rq_AR_UB__01", 0); //1: enable; 0: disable
			@sysvar::CH_Nodes::CH_SPCOffRoad_Disp_Rq_AR_UB__01 = 1;
			break;
		case (3):
			enableControl("OffRoad_Disp_Rq_AR", "CH_SPCOffRoad_Disp_Rq_AR_UB__01", 0); //1: enable; 0: disable
			@sysvar::CH_Nodes::CH_SPCOffRoad_Disp_Rq_AR_UB__01 = 0;
			break;
	}

	switch (@sysvar::CH_Nodes::CH_SPCPreview_Data_SPC_A_UB_A_01)
	{
		case (0):
			enableControl("Preview_Data_SPC_AR", "CH_SPCPreview_Data_SPC_AR_UB__01", 0); //1: enable; 0: disable
			@sysvar::CH_Nodes::CH_SPCPreview_Data_SPC_AR_UB__01 = 1;
			break;
		case (1):
			enableControl("Preview_Data_SPC_AR", "CH_SPCPreview_Data_SPC_AR_UB__01", 1); //1: enable; 0: disable
			break;
		case (2):
			enableControl("Preview_Data_SPC_AR", "CH_SPCPreview_Data_SPC_AR_UB__01", 0); //1: enable; 0: disable
			@sysvar::CH_Nodes::CH_SPCPreview_Data_SPC_AR_UB__01 = 1;
			break;
		case (3):
			enableControl("Preview_Data_SPC_AR", "CH_SPCPreview_Data_SPC_AR_UB__01", 0); //1: enable; 0: disable
			@sysvar::CH_Nodes::CH_SPCPreview_Data_SPC_AR_UB__01 = 0;
			break;
	}

	switch (@sysvar::CH_Nodes::CH_SPCSPC_SwLED_Msg_Rq_A_UB_A_01)
	{
		case (0):
			enableControl("SPC_SwLED_Msg_Rq_AR2", "CH_SPCSPC_SwLED_Msg_Rq_AR2_UB_01", 0); //1: enable; 0: disable
			@sysvar::CH_Nodes::CH_SPCSPC_SwLED_Msg_Rq_AR2_UB_01 = 1;
			break;
		case (1):
			enableControl("SPC_SwLED_Msg_Rq_AR2", "CH_SPCSPC_SwLED_Msg_Rq_AR2_UB_01", 1); //1: enable; 0: disable
			break;
		case (2):
			enableControl("SPC_SwLED_Msg_Rq_AR2", "CH_SPCSPC_SwLED_Msg_Rq_AR2_UB_01", 0); //1: enable; 0: disable
			@sysvar::CH_Nodes::CH_SPCSPC_SwLED_Msg_Rq_AR2_UB_01 = 1;
			break;
		case (3):
			enableControl("SPC_SwLED_Msg_Rq_AR2", "CH_SPCSPC_SwLED_Msg_Rq_AR2_UB_01", 0); //1: enable; 0: disable
			@sysvar::CH_Nodes::CH_SPCSPC_SwLED_Msg_Rq_AR2_UB_01 = 0;
			break;
	}

	CRC_SPC_Msg_Rq_Pr2 = 0;
	SQC_VAL_SPC_Msg_Rq_Pr2 = 0;
	SQC_SPC_Msg_Rq_Pr2 = 0;
	switch (@sysvar::CH_Nodes::CH_SPCSpringVlv_Rq_AR_UB_AUTO_01)
	{
		case (0):
			enableControl("SpringVlv_Rq_AR", "CH_SPCSpringVlv_Rq_AR_UB__01", 0); //1: enable; 0: disable
			@sysvar::CH_Nodes::CH_SPCSpringVlv_Rq_AR_UB__01 = 1;
			break;
		case (1):
			enableControl("SpringVlv_Rq_AR", "CH_SPCSpringVlv_Rq_AR_UB__01", 1); //1: enable; 0: disable
			break;
		case (2):
			enableControl("SpringVlv_Rq_AR", "CH_SPCSpringVlv_Rq_AR_UB__01", 0); //1: enable; 0: disable
			@sysvar::CH_Nodes::CH_SPCSpringVlv_Rq_AR_UB__01 = 1;
			break;
		case (3):
			enableControl("SpringVlv_Rq_AR", "CH_SPCSpringVlv_Rq_AR_UB__01", 0); //1: enable; 0: disable
			@sysvar::CH_Nodes::CH_SPCSpringVlv_Rq_AR_UB__01 = 0;
			break;
	}

	switch (@sysvar::CH_Nodes::CH_SPCVehCarv_Stat_AR_UB_AUTO_01)
	{
		case (0):
			enableControl("VehCarv_Stat_AR", "CH_SPCVehCarv_Stat_AR_UB__01", 0); //1: enable; 0: disable
			@sysvar::CH_Nodes::CH_SPCVehCarv_Stat_AR_UB__01 = 1;
			break;
		case (1):
			enableControl("VehCarv_Stat_AR", "CH_SPCVehCarv_Stat_AR_UB__01", 1); //1: enable; 0: disable
			break;
		case (2):
			enableControl("VehCarv_Stat_AR", "CH_SPCVehCarv_Stat_AR_UB__01", 0); //1: enable; 0: disable
			@sysvar::CH_Nodes::CH_SPCVehCarv_Stat_AR_UB__01 = 1;
			break;
		case (3):
			enableControl("VehCarv_Stat_AR", "CH_SPCVehCarv_Stat_AR_UB__01", 0); //1: enable; 0: disable
			@sysvar::CH_Nodes::CH_SPCVehCarv_Stat_AR_UB__01 = 0;
			break;
	}

	switch (@sysvar::CH_Nodes::CH_SPCVehLvl_Stat_AR2_UB_AUTO_01)
	{
		case (0):
			enableControl("VehLvl_Stat_AR2", "CH_SPCVehLvl_Stat_AR2_UB__01", 0); //1: enable; 0: disable
			@sysvar::CH_Nodes::CH_SPCVehLvl_Stat_AR2_UB__01 = 1;
			break;
		case (1):
			enableControl("VehLvl_Stat_AR2", "CH_SPCVehLvl_Stat_AR2_UB__01", 1); //1: enable; 0: disable
			break;
		case (2):
			enableControl("VehLvl_Stat_AR2", "CH_SPCVehLvl_Stat_AR2_UB__01", 0); //1: enable; 0: disable
			@sysvar::CH_Nodes::CH_SPCVehLvl_Stat_AR2_UB__01 = 1;
			break;
		case (3):
			enableControl("VehLvl_Stat_AR2", "CH_SPCVehLvl_Stat_AR2_UB__01", 0); //1: enable; 0: disable
			@sysvar::CH_Nodes::CH_SPCVehLvl_Stat_AR2_UB__01 = 0;
			break;
	}

	CRC_VehLvl_Stat_Pr2 = 0;
	SQC_VAL_VehLvl_Stat_Pr2 = 0;
	SQC_VehLvl_Stat_Pr2 = 0;
}
/*@@end*/

/*@@caplFunc:StopSim():*/
StopSim()
{
}
/*@@end*/

/*@@frPDU:MsgChannel1.CHASSIS::Eng_Rq_ABC_AR2:*/
on frPDU MsgChannel1.CHASSIS::Eng_Rq_ABC_AR2
{
}
/*@@end*/

/*@@frPDU:MsgChannel1.CHASSIS::OffRoad_Disp_Rq_AR:*/
on frPDU MsgChannel1.CHASSIS::OffRoad_Disp_Rq_AR
{
}
/*@@end*/

/*@@frPDU:MsgChannel1.CHASSIS::Preview_Data_SPC_AR:*/
on frPDU MsgChannel1.CHASSIS::Preview_Data_SPC_AR
{
}
/*@@end*/

/*@@frPDU:MsgChannel1.CHASSIS::ROE_MPU_FL:*/
on frPDU MsgChannel1.CHASSIS::ROE_MPU_FL
{
}
/*@@end*/

/*@@frPDU:MsgChannel1.CHASSIS::ROE_MPU_FR:*/
on frPDU MsgChannel1.CHASSIS::ROE_MPU_FR
{
}
/*@@end*/

/*@@frPDU:MsgChannel1.CHASSIS::ROE_MPU_RL:*/
on frPDU MsgChannel1.CHASSIS::ROE_MPU_RL
{
}
/*@@end*/

/*@@frPDU:MsgChannel1.CHASSIS::ROE_MPU_RR:*/
on frPDU MsgChannel1.CHASSIS::ROE_MPU_RR
{
}
/*@@end*/

/*@@frPDU:MsgChannel1.CHASSIS::ROE_SPC:*/
on frPDU MsgChannel1.CHASSIS::ROE_SPC
{
}
/*@@end*/

/*@@frPDU:MsgChannel1.CHASSIS::SPC_Disp_Rq_AR:*/
on frPDU MsgChannel1.CHASSIS::SPC_Disp_Rq_AR
{
}
/*@@end*/

/*@@frPDU:MsgChannel1.CHASSIS::SPC_SwLED_Msg_Rq_AR2:*/
on frPDU MsgChannel1.CHASSIS::SPC_SwLED_Msg_Rq_AR2
{
}
/*@@end*/

/*@@frPDU:MsgChannel1.CHASSIS::SpringVlv_Rq_AR:*/
on frPDU MsgChannel1.CHASSIS::SpringVlv_Rq_AR
{
}
/*@@end*/

/*@@frPDU:MsgChannel1.CHASSIS::VehCarv_Stat_AR:*/
on frPDU MsgChannel1.CHASSIS::VehCarv_Stat_AR
{
}
/*@@end*/

/*@@frPDU:MsgChannel1.CHASSIS::VehLvl_Stat_AR2:*/
on frPDU MsgChannel1.CHASSIS::VehLvl_Stat_AR2
{
}
/*@@end*/

