includes
{
	#include "ASR_FR_NM_IL.CIN"
}

/*
|==========================================================================================|
|                                                                                          |
|                                                                                          |
|                                         COPYRIGHT                                        |
|                                                                                          |
|                   Copyright (c) by Daimler AG Abt. RD/EEV 2015                           |
|                                                                                          |
|                                                                                          |
|==========================================================================================|
|                                                                                          |
|                                   CAPL AUTHOR IDENTITY                                   |
|                                   --------------------                                   |
|                                                                                          |
| Initials   | Name                 | Company                                              |
| -----------+----------------------+----------------------------------------------------- |
| BH         | Björn Haßelkus       | Firma TZM (EXTERN im Auftrag der Daimler AG)         |
| RS         | Rainer Schulte       | Firma TZM (EXTERN im Auftrag der Daimler AG)         |
|            |                      |                                                      |
|                                                                                          |
|==========================================================================================|
|                                                                                          |
|                                     REVISION HISTORY                                     |
|                                     ----------------                                     |
|                                                                                          |
| Date       | Ver   | Author       | Description                                          |
| -----------+-------+--------------+----------------------------------------------------- |
| 27.04.15   | 1.0   | RS           | creation                                             |
|            |       |              |                                                      |
|                                                                                          |
|------------------------------------------------------------------------------------------|
*/

variables
{
	long ret_Register;
	// global variable for getting (showing) results auf dll-Functions
	long result;

	int OldVal_EHC_Curr = 0;
	int OldVal_AddWtrPmp_On_Rq_ECM = 0;
	float OldVal_PNHV_Bat_Volt = 0;
	int OldVal_DCDC1_Md = 0;
	float OldVal_Therm_HiTempSTOut1 = 0;
	int CRC_DCDC1_Rs1_Pr2;
	dword CounterValForCRC_DCDC1_Rs1_Pr2;
	int SQC_VAL_DCDC1_Rs1_Pr2;
	int SQC_DCDC1_Rs1_Pr2;
	int CRC_EM01_Stat1_Pr2;
	dword CounterValForCRC_EM01_Stat1_Pr2;
	int SQC_VAL_EM01_Stat1_Pr2;
	int SQC_EM01_Stat1_Pr2;
	int CRC_EM01_Stat2_Pr2;
	dword CounterValForCRC_EM01_Stat2_Pr2;
	int SQC_VAL_EM01_Stat2_Pr2;
	int SQC_EM01_Stat2_Pr2;
	int CRC_EM01_Trq_Rs_Pr2;
	dword CounterValForCRC_EM01_Trq_Rs_Pr2;
	int SQC_VAL_EM01_Trq_Rs_Pr2;
	int SQC_EM01_Trq_Rs_Pr2;
	int CRC_Eng_Rs1_Pr2;
	dword CounterValForCRC_Eng_Rs1_Pr2;
	int SQC_VAL_Eng_Rs1_Pr2;
	int SQC_Eng_Rs1_Pr2;
	int CRC_Eng_Rs2_Pr2;
	dword CounterValForCRC_Eng_Rs2_Pr2;
	int SQC_VAL_Eng_Rs2_Pr2;
	int SQC_Eng_Rs2_Pr2;
	int CRC_Eng_Rs3_Pr2;
	dword CounterValForCRC_Eng_Rs3_Pr2;
	int SQC_VAL_Eng_Rs3_Pr2;
	int SQC_Eng_Rs3_Pr2;
	int CRC_Eng_Rs_EM_Pr2;
	dword CounterValForCRC_Eng_Rs_EM_Pr2;
	int SQC_VAL_Eng_Rs_EM_Pr2;
	int SQC_Eng_Rs_EM_Pr2;
	int CRC_Eng_Rs_EngCtrl_Pr2;
	dword CounterValForCRC_Eng_Rs_EngCtrl_Pr2;
	int SQC_VAL_Eng_Rs_EngCtrl_Pr2;
	int SQC_Eng_Rs_EngCtrl_Pr2;
	int CRC_PARK_Drv_Rs_TCM_Pr2;
	dword CounterValForCRC_PARK_Drv_Rs_TCM_Pr2;
	int SQC_VAL_PARK_Drv_Rs_TCM_Pr2;
	int SQC_PARK_Drv_Rs_TCM_Pr2;
	int OldVal_Term61_Actv = 0;
	int TGL_VAL_NM_CALID_CVN_ErrNum_;	
	int TGL_NM_CALID_CVN_ErrNum_;	
	int CRC_PNHV_Stat_Pr2;
	dword CounterValForCRC_PNHV_Stat_Pr2;
	int SQC_VAL_PNHV_Stat_Pr2;
	int SQC_PNHV_Stat_Pr2;
	FrPDU PNHV_WeekDepTmTbl_Stat_AR2 PDU_PNHV_WeekDepTmTbl_Stat_AR2;
	int CRC_PtMngmnt_Rq_Pr2;
	dword CounterValForCRC_PtMngmnt_Rq_Pr2;
	int SQC_VAL_PtMngmnt_Rq_Pr2;
	int SQC_PtMngmnt_Rq_Pr2;
	int CRC_PtMngmnt_Stat2_Pr2;
	dword CounterValForCRC_PtMngmnt_Stat2_Pr2;
	int SQC_VAL_PtMngmnt_Stat2_Pr2;
	int SQC_PtMngmnt_Stat2_Pr2;
	int CRC_PT_Stat_Pr2;
	dword CounterValForCRC_PT_Stat_Pr2;
	int SQC_VAL_PT_Stat_Pr2;
	int SQC_PT_Stat_Pr2;
	int CRC_ISM_TxDrvPosn_Disp_Rq_Pr2;
	dword CounterValForCRC_ISM_TxDrvPosn_Disp_Rq_Pr2;
	int SQC_VAL_ISM_TxDrvPosn_Disp_Rq_Pr2;
	int SQC_ISM_TxDrvPosn_Disp_Rq_Pr2;
	int CRC_SBW_Drv_Pk_Posn_TCM_Pr2;
	dword CounterValForCRC_SBW_Drv_Pk_Posn_TCM_Pr2;
	int SQC_VAL_SBW_Drv_Pk_Posn_TCM_Pr2;
	int SQC_SBW_Drv_Pk_Posn_TCM_Pr2;
	int CRC_SBW_Stat_Pr2;
	dword CounterValForCRC_SBW_Stat_Pr2;
	int SQC_VAL_SBW_Stat_Pr2;
	int SQC_SBW_Stat_Pr2;
	FrPDU TC_Disp_Rq_ECM_AR PDU_TC_Disp_Rq_ECM_AR;
	int CRC_TCM_Data2_Pr2;
	dword CounterValForCRC_TCM_Data2_Pr2;
	int SQC_VAL_TCM_Data2_Pr2;
	int SQC_TCM_Data2_Pr2;
	int CRC_TCM_Data3_Pr2;
	dword CounterValForCRC_TCM_Data3_Pr2;
	int SQC_VAL_TCM_Data3_Pr2;
	int SQC_TCM_Data3_Pr2;
	int CRC_EMM_Disp_Rq_Pr2;
	dword CounterValForCRC_EMM_Disp_Rq_Pr2;
	int SQC_VAL_EMM_Disp_Rq_Pr2;
	int SQC_EMM_Disp_Rq_Pr2;

	msTimer Timer_CPC_Adblue_Disp_Rq_AR;
	msTimer Timer_CPC_Adblue_Disp_Warn_Rq_AR;
	msTimer Timer_CPC_Assyst_Stat2_AR;
	msTimer Timer_CPC_Assyst_Stat3_AR2;
	msTimer Timer_CPC_Assyst_Stat_AR;
	msTimer Timer_CPC_CNG_Disp_Rq_AR2;
	msTimer Timer_CPC_CPC_CHASSIS_R1_AR2;
	msTimer Timer_CPC_CPC_CHASSIS_R2_AR2;
	msTimer Timer_CPC_DCDC1_Rs1_AR2;
	msTimer Timer_CPC_DPC_PT_Rs_AR;
	msTimer Timer_CPC_ECM_DAC4_AR;
	msTimer Timer_CPC_ECO_Homepage_Data;
	msTimer Timer_CPC_ECO_Score_Disp_Rq_AR;
	msTimer Timer_CPC_EM01_Stat1_AR2;
	msTimer Timer_CPC_EM01_Stat2_AR2;
	msTimer Timer_CPC_EM01_Trq_Rs_AR2;
	msTimer Timer_CPC_EM_DAC4_AR;
	msTimer Timer_CPC_EMM_Data1_AR2;
	msTimer Timer_CPC_EnergyMngmnt_PreCond_Stat_AR2;
	msTimer Timer_CPC_Eng_Rs_1_AR2;
	msTimer Timer_CPC_Eng_Rs_2_AR2;
	msTimer Timer_CPC_Eng_Rs_3_AR2;
	msTimer Timer_CPC_Eng_Rs_EM_AR2;
	msTimer Timer_CPC_Eng_Rs_EngCtrl_AR2;
	msTimer Timer_CPC_EngCtrl_Disp_Rq_AR2;
	msTimer Timer_CPC_EngCtrl_OBD1_AR;
	msTimer Timer_CPC_EngCtrl_Stat_AR2;
	msTimer Timer_CPC_ESP_OBD_Data_AR;
	msTimer Timer_CPC_Fuel_Stat2_AR2;
	msTimer Timer_CPC_FuelLvl_Stat_AR2;
	msTimer Timer_CPC_HumanMachineIfc_AR2;
	msTimer Timer_CPC_HumanMachineIfc_Rq_AR;
	msTimer Timer_CPC_ISM_DAC4_AR;
	msTimer Timer_CPC_OBL_DC_Output_AR;
	msTimer Timer_CPC_PARK_Drv_Rs_TCM_AR2;
	msTimer Timer_CPC_PN14_Gen_Rs_AR;
	msTimer Timer_CPC_PNHV_BMS_Stat_AR2;
	msTimer Timer_CPC_PNHV_EnergyMngmnt_Disp_Rq_AR;
	msTimer Timer_CPC_PNHV_EnergyMngmnt_Stat2_AR2;
	msTimer Timer_CPC_PNHV_EnergyMngmnt_Stat3_AR2;
	msTimer Timer_CPC_PNHV_EnergyMngmntSet_Rs1_AR2;
	msTimer Timer_CPC_PNHV_EnergyMngmntSet_Rs2_AR;
	msTimer Timer_CPC_PNHV_Stat_AR2;
	msTimer Timer_CPC_PNHV_WeekDepTmTbl_Stat_AR2;
	msTimer Timer_CPC_PT_DataContain_Rq_AR2;
	msTimer Timer_CPC_PT_Disp_Rq2_AR;
	msTimer Timer_CPC_PT_ThermM_AR2;
	msTimer Timer_CPC_PT_ThermM_Rq_AR2;
	msTimer Timer_CPC_PtHyb_Mngmnt_Rq1_AR;
	msTimer Timer_CPC_PtMngmnt_Disp_Rq_AR2;
	msTimer Timer_CPC_PtMngmnt_Rq_AR2;
	msTimer Timer_CPC_PtMngmnt_Stat2_AR2;
	msTimer Timer_CPC_PtMngmnt_Stat_AR2;
	msTimer Timer_CPC_SBW_DrvPosn_Disp_Rq_ISM_AR2;
	msTimer Timer_CPC_SBW_DrvPosn_Disp_Rq_TCM_AR2;
	msTimer Timer_CPC_SBW_Stat_AR2;
	msTimer Timer_CPC_SND_GEN_Stat_AR;
	msTimer Timer_CPC_TC_Disp_Rq_ECM_AR;
	msTimer Timer_CPC_TC_EBBC_Disp_Rq_ECM_AR;
	msTimer Timer_CPC_TC_EEBBC_Disp_Rq_AR;
	msTimer Timer_CPC_TCM_DAC4_AR;
	msTimer Timer_CPC_TCM_Data2_AR2;
	msTimer Timer_CPC_TCM_Data3_AR2;
	msTimer Timer_CPC_TCM_Disp_Rq_AMG_AR;
	msTimer Timer_CPC_TCM_State3_AR2;
	msTimer Timer_CPC_TCU_Disp_Rq_AR2;
	msTimer Timer_CPC_ThermMngmnt_1_AR2;
	msTimer Timer_CPC_ThermMngmnt_4_AR;
	msTimer Timer_CPC_ThermMngmnt_EV_1_AR2;
	msTimer Timer_CPC_VehPwrMngmnt_EMM_Stat2_AR2;
	msTimer Timer_CPC_VehPwrMngmnt_Rq_AR;
	msTimer Timer_CPC_WIA_EngTrq_AR;
	msTimer Timer_CPC_WPT_Stat2_AR2;

   byte  crctable[256] = {
      0x00, 0x1D, 0x3A, 0x27, 0x74, 0x69, 0x4E, 0x53,
      0xE8, 0xF5, 0xD2, 0xCF, 0x9C, 0x81, 0xA6, 0xBB,
      0xCD, 0xD0, 0xF7, 0xEA, 0xB9, 0xA4, 0x83, 0x9E,
      0x25, 0x38, 0x1F, 0x02, 0x51, 0x4C, 0x6B, 0x76,
      0x87, 0x9A, 0xBD, 0xA0, 0xF3, 0xEE, 0xC9, 0xD4,
      0x6F, 0x72, 0x55, 0x48, 0x1B, 0x06, 0x21, 0x3C,
      0x4A, 0x57, 0x70, 0x6D, 0x3E, 0x23, 0x04, 0x19,
      0xA2, 0xBF, 0x98, 0x85, 0xD6, 0xCB, 0xEC, 0xF1,
      0x13, 0x0E, 0x29, 0x34, 0x67, 0x7A, 0x5D, 0x40,
      0xFB, 0xE6, 0xC1, 0xDC, 0x8F, 0x92, 0xB5, 0xA8,
      0xDE, 0xC3, 0xE4, 0xF9, 0xAA, 0xB7, 0x90, 0x8D,
      0x36, 0x2B, 0x0C, 0x11, 0x42, 0x5F, 0x78, 0x65,
      0x94, 0x89, 0xAE, 0xB3, 0xE0, 0xFD, 0xDA, 0xC7,
      0x7C, 0x61, 0x46, 0x5B, 0x08, 0x15, 0x32, 0x2F,
      0x59, 0x44, 0x63, 0x7E, 0x2D, 0x30, 0x17, 0x0A,
      0xB1, 0xAC, 0x8B, 0x96, 0xC5, 0xD8, 0xFF, 0xE2,
      0x26, 0x3B, 0x1C, 0x01, 0x52, 0x4F, 0x68, 0x75,
      0xCE, 0xD3, 0xF4, 0xE9, 0xBA, 0xA7, 0x80, 0x9D,
      0xEB, 0xF6, 0xD1, 0xCC, 0x9F, 0x82, 0xA5, 0xB8,
      0x03, 0x1E, 0x39, 0x24, 0x77, 0x6A, 0x4D, 0x50,
      0xA1, 0xBC, 0x9B, 0x86, 0xD5, 0xC8, 0xEF, 0xF2,
      0x49, 0x54, 0x73, 0x6E, 0x3D, 0x20, 0x07, 0x1A,
      0x6C, 0x71, 0x56, 0x4B, 0x18, 0x05, 0x22, 0x3F,
      0x84, 0x99, 0xBE, 0xA3, 0xF0, 0xED, 0xCA, 0xD7,
      0x35, 0x28, 0x0F, 0x12, 0x41, 0x5C, 0x7B, 0x66,
      0xDD, 0xC0, 0xE7, 0xFA, 0xA9, 0xB4, 0x93, 0x8E,
      0xF8, 0xE5, 0xC2, 0xDF, 0x8C, 0x91, 0xB6, 0xAB,
      0x10, 0x0D, 0x2A, 0x37, 0x64, 0x79, 0x5E, 0x43,
      0xB2, 0xAF, 0x88, 0x95, 0xC6, 0xDB, 0xFC, 0xE1,
      0x5A, 0x47, 0x60, 0x7D, 0x2E, 0x33, 0x14, 0x09,
      0x7F, 0x62, 0x45, 0x58, 0x0B, 0x16, 0x31, 0x2C,
      0x97, 0x8A, 0xAD, 0xB0, 0xE3, 0xFE, 0xD9, 0xC4
   };

   byte  crctableProfTwo[256] = {
			0x00, 0x2F, 0x5E, 0x71, 0xBC, 0x93, 0xE2, 0xCD,
			0x57, 0x78, 0x09, 0x26, 0xEB, 0xC4, 0xB5, 0x9A,
			0xAE, 0x81, 0xF0, 0xDF, 0x12, 0x3D, 0x4C, 0x63,
			0xF9, 0xD6, 0xA7, 0x88, 0x45, 0x6A, 0x1B, 0x34,
			0x73, 0x5C, 0x2D, 0x02, 0xCF, 0xE0, 0x91, 0xBE,
			0x24, 0x0B, 0x7A, 0x55, 0x98, 0xB7, 0xC6, 0xE9,
			0xDD, 0xF2, 0x83, 0xAC, 0x61, 0x4E, 0x3F, 0x10,
			0x8A, 0xA5, 0xD4, 0xFB, 0x36, 0x19, 0x68, 0x47,
			0xE6, 0xC9, 0xB8, 0x97, 0x5A, 0x75, 0x04, 0x2B,
			0xB1, 0x9E, 0xEF, 0xC0, 0x0D, 0x22, 0x53, 0x7C,
			0x48, 0x67, 0x16, 0x39, 0xF4, 0xDB, 0xAA, 0x85,
			0x1F, 0x30, 0x41, 0x6E, 0xA3, 0x8C, 0xFD, 0xD2,
			0x95, 0xBA, 0xCB, 0xE4, 0x29, 0x06, 0x77, 0x58,
			0xC2, 0xED, 0x9C, 0xB3, 0x7E, 0x51, 0x20, 0x0F,
			0x3B, 0x14, 0x65, 0x4A, 0x87, 0xA8, 0xD9, 0xF6,
			0x6C, 0x43, 0x32, 0x1D, 0xD0, 0xFF, 0x8E, 0xA1,
			0xE3, 0xCC, 0xBD, 0x92, 0x5F, 0x70, 0x01, 0x2E,
			0xB4, 0x9B, 0xEA, 0xC5, 0x08, 0x27, 0x56, 0x79,
			0x4D, 0x62, 0x13, 0x3C, 0xF1, 0xDE, 0xAF, 0x80,
			0x1A, 0x35, 0x44, 0x6B, 0xA6, 0x89, 0xF8, 0xD7,
			0x90, 0xBF, 0xCE, 0xE1, 0x2C, 0x03, 0x72, 0x5D,
			0xC7, 0xE8, 0x99, 0xB6, 0x7B, 0x54, 0x25, 0x0A,
			0x3E, 0x11, 0x60, 0x4F, 0x82, 0xAD, 0xDC, 0xF3,
			0x69, 0x46, 0x37, 0x18, 0xD5, 0xFA, 0x8B, 0xA4,
			0x05, 0x2A, 0x5B, 0x74, 0xB9, 0x96, 0xE7, 0xC8,
			0x52, 0x7D, 0x0C, 0x23, 0xEE, 0xC1, 0xB0, 0x9F,
			0xAB, 0x84, 0xF5, 0xDA, 0x17, 0x38, 0x49, 0x66,
			0xFC, 0xD3, 0xA2, 0x8D, 0x40, 0x6F, 0x1E, 0x31,
			0x76, 0x59, 0x28, 0x07, 0xCA, 0xE5, 0x94, 0xBB,
			0x21, 0x0E, 0x7F, 0x50, 0x9D, 0xB2, 0xC3, 0xEC,
			0xD8, 0xF7, 0x86, 0xA9, 0x64, 0x4B, 0x3A, 0x15,
			0x8F, 0xA0, 0xD1, 0xFE, 0x33, 0x1C, 0x6D, 0x42
   };
}

on start
{
	result = EnableCRC("", 0); // 1 = on, 0 = off
	result = EnableTGL("", 0); // 1 = on, 0 = off 
	result = EnableSQC("", 0); // 1 = on, 0 = off 
	result = EnableMC("", 0); // 1 = on, 0 = off 

	@sysvar::CH_Nodes::CH__PDURECEIPT_SIM_CPC_Adblue_Disp_Rq_AR = 1;
	@sysvar::CH_Nodes::CH__PDURECEIPT_SIM_CPC_Adblue_Disp_Warn_Rq_AR = 1;
	@sysvar::CH_Nodes::CH__PDURECEIPT_SIM_CPC_Assyst_Stat2_AR = 1;
	@sysvar::CH_Nodes::CH__PDURECEIPT_SIM_CPC_Assyst_Stat3_AR2 = 1;
	@sysvar::CH_Nodes::CH__PDURECEIPT_SIM_CPC_Assyst_Stat_AR = 1;
	@sysvar::CH_Nodes::CH__PDURECEIPT_SIM_CPC_CNG_Disp_Rq_AR2 = 1;
	switch (@sysvar::CH_Nodes::CH_CPCEHC_CurrCPC_CHASSI_UB_AUTO)
	{
		case (0):
			enableControl("CPC_CHASSIS_R1_AR2", "CH_CPCEHC_CurrCPC_CHASSIS_R1_UB__UB", 0); //1: enable; 0: disable
			break;
		case (1):
			enableControl("CPC_CHASSIS_R1_AR2", "CH_CPCEHC_CurrCPC_CHASSIS_R1_UB__UB", 1); //1: enable; 0: disable
	 		break;
		case (2):
			enableControl("CPC_CHASSIS_R1_AR2", "CH_CPCEHC_CurrCPC_CHASSIS_R1_UB__UB", 0); //1: enable; 0: disable
			break;
		case (3):
			enableControl("CPC_CHASSIS_R1_AR2", "CH_CPCEHC_CurrCPC_CHASSIS_R1_UB__UB", 0); //1: enable; 0: disable
			break;
	}
	switch (@sysvar::CH_Nodes::CH_CPCAddWtrPmp_On_Rq_EC_UB_AUTO)
	{
		case (0):
			enableControl("CPC_CHASSIS_R1_AR2", "CH_CPCAddWtrPmp_On_Rq_ECMCPC_UB__UB", 0); //1: enable; 0: disable
			break;
		case (1):
			enableControl("CPC_CHASSIS_R1_AR2", "CH_CPCAddWtrPmp_On_Rq_ECMCPC_UB__UB", 1); //1: enable; 0: disable
	 		break;
		case (2):
			enableControl("CPC_CHASSIS_R1_AR2", "CH_CPCAddWtrPmp_On_Rq_ECMCPC_UB__UB", 0); //1: enable; 0: disable
			break;
		case (3):
			enableControl("CPC_CHASSIS_R1_AR2", "CH_CPCAddWtrPmp_On_Rq_ECMCPC_UB__UB", 0); //1: enable; 0: disable
			break;
	}
	switch (@sysvar::CH_Nodes::CH_CPCPNHV_Bat_VoltCPC_C_UB_AUTO)
	{
		case (0):
			enableControl("CPC_CHASSIS_R1_AR2", "CH_CPCPNHV_Bat_VoltCPC_CHASS_UB__UB", 0); //1: enable; 0: disable
			break;
		case (1):
			enableControl("CPC_CHASSIS_R1_AR2", "CH_CPCPNHV_Bat_VoltCPC_CHASS_UB__UB", 1); //1: enable; 0: disable
	 		break;
		case (2):
			enableControl("CPC_CHASSIS_R1_AR2", "CH_CPCPNHV_Bat_VoltCPC_CHASS_UB__UB", 0); //1: enable; 0: disable
			break;
		case (3):
			enableControl("CPC_CHASSIS_R1_AR2", "CH_CPCPNHV_Bat_VoltCPC_CHASS_UB__UB", 0); //1: enable; 0: disable
			break;
	}
	switch (@sysvar::CH_Nodes::CH_CPCDCDC1_MdCPC_CHASSI_UB_AUTO)
	{
		case (0):
			enableControl("CPC_CHASSIS_R1_AR2", "CH_CPCDCDC1_MdCPC_CHASSIS_R1_UB__UB", 0); //1: enable; 0: disable
			break;
		case (1):
			enableControl("CPC_CHASSIS_R1_AR2", "CH_CPCDCDC1_MdCPC_CHASSIS_R1_UB__UB", 1); //1: enable; 0: disable
	 		break;
		case (2):
			enableControl("CPC_CHASSIS_R1_AR2", "CH_CPCDCDC1_MdCPC_CHASSIS_R1_UB__UB", 0); //1: enable; 0: disable
			break;
		case (3):
			enableControl("CPC_CHASSIS_R1_AR2", "CH_CPCDCDC1_MdCPC_CHASSIS_R1_UB__UB", 0); //1: enable; 0: disable
			break;
	}
	switch (@sysvar::CH_Nodes::CH_CPCTherm_HiTempSTOut1_UB_AUTO)
	{
		case (0):
			enableControl("CPC_CHASSIS_R1_AR2", "CH_CPCTherm_HiTempSTOut1CPC__UB__UB", 0); //1: enable; 0: disable
			break;
		case (1):
			enableControl("CPC_CHASSIS_R1_AR2", "CH_CPCTherm_HiTempSTOut1CPC__UB__UB", 1); //1: enable; 0: disable
	 		break;
		case (2):
			enableControl("CPC_CHASSIS_R1_AR2", "CH_CPCTherm_HiTempSTOut1CPC__UB__UB", 0); //1: enable; 0: disable
			break;
		case (3):
			enableControl("CPC_CHASSIS_R1_AR2", "CH_CPCTherm_HiTempSTOut1CPC__UB__UB", 0); //1: enable; 0: disable
			break;
	}
	@sysvar::CH_Nodes::CH__PDURECEIPT_SIM_CPC_CPC_CHASSIS_R1_AR2 = 1;
	@sysvar::CH_Nodes::CH__PDURECEIPT_SIM_CPC_CPC_CHASSIS_R2_AR2 = 1;
	if (@sysvar::CH_Nodes::CH_CPCCRC_DCDC1_Rs1_Pr2DCDC_AUTO == 0)
	{
		//Automatisch
		enableControl("DCDC1_Rs1_AR2", "CH_CPCCRC_DCDC1_Rs1_Pr2DCDC1_Rs_", 0); //1: enable; 0: disable
	}
	else
	{
		//Manuel
		enableControl("DCDC1_Rs1_AR2", "CH_CPCCRC_DCDC1_Rs1_Pr2DCDC1_Rs_", 1); //1: enable; 0: disable
	}
	if (@sysvar::CH_Nodes::CH_CPCSQC_DCDC1_Rs1_Pr2DCDC_AUTO == 0)
	{
		//Automatisch
		enableControl("DCDC1_Rs1_AR2", "CH_CPCSQC_DCDC1_Rs1_Pr2DCDC1_Rs_", 0); //1: enable; 0: disable
	}
	else
	{
		//Manuel
		enableControl("DCDC1_Rs1_AR2", "CH_CPCSQC_DCDC1_Rs1_Pr2DCDC1_Rs_", 1); //1: enable; 0: disable
	}
	@sysvar::CH_Nodes::CH__PDURECEIPT_SIM_CPC_DCDC1_Rs1_AR2 = 1;
	@sysvar::CH_Nodes::CH__PDURECEIPT_SIM_CPC_DPC_PT_Rs_AR = 1;
	@sysvar::CH_Nodes::CH__PDURECEIPT_SIM_CPC_ECM_DAC4_AR = 1;
	@sysvar::CH_Nodes::CH__PDURECEIPT_SIM_CPC_ECO_Homepage_Data = 1;
	@sysvar::CH_Nodes::CH__PDURECEIPT_SIM_CPC_ECO_Score_Disp_Rq_AR = 1;
	if (@sysvar::CH_Nodes::CH_CPCCRC_EM01_Stat1_Pr2EM0_AUTO == 0)
	{
		//Automatisch
		enableControl("EM01_Stat1_AR2", "CH_CPCCRC_EM01_Stat1_Pr2EM01_St_", 0); //1: enable; 0: disable
	}
	else
	{
		//Manuel
		enableControl("EM01_Stat1_AR2", "CH_CPCCRC_EM01_Stat1_Pr2EM01_St_", 1); //1: enable; 0: disable
	}
	if (@sysvar::CH_Nodes::CH_CPCSQC_EM01_Stat1_Pr2EM0_AUTO == 0)
	{
		//Automatisch
		enableControl("EM01_Stat1_AR2", "CH_CPCSQC_EM01_Stat1_Pr2EM01_St_", 0); //1: enable; 0: disable
	}
	else
	{
		//Manuel
		enableControl("EM01_Stat1_AR2", "CH_CPCSQC_EM01_Stat1_Pr2EM01_St_", 1); //1: enable; 0: disable
	}
	@sysvar::CH_Nodes::CH__PDURECEIPT_SIM_CPC_EM01_Stat1_AR2 = 1;
	if (@sysvar::CH_Nodes::CH_CPCCRC_EM01_Stat2_Pr2EM0_AUTO == 0)
	{
		//Automatisch
		enableControl("EM01_Stat2_AR2", "CH_CPCCRC_EM01_Stat2_Pr2EM01_St_", 0); //1: enable; 0: disable
	}
	else
	{
		//Manuel
		enableControl("EM01_Stat2_AR2", "CH_CPCCRC_EM01_Stat2_Pr2EM01_St_", 1); //1: enable; 0: disable
	}
	if (@sysvar::CH_Nodes::CH_CPCSQC_EM01_Stat2_Pr2EM0_AUTO == 0)
	{
		//Automatisch
		enableControl("EM01_Stat2_AR2", "CH_CPCSQC_EM01_Stat2_Pr2EM01_St_", 0); //1: enable; 0: disable
	}
	else
	{
		//Manuel
		enableControl("EM01_Stat2_AR2", "CH_CPCSQC_EM01_Stat2_Pr2EM01_St_", 1); //1: enable; 0: disable
	}
	@sysvar::CH_Nodes::CH__PDURECEIPT_SIM_CPC_EM01_Stat2_AR2 = 1;
	if (@sysvar::CH_Nodes::CH_CPCCRC_EM01_Trq_Rs_Pr2EM_AUTO == 0)
	{
		//Automatisch
		enableControl("EM01_Trq_Rs_AR2", "CH_CPCCRC_EM01_Trq_Rs_Pr2EM01_T_", 0); //1: enable; 0: disable
	}
	else
	{
		//Manuel
		enableControl("EM01_Trq_Rs_AR2", "CH_CPCCRC_EM01_Trq_Rs_Pr2EM01_T_", 1); //1: enable; 0: disable
	}
	if (@sysvar::CH_Nodes::CH_CPCSQC_EM01_Trq_Rs_Pr2EM_AUTO == 0)
	{
		//Automatisch
		enableControl("EM01_Trq_Rs_AR2", "CH_CPCSQC_EM01_Trq_Rs_Pr2EM01_T_", 0); //1: enable; 0: disable
	}
	else
	{
		//Manuel
		enableControl("EM01_Trq_Rs_AR2", "CH_CPCSQC_EM01_Trq_Rs_Pr2EM01_T_", 1); //1: enable; 0: disable
	}
	@sysvar::CH_Nodes::CH__PDURECEIPT_SIM_CPC_EM01_Trq_Rs_AR2 = 1;
	@sysvar::CH_Nodes::CH__PDURECEIPT_SIM_CPC_EM_DAC4_AR = 1;
	@sysvar::CH_Nodes::CH__PDURECEIPT_SIM_CPC_EMM_Data1_AR2 = 1;
	@sysvar::CH_Nodes::CH__PDURECEIPT_SIM_CPC_EnergyMngmnt_PreCond_Stat_AR2 = 1;
	if (@sysvar::CH_Nodes::CH_CPCCRC_Eng_Rs1_Pr2Eng_Rs_AUTO == 0)
	{
		//Automatisch
		enableControl("Eng_Rs_1_AR2", "CH_CPCCRC_Eng_Rs1_Pr2Eng_Rs_1_A_", 0); //1: enable; 0: disable
	}
	else
	{
		//Manuel
		enableControl("Eng_Rs_1_AR2", "CH_CPCCRC_Eng_Rs1_Pr2Eng_Rs_1_A_", 1); //1: enable; 0: disable
	}
	if (@sysvar::CH_Nodes::CH_CPCSQC_Eng_Rs1_Pr2Eng_Rs_AUTO == 0)
	{
		//Automatisch
		enableControl("Eng_Rs_1_AR2", "CH_CPCSQC_Eng_Rs1_Pr2Eng_Rs_1_A_", 0); //1: enable; 0: disable
	}
	else
	{
		//Manuel
		enableControl("Eng_Rs_1_AR2", "CH_CPCSQC_Eng_Rs1_Pr2Eng_Rs_1_A_", 1); //1: enable; 0: disable
	}
	@sysvar::CH_Nodes::CH__PDURECEIPT_SIM_CPC_Eng_Rs_1_AR2 = 1;
	if (@sysvar::CH_Nodes::CH_CPCCRC_Eng_Rs2_Pr2Eng_Rs_AUTO == 0)
	{
		//Automatisch
		enableControl("Eng_Rs_2_AR2", "CH_CPCCRC_Eng_Rs2_Pr2Eng_Rs_2_A_", 0); //1: enable; 0: disable
	}
	else
	{
		//Manuel
		enableControl("Eng_Rs_2_AR2", "CH_CPCCRC_Eng_Rs2_Pr2Eng_Rs_2_A_", 1); //1: enable; 0: disable
	}
	if (@sysvar::CH_Nodes::CH_CPCSQC_Eng_Rs2_Pr2Eng_Rs_AUTO == 0)
	{
		//Automatisch
		enableControl("Eng_Rs_2_AR2", "CH_CPCSQC_Eng_Rs2_Pr2Eng_Rs_2_A_", 0); //1: enable; 0: disable
	}
	else
	{
		//Manuel
		enableControl("Eng_Rs_2_AR2", "CH_CPCSQC_Eng_Rs2_Pr2Eng_Rs_2_A_", 1); //1: enable; 0: disable
	}
	@sysvar::CH_Nodes::CH__PDURECEIPT_SIM_CPC_Eng_Rs_2_AR2 = 1;
	if (@sysvar::CH_Nodes::CH_CPCCRC_Eng_Rs3_Pr2Eng_Rs_AUTO == 0)
	{
		//Automatisch
		enableControl("Eng_Rs_3_AR2", "CH_CPCCRC_Eng_Rs3_Pr2Eng_Rs_3_A_", 0); //1: enable; 0: disable
	}
	else
	{
		//Manuel
		enableControl("Eng_Rs_3_AR2", "CH_CPCCRC_Eng_Rs3_Pr2Eng_Rs_3_A_", 1); //1: enable; 0: disable
	}
	if (@sysvar::CH_Nodes::CH_CPCSQC_Eng_Rs3_Pr2Eng_Rs_AUTO == 0)
	{
		//Automatisch
		enableControl("Eng_Rs_3_AR2", "CH_CPCSQC_Eng_Rs3_Pr2Eng_Rs_3_A_", 0); //1: enable; 0: disable
	}
	else
	{
		//Manuel
		enableControl("Eng_Rs_3_AR2", "CH_CPCSQC_Eng_Rs3_Pr2Eng_Rs_3_A_", 1); //1: enable; 0: disable
	}
	@sysvar::CH_Nodes::CH__PDURECEIPT_SIM_CPC_Eng_Rs_3_AR2 = 1;
	if (@sysvar::CH_Nodes::CH_CPCCRC_Eng_Rs_EM_Pr2Eng__AUTO == 0)
	{
		//Automatisch
		enableControl("Eng_Rs_EM_AR2", "CH_CPCCRC_Eng_Rs_EM_Pr2Eng_Rs_E_", 0); //1: enable; 0: disable
	}
	else
	{
		//Manuel
		enableControl("Eng_Rs_EM_AR2", "CH_CPCCRC_Eng_Rs_EM_Pr2Eng_Rs_E_", 1); //1: enable; 0: disable
	}
	if (@sysvar::CH_Nodes::CH_CPCSQC_Eng_Rs_EM_Pr2Eng__AUTO == 0)
	{
		//Automatisch
		enableControl("Eng_Rs_EM_AR2", "CH_CPCSQC_Eng_Rs_EM_Pr2Eng_Rs_E_", 0); //1: enable; 0: disable
	}
	else
	{
		//Manuel
		enableControl("Eng_Rs_EM_AR2", "CH_CPCSQC_Eng_Rs_EM_Pr2Eng_Rs_E_", 1); //1: enable; 0: disable
	}
	@sysvar::CH_Nodes::CH__PDURECEIPT_SIM_CPC_Eng_Rs_EM_AR2 = 1;
	if (@sysvar::CH_Nodes::CH_CPCCRC_Eng_Rs_EngCtrl_Pr_AUTO == 0)
	{
		//Automatisch
		enableControl("Eng_Rs_EngCtrl_AR2", "CH_CPCCRC_Eng_Rs_EngCtrl_Pr2Eng_", 0); //1: enable; 0: disable
	}
	else
	{
		//Manuel
		enableControl("Eng_Rs_EngCtrl_AR2", "CH_CPCCRC_Eng_Rs_EngCtrl_Pr2Eng_", 1); //1: enable; 0: disable
	}
	if (@sysvar::CH_Nodes::CH_CPCSQC_Eng_Rs_EngCtrl_Pr_AUTO == 0)
	{
		//Automatisch
		enableControl("Eng_Rs_EngCtrl_AR2", "CH_CPCSQC_Eng_Rs_EngCtrl_Pr2Eng_", 0); //1: enable; 0: disable
	}
	else
	{
		//Manuel
		enableControl("Eng_Rs_EngCtrl_AR2", "CH_CPCSQC_Eng_Rs_EngCtrl_Pr2Eng_", 1); //1: enable; 0: disable
	}
	@sysvar::CH_Nodes::CH__PDURECEIPT_SIM_CPC_Eng_Rs_EngCtrl_AR2 = 1;
	@sysvar::CH_Nodes::CH__PDURECEIPT_SIM_CPC_EngCtrl_Disp_Rq_AR2 = 1;
	@sysvar::CH_Nodes::CH__PDURECEIPT_SIM_CPC_EngCtrl_OBD1_AR = 1;
	@sysvar::CH_Nodes::CH__PDURECEIPT_SIM_CPC_EngCtrl_Stat_AR2 = 1;
	@sysvar::CH_Nodes::CH__PDURECEIPT_SIM_CPC_ESP_OBD_Data_AR = 1;
	@sysvar::CH_Nodes::CH__PDURECEIPT_SIM_CPC_Fuel_Stat2_AR2 = 1;
	@sysvar::CH_Nodes::CH__PDURECEIPT_SIM_CPC_FuelLvl_Stat_AR2 = 1;
	@sysvar::CH_Nodes::CH__PDURECEIPT_SIM_CPC_HumanMachineIfc_AR2 = 1;
	@sysvar::CH_Nodes::CH__PDURECEIPT_SIM_CPC_HumanMachineIfc_Rq_AR = 1;
	@sysvar::CH_Nodes::CH__PDURECEIPT_SIM_CPC_ISM_DAC4_AR = 1;
	@sysvar::CH_Nodes::CH__PDURECEIPT_SIM_CPC_OBL_DC_Output_AR = 1;
	if (@sysvar::CH_Nodes::CH_CPCCRC_PARK_Drv_Rs_TCM_P_AUTO == 0)
	{
		//Automatisch
		enableControl("PARK_Drv_Rs_TCM_AR2", "CH_CPCCRC_PARK_Drv_Rs_TCM_Pr2PA_", 0); //1: enable; 0: disable
	}
	else
	{
		//Manuel
		enableControl("PARK_Drv_Rs_TCM_AR2", "CH_CPCCRC_PARK_Drv_Rs_TCM_Pr2PA_", 1); //1: enable; 0: disable
	}
	if (@sysvar::CH_Nodes::CH_CPCSQC_PARK_Drv_Rs_TCM_P_AUTO == 0)
	{
		//Automatisch
		enableControl("PARK_Drv_Rs_TCM_AR2", "CH_CPCSQC_PARK_Drv_Rs_TCM_Pr2PA_", 0); //1: enable; 0: disable
	}
	else
	{
		//Manuel
		enableControl("PARK_Drv_Rs_TCM_AR2", "CH_CPCSQC_PARK_Drv_Rs_TCM_Pr2PA_", 1); //1: enable; 0: disable
	}
	@sysvar::CH_Nodes::CH__PDURECEIPT_SIM_CPC_PARK_Drv_Rs_TCM_AR2 = 1;
	@sysvar::CH_Nodes::CH__PDURECEIPT_SIM_CPC_PN14_Gen_Rs_AR = 1;
	@sysvar::CH_Nodes::CH__PDURECEIPT_SIM_CPC_PNHV_BMS_Stat_AR2 = 1;
	@sysvar::CH_Nodes::CH__PDURECEIPT_SIM_CPC_PNHV_EnergyMngmnt_Disp_Rq_AR = 1;
	switch (@sysvar::CH_Nodes::CH_CPCTerm61_ActvPNHV_En_UB_AUTO)
	{
		case (0):
			enableControl("PNHV_EnergyMngmnt_Stat2_AR2", "CH_CPCTerm61_ActvPNHV_Energy_UB__UB", 0); //1: enable; 0: disable
			break;
		case (1):
			enableControl("PNHV_EnergyMngmnt_Stat2_AR2", "CH_CPCTerm61_ActvPNHV_Energy_UB__UB", 1); //1: enable; 0: disable
	 		break;
		case (2):
			enableControl("PNHV_EnergyMngmnt_Stat2_AR2", "CH_CPCTerm61_ActvPNHV_Energy_UB__UB", 0); //1: enable; 0: disable
			break;
		case (3):
			enableControl("PNHV_EnergyMngmnt_Stat2_AR2", "CH_CPCTerm61_ActvPNHV_Energy_UB__UB", 0); //1: enable; 0: disable
			break;
	}
	@sysvar::CH_Nodes::CH__PDURECEIPT_SIM_CPC_PNHV_EnergyMngmnt_Stat2_AR2 = 1;
	if (@sysvar::CH_Nodes::CH_CPCPNM_CALID_CVN_ErrNum__AUTO == 0)
	{
		//Automatisch
		enableControl("PNHV_EnergyMngmnt_Stat3_AR2", "CH_CPCPNM_CALID_CVN_ErrNum_TglP_", 0); //1: enable; 0: disable
	}
	else
	{
		//Manuel
		enableControl("PNHV_EnergyMngmnt_Stat3_AR2", "CH_CPCPNM_CALID_CVN_ErrNum_TglP_", 1); //1: enable; 0: disable
	}
	@sysvar::CH_Nodes::CH__PDURECEIPT_SIM_CPC_PNHV_EnergyMngmnt_Stat3_AR2 = 1;
	@sysvar::CH_Nodes::CH__PDURECEIPT_SIM_CPC_PNHV_EnergyMngmntSet_Rs1_AR2 = 1;
	@sysvar::CH_Nodes::CH__PDURECEIPT_SIM_CPC_PNHV_EnergyMngmntSet_Rs2_AR = 1;
	if (@sysvar::CH_Nodes::CH_CPCCRC_PNHV_Stat_Pr2PNHV_AUTO == 0)
	{
		//Automatisch
		enableControl("PNHV_Stat_AR2", "CH_CPCCRC_PNHV_Stat_Pr2PNHV_Sta_", 0); //1: enable; 0: disable
	}
	else
	{
		//Manuel
		enableControl("PNHV_Stat_AR2", "CH_CPCCRC_PNHV_Stat_Pr2PNHV_Sta_", 1); //1: enable; 0: disable
	}
	if (@sysvar::CH_Nodes::CH_CPCSQC_PNHV_Stat_Pr2PNHV_AUTO == 0)
	{
		//Automatisch
		enableControl("PNHV_Stat_AR2", "CH_CPCSQC_PNHV_Stat_Pr2PNHV_Sta_", 0); //1: enable; 0: disable
	}
	else
	{
		//Manuel
		enableControl("PNHV_Stat_AR2", "CH_CPCSQC_PNHV_Stat_Pr2PNHV_Sta_", 1); //1: enable; 0: disable
	}
	@sysvar::CH_Nodes::CH__PDURECEIPT_SIM_CPC_PNHV_Stat_AR2 = 1;
	ret_Register = RegisterSignalDriver(PNHV_WeekDepTmTbl_TxActv,"callback_PNHV_WeekDepTmTbl_Stat_AR2PNHV_WeekDepTmTbl_TxActv");
	ret_Register = RegisterSignalDriver(PNHV_WeekDepTmTbl_New,"callback_PNHV_WeekDepTmTbl_Stat_AR2PNHV_WeekDepTmTbl_New");
	@sysvar::CH_Nodes::CH__PDURECEIPT_SIM_CPC_PNHV_WeekDepTmTbl_Stat_AR2 = 1;
	@sysvar::CH_Nodes::CH__PDURECEIPT_SIM_CPC_PT_DataContain_Rq_AR2 = 1;
	@sysvar::CH_Nodes::CH__PDURECEIPT_SIM_CPC_PT_Disp_Rq2_AR = 1;
	@sysvar::CH_Nodes::CH__PDURECEIPT_SIM_CPC_PT_ThermM_AR2 = 1;
	@sysvar::CH_Nodes::CH__PDURECEIPT_SIM_CPC_PT_ThermM_Rq_AR2 = 1;
	@sysvar::CH_Nodes::CH__PDURECEIPT_SIM_CPC_PtHyb_Mngmnt_Rq1_AR = 1;
	@sysvar::CH_Nodes::CH__PDURECEIPT_SIM_CPC_PtMngmnt_Disp_Rq_AR2 = 1;
	if (@sysvar::CH_Nodes::CH_CPCCRC_PtMngmnt_Rq_Pr2Pt_AUTO == 0)
	{
		//Automatisch
		enableControl("PtMngmnt_Rq_AR2", "CH_CPCCRC_PtMngmnt_Rq_Pr2PtMngm_", 0); //1: enable; 0: disable
	}
	else
	{
		//Manuel
		enableControl("PtMngmnt_Rq_AR2", "CH_CPCCRC_PtMngmnt_Rq_Pr2PtMngm_", 1); //1: enable; 0: disable
	}
	if (@sysvar::CH_Nodes::CH_CPCSQC_PtMngmnt_Rq_Pr2Pt_AUTO == 0)
	{
		//Automatisch
		enableControl("PtMngmnt_Rq_AR2", "CH_CPCSQC_PtMngmnt_Rq_Pr2PtMngm_", 0); //1: enable; 0: disable
	}
	else
	{
		//Manuel
		enableControl("PtMngmnt_Rq_AR2", "CH_CPCSQC_PtMngmnt_Rq_Pr2PtMngm_", 1); //1: enable; 0: disable
	}
	@sysvar::CH_Nodes::CH__PDURECEIPT_SIM_CPC_PtMngmnt_Rq_AR2 = 1;
	if (@sysvar::CH_Nodes::CH_CPCCRC_PtMngmnt_Stat2_Pr_AUTO == 0)
	{
		//Automatisch
		enableControl("PtMngmnt_Stat2_AR2", "CH_CPCCRC_PtMngmnt_Stat2_Pr2PtM_", 0); //1: enable; 0: disable
	}
	else
	{
		//Manuel
		enableControl("PtMngmnt_Stat2_AR2", "CH_CPCCRC_PtMngmnt_Stat2_Pr2PtM_", 1); //1: enable; 0: disable
	}
	if (@sysvar::CH_Nodes::CH_CPCSQC_PtMngmnt_Stat2_Pr_AUTO == 0)
	{
		//Automatisch
		enableControl("PtMngmnt_Stat2_AR2", "CH_CPCSQC_PtMngmnt_Stat2_Pr2PtM_", 0); //1: enable; 0: disable
	}
	else
	{
		//Manuel
		enableControl("PtMngmnt_Stat2_AR2", "CH_CPCSQC_PtMngmnt_Stat2_Pr2PtM_", 1); //1: enable; 0: disable
	}
	@sysvar::CH_Nodes::CH__PDURECEIPT_SIM_CPC_PtMngmnt_Stat2_AR2 = 1;
	if (@sysvar::CH_Nodes::CH_CPCCRC_PT_Stat_Pr2PtMngm_AUTO == 0)
	{
		//Automatisch
		enableControl("PtMngmnt_Stat_AR2", "CH_CPCCRC_PT_Stat_Pr2PtMngmnt_S_", 0); //1: enable; 0: disable
	}
	else
	{
		//Manuel
		enableControl("PtMngmnt_Stat_AR2", "CH_CPCCRC_PT_Stat_Pr2PtMngmnt_S_", 1); //1: enable; 0: disable
	}
	if (@sysvar::CH_Nodes::CH_CPCSQC_PT_Stat_Pr2PtMngm_AUTO == 0)
	{
		//Automatisch
		enableControl("PtMngmnt_Stat_AR2", "CH_CPCSQC_PT_Stat_Pr2PtMngmnt_S_", 0); //1: enable; 0: disable
	}
	else
	{
		//Manuel
		enableControl("PtMngmnt_Stat_AR2", "CH_CPCSQC_PT_Stat_Pr2PtMngmnt_S_", 1); //1: enable; 0: disable
	}
	@sysvar::CH_Nodes::CH__PDURECEIPT_SIM_CPC_PtMngmnt_Stat_AR2 = 1;
	if (@sysvar::CH_Nodes::CH_CPCCRC_ISM_TxDrvPosn_Dis_AUTO == 0)
	{
		//Automatisch
		enableControl("SBW_DrvPosn_Disp_Rq_ISM_AR2", "CH_CPCCRC_ISM_TxDrvPosn_Disp_Rq_", 0); //1: enable; 0: disable
	}
	else
	{
		//Manuel
		enableControl("SBW_DrvPosn_Disp_Rq_ISM_AR2", "CH_CPCCRC_ISM_TxDrvPosn_Disp_Rq_", 1); //1: enable; 0: disable
	}
	if (@sysvar::CH_Nodes::CH_CPCSQC_ISM_TxDrvPosn_Dis_AUTO == 0)
	{
		//Automatisch
		enableControl("SBW_DrvPosn_Disp_Rq_ISM_AR2", "CH_CPCSQC_ISM_TxDrvPosn_Disp_Rq_", 0); //1: enable; 0: disable
	}
	else
	{
		//Manuel
		enableControl("SBW_DrvPosn_Disp_Rq_ISM_AR2", "CH_CPCSQC_ISM_TxDrvPosn_Disp_Rq_", 1); //1: enable; 0: disable
	}
	@sysvar::CH_Nodes::CH__PDURECEIPT_SIM_CPC_SBW_DrvPosn_Disp_Rq_ISM_AR2 = 1;
	if (@sysvar::CH_Nodes::CH_CPCCRC_SBW_Drv_Pk_Posn_T_AUTO == 0)
	{
		//Automatisch
		enableControl("SBW_DrvPosn_Disp_Rq_TCM_AR2", "CH_CPCCRC_SBW_Drv_Pk_Posn_TCM_P_", 0); //1: enable; 0: disable
	}
	else
	{
		//Manuel
		enableControl("SBW_DrvPosn_Disp_Rq_TCM_AR2", "CH_CPCCRC_SBW_Drv_Pk_Posn_TCM_P_", 1); //1: enable; 0: disable
	}
	if (@sysvar::CH_Nodes::CH_CPCSQC_SBW_Drv_Pk_Posn_T_AUTO == 0)
	{
		//Automatisch
		enableControl("SBW_DrvPosn_Disp_Rq_TCM_AR2", "CH_CPCSQC_SBW_Drv_Pk_Posn_TCM_P_", 0); //1: enable; 0: disable
	}
	else
	{
		//Manuel
		enableControl("SBW_DrvPosn_Disp_Rq_TCM_AR2", "CH_CPCSQC_SBW_Drv_Pk_Posn_TCM_P_", 1); //1: enable; 0: disable
	}
	@sysvar::CH_Nodes::CH__PDURECEIPT_SIM_CPC_SBW_DrvPosn_Disp_Rq_TCM_AR2 = 1;
	if (@sysvar::CH_Nodes::CH_CPCCRC_SBW_Stat_Pr2SBW_S_AUTO == 0)
	{
		//Automatisch
		enableControl("SBW_Stat_AR2", "CH_CPCCRC_SBW_Stat_Pr2SBW_Stat__", 0); //1: enable; 0: disable
	}
	else
	{
		//Manuel
		enableControl("SBW_Stat_AR2", "CH_CPCCRC_SBW_Stat_Pr2SBW_Stat__", 1); //1: enable; 0: disable
	}
	if (@sysvar::CH_Nodes::CH_CPCSQC_SBW_Stat_Pr2SBW_S_AUTO == 0)
	{
		//Automatisch
		enableControl("SBW_Stat_AR2", "CH_CPCSQC_SBW_Stat_Pr2SBW_Stat__", 0); //1: enable; 0: disable
	}
	else
	{
		//Manuel
		enableControl("SBW_Stat_AR2", "CH_CPCSQC_SBW_Stat_Pr2SBW_Stat__", 1); //1: enable; 0: disable
	}
	@sysvar::CH_Nodes::CH__PDURECEIPT_SIM_CPC_SBW_Stat_AR2 = 1;
	@sysvar::CH_Nodes::CH__PDURECEIPT_SIM_CPC_SND_GEN_Stat_AR = 1;
	ret_Register = RegisterSignalDriver(TC_PN14_RecupPwr,"callback_TC_Disp_Rq_ECM_ARTC_PN14_RecupPwr");
	ret_Register = RegisterSignalDriver(ZeroEmission_Actv,"callback_TC_Disp_Rq_ECM_ARZeroEmission_Actv");
	@sysvar::CH_Nodes::CH__PDURECEIPT_SIM_CPC_TC_Disp_Rq_ECM_AR = 1;
	@sysvar::CH_Nodes::CH__PDURECEIPT_SIM_CPC_TC_EBBC_Disp_Rq_ECM_AR = 1;
	@sysvar::CH_Nodes::CH__PDURECEIPT_SIM_CPC_TC_EEBBC_Disp_Rq_AR = 1;
	@sysvar::CH_Nodes::CH__PDURECEIPT_SIM_CPC_TCM_DAC4_AR = 1;
	if (@sysvar::CH_Nodes::CH_CPCCRC_TCM_Data2_Pr2TCM__AUTO == 0)
	{
		//Automatisch
		enableControl("TCM_Data2_AR2", "CH_CPCCRC_TCM_Data2_Pr2TCM_Data_", 0); //1: enable; 0: disable
	}
	else
	{
		//Manuel
		enableControl("TCM_Data2_AR2", "CH_CPCCRC_TCM_Data2_Pr2TCM_Data_", 1); //1: enable; 0: disable
	}
	if (@sysvar::CH_Nodes::CH_CPCSQC_TCM_Data2_Pr2TCM__AUTO == 0)
	{
		//Automatisch
		enableControl("TCM_Data2_AR2", "CH_CPCSQC_TCM_Data2_Pr2TCM_Data_", 0); //1: enable; 0: disable
	}
	else
	{
		//Manuel
		enableControl("TCM_Data2_AR2", "CH_CPCSQC_TCM_Data2_Pr2TCM_Data_", 1); //1: enable; 0: disable
	}
	@sysvar::CH_Nodes::CH__PDURECEIPT_SIM_CPC_TCM_Data2_AR2 = 1;
	if (@sysvar::CH_Nodes::CH_CPCCRC_TCM_Data3_Pr2TCM__AUTO == 0)
	{
		//Automatisch
		enableControl("TCM_Data3_AR2", "CH_CPCCRC_TCM_Data3_Pr2TCM_Data_", 0); //1: enable; 0: disable
	}
	else
	{
		//Manuel
		enableControl("TCM_Data3_AR2", "CH_CPCCRC_TCM_Data3_Pr2TCM_Data_", 1); //1: enable; 0: disable
	}
	if (@sysvar::CH_Nodes::CH_CPCSQC_TCM_Data3_Pr2TCM__AUTO == 0)
	{
		//Automatisch
		enableControl("TCM_Data3_AR2", "CH_CPCSQC_TCM_Data3_Pr2TCM_Data_", 0); //1: enable; 0: disable
	}
	else
	{
		//Manuel
		enableControl("TCM_Data3_AR2", "CH_CPCSQC_TCM_Data3_Pr2TCM_Data_", 1); //1: enable; 0: disable
	}
	@sysvar::CH_Nodes::CH__PDURECEIPT_SIM_CPC_TCM_Data3_AR2 = 1;
	@sysvar::CH_Nodes::CH__PDURECEIPT_SIM_CPC_TCM_Disp_Rq_AMG_AR = 1;
	@sysvar::CH_Nodes::CH__PDURECEIPT_SIM_CPC_TCM_State3_AR2 = 1;
	@sysvar::CH_Nodes::CH__PDURECEIPT_SIM_CPC_TCU_Disp_Rq_AR2 = 1;
	@sysvar::CH_Nodes::CH__PDURECEIPT_SIM_CPC_ThermMngmnt_1_AR2 = 1;
	@sysvar::CH_Nodes::CH__PDURECEIPT_SIM_CPC_ThermMngmnt_4_AR = 1;
	@sysvar::CH_Nodes::CH__PDURECEIPT_SIM_CPC_ThermMngmnt_EV_1_AR2 = 1;
	if (@sysvar::CH_Nodes::CH_CPCCRC_EMM_Disp_Rq_Pr2Ve_AUTO == 0)
	{
		//Automatisch
		enableControl("VehPwrMngmnt_EMM_Stat2_AR2", "CH_CPCCRC_EMM_Disp_Rq_Pr2VehPwr_", 0); //1: enable; 0: disable
	}
	else
	{
		//Manuel
		enableControl("VehPwrMngmnt_EMM_Stat2_AR2", "CH_CPCCRC_EMM_Disp_Rq_Pr2VehPwr_", 1); //1: enable; 0: disable
	}
	if (@sysvar::CH_Nodes::CH_CPCSQC_EMM_Disp_Rq_Pr2Ve_AUTO == 0)
	{
		//Automatisch
		enableControl("VehPwrMngmnt_EMM_Stat2_AR2", "CH_CPCSQC_EMM_Disp_Rq_Pr2VehPwr_", 0); //1: enable; 0: disable
	}
	else
	{
		//Manuel
		enableControl("VehPwrMngmnt_EMM_Stat2_AR2", "CH_CPCSQC_EMM_Disp_Rq_Pr2VehPwr_", 1); //1: enable; 0: disable
	}
	@sysvar::CH_Nodes::CH__PDURECEIPT_SIM_CPC_VehPwrMngmnt_EMM_Stat2_AR2 = 1;
	@sysvar::CH_Nodes::CH__PDURECEIPT_SIM_CPC_VehPwrMngmnt_Rq_AR = 1;
	@sysvar::CH_Nodes::CH__PDURECEIPT_SIM_CPC_WIA_EngTrq_AR = 1;
	@sysvar::CH_Nodes::CH__PDURECEIPT_SIM_CPC_WPT_Stat2_AR2 = 1;
	// netzwerk management

	enableControl("CHASSIS_FR Netzmanagement", "CH__NMActive_CPC", 1);
}

on preStart
{

	FrSetSendPDU(PDU_PNHV_WeekDepTmTbl_Stat_AR2);
	FrSetSendPDU(PDU_TC_Disp_Rq_ECM_AR);

}

on timer Timer_CPC_Adblue_Disp_Rq_AR
{
	@sysvar::CH_Nodes::CH__STPDU_CPC_Adblue_Disp_Rq_AR = 0;
}

on timer Timer_CPC_Adblue_Disp_Warn_Rq_AR
{
	@sysvar::CH_Nodes::CH__STPDU_CPC_Adblue_Disp_Warn_Rq_AR = 0;
}

on timer Timer_CPC_Assyst_Stat2_AR
{
	@sysvar::CH_Nodes::CH__STPDU_CPC_Assyst_Stat2_AR = 0;
}

on timer Timer_CPC_Assyst_Stat3_AR2
{
	@sysvar::CH_Nodes::CH__STPDU_CPC_Assyst_Stat3_AR2 = 0;
}

on timer Timer_CPC_Assyst_Stat_AR
{
	@sysvar::CH_Nodes::CH__STPDU_CPC_Assyst_Stat_AR = 0;
}

on timer Timer_CPC_CNG_Disp_Rq_AR2
{
	@sysvar::CH_Nodes::CH__STPDU_CPC_CNG_Disp_Rq_AR2 = 0;
}

on timer Timer_CPC_CPC_CHASSIS_R1_AR2
{
	@sysvar::CH_Nodes::CH__STPDU_CPC_CPC_CHASSIS_R1_AR2 = 0;
}

on timer Timer_CPC_CPC_CHASSIS_R2_AR2
{
	@sysvar::CH_Nodes::CH__STPDU_CPC_CPC_CHASSIS_R2_AR2 = 0;
}

on timer Timer_CPC_DCDC1_Rs1_AR2
{
	@sysvar::CH_Nodes::CH__STPDU_CPC_DCDC1_Rs1_AR2 = 0;
}

on timer Timer_CPC_DPC_PT_Rs_AR
{
	@sysvar::CH_Nodes::CH__STPDU_CPC_DPC_PT_Rs_AR = 0;
}

on timer Timer_CPC_ECM_DAC4_AR
{
	@sysvar::CH_Nodes::CH__STPDU_CPC_ECM_DAC4_AR = 0;
}

on timer Timer_CPC_ECO_Homepage_Data
{
	@sysvar::CH_Nodes::CH__STPDU_CPC_ECO_Homepage_Data = 0;
}

on timer Timer_CPC_ECO_Score_Disp_Rq_AR
{
	@sysvar::CH_Nodes::CH__STPDU_CPC_ECO_Score_Disp_Rq_AR = 0;
}

on timer Timer_CPC_EM01_Stat1_AR2
{
	@sysvar::CH_Nodes::CH__STPDU_CPC_EM01_Stat1_AR2 = 0;
}

on timer Timer_CPC_EM01_Stat2_AR2
{
	@sysvar::CH_Nodes::CH__STPDU_CPC_EM01_Stat2_AR2 = 0;
}

on timer Timer_CPC_EM01_Trq_Rs_AR2
{
	@sysvar::CH_Nodes::CH__STPDU_CPC_EM01_Trq_Rs_AR2 = 0;
}

on timer Timer_CPC_EM_DAC4_AR
{
	@sysvar::CH_Nodes::CH__STPDU_CPC_EM_DAC4_AR = 0;
}

on timer Timer_CPC_EMM_Data1_AR2
{
	@sysvar::CH_Nodes::CH__STPDU_CPC_EMM_Data1_AR2 = 0;
}

on timer Timer_CPC_EnergyMngmnt_PreCond_Stat_AR2
{
	@sysvar::CH_Nodes::CH__STPDU_CPC_EnergyMngmnt_PreCond_Stat_AR2 = 0;
}

on timer Timer_CPC_Eng_Rs_1_AR2
{
	@sysvar::CH_Nodes::CH__STPDU_CPC_Eng_Rs_1_AR2 = 0;
}

on timer Timer_CPC_Eng_Rs_2_AR2
{
	@sysvar::CH_Nodes::CH__STPDU_CPC_Eng_Rs_2_AR2 = 0;
}

on timer Timer_CPC_Eng_Rs_3_AR2
{
	@sysvar::CH_Nodes::CH__STPDU_CPC_Eng_Rs_3_AR2 = 0;
}

on timer Timer_CPC_Eng_Rs_EM_AR2
{
	@sysvar::CH_Nodes::CH__STPDU_CPC_Eng_Rs_EM_AR2 = 0;
}

on timer Timer_CPC_Eng_Rs_EngCtrl_AR2
{
	@sysvar::CH_Nodes::CH__STPDU_CPC_Eng_Rs_EngCtrl_AR2 = 0;
}

on timer Timer_CPC_EngCtrl_Disp_Rq_AR2
{
	@sysvar::CH_Nodes::CH__STPDU_CPC_EngCtrl_Disp_Rq_AR2 = 0;
}

on timer Timer_CPC_EngCtrl_OBD1_AR
{
	@sysvar::CH_Nodes::CH__STPDU_CPC_EngCtrl_OBD1_AR = 0;
}

on timer Timer_CPC_EngCtrl_Stat_AR2
{
	@sysvar::CH_Nodes::CH__STPDU_CPC_EngCtrl_Stat_AR2 = 0;
}

on timer Timer_CPC_ESP_OBD_Data_AR
{
	@sysvar::CH_Nodes::CH__STPDU_CPC_ESP_OBD_Data_AR = 0;
}

on timer Timer_CPC_Fuel_Stat2_AR2
{
	@sysvar::CH_Nodes::CH__STPDU_CPC_Fuel_Stat2_AR2 = 0;
}

on timer Timer_CPC_FuelLvl_Stat_AR2
{
	@sysvar::CH_Nodes::CH__STPDU_CPC_FuelLvl_Stat_AR2 = 0;
}

on timer Timer_CPC_HumanMachineIfc_AR2
{
	@sysvar::CH_Nodes::CH__STPDU_CPC_HumanMachineIfc_AR2 = 0;
}

on timer Timer_CPC_HumanMachineIfc_Rq_AR
{
	@sysvar::CH_Nodes::CH__STPDU_CPC_HumanMachineIfc_Rq_AR = 0;
}

on timer Timer_CPC_ISM_DAC4_AR
{
	@sysvar::CH_Nodes::CH__STPDU_CPC_ISM_DAC4_AR = 0;
}

on timer Timer_CPC_OBL_DC_Output_AR
{
	@sysvar::CH_Nodes::CH__STPDU_CPC_OBL_DC_Output_AR = 0;
}

on timer Timer_CPC_PARK_Drv_Rs_TCM_AR2
{
	@sysvar::CH_Nodes::CH__STPDU_CPC_PARK_Drv_Rs_TCM_AR2 = 0;
}

on timer Timer_CPC_PN14_Gen_Rs_AR
{
	@sysvar::CH_Nodes::CH__STPDU_CPC_PN14_Gen_Rs_AR = 0;
}

on timer Timer_CPC_PNHV_BMS_Stat_AR2
{
	@sysvar::CH_Nodes::CH__STPDU_CPC_PNHV_BMS_Stat_AR2 = 0;
}

on timer Timer_CPC_PNHV_EnergyMngmnt_Disp_Rq_AR
{
	@sysvar::CH_Nodes::CH__STPDU_CPC_PNHV_EnergyMngmnt_Disp_Rq_AR = 0;
}

on timer Timer_CPC_PNHV_EnergyMngmnt_Stat2_AR2
{
	@sysvar::CH_Nodes::CH__STPDU_CPC_PNHV_EnergyMngmnt_Stat2_AR2 = 0;
}

on timer Timer_CPC_PNHV_EnergyMngmnt_Stat3_AR2
{
	@sysvar::CH_Nodes::CH__STPDU_CPC_PNHV_EnergyMngmnt_Stat3_AR2 = 0;
}

on timer Timer_CPC_PNHV_EnergyMngmntSet_Rs1_AR2
{
	@sysvar::CH_Nodes::CH__STPDU_CPC_PNHV_EnergyMngmntSet_Rs1_AR2 = 0;
}

on timer Timer_CPC_PNHV_EnergyMngmntSet_Rs2_AR
{
	@sysvar::CH_Nodes::CH__STPDU_CPC_PNHV_EnergyMngmntSet_Rs2_AR = 0;
}

on timer Timer_CPC_PNHV_Stat_AR2
{
	@sysvar::CH_Nodes::CH__STPDU_CPC_PNHV_Stat_AR2 = 0;
}

on timer Timer_CPC_PNHV_WeekDepTmTbl_Stat_AR2
{
	@sysvar::CH_Nodes::CH__STPDU_CPC_PNHV_WeekDepTmTbl_Stat_AR2 = 0;
}

on timer Timer_CPC_PT_DataContain_Rq_AR2
{
	@sysvar::CH_Nodes::CH__STPDU_CPC_PT_DataContain_Rq_AR2 = 0;
}

on timer Timer_CPC_PT_Disp_Rq2_AR
{
	@sysvar::CH_Nodes::CH__STPDU_CPC_PT_Disp_Rq2_AR = 0;
}

on timer Timer_CPC_PT_ThermM_AR2
{
	@sysvar::CH_Nodes::CH__STPDU_CPC_PT_ThermM_AR2 = 0;
}

on timer Timer_CPC_PT_ThermM_Rq_AR2
{
	@sysvar::CH_Nodes::CH__STPDU_CPC_PT_ThermM_Rq_AR2 = 0;
}

on timer Timer_CPC_PtHyb_Mngmnt_Rq1_AR
{
	@sysvar::CH_Nodes::CH__STPDU_CPC_PtHyb_Mngmnt_Rq1_AR = 0;
}

on timer Timer_CPC_PtMngmnt_Disp_Rq_AR2
{
	@sysvar::CH_Nodes::CH__STPDU_CPC_PtMngmnt_Disp_Rq_AR2 = 0;
}

on timer Timer_CPC_PtMngmnt_Rq_AR2
{
	@sysvar::CH_Nodes::CH__STPDU_CPC_PtMngmnt_Rq_AR2 = 0;
}

on timer Timer_CPC_PtMngmnt_Stat2_AR2
{
	@sysvar::CH_Nodes::CH__STPDU_CPC_PtMngmnt_Stat2_AR2 = 0;
}

on timer Timer_CPC_PtMngmnt_Stat_AR2
{
	@sysvar::CH_Nodes::CH__STPDU_CPC_PtMngmnt_Stat_AR2 = 0;
}

on timer Timer_CPC_SBW_DrvPosn_Disp_Rq_ISM_AR2
{
	@sysvar::CH_Nodes::CH__STPDU_CPC_SBW_DrvPosn_Disp_Rq_ISM_AR2 = 0;
}

on timer Timer_CPC_SBW_DrvPosn_Disp_Rq_TCM_AR2
{
	@sysvar::CH_Nodes::CH__STPDU_CPC_SBW_DrvPosn_Disp_Rq_TCM_AR2 = 0;
}

on timer Timer_CPC_SBW_Stat_AR2
{
	@sysvar::CH_Nodes::CH__STPDU_CPC_SBW_Stat_AR2 = 0;
}

on timer Timer_CPC_SND_GEN_Stat_AR
{
	@sysvar::CH_Nodes::CH__STPDU_CPC_SND_GEN_Stat_AR = 0;
}

on timer Timer_CPC_TC_Disp_Rq_ECM_AR
{
	@sysvar::CH_Nodes::CH__STPDU_CPC_TC_Disp_Rq_ECM_AR = 0;
}

on timer Timer_CPC_TC_EBBC_Disp_Rq_ECM_AR
{
	@sysvar::CH_Nodes::CH__STPDU_CPC_TC_EBBC_Disp_Rq_ECM_AR = 0;
}

on timer Timer_CPC_TC_EEBBC_Disp_Rq_AR
{
	@sysvar::CH_Nodes::CH__STPDU_CPC_TC_EEBBC_Disp_Rq_AR = 0;
}

on timer Timer_CPC_TCM_DAC4_AR
{
	@sysvar::CH_Nodes::CH__STPDU_CPC_TCM_DAC4_AR = 0;
}

on timer Timer_CPC_TCM_Data2_AR2
{
	@sysvar::CH_Nodes::CH__STPDU_CPC_TCM_Data2_AR2 = 0;
}

on timer Timer_CPC_TCM_Data3_AR2
{
	@sysvar::CH_Nodes::CH__STPDU_CPC_TCM_Data3_AR2 = 0;
}

on timer Timer_CPC_TCM_Disp_Rq_AMG_AR
{
	@sysvar::CH_Nodes::CH__STPDU_CPC_TCM_Disp_Rq_AMG_AR = 0;
}

on timer Timer_CPC_TCM_State3_AR2
{
	@sysvar::CH_Nodes::CH__STPDU_CPC_TCM_State3_AR2 = 0;
}

on timer Timer_CPC_TCU_Disp_Rq_AR2
{
	@sysvar::CH_Nodes::CH__STPDU_CPC_TCU_Disp_Rq_AR2 = 0;
}

on timer Timer_CPC_ThermMngmnt_1_AR2
{
	@sysvar::CH_Nodes::CH__STPDU_CPC_ThermMngmnt_1_AR2 = 0;
}

on timer Timer_CPC_ThermMngmnt_4_AR
{
	@sysvar::CH_Nodes::CH__STPDU_CPC_ThermMngmnt_4_AR = 0;
}

on timer Timer_CPC_ThermMngmnt_EV_1_AR2
{
	@sysvar::CH_Nodes::CH__STPDU_CPC_ThermMngmnt_EV_1_AR2 = 0;
}

on timer Timer_CPC_VehPwrMngmnt_EMM_Stat2_AR2
{
	@sysvar::CH_Nodes::CH__STPDU_CPC_VehPwrMngmnt_EMM_Stat2_AR2 = 0;
}

on timer Timer_CPC_VehPwrMngmnt_Rq_AR
{
	@sysvar::CH_Nodes::CH__STPDU_CPC_VehPwrMngmnt_Rq_AR = 0;
}

on timer Timer_CPC_WIA_EngTrq_AR
{
	@sysvar::CH_Nodes::CH__STPDU_CPC_WIA_EngTrq_AR = 0;
}

on timer Timer_CPC_WPT_Stat2_AR2
{
	@sysvar::CH_Nodes::CH__STPDU_CPC_WPT_Stat2_AR2 = 0;
}



on sysvar sysvar::CH_Nodes::CH__STPDU_CPC_Adblue_Disp_Rq_AR
{
	long res;
	long tDelay;
	switch (@this)
	{
		case (0):
			res = ResetTimingCyclic("Adblue_Disp_Rq_AR");
			res = ResetTimingEvtTrg("Adblue_Disp_Rq_AR");
			res = EnableTimingCyclic("Adblue_Disp_Rq_AR", 1);
			res = EnableTimingEvtTrg("Adblue_Disp_Rq_AR", 1);
			break;
		case (1):
			tDelay = @sysvar::CH_Nodes::CH__STPDU_T_CPC_Adblue_Disp_Rq_AR;
			if (tDelay > 0)
			{
				if (isTimerActive(Timer_CPC_Adblue_Disp_Rq_AR) == 0)
				{
					res = SetTimingCyclic("Adblue_Disp_Rq_AR", 1, tDelay, 1);
					setTimer (Timer_CPC_Adblue_Disp_Rq_AR, tDelay);
					@sysvar::CH_Nodes::CH__STPDU_CPC_Adblue_Disp_Rq_AR = 2;
				}
			}
			else if (tDelay == 0)
			{
				if (isTimerActive(Timer_CPC_Adblue_Disp_Rq_AR) == 0)
				{
					res = EnableTimingCyclic("Adblue_Disp_Rq_AR", 0);
					res = EnableTimingEvtTrg("Adblue_Disp_Rq_AR", 0);
				}
			}
			break;
		case (2):
			break;
		default:
			Write("error: wrong parameter (%d)", @this);
			stop();
			break;
	}
}

on sysvar sysvar::CH_Nodes::CH__STPDU_CPC_Adblue_Disp_Warn_Rq_AR
{
	long res;
	long tDelay;
	switch (@this)
	{
		case (0):
			res = ResetTimingCyclic("Adblue_Disp_Warn_Rq_AR");
			res = ResetTimingEvtTrg("Adblue_Disp_Warn_Rq_AR");
			res = EnableTimingCyclic("Adblue_Disp_Warn_Rq_AR", 1);
			res = EnableTimingEvtTrg("Adblue_Disp_Warn_Rq_AR", 1);
			break;
		case (1):
			tDelay = @sysvar::CH_Nodes::CH__STPDU_T_CPC_Adblue_Disp_Warn_Rq_AR;
			if (tDelay > 0)
			{
				if (isTimerActive(Timer_CPC_Adblue_Disp_Warn_Rq_AR) == 0)
				{
					res = SetTimingCyclic("Adblue_Disp_Warn_Rq_AR", 1, tDelay, 1);
					setTimer (Timer_CPC_Adblue_Disp_Warn_Rq_AR, tDelay);
					@sysvar::CH_Nodes::CH__STPDU_CPC_Adblue_Disp_Warn_Rq_AR = 2;
				}
			}
			else if (tDelay == 0)
			{
				if (isTimerActive(Timer_CPC_Adblue_Disp_Warn_Rq_AR) == 0)
				{
					res = EnableTimingCyclic("Adblue_Disp_Warn_Rq_AR", 0);
					res = EnableTimingEvtTrg("Adblue_Disp_Warn_Rq_AR", 0);
				}
			}
			break;
		case (2):
			break;
		default:
			Write("error: wrong parameter (%d)", @this);
			stop();
			break;
	}
}

on sysvar sysvar::CH_Nodes::CH__STPDU_CPC_Assyst_Stat2_AR
{
	long res;
	long tDelay;
	switch (@this)
	{
		case (0):
			res = ResetTimingCyclic("Assyst_Stat2_AR");
			res = ResetTimingEvtTrg("Assyst_Stat2_AR");
			res = EnableTimingCyclic("Assyst_Stat2_AR", 1);
			res = EnableTimingEvtTrg("Assyst_Stat2_AR", 1);
			break;
		case (1):
			tDelay = @sysvar::CH_Nodes::CH__STPDU_T_CPC_Assyst_Stat2_AR;
			if (tDelay > 0)
			{
				if (isTimerActive(Timer_CPC_Assyst_Stat2_AR) == 0)
				{
					res = SetTimingCyclic("Assyst_Stat2_AR", 1, tDelay, 1);
					setTimer (Timer_CPC_Assyst_Stat2_AR, tDelay);
					@sysvar::CH_Nodes::CH__STPDU_CPC_Assyst_Stat2_AR = 2;
				}
			}
			else if (tDelay == 0)
			{
				if (isTimerActive(Timer_CPC_Assyst_Stat2_AR) == 0)
				{
					res = EnableTimingCyclic("Assyst_Stat2_AR", 0);
					res = EnableTimingEvtTrg("Assyst_Stat2_AR", 0);
				}
			}
			break;
		case (2):
			break;
		default:
			Write("error: wrong parameter (%d)", @this);
			stop();
			break;
	}
}

on sysvar sysvar::CH_Nodes::CH__STPDU_CPC_Assyst_Stat3_AR2
{
	long res;
	long tDelay;
	switch (@this)
	{
		case (0):
			res = ResetTimingCyclic("Assyst_Stat3_AR2");
			res = ResetTimingEvtTrg("Assyst_Stat3_AR2");
			res = EnableTimingCyclic("Assyst_Stat3_AR2", 1);
			res = EnableTimingEvtTrg("Assyst_Stat3_AR2", 1);
			break;
		case (1):
			tDelay = @sysvar::CH_Nodes::CH__STPDU_T_CPC_Assyst_Stat3_AR2;
			if (tDelay > 0)
			{
				if (isTimerActive(Timer_CPC_Assyst_Stat3_AR2) == 0)
				{
					res = SetTimingCyclic("Assyst_Stat3_AR2", 1, tDelay, 1);
					setTimer (Timer_CPC_Assyst_Stat3_AR2, tDelay);
					@sysvar::CH_Nodes::CH__STPDU_CPC_Assyst_Stat3_AR2 = 2;
				}
			}
			else if (tDelay == 0)
			{
				if (isTimerActive(Timer_CPC_Assyst_Stat3_AR2) == 0)
				{
					res = EnableTimingCyclic("Assyst_Stat3_AR2", 0);
					res = EnableTimingEvtTrg("Assyst_Stat3_AR2", 0);
				}
			}
			break;
		case (2):
			break;
		default:
			Write("error: wrong parameter (%d)", @this);
			stop();
			break;
	}
}

on sysvar sysvar::CH_Nodes::CH__STPDU_CPC_Assyst_Stat_AR
{
	long res;
	long tDelay;
	switch (@this)
	{
		case (0):
			res = ResetTimingCyclic("Assyst_Stat_AR");
			res = ResetTimingEvtTrg("Assyst_Stat_AR");
			res = EnableTimingCyclic("Assyst_Stat_AR", 1);
			res = EnableTimingEvtTrg("Assyst_Stat_AR", 1);
			break;
		case (1):
			tDelay = @sysvar::CH_Nodes::CH__STPDU_T_CPC_Assyst_Stat_AR;
			if (tDelay > 0)
			{
				if (isTimerActive(Timer_CPC_Assyst_Stat_AR) == 0)
				{
					res = SetTimingCyclic("Assyst_Stat_AR", 1, tDelay, 1);
					setTimer (Timer_CPC_Assyst_Stat_AR, tDelay);
					@sysvar::CH_Nodes::CH__STPDU_CPC_Assyst_Stat_AR = 2;
				}
			}
			else if (tDelay == 0)
			{
				if (isTimerActive(Timer_CPC_Assyst_Stat_AR) == 0)
				{
					res = EnableTimingCyclic("Assyst_Stat_AR", 0);
					res = EnableTimingEvtTrg("Assyst_Stat_AR", 0);
				}
			}
			break;
		case (2):
			break;
		default:
			Write("error: wrong parameter (%d)", @this);
			stop();
			break;
	}
}

on sysvar sysvar::CH_Nodes::CH__STPDU_CPC_CNG_Disp_Rq_AR2
{
	long res;
	long tDelay;
	switch (@this)
	{
		case (0):
			res = ResetTimingCyclic("CNG_Disp_Rq_AR2");
			res = ResetTimingEvtTrg("CNG_Disp_Rq_AR2");
			res = EnableTimingCyclic("CNG_Disp_Rq_AR2", 1);
			res = EnableTimingEvtTrg("CNG_Disp_Rq_AR2", 1);
			break;
		case (1):
			tDelay = @sysvar::CH_Nodes::CH__STPDU_T_CPC_CNG_Disp_Rq_AR2;
			if (tDelay > 0)
			{
				if (isTimerActive(Timer_CPC_CNG_Disp_Rq_AR2) == 0)
				{
					res = SetTimingCyclic("CNG_Disp_Rq_AR2", 1, tDelay, 1);
					setTimer (Timer_CPC_CNG_Disp_Rq_AR2, tDelay);
					@sysvar::CH_Nodes::CH__STPDU_CPC_CNG_Disp_Rq_AR2 = 2;
				}
			}
			else if (tDelay == 0)
			{
				if (isTimerActive(Timer_CPC_CNG_Disp_Rq_AR2) == 0)
				{
					res = EnableTimingCyclic("CNG_Disp_Rq_AR2", 0);
					res = EnableTimingEvtTrg("CNG_Disp_Rq_AR2", 0);
				}
			}
			break;
		case (2):
			break;
		default:
			Write("error: wrong parameter (%d)", @this);
			stop();
			break;
	}
}

on sysvar sysvar::CH_Nodes::CH__STPDU_CPC_CPC_CHASSIS_R1_AR2
{
	long res;
	long tDelay;
	switch (@this)
	{
		case (0):
			res = ResetTimingCyclic("CPC_CHASSIS_R1_AR2");
			res = ResetTimingEvtTrg("CPC_CHASSIS_R1_AR2");
			res = EnableTimingCyclic("CPC_CHASSIS_R1_AR2", 1);
			res = EnableTimingEvtTrg("CPC_CHASSIS_R1_AR2", 1);
			break;
		case (1):
			tDelay = @sysvar::CH_Nodes::CH__STPDU_T_CPC_CPC_CHASSIS_R1_AR2;
			if (tDelay > 0)
			{
				if (isTimerActive(Timer_CPC_CPC_CHASSIS_R1_AR2) == 0)
				{
					res = SetTimingCyclic("CPC_CHASSIS_R1_AR2", 1, tDelay, 1);
					setTimer (Timer_CPC_CPC_CHASSIS_R1_AR2, tDelay);
					@sysvar::CH_Nodes::CH__STPDU_CPC_CPC_CHASSIS_R1_AR2 = 2;
				}
			}
			else if (tDelay == 0)
			{
				if (isTimerActive(Timer_CPC_CPC_CHASSIS_R1_AR2) == 0)
				{
					res = EnableTimingCyclic("CPC_CHASSIS_R1_AR2", 0);
					res = EnableTimingEvtTrg("CPC_CHASSIS_R1_AR2", 0);
				}
			}
			break;
		case (2):
			break;
		default:
			Write("error: wrong parameter (%d)", @this);
			stop();
			break;
	}
}

on sysvar sysvar::CH_Nodes::CH__STPDU_CPC_CPC_CHASSIS_R2_AR2
{
	long res;
	long tDelay;
	switch (@this)
	{
		case (0):
			res = ResetTimingCyclic("CPC_CHASSIS_R2_AR2");
			res = ResetTimingEvtTrg("CPC_CHASSIS_R2_AR2");
			res = EnableTimingCyclic("CPC_CHASSIS_R2_AR2", 1);
			res = EnableTimingEvtTrg("CPC_CHASSIS_R2_AR2", 1);
			break;
		case (1):
			tDelay = @sysvar::CH_Nodes::CH__STPDU_T_CPC_CPC_CHASSIS_R2_AR2;
			if (tDelay > 0)
			{
				if (isTimerActive(Timer_CPC_CPC_CHASSIS_R2_AR2) == 0)
				{
					res = SetTimingCyclic("CPC_CHASSIS_R2_AR2", 1, tDelay, 1);
					setTimer (Timer_CPC_CPC_CHASSIS_R2_AR2, tDelay);
					@sysvar::CH_Nodes::CH__STPDU_CPC_CPC_CHASSIS_R2_AR2 = 2;
				}
			}
			else if (tDelay == 0)
			{
				if (isTimerActive(Timer_CPC_CPC_CHASSIS_R2_AR2) == 0)
				{
					res = EnableTimingCyclic("CPC_CHASSIS_R2_AR2", 0);
					res = EnableTimingEvtTrg("CPC_CHASSIS_R2_AR2", 0);
				}
			}
			break;
		case (2):
			break;
		default:
			Write("error: wrong parameter (%d)", @this);
			stop();
			break;
	}
}

on sysvar sysvar::CH_Nodes::CH__STPDU_CPC_DCDC1_Rs1_AR2
{
	long res;
	long tDelay;
	switch (@this)
	{
		case (0):
			res = ResetTimingCyclic("DCDC1_Rs1_AR2");
			res = ResetTimingEvtTrg("DCDC1_Rs1_AR2");
			res = EnableTimingCyclic("DCDC1_Rs1_AR2", 1);
			res = EnableTimingEvtTrg("DCDC1_Rs1_AR2", 1);
			break;
		case (1):
			tDelay = @sysvar::CH_Nodes::CH__STPDU_T_CPC_DCDC1_Rs1_AR2;
			if (tDelay > 0)
			{
				if (isTimerActive(Timer_CPC_DCDC1_Rs1_AR2) == 0)
				{
					res = SetTimingCyclic("DCDC1_Rs1_AR2", 1, tDelay, 1);
					setTimer (Timer_CPC_DCDC1_Rs1_AR2, tDelay);
					@sysvar::CH_Nodes::CH__STPDU_CPC_DCDC1_Rs1_AR2 = 2;
				}
			}
			else if (tDelay == 0)
			{
				if (isTimerActive(Timer_CPC_DCDC1_Rs1_AR2) == 0)
				{
					res = EnableTimingCyclic("DCDC1_Rs1_AR2", 0);
					res = EnableTimingEvtTrg("DCDC1_Rs1_AR2", 0);
				}
			}
			break;
		case (2):
			break;
		default:
			Write("error: wrong parameter (%d)", @this);
			stop();
			break;
	}
}

on sysvar sysvar::CH_Nodes::CH__STPDU_CPC_DPC_PT_Rs_AR
{
	long res;
	long tDelay;
	switch (@this)
	{
		case (0):
			res = ResetTimingCyclic("DPC_PT_Rs_AR");
			res = ResetTimingEvtTrg("DPC_PT_Rs_AR");
			res = EnableTimingCyclic("DPC_PT_Rs_AR", 1);
			res = EnableTimingEvtTrg("DPC_PT_Rs_AR", 1);
			break;
		case (1):
			tDelay = @sysvar::CH_Nodes::CH__STPDU_T_CPC_DPC_PT_Rs_AR;
			if (tDelay > 0)
			{
				if (isTimerActive(Timer_CPC_DPC_PT_Rs_AR) == 0)
				{
					res = SetTimingCyclic("DPC_PT_Rs_AR", 1, tDelay, 1);
					setTimer (Timer_CPC_DPC_PT_Rs_AR, tDelay);
					@sysvar::CH_Nodes::CH__STPDU_CPC_DPC_PT_Rs_AR = 2;
				}
			}
			else if (tDelay == 0)
			{
				if (isTimerActive(Timer_CPC_DPC_PT_Rs_AR) == 0)
				{
					res = EnableTimingCyclic("DPC_PT_Rs_AR", 0);
					res = EnableTimingEvtTrg("DPC_PT_Rs_AR", 0);
				}
			}
			break;
		case (2):
			break;
		default:
			Write("error: wrong parameter (%d)", @this);
			stop();
			break;
	}
}

on sysvar sysvar::CH_Nodes::CH__STPDU_CPC_ECM_DAC4_AR
{
	long res;
	long tDelay;
	switch (@this)
	{
		case (0):
			res = ResetTimingCyclic("ECM_DAC4_AR");
			res = ResetTimingEvtTrg("ECM_DAC4_AR");
			res = EnableTimingCyclic("ECM_DAC4_AR", 1);
			res = EnableTimingEvtTrg("ECM_DAC4_AR", 1);
			break;
		case (1):
			tDelay = @sysvar::CH_Nodes::CH__STPDU_T_CPC_ECM_DAC4_AR;
			if (tDelay > 0)
			{
				if (isTimerActive(Timer_CPC_ECM_DAC4_AR) == 0)
				{
					res = SetTimingCyclic("ECM_DAC4_AR", 1, tDelay, 1);
					setTimer (Timer_CPC_ECM_DAC4_AR, tDelay);
					@sysvar::CH_Nodes::CH__STPDU_CPC_ECM_DAC4_AR = 2;
				}
			}
			else if (tDelay == 0)
			{
				if (isTimerActive(Timer_CPC_ECM_DAC4_AR) == 0)
				{
					res = EnableTimingCyclic("ECM_DAC4_AR", 0);
					res = EnableTimingEvtTrg("ECM_DAC4_AR", 0);
				}
			}
			break;
		case (2):
			break;
		default:
			Write("error: wrong parameter (%d)", @this);
			stop();
			break;
	}
}

on sysvar sysvar::CH_Nodes::CH__STPDU_CPC_ECO_Homepage_Data
{
	long res;
	long tDelay;
	switch (@this)
	{
		case (0):
			res = ResetTimingCyclic("ECO_Homepage_Data");
			res = ResetTimingEvtTrg("ECO_Homepage_Data");
			res = EnableTimingCyclic("ECO_Homepage_Data", 1);
			res = EnableTimingEvtTrg("ECO_Homepage_Data", 1);
			break;
		case (1):
			tDelay = @sysvar::CH_Nodes::CH__STPDU_T_CPC_ECO_Homepage_Data;
			if (tDelay > 0)
			{
				if (isTimerActive(Timer_CPC_ECO_Homepage_Data) == 0)
				{
					res = SetTimingCyclic("ECO_Homepage_Data", 1, tDelay, 1);
					setTimer (Timer_CPC_ECO_Homepage_Data, tDelay);
					@sysvar::CH_Nodes::CH__STPDU_CPC_ECO_Homepage_Data = 2;
				}
			}
			else if (tDelay == 0)
			{
				if (isTimerActive(Timer_CPC_ECO_Homepage_Data) == 0)
				{
					res = EnableTimingCyclic("ECO_Homepage_Data", 0);
					res = EnableTimingEvtTrg("ECO_Homepage_Data", 0);
				}
			}
			break;
		case (2):
			break;
		default:
			Write("error: wrong parameter (%d)", @this);
			stop();
			break;
	}
}

on sysvar sysvar::CH_Nodes::CH__STPDU_CPC_ECO_Score_Disp_Rq_AR
{
	long res;
	long tDelay;
	switch (@this)
	{
		case (0):
			res = ResetTimingCyclic("ECO_Score_Disp_Rq_AR");
			res = ResetTimingEvtTrg("ECO_Score_Disp_Rq_AR");
			res = EnableTimingCyclic("ECO_Score_Disp_Rq_AR", 1);
			res = EnableTimingEvtTrg("ECO_Score_Disp_Rq_AR", 1);
			break;
		case (1):
			tDelay = @sysvar::CH_Nodes::CH__STPDU_T_CPC_ECO_Score_Disp_Rq_AR;
			if (tDelay > 0)
			{
				if (isTimerActive(Timer_CPC_ECO_Score_Disp_Rq_AR) == 0)
				{
					res = SetTimingCyclic("ECO_Score_Disp_Rq_AR", 1, tDelay, 1);
					setTimer (Timer_CPC_ECO_Score_Disp_Rq_AR, tDelay);
					@sysvar::CH_Nodes::CH__STPDU_CPC_ECO_Score_Disp_Rq_AR = 2;
				}
			}
			else if (tDelay == 0)
			{
				if (isTimerActive(Timer_CPC_ECO_Score_Disp_Rq_AR) == 0)
				{
					res = EnableTimingCyclic("ECO_Score_Disp_Rq_AR", 0);
					res = EnableTimingEvtTrg("ECO_Score_Disp_Rq_AR", 0);
				}
			}
			break;
		case (2):
			break;
		default:
			Write("error: wrong parameter (%d)", @this);
			stop();
			break;
	}
}

on sysvar sysvar::CH_Nodes::CH__STPDU_CPC_EM01_Stat1_AR2
{
	long res;
	long tDelay;
	switch (@this)
	{
		case (0):
			res = ResetTimingCyclic("EM01_Stat1_AR2");
			res = ResetTimingEvtTrg("EM01_Stat1_AR2");
			res = EnableTimingCyclic("EM01_Stat1_AR2", 1);
			res = EnableTimingEvtTrg("EM01_Stat1_AR2", 1);
			break;
		case (1):
			tDelay = @sysvar::CH_Nodes::CH__STPDU_T_CPC_EM01_Stat1_AR2;
			if (tDelay > 0)
			{
				if (isTimerActive(Timer_CPC_EM01_Stat1_AR2) == 0)
				{
					res = SetTimingCyclic("EM01_Stat1_AR2", 1, tDelay, 1);
					setTimer (Timer_CPC_EM01_Stat1_AR2, tDelay);
					@sysvar::CH_Nodes::CH__STPDU_CPC_EM01_Stat1_AR2 = 2;
				}
			}
			else if (tDelay == 0)
			{
				if (isTimerActive(Timer_CPC_EM01_Stat1_AR2) == 0)
				{
					res = EnableTimingCyclic("EM01_Stat1_AR2", 0);
					res = EnableTimingEvtTrg("EM01_Stat1_AR2", 0);
				}
			}
			break;
		case (2):
			break;
		default:
			Write("error: wrong parameter (%d)", @this);
			stop();
			break;
	}
}

on sysvar sysvar::CH_Nodes::CH__STPDU_CPC_EM01_Stat2_AR2
{
	long res;
	long tDelay;
	switch (@this)
	{
		case (0):
			res = ResetTimingCyclic("EM01_Stat2_AR2");
			res = ResetTimingEvtTrg("EM01_Stat2_AR2");
			res = EnableTimingCyclic("EM01_Stat2_AR2", 1);
			res = EnableTimingEvtTrg("EM01_Stat2_AR2", 1);
			break;
		case (1):
			tDelay = @sysvar::CH_Nodes::CH__STPDU_T_CPC_EM01_Stat2_AR2;
			if (tDelay > 0)
			{
				if (isTimerActive(Timer_CPC_EM01_Stat2_AR2) == 0)
				{
					res = SetTimingCyclic("EM01_Stat2_AR2", 1, tDelay, 1);
					setTimer (Timer_CPC_EM01_Stat2_AR2, tDelay);
					@sysvar::CH_Nodes::CH__STPDU_CPC_EM01_Stat2_AR2 = 2;
				}
			}
			else if (tDelay == 0)
			{
				if (isTimerActive(Timer_CPC_EM01_Stat2_AR2) == 0)
				{
					res = EnableTimingCyclic("EM01_Stat2_AR2", 0);
					res = EnableTimingEvtTrg("EM01_Stat2_AR2", 0);
				}
			}
			break;
		case (2):
			break;
		default:
			Write("error: wrong parameter (%d)", @this);
			stop();
			break;
	}
}

on sysvar sysvar::CH_Nodes::CH__STPDU_CPC_EM01_Trq_Rs_AR2
{
	long res;
	long tDelay;
	switch (@this)
	{
		case (0):
			res = ResetTimingCyclic("EM01_Trq_Rs_AR2");
			res = ResetTimingEvtTrg("EM01_Trq_Rs_AR2");
			res = EnableTimingCyclic("EM01_Trq_Rs_AR2", 1);
			res = EnableTimingEvtTrg("EM01_Trq_Rs_AR2", 1);
			break;
		case (1):
			tDelay = @sysvar::CH_Nodes::CH__STPDU_T_CPC_EM01_Trq_Rs_AR2;
			if (tDelay > 0)
			{
				if (isTimerActive(Timer_CPC_EM01_Trq_Rs_AR2) == 0)
				{
					res = SetTimingCyclic("EM01_Trq_Rs_AR2", 1, tDelay, 1);
					setTimer (Timer_CPC_EM01_Trq_Rs_AR2, tDelay);
					@sysvar::CH_Nodes::CH__STPDU_CPC_EM01_Trq_Rs_AR2 = 2;
				}
			}
			else if (tDelay == 0)
			{
				if (isTimerActive(Timer_CPC_EM01_Trq_Rs_AR2) == 0)
				{
					res = EnableTimingCyclic("EM01_Trq_Rs_AR2", 0);
					res = EnableTimingEvtTrg("EM01_Trq_Rs_AR2", 0);
				}
			}
			break;
		case (2):
			break;
		default:
			Write("error: wrong parameter (%d)", @this);
			stop();
			break;
	}
}

on sysvar sysvar::CH_Nodes::CH__STPDU_CPC_EM_DAC4_AR
{
	long res;
	long tDelay;
	switch (@this)
	{
		case (0):
			res = ResetTimingCyclic("EM_DAC4_AR");
			res = ResetTimingEvtTrg("EM_DAC4_AR");
			res = EnableTimingCyclic("EM_DAC4_AR", 1);
			res = EnableTimingEvtTrg("EM_DAC4_AR", 1);
			break;
		case (1):
			tDelay = @sysvar::CH_Nodes::CH__STPDU_T_CPC_EM_DAC4_AR;
			if (tDelay > 0)
			{
				if (isTimerActive(Timer_CPC_EM_DAC4_AR) == 0)
				{
					res = SetTimingCyclic("EM_DAC4_AR", 1, tDelay, 1);
					setTimer (Timer_CPC_EM_DAC4_AR, tDelay);
					@sysvar::CH_Nodes::CH__STPDU_CPC_EM_DAC4_AR = 2;
				}
			}
			else if (tDelay == 0)
			{
				if (isTimerActive(Timer_CPC_EM_DAC4_AR) == 0)
				{
					res = EnableTimingCyclic("EM_DAC4_AR", 0);
					res = EnableTimingEvtTrg("EM_DAC4_AR", 0);
				}
			}
			break;
		case (2):
			break;
		default:
			Write("error: wrong parameter (%d)", @this);
			stop();
			break;
	}
}

on sysvar sysvar::CH_Nodes::CH__STPDU_CPC_EMM_Data1_AR2
{
	long res;
	long tDelay;
	switch (@this)
	{
		case (0):
			res = ResetTimingCyclic("EMM_Data1_AR2");
			res = ResetTimingEvtTrg("EMM_Data1_AR2");
			res = EnableTimingCyclic("EMM_Data1_AR2", 1);
			res = EnableTimingEvtTrg("EMM_Data1_AR2", 1);
			break;
		case (1):
			tDelay = @sysvar::CH_Nodes::CH__STPDU_T_CPC_EMM_Data1_AR2;
			if (tDelay > 0)
			{
				if (isTimerActive(Timer_CPC_EMM_Data1_AR2) == 0)
				{
					res = SetTimingCyclic("EMM_Data1_AR2", 1, tDelay, 1);
					setTimer (Timer_CPC_EMM_Data1_AR2, tDelay);
					@sysvar::CH_Nodes::CH__STPDU_CPC_EMM_Data1_AR2 = 2;
				}
			}
			else if (tDelay == 0)
			{
				if (isTimerActive(Timer_CPC_EMM_Data1_AR2) == 0)
				{
					res = EnableTimingCyclic("EMM_Data1_AR2", 0);
					res = EnableTimingEvtTrg("EMM_Data1_AR2", 0);
				}
			}
			break;
		case (2):
			break;
		default:
			Write("error: wrong parameter (%d)", @this);
			stop();
			break;
	}
}

on sysvar sysvar::CH_Nodes::CH__STPDU_CPC_EnergyMngmnt_PreCond_Stat_AR2
{
	long res;
	long tDelay;
	switch (@this)
	{
		case (0):
			res = ResetTimingCyclic("EnergyMngmnt_PreCond_Stat_AR2");
			res = ResetTimingEvtTrg("EnergyMngmnt_PreCond_Stat_AR2");
			res = EnableTimingCyclic("EnergyMngmnt_PreCond_Stat_AR2", 1);
			res = EnableTimingEvtTrg("EnergyMngmnt_PreCond_Stat_AR2", 1);
			break;
		case (1):
			tDelay = @sysvar::CH_Nodes::CH__STPDU_T_CPC_EnergyMngmnt_PreCond_Stat_AR2;
			if (tDelay > 0)
			{
				if (isTimerActive(Timer_CPC_EnergyMngmnt_PreCond_Stat_AR2) == 0)
				{
					res = SetTimingCyclic("EnergyMngmnt_PreCond_Stat_AR2", 1, tDelay, 1);
					setTimer (Timer_CPC_EnergyMngmnt_PreCond_Stat_AR2, tDelay);
					@sysvar::CH_Nodes::CH__STPDU_CPC_EnergyMngmnt_PreCond_Stat_AR2 = 2;
				}
			}
			else if (tDelay == 0)
			{
				if (isTimerActive(Timer_CPC_EnergyMngmnt_PreCond_Stat_AR2) == 0)
				{
					res = EnableTimingCyclic("EnergyMngmnt_PreCond_Stat_AR2", 0);
					res = EnableTimingEvtTrg("EnergyMngmnt_PreCond_Stat_AR2", 0);
				}
			}
			break;
		case (2):
			break;
		default:
			Write("error: wrong parameter (%d)", @this);
			stop();
			break;
	}
}

on sysvar sysvar::CH_Nodes::CH__STPDU_CPC_Eng_Rs_1_AR2
{
	long res;
	long tDelay;
	switch (@this)
	{
		case (0):
			res = ResetTimingCyclic("Eng_Rs_1_AR2");
			res = ResetTimingEvtTrg("Eng_Rs_1_AR2");
			res = EnableTimingCyclic("Eng_Rs_1_AR2", 1);
			res = EnableTimingEvtTrg("Eng_Rs_1_AR2", 1);
			break;
		case (1):
			tDelay = @sysvar::CH_Nodes::CH__STPDU_T_CPC_Eng_Rs_1_AR2;
			if (tDelay > 0)
			{
				if (isTimerActive(Timer_CPC_Eng_Rs_1_AR2) == 0)
				{
					res = SetTimingCyclic("Eng_Rs_1_AR2", 1, tDelay, 1);
					setTimer (Timer_CPC_Eng_Rs_1_AR2, tDelay);
					@sysvar::CH_Nodes::CH__STPDU_CPC_Eng_Rs_1_AR2 = 2;
				}
			}
			else if (tDelay == 0)
			{
				if (isTimerActive(Timer_CPC_Eng_Rs_1_AR2) == 0)
				{
					res = EnableTimingCyclic("Eng_Rs_1_AR2", 0);
					res = EnableTimingEvtTrg("Eng_Rs_1_AR2", 0);
				}
			}
			break;
		case (2):
			break;
		default:
			Write("error: wrong parameter (%d)", @this);
			stop();
			break;
	}
}

on sysvar sysvar::CH_Nodes::CH__STPDU_CPC_Eng_Rs_2_AR2
{
	long res;
	long tDelay;
	switch (@this)
	{
		case (0):
			res = ResetTimingCyclic("Eng_Rs_2_AR2");
			res = ResetTimingEvtTrg("Eng_Rs_2_AR2");
			res = EnableTimingCyclic("Eng_Rs_2_AR2", 1);
			res = EnableTimingEvtTrg("Eng_Rs_2_AR2", 1);
			break;
		case (1):
			tDelay = @sysvar::CH_Nodes::CH__STPDU_T_CPC_Eng_Rs_2_AR2;
			if (tDelay > 0)
			{
				if (isTimerActive(Timer_CPC_Eng_Rs_2_AR2) == 0)
				{
					res = SetTimingCyclic("Eng_Rs_2_AR2", 1, tDelay, 1);
					setTimer (Timer_CPC_Eng_Rs_2_AR2, tDelay);
					@sysvar::CH_Nodes::CH__STPDU_CPC_Eng_Rs_2_AR2 = 2;
				}
			}
			else if (tDelay == 0)
			{
				if (isTimerActive(Timer_CPC_Eng_Rs_2_AR2) == 0)
				{
					res = EnableTimingCyclic("Eng_Rs_2_AR2", 0);
					res = EnableTimingEvtTrg("Eng_Rs_2_AR2", 0);
				}
			}
			break;
		case (2):
			break;
		default:
			Write("error: wrong parameter (%d)", @this);
			stop();
			break;
	}
}

on sysvar sysvar::CH_Nodes::CH__STPDU_CPC_Eng_Rs_3_AR2
{
	long res;
	long tDelay;
	switch (@this)
	{
		case (0):
			res = ResetTimingCyclic("Eng_Rs_3_AR2");
			res = ResetTimingEvtTrg("Eng_Rs_3_AR2");
			res = EnableTimingCyclic("Eng_Rs_3_AR2", 1);
			res = EnableTimingEvtTrg("Eng_Rs_3_AR2", 1);
			break;
		case (1):
			tDelay = @sysvar::CH_Nodes::CH__STPDU_T_CPC_Eng_Rs_3_AR2;
			if (tDelay > 0)
			{
				if (isTimerActive(Timer_CPC_Eng_Rs_3_AR2) == 0)
				{
					res = SetTimingCyclic("Eng_Rs_3_AR2", 1, tDelay, 1);
					setTimer (Timer_CPC_Eng_Rs_3_AR2, tDelay);
					@sysvar::CH_Nodes::CH__STPDU_CPC_Eng_Rs_3_AR2 = 2;
				}
			}
			else if (tDelay == 0)
			{
				if (isTimerActive(Timer_CPC_Eng_Rs_3_AR2) == 0)
				{
					res = EnableTimingCyclic("Eng_Rs_3_AR2", 0);
					res = EnableTimingEvtTrg("Eng_Rs_3_AR2", 0);
				}
			}
			break;
		case (2):
			break;
		default:
			Write("error: wrong parameter (%d)", @this);
			stop();
			break;
	}
}

on sysvar sysvar::CH_Nodes::CH__STPDU_CPC_Eng_Rs_EM_AR2
{
	long res;
	long tDelay;
	switch (@this)
	{
		case (0):
			res = ResetTimingCyclic("Eng_Rs_EM_AR2");
			res = ResetTimingEvtTrg("Eng_Rs_EM_AR2");
			res = EnableTimingCyclic("Eng_Rs_EM_AR2", 1);
			res = EnableTimingEvtTrg("Eng_Rs_EM_AR2", 1);
			break;
		case (1):
			tDelay = @sysvar::CH_Nodes::CH__STPDU_T_CPC_Eng_Rs_EM_AR2;
			if (tDelay > 0)
			{
				if (isTimerActive(Timer_CPC_Eng_Rs_EM_AR2) == 0)
				{
					res = SetTimingCyclic("Eng_Rs_EM_AR2", 1, tDelay, 1);
					setTimer (Timer_CPC_Eng_Rs_EM_AR2, tDelay);
					@sysvar::CH_Nodes::CH__STPDU_CPC_Eng_Rs_EM_AR2 = 2;
				}
			}
			else if (tDelay == 0)
			{
				if (isTimerActive(Timer_CPC_Eng_Rs_EM_AR2) == 0)
				{
					res = EnableTimingCyclic("Eng_Rs_EM_AR2", 0);
					res = EnableTimingEvtTrg("Eng_Rs_EM_AR2", 0);
				}
			}
			break;
		case (2):
			break;
		default:
			Write("error: wrong parameter (%d)", @this);
			stop();
			break;
	}
}

on sysvar sysvar::CH_Nodes::CH__STPDU_CPC_Eng_Rs_EngCtrl_AR2
{
	long res;
	long tDelay;
	switch (@this)
	{
		case (0):
			res = ResetTimingCyclic("Eng_Rs_EngCtrl_AR2");
			res = ResetTimingEvtTrg("Eng_Rs_EngCtrl_AR2");
			res = EnableTimingCyclic("Eng_Rs_EngCtrl_AR2", 1);
			res = EnableTimingEvtTrg("Eng_Rs_EngCtrl_AR2", 1);
			break;
		case (1):
			tDelay = @sysvar::CH_Nodes::CH__STPDU_T_CPC_Eng_Rs_EngCtrl_AR2;
			if (tDelay > 0)
			{
				if (isTimerActive(Timer_CPC_Eng_Rs_EngCtrl_AR2) == 0)
				{
					res = SetTimingCyclic("Eng_Rs_EngCtrl_AR2", 1, tDelay, 1);
					setTimer (Timer_CPC_Eng_Rs_EngCtrl_AR2, tDelay);
					@sysvar::CH_Nodes::CH__STPDU_CPC_Eng_Rs_EngCtrl_AR2 = 2;
				}
			}
			else if (tDelay == 0)
			{
				if (isTimerActive(Timer_CPC_Eng_Rs_EngCtrl_AR2) == 0)
				{
					res = EnableTimingCyclic("Eng_Rs_EngCtrl_AR2", 0);
					res = EnableTimingEvtTrg("Eng_Rs_EngCtrl_AR2", 0);
				}
			}
			break;
		case (2):
			break;
		default:
			Write("error: wrong parameter (%d)", @this);
			stop();
			break;
	}
}

on sysvar sysvar::CH_Nodes::CH__STPDU_CPC_EngCtrl_Disp_Rq_AR2
{
	long res;
	long tDelay;
	switch (@this)
	{
		case (0):
			res = ResetTimingCyclic("EngCtrl_Disp_Rq_AR2");
			res = ResetTimingEvtTrg("EngCtrl_Disp_Rq_AR2");
			res = EnableTimingCyclic("EngCtrl_Disp_Rq_AR2", 1);
			res = EnableTimingEvtTrg("EngCtrl_Disp_Rq_AR2", 1);
			break;
		case (1):
			tDelay = @sysvar::CH_Nodes::CH__STPDU_T_CPC_EngCtrl_Disp_Rq_AR2;
			if (tDelay > 0)
			{
				if (isTimerActive(Timer_CPC_EngCtrl_Disp_Rq_AR2) == 0)
				{
					res = SetTimingCyclic("EngCtrl_Disp_Rq_AR2", 1, tDelay, 1);
					setTimer (Timer_CPC_EngCtrl_Disp_Rq_AR2, tDelay);
					@sysvar::CH_Nodes::CH__STPDU_CPC_EngCtrl_Disp_Rq_AR2 = 2;
				}
			}
			else if (tDelay == 0)
			{
				if (isTimerActive(Timer_CPC_EngCtrl_Disp_Rq_AR2) == 0)
				{
					res = EnableTimingCyclic("EngCtrl_Disp_Rq_AR2", 0);
					res = EnableTimingEvtTrg("EngCtrl_Disp_Rq_AR2", 0);
				}
			}
			break;
		case (2):
			break;
		default:
			Write("error: wrong parameter (%d)", @this);
			stop();
			break;
	}
}

on sysvar sysvar::CH_Nodes::CH__STPDU_CPC_EngCtrl_OBD1_AR
{
	long res;
	long tDelay;
	switch (@this)
	{
		case (0):
			res = ResetTimingCyclic("EngCtrl_OBD1_AR");
			res = ResetTimingEvtTrg("EngCtrl_OBD1_AR");
			res = EnableTimingCyclic("EngCtrl_OBD1_AR", 1);
			res = EnableTimingEvtTrg("EngCtrl_OBD1_AR", 1);
			break;
		case (1):
			tDelay = @sysvar::CH_Nodes::CH__STPDU_T_CPC_EngCtrl_OBD1_AR;
			if (tDelay > 0)
			{
				if (isTimerActive(Timer_CPC_EngCtrl_OBD1_AR) == 0)
				{
					res = SetTimingCyclic("EngCtrl_OBD1_AR", 1, tDelay, 1);
					setTimer (Timer_CPC_EngCtrl_OBD1_AR, tDelay);
					@sysvar::CH_Nodes::CH__STPDU_CPC_EngCtrl_OBD1_AR = 2;
				}
			}
			else if (tDelay == 0)
			{
				if (isTimerActive(Timer_CPC_EngCtrl_OBD1_AR) == 0)
				{
					res = EnableTimingCyclic("EngCtrl_OBD1_AR", 0);
					res = EnableTimingEvtTrg("EngCtrl_OBD1_AR", 0);
				}
			}
			break;
		case (2):
			break;
		default:
			Write("error: wrong parameter (%d)", @this);
			stop();
			break;
	}
}

on sysvar sysvar::CH_Nodes::CH__STPDU_CPC_EngCtrl_Stat_AR2
{
	long res;
	long tDelay;
	switch (@this)
	{
		case (0):
			res = ResetTimingCyclic("EngCtrl_Stat_AR2");
			res = ResetTimingEvtTrg("EngCtrl_Stat_AR2");
			res = EnableTimingCyclic("EngCtrl_Stat_AR2", 1);
			res = EnableTimingEvtTrg("EngCtrl_Stat_AR2", 1);
			break;
		case (1):
			tDelay = @sysvar::CH_Nodes::CH__STPDU_T_CPC_EngCtrl_Stat_AR2;
			if (tDelay > 0)
			{
				if (isTimerActive(Timer_CPC_EngCtrl_Stat_AR2) == 0)
				{
					res = SetTimingCyclic("EngCtrl_Stat_AR2", 1, tDelay, 1);
					setTimer (Timer_CPC_EngCtrl_Stat_AR2, tDelay);
					@sysvar::CH_Nodes::CH__STPDU_CPC_EngCtrl_Stat_AR2 = 2;
				}
			}
			else if (tDelay == 0)
			{
				if (isTimerActive(Timer_CPC_EngCtrl_Stat_AR2) == 0)
				{
					res = EnableTimingCyclic("EngCtrl_Stat_AR2", 0);
					res = EnableTimingEvtTrg("EngCtrl_Stat_AR2", 0);
				}
			}
			break;
		case (2):
			break;
		default:
			Write("error: wrong parameter (%d)", @this);
			stop();
			break;
	}
}

on sysvar sysvar::CH_Nodes::CH__STPDU_CPC_ESP_OBD_Data_AR
{
	long res;
	long tDelay;
	switch (@this)
	{
		case (0):
			res = ResetTimingCyclic("ESP_OBD_Data_AR");
			res = ResetTimingEvtTrg("ESP_OBD_Data_AR");
			res = EnableTimingCyclic("ESP_OBD_Data_AR", 1);
			res = EnableTimingEvtTrg("ESP_OBD_Data_AR", 1);
			break;
		case (1):
			tDelay = @sysvar::CH_Nodes::CH__STPDU_T_CPC_ESP_OBD_Data_AR;
			if (tDelay > 0)
			{
				if (isTimerActive(Timer_CPC_ESP_OBD_Data_AR) == 0)
				{
					res = SetTimingCyclic("ESP_OBD_Data_AR", 1, tDelay, 1);
					setTimer (Timer_CPC_ESP_OBD_Data_AR, tDelay);
					@sysvar::CH_Nodes::CH__STPDU_CPC_ESP_OBD_Data_AR = 2;
				}
			}
			else if (tDelay == 0)
			{
				if (isTimerActive(Timer_CPC_ESP_OBD_Data_AR) == 0)
				{
					res = EnableTimingCyclic("ESP_OBD_Data_AR", 0);
					res = EnableTimingEvtTrg("ESP_OBD_Data_AR", 0);
				}
			}
			break;
		case (2):
			break;
		default:
			Write("error: wrong parameter (%d)", @this);
			stop();
			break;
	}
}

on sysvar sysvar::CH_Nodes::CH__STPDU_CPC_Fuel_Stat2_AR2
{
	long res;
	long tDelay;
	switch (@this)
	{
		case (0):
			res = ResetTimingCyclic("Fuel_Stat2_AR2");
			res = ResetTimingEvtTrg("Fuel_Stat2_AR2");
			res = EnableTimingCyclic("Fuel_Stat2_AR2", 1);
			res = EnableTimingEvtTrg("Fuel_Stat2_AR2", 1);
			break;
		case (1):
			tDelay = @sysvar::CH_Nodes::CH__STPDU_T_CPC_Fuel_Stat2_AR2;
			if (tDelay > 0)
			{
				if (isTimerActive(Timer_CPC_Fuel_Stat2_AR2) == 0)
				{
					res = SetTimingCyclic("Fuel_Stat2_AR2", 1, tDelay, 1);
					setTimer (Timer_CPC_Fuel_Stat2_AR2, tDelay);
					@sysvar::CH_Nodes::CH__STPDU_CPC_Fuel_Stat2_AR2 = 2;
				}
			}
			else if (tDelay == 0)
			{
				if (isTimerActive(Timer_CPC_Fuel_Stat2_AR2) == 0)
				{
					res = EnableTimingCyclic("Fuel_Stat2_AR2", 0);
					res = EnableTimingEvtTrg("Fuel_Stat2_AR2", 0);
				}
			}
			break;
		case (2):
			break;
		default:
			Write("error: wrong parameter (%d)", @this);
			stop();
			break;
	}
}

on sysvar sysvar::CH_Nodes::CH__STPDU_CPC_FuelLvl_Stat_AR2
{
	long res;
	long tDelay;
	switch (@this)
	{
		case (0):
			res = ResetTimingCyclic("FuelLvl_Stat_AR2");
			res = ResetTimingEvtTrg("FuelLvl_Stat_AR2");
			res = EnableTimingCyclic("FuelLvl_Stat_AR2", 1);
			res = EnableTimingEvtTrg("FuelLvl_Stat_AR2", 1);
			break;
		case (1):
			tDelay = @sysvar::CH_Nodes::CH__STPDU_T_CPC_FuelLvl_Stat_AR2;
			if (tDelay > 0)
			{
				if (isTimerActive(Timer_CPC_FuelLvl_Stat_AR2) == 0)
				{
					res = SetTimingCyclic("FuelLvl_Stat_AR2", 1, tDelay, 1);
					setTimer (Timer_CPC_FuelLvl_Stat_AR2, tDelay);
					@sysvar::CH_Nodes::CH__STPDU_CPC_FuelLvl_Stat_AR2 = 2;
				}
			}
			else if (tDelay == 0)
			{
				if (isTimerActive(Timer_CPC_FuelLvl_Stat_AR2) == 0)
				{
					res = EnableTimingCyclic("FuelLvl_Stat_AR2", 0);
					res = EnableTimingEvtTrg("FuelLvl_Stat_AR2", 0);
				}
			}
			break;
		case (2):
			break;
		default:
			Write("error: wrong parameter (%d)", @this);
			stop();
			break;
	}
}

on sysvar sysvar::CH_Nodes::CH__STPDU_CPC_HumanMachineIfc_AR2
{
	long res;
	long tDelay;
	switch (@this)
	{
		case (0):
			res = ResetTimingCyclic("HumanMachineIfc_AR2");
			res = ResetTimingEvtTrg("HumanMachineIfc_AR2");
			res = EnableTimingCyclic("HumanMachineIfc_AR2", 1);
			res = EnableTimingEvtTrg("HumanMachineIfc_AR2", 1);
			break;
		case (1):
			tDelay = @sysvar::CH_Nodes::CH__STPDU_T_CPC_HumanMachineIfc_AR2;
			if (tDelay > 0)
			{
				if (isTimerActive(Timer_CPC_HumanMachineIfc_AR2) == 0)
				{
					res = SetTimingCyclic("HumanMachineIfc_AR2", 1, tDelay, 1);
					setTimer (Timer_CPC_HumanMachineIfc_AR2, tDelay);
					@sysvar::CH_Nodes::CH__STPDU_CPC_HumanMachineIfc_AR2 = 2;
				}
			}
			else if (tDelay == 0)
			{
				if (isTimerActive(Timer_CPC_HumanMachineIfc_AR2) == 0)
				{
					res = EnableTimingCyclic("HumanMachineIfc_AR2", 0);
					res = EnableTimingEvtTrg("HumanMachineIfc_AR2", 0);
				}
			}
			break;
		case (2):
			break;
		default:
			Write("error: wrong parameter (%d)", @this);
			stop();
			break;
	}
}

on sysvar sysvar::CH_Nodes::CH__STPDU_CPC_HumanMachineIfc_Rq_AR
{
	long res;
	long tDelay;
	switch (@this)
	{
		case (0):
			res = ResetTimingCyclic("HumanMachineIfc_Rq_AR");
			res = ResetTimingEvtTrg("HumanMachineIfc_Rq_AR");
			res = EnableTimingCyclic("HumanMachineIfc_Rq_AR", 1);
			res = EnableTimingEvtTrg("HumanMachineIfc_Rq_AR", 1);
			break;
		case (1):
			tDelay = @sysvar::CH_Nodes::CH__STPDU_T_CPC_HumanMachineIfc_Rq_AR;
			if (tDelay > 0)
			{
				if (isTimerActive(Timer_CPC_HumanMachineIfc_Rq_AR) == 0)
				{
					res = SetTimingCyclic("HumanMachineIfc_Rq_AR", 1, tDelay, 1);
					setTimer (Timer_CPC_HumanMachineIfc_Rq_AR, tDelay);
					@sysvar::CH_Nodes::CH__STPDU_CPC_HumanMachineIfc_Rq_AR = 2;
				}
			}
			else if (tDelay == 0)
			{
				if (isTimerActive(Timer_CPC_HumanMachineIfc_Rq_AR) == 0)
				{
					res = EnableTimingCyclic("HumanMachineIfc_Rq_AR", 0);
					res = EnableTimingEvtTrg("HumanMachineIfc_Rq_AR", 0);
				}
			}
			break;
		case (2):
			break;
		default:
			Write("error: wrong parameter (%d)", @this);
			stop();
			break;
	}
}

on sysvar sysvar::CH_Nodes::CH__STPDU_CPC_ISM_DAC4_AR
{
	long res;
	long tDelay;
	switch (@this)
	{
		case (0):
			res = ResetTimingCyclic("ISM_DAC4_AR");
			res = ResetTimingEvtTrg("ISM_DAC4_AR");
			res = EnableTimingCyclic("ISM_DAC4_AR", 1);
			res = EnableTimingEvtTrg("ISM_DAC4_AR", 1);
			break;
		case (1):
			tDelay = @sysvar::CH_Nodes::CH__STPDU_T_CPC_ISM_DAC4_AR;
			if (tDelay > 0)
			{
				if (isTimerActive(Timer_CPC_ISM_DAC4_AR) == 0)
				{
					res = SetTimingCyclic("ISM_DAC4_AR", 1, tDelay, 1);
					setTimer (Timer_CPC_ISM_DAC4_AR, tDelay);
					@sysvar::CH_Nodes::CH__STPDU_CPC_ISM_DAC4_AR = 2;
				}
			}
			else if (tDelay == 0)
			{
				if (isTimerActive(Timer_CPC_ISM_DAC4_AR) == 0)
				{
					res = EnableTimingCyclic("ISM_DAC4_AR", 0);
					res = EnableTimingEvtTrg("ISM_DAC4_AR", 0);
				}
			}
			break;
		case (2):
			break;
		default:
			Write("error: wrong parameter (%d)", @this);
			stop();
			break;
	}
}

on sysvar sysvar::CH_Nodes::CH__STPDU_CPC_OBL_DC_Output_AR
{
	long res;
	long tDelay;
	switch (@this)
	{
		case (0):
			res = ResetTimingCyclic("OBL_DC_Output_AR");
			res = ResetTimingEvtTrg("OBL_DC_Output_AR");
			res = EnableTimingCyclic("OBL_DC_Output_AR", 1);
			res = EnableTimingEvtTrg("OBL_DC_Output_AR", 1);
			break;
		case (1):
			tDelay = @sysvar::CH_Nodes::CH__STPDU_T_CPC_OBL_DC_Output_AR;
			if (tDelay > 0)
			{
				if (isTimerActive(Timer_CPC_OBL_DC_Output_AR) == 0)
				{
					res = SetTimingCyclic("OBL_DC_Output_AR", 1, tDelay, 1);
					setTimer (Timer_CPC_OBL_DC_Output_AR, tDelay);
					@sysvar::CH_Nodes::CH__STPDU_CPC_OBL_DC_Output_AR = 2;
				}
			}
			else if (tDelay == 0)
			{
				if (isTimerActive(Timer_CPC_OBL_DC_Output_AR) == 0)
				{
					res = EnableTimingCyclic("OBL_DC_Output_AR", 0);
					res = EnableTimingEvtTrg("OBL_DC_Output_AR", 0);
				}
			}
			break;
		case (2):
			break;
		default:
			Write("error: wrong parameter (%d)", @this);
			stop();
			break;
	}
}

on sysvar sysvar::CH_Nodes::CH__STPDU_CPC_PARK_Drv_Rs_TCM_AR2
{
	long res;
	long tDelay;
	switch (@this)
	{
		case (0):
			res = ResetTimingCyclic("PARK_Drv_Rs_TCM_AR2");
			res = ResetTimingEvtTrg("PARK_Drv_Rs_TCM_AR2");
			res = EnableTimingCyclic("PARK_Drv_Rs_TCM_AR2", 1);
			res = EnableTimingEvtTrg("PARK_Drv_Rs_TCM_AR2", 1);
			break;
		case (1):
			tDelay = @sysvar::CH_Nodes::CH__STPDU_T_CPC_PARK_Drv_Rs_TCM_AR2;
			if (tDelay > 0)
			{
				if (isTimerActive(Timer_CPC_PARK_Drv_Rs_TCM_AR2) == 0)
				{
					res = SetTimingCyclic("PARK_Drv_Rs_TCM_AR2", 1, tDelay, 1);
					setTimer (Timer_CPC_PARK_Drv_Rs_TCM_AR2, tDelay);
					@sysvar::CH_Nodes::CH__STPDU_CPC_PARK_Drv_Rs_TCM_AR2 = 2;
				}
			}
			else if (tDelay == 0)
			{
				if (isTimerActive(Timer_CPC_PARK_Drv_Rs_TCM_AR2) == 0)
				{
					res = EnableTimingCyclic("PARK_Drv_Rs_TCM_AR2", 0);
					res = EnableTimingEvtTrg("PARK_Drv_Rs_TCM_AR2", 0);
				}
			}
			break;
		case (2):
			break;
		default:
			Write("error: wrong parameter (%d)", @this);
			stop();
			break;
	}
}

on sysvar sysvar::CH_Nodes::CH__STPDU_CPC_PN14_Gen_Rs_AR
{
	long res;
	long tDelay;
	switch (@this)
	{
		case (0):
			res = ResetTimingCyclic("PN14_Gen_Rs_AR");
			res = ResetTimingEvtTrg("PN14_Gen_Rs_AR");
			res = EnableTimingCyclic("PN14_Gen_Rs_AR", 1);
			res = EnableTimingEvtTrg("PN14_Gen_Rs_AR", 1);
			break;
		case (1):
			tDelay = @sysvar::CH_Nodes::CH__STPDU_T_CPC_PN14_Gen_Rs_AR;
			if (tDelay > 0)
			{
				if (isTimerActive(Timer_CPC_PN14_Gen_Rs_AR) == 0)
				{
					res = SetTimingCyclic("PN14_Gen_Rs_AR", 1, tDelay, 1);
					setTimer (Timer_CPC_PN14_Gen_Rs_AR, tDelay);
					@sysvar::CH_Nodes::CH__STPDU_CPC_PN14_Gen_Rs_AR = 2;
				}
			}
			else if (tDelay == 0)
			{
				if (isTimerActive(Timer_CPC_PN14_Gen_Rs_AR) == 0)
				{
					res = EnableTimingCyclic("PN14_Gen_Rs_AR", 0);
					res = EnableTimingEvtTrg("PN14_Gen_Rs_AR", 0);
				}
			}
			break;
		case (2):
			break;
		default:
			Write("error: wrong parameter (%d)", @this);
			stop();
			break;
	}
}

on sysvar sysvar::CH_Nodes::CH__STPDU_CPC_PNHV_BMS_Stat_AR2
{
	long res;
	long tDelay;
	switch (@this)
	{
		case (0):
			res = ResetTimingCyclic("PNHV_BMS_Stat_AR2");
			res = ResetTimingEvtTrg("PNHV_BMS_Stat_AR2");
			res = EnableTimingCyclic("PNHV_BMS_Stat_AR2", 1);
			res = EnableTimingEvtTrg("PNHV_BMS_Stat_AR2", 1);
			break;
		case (1):
			tDelay = @sysvar::CH_Nodes::CH__STPDU_T_CPC_PNHV_BMS_Stat_AR2;
			if (tDelay > 0)
			{
				if (isTimerActive(Timer_CPC_PNHV_BMS_Stat_AR2) == 0)
				{
					res = SetTimingCyclic("PNHV_BMS_Stat_AR2", 1, tDelay, 1);
					setTimer (Timer_CPC_PNHV_BMS_Stat_AR2, tDelay);
					@sysvar::CH_Nodes::CH__STPDU_CPC_PNHV_BMS_Stat_AR2 = 2;
				}
			}
			else if (tDelay == 0)
			{
				if (isTimerActive(Timer_CPC_PNHV_BMS_Stat_AR2) == 0)
				{
					res = EnableTimingCyclic("PNHV_BMS_Stat_AR2", 0);
					res = EnableTimingEvtTrg("PNHV_BMS_Stat_AR2", 0);
				}
			}
			break;
		case (2):
			break;
		default:
			Write("error: wrong parameter (%d)", @this);
			stop();
			break;
	}
}

on sysvar sysvar::CH_Nodes::CH__STPDU_CPC_PNHV_EnergyMngmnt_Disp_Rq_AR
{
	long res;
	long tDelay;
	switch (@this)
	{
		case (0):
			res = ResetTimingCyclic("PNHV_EnergyMngmnt_Disp_Rq_AR");
			res = ResetTimingEvtTrg("PNHV_EnergyMngmnt_Disp_Rq_AR");
			res = EnableTimingCyclic("PNHV_EnergyMngmnt_Disp_Rq_AR", 1);
			res = EnableTimingEvtTrg("PNHV_EnergyMngmnt_Disp_Rq_AR", 1);
			break;
		case (1):
			tDelay = @sysvar::CH_Nodes::CH__STPDU_T_CPC_PNHV_EnergyMngmnt_Disp_Rq_AR;
			if (tDelay > 0)
			{
				if (isTimerActive(Timer_CPC_PNHV_EnergyMngmnt_Disp_Rq_AR) == 0)
				{
					res = SetTimingCyclic("PNHV_EnergyMngmnt_Disp_Rq_AR", 1, tDelay, 1);
					setTimer (Timer_CPC_PNHV_EnergyMngmnt_Disp_Rq_AR, tDelay);
					@sysvar::CH_Nodes::CH__STPDU_CPC_PNHV_EnergyMngmnt_Disp_Rq_AR = 2;
				}
			}
			else if (tDelay == 0)
			{
				if (isTimerActive(Timer_CPC_PNHV_EnergyMngmnt_Disp_Rq_AR) == 0)
				{
					res = EnableTimingCyclic("PNHV_EnergyMngmnt_Disp_Rq_AR", 0);
					res = EnableTimingEvtTrg("PNHV_EnergyMngmnt_Disp_Rq_AR", 0);
				}
			}
			break;
		case (2):
			break;
		default:
			Write("error: wrong parameter (%d)", @this);
			stop();
			break;
	}
}

on sysvar sysvar::CH_Nodes::CH__STPDU_CPC_PNHV_EnergyMngmnt_Stat2_AR2
{
	long res;
	long tDelay;
	switch (@this)
	{
		case (0):
			res = ResetTimingCyclic("PNHV_EnergyMngmnt_Stat2_AR2");
			res = ResetTimingEvtTrg("PNHV_EnergyMngmnt_Stat2_AR2");
			res = EnableTimingCyclic("PNHV_EnergyMngmnt_Stat2_AR2", 1);
			res = EnableTimingEvtTrg("PNHV_EnergyMngmnt_Stat2_AR2", 1);
			break;
		case (1):
			tDelay = @sysvar::CH_Nodes::CH__STPDU_T_CPC_PNHV_EnergyMngmnt_Stat2_AR2;
			if (tDelay > 0)
			{
				if (isTimerActive(Timer_CPC_PNHV_EnergyMngmnt_Stat2_AR2) == 0)
				{
					res = SetTimingCyclic("PNHV_EnergyMngmnt_Stat2_AR2", 1, tDelay, 1);
					setTimer (Timer_CPC_PNHV_EnergyMngmnt_Stat2_AR2, tDelay);
					@sysvar::CH_Nodes::CH__STPDU_CPC_PNHV_EnergyMngmnt_Stat2_AR2 = 2;
				}
			}
			else if (tDelay == 0)
			{
				if (isTimerActive(Timer_CPC_PNHV_EnergyMngmnt_Stat2_AR2) == 0)
				{
					res = EnableTimingCyclic("PNHV_EnergyMngmnt_Stat2_AR2", 0);
					res = EnableTimingEvtTrg("PNHV_EnergyMngmnt_Stat2_AR2", 0);
				}
			}
			break;
		case (2):
			break;
		default:
			Write("error: wrong parameter (%d)", @this);
			stop();
			break;
	}
}

on sysvar sysvar::CH_Nodes::CH__STPDU_CPC_PNHV_EnergyMngmnt_Stat3_AR2
{
	long res;
	long tDelay;
	switch (@this)
	{
		case (0):
			res = ResetTimingCyclic("PNHV_EnergyMngmnt_Stat3_AR2");
			res = ResetTimingEvtTrg("PNHV_EnergyMngmnt_Stat3_AR2");
			res = EnableTimingCyclic("PNHV_EnergyMngmnt_Stat3_AR2", 1);
			res = EnableTimingEvtTrg("PNHV_EnergyMngmnt_Stat3_AR2", 1);
			break;
		case (1):
			tDelay = @sysvar::CH_Nodes::CH__STPDU_T_CPC_PNHV_EnergyMngmnt_Stat3_AR2;
			if (tDelay > 0)
			{
				if (isTimerActive(Timer_CPC_PNHV_EnergyMngmnt_Stat3_AR2) == 0)
				{
					res = SetTimingCyclic("PNHV_EnergyMngmnt_Stat3_AR2", 1, tDelay, 1);
					setTimer (Timer_CPC_PNHV_EnergyMngmnt_Stat3_AR2, tDelay);
					@sysvar::CH_Nodes::CH__STPDU_CPC_PNHV_EnergyMngmnt_Stat3_AR2 = 2;
				}
			}
			else if (tDelay == 0)
			{
				if (isTimerActive(Timer_CPC_PNHV_EnergyMngmnt_Stat3_AR2) == 0)
				{
					res = EnableTimingCyclic("PNHV_EnergyMngmnt_Stat3_AR2", 0);
					res = EnableTimingEvtTrg("PNHV_EnergyMngmnt_Stat3_AR2", 0);
				}
			}
			break;
		case (2):
			break;
		default:
			Write("error: wrong parameter (%d)", @this);
			stop();
			break;
	}
}

on sysvar sysvar::CH_Nodes::CH__STPDU_CPC_PNHV_EnergyMngmntSet_Rs1_AR2
{
	long res;
	long tDelay;
	switch (@this)
	{
		case (0):
			res = ResetTimingCyclic("PNHV_EnergyMngmntSet_Rs1_AR2");
			res = ResetTimingEvtTrg("PNHV_EnergyMngmntSet_Rs1_AR2");
			res = EnableTimingCyclic("PNHV_EnergyMngmntSet_Rs1_AR2", 1);
			res = EnableTimingEvtTrg("PNHV_EnergyMngmntSet_Rs1_AR2", 1);
			break;
		case (1):
			tDelay = @sysvar::CH_Nodes::CH__STPDU_T_CPC_PNHV_EnergyMngmntSet_Rs1_AR2;
			if (tDelay > 0)
			{
				if (isTimerActive(Timer_CPC_PNHV_EnergyMngmntSet_Rs1_AR2) == 0)
				{
					res = SetTimingCyclic("PNHV_EnergyMngmntSet_Rs1_AR2", 1, tDelay, 1);
					setTimer (Timer_CPC_PNHV_EnergyMngmntSet_Rs1_AR2, tDelay);
					@sysvar::CH_Nodes::CH__STPDU_CPC_PNHV_EnergyMngmntSet_Rs1_AR2 = 2;
				}
			}
			else if (tDelay == 0)
			{
				if (isTimerActive(Timer_CPC_PNHV_EnergyMngmntSet_Rs1_AR2) == 0)
				{
					res = EnableTimingCyclic("PNHV_EnergyMngmntSet_Rs1_AR2", 0);
					res = EnableTimingEvtTrg("PNHV_EnergyMngmntSet_Rs1_AR2", 0);
				}
			}
			break;
		case (2):
			break;
		default:
			Write("error: wrong parameter (%d)", @this);
			stop();
			break;
	}
}

on sysvar sysvar::CH_Nodes::CH__STPDU_CPC_PNHV_EnergyMngmntSet_Rs2_AR
{
	long res;
	long tDelay;
	switch (@this)
	{
		case (0):
			res = ResetTimingCyclic("PNHV_EnergyMngmntSet_Rs2_AR");
			res = ResetTimingEvtTrg("PNHV_EnergyMngmntSet_Rs2_AR");
			res = EnableTimingCyclic("PNHV_EnergyMngmntSet_Rs2_AR", 1);
			res = EnableTimingEvtTrg("PNHV_EnergyMngmntSet_Rs2_AR", 1);
			break;
		case (1):
			tDelay = @sysvar::CH_Nodes::CH__STPDU_T_CPC_PNHV_EnergyMngmntSet_Rs2_AR;
			if (tDelay > 0)
			{
				if (isTimerActive(Timer_CPC_PNHV_EnergyMngmntSet_Rs2_AR) == 0)
				{
					res = SetTimingCyclic("PNHV_EnergyMngmntSet_Rs2_AR", 1, tDelay, 1);
					setTimer (Timer_CPC_PNHV_EnergyMngmntSet_Rs2_AR, tDelay);
					@sysvar::CH_Nodes::CH__STPDU_CPC_PNHV_EnergyMngmntSet_Rs2_AR = 2;
				}
			}
			else if (tDelay == 0)
			{
				if (isTimerActive(Timer_CPC_PNHV_EnergyMngmntSet_Rs2_AR) == 0)
				{
					res = EnableTimingCyclic("PNHV_EnergyMngmntSet_Rs2_AR", 0);
					res = EnableTimingEvtTrg("PNHV_EnergyMngmntSet_Rs2_AR", 0);
				}
			}
			break;
		case (2):
			break;
		default:
			Write("error: wrong parameter (%d)", @this);
			stop();
			break;
	}
}

on sysvar sysvar::CH_Nodes::CH__STPDU_CPC_PNHV_Stat_AR2
{
	long res;
	long tDelay;
	switch (@this)
	{
		case (0):
			res = ResetTimingCyclic("PNHV_Stat_AR2");
			res = ResetTimingEvtTrg("PNHV_Stat_AR2");
			res = EnableTimingCyclic("PNHV_Stat_AR2", 1);
			res = EnableTimingEvtTrg("PNHV_Stat_AR2", 1);
			break;
		case (1):
			tDelay = @sysvar::CH_Nodes::CH__STPDU_T_CPC_PNHV_Stat_AR2;
			if (tDelay > 0)
			{
				if (isTimerActive(Timer_CPC_PNHV_Stat_AR2) == 0)
				{
					res = SetTimingCyclic("PNHV_Stat_AR2", 1, tDelay, 1);
					setTimer (Timer_CPC_PNHV_Stat_AR2, tDelay);
					@sysvar::CH_Nodes::CH__STPDU_CPC_PNHV_Stat_AR2 = 2;
				}
			}
			else if (tDelay == 0)
			{
				if (isTimerActive(Timer_CPC_PNHV_Stat_AR2) == 0)
				{
					res = EnableTimingCyclic("PNHV_Stat_AR2", 0);
					res = EnableTimingEvtTrg("PNHV_Stat_AR2", 0);
				}
			}
			break;
		case (2):
			break;
		default:
			Write("error: wrong parameter (%d)", @this);
			stop();
			break;
	}
}

on sysvar sysvar::CH_Nodes::CH__STPDU_CPC_PNHV_WeekDepTmTbl_Stat_AR2
{
	long res;
	long tDelay;
	switch (@this)
	{
		case (0):
			res = ResetTimingCyclic("PNHV_WeekDepTmTbl_Stat_AR2");
			res = ResetTimingEvtTrg("PNHV_WeekDepTmTbl_Stat_AR2");
			res = EnableTimingCyclic("PNHV_WeekDepTmTbl_Stat_AR2", 1);
			res = EnableTimingEvtTrg("PNHV_WeekDepTmTbl_Stat_AR2", 1);
			break;
		case (1):
			tDelay = @sysvar::CH_Nodes::CH__STPDU_T_CPC_PNHV_WeekDepTmTbl_Stat_AR2;
			if (tDelay > 0)
			{
				if (isTimerActive(Timer_CPC_PNHV_WeekDepTmTbl_Stat_AR2) == 0)
				{
					res = SetTimingCyclic("PNHV_WeekDepTmTbl_Stat_AR2", 1, tDelay, 1);
					setTimer (Timer_CPC_PNHV_WeekDepTmTbl_Stat_AR2, tDelay);
					@sysvar::CH_Nodes::CH__STPDU_CPC_PNHV_WeekDepTmTbl_Stat_AR2 = 2;
				}
			}
			else if (tDelay == 0)
			{
				if (isTimerActive(Timer_CPC_PNHV_WeekDepTmTbl_Stat_AR2) == 0)
				{
					res = EnableTimingCyclic("PNHV_WeekDepTmTbl_Stat_AR2", 0);
					res = EnableTimingEvtTrg("PNHV_WeekDepTmTbl_Stat_AR2", 0);
				}
			}
			break;
		case (2):
			break;
		default:
			Write("error: wrong parameter (%d)", @this);
			stop();
			break;
	}
}

on sysvar sysvar::CH_Nodes::CH__STPDU_CPC_PT_DataContain_Rq_AR2
{
	long res;
	long tDelay;
	switch (@this)
	{
		case (0):
			res = ResetTimingCyclic("PT_DataContain_Rq_AR2");
			res = ResetTimingEvtTrg("PT_DataContain_Rq_AR2");
			res = EnableTimingCyclic("PT_DataContain_Rq_AR2", 1);
			res = EnableTimingEvtTrg("PT_DataContain_Rq_AR2", 1);
			break;
		case (1):
			tDelay = @sysvar::CH_Nodes::CH__STPDU_T_CPC_PT_DataContain_Rq_AR2;
			if (tDelay > 0)
			{
				if (isTimerActive(Timer_CPC_PT_DataContain_Rq_AR2) == 0)
				{
					res = SetTimingCyclic("PT_DataContain_Rq_AR2", 1, tDelay, 1);
					setTimer (Timer_CPC_PT_DataContain_Rq_AR2, tDelay);
					@sysvar::CH_Nodes::CH__STPDU_CPC_PT_DataContain_Rq_AR2 = 2;
				}
			}
			else if (tDelay == 0)
			{
				if (isTimerActive(Timer_CPC_PT_DataContain_Rq_AR2) == 0)
				{
					res = EnableTimingCyclic("PT_DataContain_Rq_AR2", 0);
					res = EnableTimingEvtTrg("PT_DataContain_Rq_AR2", 0);
				}
			}
			break;
		case (2):
			break;
		default:
			Write("error: wrong parameter (%d)", @this);
			stop();
			break;
	}
}

on sysvar sysvar::CH_Nodes::CH__STPDU_CPC_PT_Disp_Rq2_AR
{
	long res;
	long tDelay;
	switch (@this)
	{
		case (0):
			res = ResetTimingCyclic("PT_Disp_Rq2_AR");
			res = ResetTimingEvtTrg("PT_Disp_Rq2_AR");
			res = EnableTimingCyclic("PT_Disp_Rq2_AR", 1);
			res = EnableTimingEvtTrg("PT_Disp_Rq2_AR", 1);
			break;
		case (1):
			tDelay = @sysvar::CH_Nodes::CH__STPDU_T_CPC_PT_Disp_Rq2_AR;
			if (tDelay > 0)
			{
				if (isTimerActive(Timer_CPC_PT_Disp_Rq2_AR) == 0)
				{
					res = SetTimingCyclic("PT_Disp_Rq2_AR", 1, tDelay, 1);
					setTimer (Timer_CPC_PT_Disp_Rq2_AR, tDelay);
					@sysvar::CH_Nodes::CH__STPDU_CPC_PT_Disp_Rq2_AR = 2;
				}
			}
			else if (tDelay == 0)
			{
				if (isTimerActive(Timer_CPC_PT_Disp_Rq2_AR) == 0)
				{
					res = EnableTimingCyclic("PT_Disp_Rq2_AR", 0);
					res = EnableTimingEvtTrg("PT_Disp_Rq2_AR", 0);
				}
			}
			break;
		case (2):
			break;
		default:
			Write("error: wrong parameter (%d)", @this);
			stop();
			break;
	}
}

on sysvar sysvar::CH_Nodes::CH__STPDU_CPC_PT_ThermM_AR2
{
	long res;
	long tDelay;
	switch (@this)
	{
		case (0):
			res = ResetTimingCyclic("PT_ThermM_AR2");
			res = ResetTimingEvtTrg("PT_ThermM_AR2");
			res = EnableTimingCyclic("PT_ThermM_AR2", 1);
			res = EnableTimingEvtTrg("PT_ThermM_AR2", 1);
			break;
		case (1):
			tDelay = @sysvar::CH_Nodes::CH__STPDU_T_CPC_PT_ThermM_AR2;
			if (tDelay > 0)
			{
				if (isTimerActive(Timer_CPC_PT_ThermM_AR2) == 0)
				{
					res = SetTimingCyclic("PT_ThermM_AR2", 1, tDelay, 1);
					setTimer (Timer_CPC_PT_ThermM_AR2, tDelay);
					@sysvar::CH_Nodes::CH__STPDU_CPC_PT_ThermM_AR2 = 2;
				}
			}
			else if (tDelay == 0)
			{
				if (isTimerActive(Timer_CPC_PT_ThermM_AR2) == 0)
				{
					res = EnableTimingCyclic("PT_ThermM_AR2", 0);
					res = EnableTimingEvtTrg("PT_ThermM_AR2", 0);
				}
			}
			break;
		case (2):
			break;
		default:
			Write("error: wrong parameter (%d)", @this);
			stop();
			break;
	}
}

on sysvar sysvar::CH_Nodes::CH__STPDU_CPC_PT_ThermM_Rq_AR2
{
	long res;
	long tDelay;
	switch (@this)
	{
		case (0):
			res = ResetTimingCyclic("PT_ThermM_Rq_AR2");
			res = ResetTimingEvtTrg("PT_ThermM_Rq_AR2");
			res = EnableTimingCyclic("PT_ThermM_Rq_AR2", 1);
			res = EnableTimingEvtTrg("PT_ThermM_Rq_AR2", 1);
			break;
		case (1):
			tDelay = @sysvar::CH_Nodes::CH__STPDU_T_CPC_PT_ThermM_Rq_AR2;
			if (tDelay > 0)
			{
				if (isTimerActive(Timer_CPC_PT_ThermM_Rq_AR2) == 0)
				{
					res = SetTimingCyclic("PT_ThermM_Rq_AR2", 1, tDelay, 1);
					setTimer (Timer_CPC_PT_ThermM_Rq_AR2, tDelay);
					@sysvar::CH_Nodes::CH__STPDU_CPC_PT_ThermM_Rq_AR2 = 2;
				}
			}
			else if (tDelay == 0)
			{
				if (isTimerActive(Timer_CPC_PT_ThermM_Rq_AR2) == 0)
				{
					res = EnableTimingCyclic("PT_ThermM_Rq_AR2", 0);
					res = EnableTimingEvtTrg("PT_ThermM_Rq_AR2", 0);
				}
			}
			break;
		case (2):
			break;
		default:
			Write("error: wrong parameter (%d)", @this);
			stop();
			break;
	}
}

on sysvar sysvar::CH_Nodes::CH__STPDU_CPC_PtHyb_Mngmnt_Rq1_AR
{
	long res;
	long tDelay;
	switch (@this)
	{
		case (0):
			res = ResetTimingCyclic("PtHyb_Mngmnt_Rq1_AR");
			res = ResetTimingEvtTrg("PtHyb_Mngmnt_Rq1_AR");
			res = EnableTimingCyclic("PtHyb_Mngmnt_Rq1_AR", 1);
			res = EnableTimingEvtTrg("PtHyb_Mngmnt_Rq1_AR", 1);
			break;
		case (1):
			tDelay = @sysvar::CH_Nodes::CH__STPDU_T_CPC_PtHyb_Mngmnt_Rq1_AR;
			if (tDelay > 0)
			{
				if (isTimerActive(Timer_CPC_PtHyb_Mngmnt_Rq1_AR) == 0)
				{
					res = SetTimingCyclic("PtHyb_Mngmnt_Rq1_AR", 1, tDelay, 1);
					setTimer (Timer_CPC_PtHyb_Mngmnt_Rq1_AR, tDelay);
					@sysvar::CH_Nodes::CH__STPDU_CPC_PtHyb_Mngmnt_Rq1_AR = 2;
				}
			}
			else if (tDelay == 0)
			{
				if (isTimerActive(Timer_CPC_PtHyb_Mngmnt_Rq1_AR) == 0)
				{
					res = EnableTimingCyclic("PtHyb_Mngmnt_Rq1_AR", 0);
					res = EnableTimingEvtTrg("PtHyb_Mngmnt_Rq1_AR", 0);
				}
			}
			break;
		case (2):
			break;
		default:
			Write("error: wrong parameter (%d)", @this);
			stop();
			break;
	}
}

on sysvar sysvar::CH_Nodes::CH__STPDU_CPC_PtMngmnt_Disp_Rq_AR2
{
	long res;
	long tDelay;
	switch (@this)
	{
		case (0):
			res = ResetTimingCyclic("PtMngmnt_Disp_Rq_AR2");
			res = ResetTimingEvtTrg("PtMngmnt_Disp_Rq_AR2");
			res = EnableTimingCyclic("PtMngmnt_Disp_Rq_AR2", 1);
			res = EnableTimingEvtTrg("PtMngmnt_Disp_Rq_AR2", 1);
			break;
		case (1):
			tDelay = @sysvar::CH_Nodes::CH__STPDU_T_CPC_PtMngmnt_Disp_Rq_AR2;
			if (tDelay > 0)
			{
				if (isTimerActive(Timer_CPC_PtMngmnt_Disp_Rq_AR2) == 0)
				{
					res = SetTimingCyclic("PtMngmnt_Disp_Rq_AR2", 1, tDelay, 1);
					setTimer (Timer_CPC_PtMngmnt_Disp_Rq_AR2, tDelay);
					@sysvar::CH_Nodes::CH__STPDU_CPC_PtMngmnt_Disp_Rq_AR2 = 2;
				}
			}
			else if (tDelay == 0)
			{
				if (isTimerActive(Timer_CPC_PtMngmnt_Disp_Rq_AR2) == 0)
				{
					res = EnableTimingCyclic("PtMngmnt_Disp_Rq_AR2", 0);
					res = EnableTimingEvtTrg("PtMngmnt_Disp_Rq_AR2", 0);
				}
			}
			break;
		case (2):
			break;
		default:
			Write("error: wrong parameter (%d)", @this);
			stop();
			break;
	}
}

on sysvar sysvar::CH_Nodes::CH__STPDU_CPC_PtMngmnt_Rq_AR2
{
	long res;
	long tDelay;
	switch (@this)
	{
		case (0):
			res = ResetTimingCyclic("PtMngmnt_Rq_AR2");
			res = ResetTimingEvtTrg("PtMngmnt_Rq_AR2");
			res = EnableTimingCyclic("PtMngmnt_Rq_AR2", 1);
			res = EnableTimingEvtTrg("PtMngmnt_Rq_AR2", 1);
			break;
		case (1):
			tDelay = @sysvar::CH_Nodes::CH__STPDU_T_CPC_PtMngmnt_Rq_AR2;
			if (tDelay > 0)
			{
				if (isTimerActive(Timer_CPC_PtMngmnt_Rq_AR2) == 0)
				{
					res = SetTimingCyclic("PtMngmnt_Rq_AR2", 1, tDelay, 1);
					setTimer (Timer_CPC_PtMngmnt_Rq_AR2, tDelay);
					@sysvar::CH_Nodes::CH__STPDU_CPC_PtMngmnt_Rq_AR2 = 2;
				}
			}
			else if (tDelay == 0)
			{
				if (isTimerActive(Timer_CPC_PtMngmnt_Rq_AR2) == 0)
				{
					res = EnableTimingCyclic("PtMngmnt_Rq_AR2", 0);
					res = EnableTimingEvtTrg("PtMngmnt_Rq_AR2", 0);
				}
			}
			break;
		case (2):
			break;
		default:
			Write("error: wrong parameter (%d)", @this);
			stop();
			break;
	}
}

on sysvar sysvar::CH_Nodes::CH__STPDU_CPC_PtMngmnt_Stat2_AR2
{
	long res;
	long tDelay;
	switch (@this)
	{
		case (0):
			res = ResetTimingCyclic("PtMngmnt_Stat2_AR2");
			res = ResetTimingEvtTrg("PtMngmnt_Stat2_AR2");
			res = EnableTimingCyclic("PtMngmnt_Stat2_AR2", 1);
			res = EnableTimingEvtTrg("PtMngmnt_Stat2_AR2", 1);
			break;
		case (1):
			tDelay = @sysvar::CH_Nodes::CH__STPDU_T_CPC_PtMngmnt_Stat2_AR2;
			if (tDelay > 0)
			{
				if (isTimerActive(Timer_CPC_PtMngmnt_Stat2_AR2) == 0)
				{
					res = SetTimingCyclic("PtMngmnt_Stat2_AR2", 1, tDelay, 1);
					setTimer (Timer_CPC_PtMngmnt_Stat2_AR2, tDelay);
					@sysvar::CH_Nodes::CH__STPDU_CPC_PtMngmnt_Stat2_AR2 = 2;
				}
			}
			else if (tDelay == 0)
			{
				if (isTimerActive(Timer_CPC_PtMngmnt_Stat2_AR2) == 0)
				{
					res = EnableTimingCyclic("PtMngmnt_Stat2_AR2", 0);
					res = EnableTimingEvtTrg("PtMngmnt_Stat2_AR2", 0);
				}
			}
			break;
		case (2):
			break;
		default:
			Write("error: wrong parameter (%d)", @this);
			stop();
			break;
	}
}

on sysvar sysvar::CH_Nodes::CH__STPDU_CPC_PtMngmnt_Stat_AR2
{
	long res;
	long tDelay;
	switch (@this)
	{
		case (0):
			res = ResetTimingCyclic("PtMngmnt_Stat_AR2");
			res = ResetTimingEvtTrg("PtMngmnt_Stat_AR2");
			res = EnableTimingCyclic("PtMngmnt_Stat_AR2", 1);
			res = EnableTimingEvtTrg("PtMngmnt_Stat_AR2", 1);
			break;
		case (1):
			tDelay = @sysvar::CH_Nodes::CH__STPDU_T_CPC_PtMngmnt_Stat_AR2;
			if (tDelay > 0)
			{
				if (isTimerActive(Timer_CPC_PtMngmnt_Stat_AR2) == 0)
				{
					res = SetTimingCyclic("PtMngmnt_Stat_AR2", 1, tDelay, 1);
					setTimer (Timer_CPC_PtMngmnt_Stat_AR2, tDelay);
					@sysvar::CH_Nodes::CH__STPDU_CPC_PtMngmnt_Stat_AR2 = 2;
				}
			}
			else if (tDelay == 0)
			{
				if (isTimerActive(Timer_CPC_PtMngmnt_Stat_AR2) == 0)
				{
					res = EnableTimingCyclic("PtMngmnt_Stat_AR2", 0);
					res = EnableTimingEvtTrg("PtMngmnt_Stat_AR2", 0);
				}
			}
			break;
		case (2):
			break;
		default:
			Write("error: wrong parameter (%d)", @this);
			stop();
			break;
	}
}

on sysvar sysvar::CH_Nodes::CH__STPDU_CPC_SBW_DrvPosn_Disp_Rq_ISM_AR2
{
	long res;
	long tDelay;
	switch (@this)
	{
		case (0):
			res = ResetTimingCyclic("SBW_DrvPosn_Disp_Rq_ISM_AR2");
			res = ResetTimingEvtTrg("SBW_DrvPosn_Disp_Rq_ISM_AR2");
			res = EnableTimingCyclic("SBW_DrvPosn_Disp_Rq_ISM_AR2", 1);
			res = EnableTimingEvtTrg("SBW_DrvPosn_Disp_Rq_ISM_AR2", 1);
			break;
		case (1):
			tDelay = @sysvar::CH_Nodes::CH__STPDU_T_CPC_SBW_DrvPosn_Disp_Rq_ISM_AR2;
			if (tDelay > 0)
			{
				if (isTimerActive(Timer_CPC_SBW_DrvPosn_Disp_Rq_ISM_AR2) == 0)
				{
					res = SetTimingCyclic("SBW_DrvPosn_Disp_Rq_ISM_AR2", 1, tDelay, 1);
					setTimer (Timer_CPC_SBW_DrvPosn_Disp_Rq_ISM_AR2, tDelay);
					@sysvar::CH_Nodes::CH__STPDU_CPC_SBW_DrvPosn_Disp_Rq_ISM_AR2 = 2;
				}
			}
			else if (tDelay == 0)
			{
				if (isTimerActive(Timer_CPC_SBW_DrvPosn_Disp_Rq_ISM_AR2) == 0)
				{
					res = EnableTimingCyclic("SBW_DrvPosn_Disp_Rq_ISM_AR2", 0);
					res = EnableTimingEvtTrg("SBW_DrvPosn_Disp_Rq_ISM_AR2", 0);
				}
			}
			break;
		case (2):
			break;
		default:
			Write("error: wrong parameter (%d)", @this);
			stop();
			break;
	}
}

on sysvar sysvar::CH_Nodes::CH__STPDU_CPC_SBW_DrvPosn_Disp_Rq_TCM_AR2
{
	long res;
	long tDelay;
	switch (@this)
	{
		case (0):
			res = ResetTimingCyclic("SBW_DrvPosn_Disp_Rq_TCM_AR2");
			res = ResetTimingEvtTrg("SBW_DrvPosn_Disp_Rq_TCM_AR2");
			res = EnableTimingCyclic("SBW_DrvPosn_Disp_Rq_TCM_AR2", 1);
			res = EnableTimingEvtTrg("SBW_DrvPosn_Disp_Rq_TCM_AR2", 1);
			break;
		case (1):
			tDelay = @sysvar::CH_Nodes::CH__STPDU_T_CPC_SBW_DrvPosn_Disp_Rq_TCM_AR2;
			if (tDelay > 0)
			{
				if (isTimerActive(Timer_CPC_SBW_DrvPosn_Disp_Rq_TCM_AR2) == 0)
				{
					res = SetTimingCyclic("SBW_DrvPosn_Disp_Rq_TCM_AR2", 1, tDelay, 1);
					setTimer (Timer_CPC_SBW_DrvPosn_Disp_Rq_TCM_AR2, tDelay);
					@sysvar::CH_Nodes::CH__STPDU_CPC_SBW_DrvPosn_Disp_Rq_TCM_AR2 = 2;
				}
			}
			else if (tDelay == 0)
			{
				if (isTimerActive(Timer_CPC_SBW_DrvPosn_Disp_Rq_TCM_AR2) == 0)
				{
					res = EnableTimingCyclic("SBW_DrvPosn_Disp_Rq_TCM_AR2", 0);
					res = EnableTimingEvtTrg("SBW_DrvPosn_Disp_Rq_TCM_AR2", 0);
				}
			}
			break;
		case (2):
			break;
		default:
			Write("error: wrong parameter (%d)", @this);
			stop();
			break;
	}
}

on sysvar sysvar::CH_Nodes::CH__STPDU_CPC_SBW_Stat_AR2
{
	long res;
	long tDelay;
	switch (@this)
	{
		case (0):
			res = ResetTimingCyclic("SBW_Stat_AR2");
			res = ResetTimingEvtTrg("SBW_Stat_AR2");
			res = EnableTimingCyclic("SBW_Stat_AR2", 1);
			res = EnableTimingEvtTrg("SBW_Stat_AR2", 1);
			break;
		case (1):
			tDelay = @sysvar::CH_Nodes::CH__STPDU_T_CPC_SBW_Stat_AR2;
			if (tDelay > 0)
			{
				if (isTimerActive(Timer_CPC_SBW_Stat_AR2) == 0)
				{
					res = SetTimingCyclic("SBW_Stat_AR2", 1, tDelay, 1);
					setTimer (Timer_CPC_SBW_Stat_AR2, tDelay);
					@sysvar::CH_Nodes::CH__STPDU_CPC_SBW_Stat_AR2 = 2;
				}
			}
			else if (tDelay == 0)
			{
				if (isTimerActive(Timer_CPC_SBW_Stat_AR2) == 0)
				{
					res = EnableTimingCyclic("SBW_Stat_AR2", 0);
					res = EnableTimingEvtTrg("SBW_Stat_AR2", 0);
				}
			}
			break;
		case (2):
			break;
		default:
			Write("error: wrong parameter (%d)", @this);
			stop();
			break;
	}
}

on sysvar sysvar::CH_Nodes::CH__STPDU_CPC_SND_GEN_Stat_AR
{
	long res;
	long tDelay;
	switch (@this)
	{
		case (0):
			res = ResetTimingCyclic("SND_GEN_Stat_AR");
			res = ResetTimingEvtTrg("SND_GEN_Stat_AR");
			res = EnableTimingCyclic("SND_GEN_Stat_AR", 1);
			res = EnableTimingEvtTrg("SND_GEN_Stat_AR", 1);
			break;
		case (1):
			tDelay = @sysvar::CH_Nodes::CH__STPDU_T_CPC_SND_GEN_Stat_AR;
			if (tDelay > 0)
			{
				if (isTimerActive(Timer_CPC_SND_GEN_Stat_AR) == 0)
				{
					res = SetTimingCyclic("SND_GEN_Stat_AR", 1, tDelay, 1);
					setTimer (Timer_CPC_SND_GEN_Stat_AR, tDelay);
					@sysvar::CH_Nodes::CH__STPDU_CPC_SND_GEN_Stat_AR = 2;
				}
			}
			else if (tDelay == 0)
			{
				if (isTimerActive(Timer_CPC_SND_GEN_Stat_AR) == 0)
				{
					res = EnableTimingCyclic("SND_GEN_Stat_AR", 0);
					res = EnableTimingEvtTrg("SND_GEN_Stat_AR", 0);
				}
			}
			break;
		case (2):
			break;
		default:
			Write("error: wrong parameter (%d)", @this);
			stop();
			break;
	}
}

on sysvar sysvar::CH_Nodes::CH__STPDU_CPC_TC_Disp_Rq_ECM_AR
{
	long res;
	long tDelay;
	switch (@this)
	{
		case (0):
			res = ResetTimingCyclic("TC_Disp_Rq_ECM_AR");
			res = ResetTimingEvtTrg("TC_Disp_Rq_ECM_AR");
			res = EnableTimingCyclic("TC_Disp_Rq_ECM_AR", 1);
			res = EnableTimingEvtTrg("TC_Disp_Rq_ECM_AR", 1);
			break;
		case (1):
			tDelay = @sysvar::CH_Nodes::CH__STPDU_T_CPC_TC_Disp_Rq_ECM_AR;
			if (tDelay > 0)
			{
				if (isTimerActive(Timer_CPC_TC_Disp_Rq_ECM_AR) == 0)
				{
					res = SetTimingCyclic("TC_Disp_Rq_ECM_AR", 1, tDelay, 1);
					setTimer (Timer_CPC_TC_Disp_Rq_ECM_AR, tDelay);
					@sysvar::CH_Nodes::CH__STPDU_CPC_TC_Disp_Rq_ECM_AR = 2;
				}
			}
			else if (tDelay == 0)
			{
				if (isTimerActive(Timer_CPC_TC_Disp_Rq_ECM_AR) == 0)
				{
					res = EnableTimingCyclic("TC_Disp_Rq_ECM_AR", 0);
					res = EnableTimingEvtTrg("TC_Disp_Rq_ECM_AR", 0);
				}
			}
			break;
		case (2):
			break;
		default:
			Write("error: wrong parameter (%d)", @this);
			stop();
			break;
	}
}

on sysvar sysvar::CH_Nodes::CH__STPDU_CPC_TC_EBBC_Disp_Rq_ECM_AR
{
	long res;
	long tDelay;
	switch (@this)
	{
		case (0):
			res = ResetTimingCyclic("TC_EBBC_Disp_Rq_ECM_AR");
			res = ResetTimingEvtTrg("TC_EBBC_Disp_Rq_ECM_AR");
			res = EnableTimingCyclic("TC_EBBC_Disp_Rq_ECM_AR", 1);
			res = EnableTimingEvtTrg("TC_EBBC_Disp_Rq_ECM_AR", 1);
			break;
		case (1):
			tDelay = @sysvar::CH_Nodes::CH__STPDU_T_CPC_TC_EBBC_Disp_Rq_ECM_AR;
			if (tDelay > 0)
			{
				if (isTimerActive(Timer_CPC_TC_EBBC_Disp_Rq_ECM_AR) == 0)
				{
					res = SetTimingCyclic("TC_EBBC_Disp_Rq_ECM_AR", 1, tDelay, 1);
					setTimer (Timer_CPC_TC_EBBC_Disp_Rq_ECM_AR, tDelay);
					@sysvar::CH_Nodes::CH__STPDU_CPC_TC_EBBC_Disp_Rq_ECM_AR = 2;
				}
			}
			else if (tDelay == 0)
			{
				if (isTimerActive(Timer_CPC_TC_EBBC_Disp_Rq_ECM_AR) == 0)
				{
					res = EnableTimingCyclic("TC_EBBC_Disp_Rq_ECM_AR", 0);
					res = EnableTimingEvtTrg("TC_EBBC_Disp_Rq_ECM_AR", 0);
				}
			}
			break;
		case (2):
			break;
		default:
			Write("error: wrong parameter (%d)", @this);
			stop();
			break;
	}
}

on sysvar sysvar::CH_Nodes::CH__STPDU_CPC_TC_EEBBC_Disp_Rq_AR
{
	long res;
	long tDelay;
	switch (@this)
	{
		case (0):
			res = ResetTimingCyclic("TC_EEBBC_Disp_Rq_AR");
			res = ResetTimingEvtTrg("TC_EEBBC_Disp_Rq_AR");
			res = EnableTimingCyclic("TC_EEBBC_Disp_Rq_AR", 1);
			res = EnableTimingEvtTrg("TC_EEBBC_Disp_Rq_AR", 1);
			break;
		case (1):
			tDelay = @sysvar::CH_Nodes::CH__STPDU_T_CPC_TC_EEBBC_Disp_Rq_AR;
			if (tDelay > 0)
			{
				if (isTimerActive(Timer_CPC_TC_EEBBC_Disp_Rq_AR) == 0)
				{
					res = SetTimingCyclic("TC_EEBBC_Disp_Rq_AR", 1, tDelay, 1);
					setTimer (Timer_CPC_TC_EEBBC_Disp_Rq_AR, tDelay);
					@sysvar::CH_Nodes::CH__STPDU_CPC_TC_EEBBC_Disp_Rq_AR = 2;
				}
			}
			else if (tDelay == 0)
			{
				if (isTimerActive(Timer_CPC_TC_EEBBC_Disp_Rq_AR) == 0)
				{
					res = EnableTimingCyclic("TC_EEBBC_Disp_Rq_AR", 0);
					res = EnableTimingEvtTrg("TC_EEBBC_Disp_Rq_AR", 0);
				}
			}
			break;
		case (2):
			break;
		default:
			Write("error: wrong parameter (%d)", @this);
			stop();
			break;
	}
}

on sysvar sysvar::CH_Nodes::CH__STPDU_CPC_TCM_DAC4_AR
{
	long res;
	long tDelay;
	switch (@this)
	{
		case (0):
			res = ResetTimingCyclic("TCM_DAC4_AR");
			res = ResetTimingEvtTrg("TCM_DAC4_AR");
			res = EnableTimingCyclic("TCM_DAC4_AR", 1);
			res = EnableTimingEvtTrg("TCM_DAC4_AR", 1);
			break;
		case (1):
			tDelay = @sysvar::CH_Nodes::CH__STPDU_T_CPC_TCM_DAC4_AR;
			if (tDelay > 0)
			{
				if (isTimerActive(Timer_CPC_TCM_DAC4_AR) == 0)
				{
					res = SetTimingCyclic("TCM_DAC4_AR", 1, tDelay, 1);
					setTimer (Timer_CPC_TCM_DAC4_AR, tDelay);
					@sysvar::CH_Nodes::CH__STPDU_CPC_TCM_DAC4_AR = 2;
				}
			}
			else if (tDelay == 0)
			{
				if (isTimerActive(Timer_CPC_TCM_DAC4_AR) == 0)
				{
					res = EnableTimingCyclic("TCM_DAC4_AR", 0);
					res = EnableTimingEvtTrg("TCM_DAC4_AR", 0);
				}
			}
			break;
		case (2):
			break;
		default:
			Write("error: wrong parameter (%d)", @this);
			stop();
			break;
	}
}

on sysvar sysvar::CH_Nodes::CH__STPDU_CPC_TCM_Data2_AR2
{
	long res;
	long tDelay;
	switch (@this)
	{
		case (0):
			res = ResetTimingCyclic("TCM_Data2_AR2");
			res = ResetTimingEvtTrg("TCM_Data2_AR2");
			res = EnableTimingCyclic("TCM_Data2_AR2", 1);
			res = EnableTimingEvtTrg("TCM_Data2_AR2", 1);
			break;
		case (1):
			tDelay = @sysvar::CH_Nodes::CH__STPDU_T_CPC_TCM_Data2_AR2;
			if (tDelay > 0)
			{
				if (isTimerActive(Timer_CPC_TCM_Data2_AR2) == 0)
				{
					res = SetTimingCyclic("TCM_Data2_AR2", 1, tDelay, 1);
					setTimer (Timer_CPC_TCM_Data2_AR2, tDelay);
					@sysvar::CH_Nodes::CH__STPDU_CPC_TCM_Data2_AR2 = 2;
				}
			}
			else if (tDelay == 0)
			{
				if (isTimerActive(Timer_CPC_TCM_Data2_AR2) == 0)
				{
					res = EnableTimingCyclic("TCM_Data2_AR2", 0);
					res = EnableTimingEvtTrg("TCM_Data2_AR2", 0);
				}
			}
			break;
		case (2):
			break;
		default:
			Write("error: wrong parameter (%d)", @this);
			stop();
			break;
	}
}

on sysvar sysvar::CH_Nodes::CH__STPDU_CPC_TCM_Data3_AR2
{
	long res;
	long tDelay;
	switch (@this)
	{
		case (0):
			res = ResetTimingCyclic("TCM_Data3_AR2");
			res = ResetTimingEvtTrg("TCM_Data3_AR2");
			res = EnableTimingCyclic("TCM_Data3_AR2", 1);
			res = EnableTimingEvtTrg("TCM_Data3_AR2", 1);
			break;
		case (1):
			tDelay = @sysvar::CH_Nodes::CH__STPDU_T_CPC_TCM_Data3_AR2;
			if (tDelay > 0)
			{
				if (isTimerActive(Timer_CPC_TCM_Data3_AR2) == 0)
				{
					res = SetTimingCyclic("TCM_Data3_AR2", 1, tDelay, 1);
					setTimer (Timer_CPC_TCM_Data3_AR2, tDelay);
					@sysvar::CH_Nodes::CH__STPDU_CPC_TCM_Data3_AR2 = 2;
				}
			}
			else if (tDelay == 0)
			{
				if (isTimerActive(Timer_CPC_TCM_Data3_AR2) == 0)
				{
					res = EnableTimingCyclic("TCM_Data3_AR2", 0);
					res = EnableTimingEvtTrg("TCM_Data3_AR2", 0);
				}
			}
			break;
		case (2):
			break;
		default:
			Write("error: wrong parameter (%d)", @this);
			stop();
			break;
	}
}

on sysvar sysvar::CH_Nodes::CH__STPDU_CPC_TCM_Disp_Rq_AMG_AR
{
	long res;
	long tDelay;
	switch (@this)
	{
		case (0):
			res = ResetTimingCyclic("TCM_Disp_Rq_AMG_AR");
			res = ResetTimingEvtTrg("TCM_Disp_Rq_AMG_AR");
			res = EnableTimingCyclic("TCM_Disp_Rq_AMG_AR", 1);
			res = EnableTimingEvtTrg("TCM_Disp_Rq_AMG_AR", 1);
			break;
		case (1):
			tDelay = @sysvar::CH_Nodes::CH__STPDU_T_CPC_TCM_Disp_Rq_AMG_AR;
			if (tDelay > 0)
			{
				if (isTimerActive(Timer_CPC_TCM_Disp_Rq_AMG_AR) == 0)
				{
					res = SetTimingCyclic("TCM_Disp_Rq_AMG_AR", 1, tDelay, 1);
					setTimer (Timer_CPC_TCM_Disp_Rq_AMG_AR, tDelay);
					@sysvar::CH_Nodes::CH__STPDU_CPC_TCM_Disp_Rq_AMG_AR = 2;
				}
			}
			else if (tDelay == 0)
			{
				if (isTimerActive(Timer_CPC_TCM_Disp_Rq_AMG_AR) == 0)
				{
					res = EnableTimingCyclic("TCM_Disp_Rq_AMG_AR", 0);
					res = EnableTimingEvtTrg("TCM_Disp_Rq_AMG_AR", 0);
				}
			}
			break;
		case (2):
			break;
		default:
			Write("error: wrong parameter (%d)", @this);
			stop();
			break;
	}
}

on sysvar sysvar::CH_Nodes::CH__STPDU_CPC_TCM_State3_AR2
{
	long res;
	long tDelay;
	switch (@this)
	{
		case (0):
			res = ResetTimingCyclic("TCM_State3_AR2");
			res = ResetTimingEvtTrg("TCM_State3_AR2");
			res = EnableTimingCyclic("TCM_State3_AR2", 1);
			res = EnableTimingEvtTrg("TCM_State3_AR2", 1);
			break;
		case (1):
			tDelay = @sysvar::CH_Nodes::CH__STPDU_T_CPC_TCM_State3_AR2;
			if (tDelay > 0)
			{
				if (isTimerActive(Timer_CPC_TCM_State3_AR2) == 0)
				{
					res = SetTimingCyclic("TCM_State3_AR2", 1, tDelay, 1);
					setTimer (Timer_CPC_TCM_State3_AR2, tDelay);
					@sysvar::CH_Nodes::CH__STPDU_CPC_TCM_State3_AR2 = 2;
				}
			}
			else if (tDelay == 0)
			{
				if (isTimerActive(Timer_CPC_TCM_State3_AR2) == 0)
				{
					res = EnableTimingCyclic("TCM_State3_AR2", 0);
					res = EnableTimingEvtTrg("TCM_State3_AR2", 0);
				}
			}
			break;
		case (2):
			break;
		default:
			Write("error: wrong parameter (%d)", @this);
			stop();
			break;
	}
}

on sysvar sysvar::CH_Nodes::CH__STPDU_CPC_TCU_Disp_Rq_AR2
{
	long res;
	long tDelay;
	switch (@this)
	{
		case (0):
			res = ResetTimingCyclic("TCU_Disp_Rq_AR2");
			res = ResetTimingEvtTrg("TCU_Disp_Rq_AR2");
			res = EnableTimingCyclic("TCU_Disp_Rq_AR2", 1);
			res = EnableTimingEvtTrg("TCU_Disp_Rq_AR2", 1);
			break;
		case (1):
			tDelay = @sysvar::CH_Nodes::CH__STPDU_T_CPC_TCU_Disp_Rq_AR2;
			if (tDelay > 0)
			{
				if (isTimerActive(Timer_CPC_TCU_Disp_Rq_AR2) == 0)
				{
					res = SetTimingCyclic("TCU_Disp_Rq_AR2", 1, tDelay, 1);
					setTimer (Timer_CPC_TCU_Disp_Rq_AR2, tDelay);
					@sysvar::CH_Nodes::CH__STPDU_CPC_TCU_Disp_Rq_AR2 = 2;
				}
			}
			else if (tDelay == 0)
			{
				if (isTimerActive(Timer_CPC_TCU_Disp_Rq_AR2) == 0)
				{
					res = EnableTimingCyclic("TCU_Disp_Rq_AR2", 0);
					res = EnableTimingEvtTrg("TCU_Disp_Rq_AR2", 0);
				}
			}
			break;
		case (2):
			break;
		default:
			Write("error: wrong parameter (%d)", @this);
			stop();
			break;
	}
}

on sysvar sysvar::CH_Nodes::CH__STPDU_CPC_ThermMngmnt_1_AR2
{
	long res;
	long tDelay;
	switch (@this)
	{
		case (0):
			res = ResetTimingCyclic("ThermMngmnt_1_AR2");
			res = ResetTimingEvtTrg("ThermMngmnt_1_AR2");
			res = EnableTimingCyclic("ThermMngmnt_1_AR2", 1);
			res = EnableTimingEvtTrg("ThermMngmnt_1_AR2", 1);
			break;
		case (1):
			tDelay = @sysvar::CH_Nodes::CH__STPDU_T_CPC_ThermMngmnt_1_AR2;
			if (tDelay > 0)
			{
				if (isTimerActive(Timer_CPC_ThermMngmnt_1_AR2) == 0)
				{
					res = SetTimingCyclic("ThermMngmnt_1_AR2", 1, tDelay, 1);
					setTimer (Timer_CPC_ThermMngmnt_1_AR2, tDelay);
					@sysvar::CH_Nodes::CH__STPDU_CPC_ThermMngmnt_1_AR2 = 2;
				}
			}
			else if (tDelay == 0)
			{
				if (isTimerActive(Timer_CPC_ThermMngmnt_1_AR2) == 0)
				{
					res = EnableTimingCyclic("ThermMngmnt_1_AR2", 0);
					res = EnableTimingEvtTrg("ThermMngmnt_1_AR2", 0);
				}
			}
			break;
		case (2):
			break;
		default:
			Write("error: wrong parameter (%d)", @this);
			stop();
			break;
	}
}

on sysvar sysvar::CH_Nodes::CH__STPDU_CPC_ThermMngmnt_4_AR
{
	long res;
	long tDelay;
	switch (@this)
	{
		case (0):
			res = ResetTimingCyclic("ThermMngmnt_4_AR");
			res = ResetTimingEvtTrg("ThermMngmnt_4_AR");
			res = EnableTimingCyclic("ThermMngmnt_4_AR", 1);
			res = EnableTimingEvtTrg("ThermMngmnt_4_AR", 1);
			break;
		case (1):
			tDelay = @sysvar::CH_Nodes::CH__STPDU_T_CPC_ThermMngmnt_4_AR;
			if (tDelay > 0)
			{
				if (isTimerActive(Timer_CPC_ThermMngmnt_4_AR) == 0)
				{
					res = SetTimingCyclic("ThermMngmnt_4_AR", 1, tDelay, 1);
					setTimer (Timer_CPC_ThermMngmnt_4_AR, tDelay);
					@sysvar::CH_Nodes::CH__STPDU_CPC_ThermMngmnt_4_AR = 2;
				}
			}
			else if (tDelay == 0)
			{
				if (isTimerActive(Timer_CPC_ThermMngmnt_4_AR) == 0)
				{
					res = EnableTimingCyclic("ThermMngmnt_4_AR", 0);
					res = EnableTimingEvtTrg("ThermMngmnt_4_AR", 0);
				}
			}
			break;
		case (2):
			break;
		default:
			Write("error: wrong parameter (%d)", @this);
			stop();
			break;
	}
}

on sysvar sysvar::CH_Nodes::CH__STPDU_CPC_ThermMngmnt_EV_1_AR2
{
	long res;
	long tDelay;
	switch (@this)
	{
		case (0):
			res = ResetTimingCyclic("ThermMngmnt_EV_1_AR2");
			res = ResetTimingEvtTrg("ThermMngmnt_EV_1_AR2");
			res = EnableTimingCyclic("ThermMngmnt_EV_1_AR2", 1);
			res = EnableTimingEvtTrg("ThermMngmnt_EV_1_AR2", 1);
			break;
		case (1):
			tDelay = @sysvar::CH_Nodes::CH__STPDU_T_CPC_ThermMngmnt_EV_1_AR2;
			if (tDelay > 0)
			{
				if (isTimerActive(Timer_CPC_ThermMngmnt_EV_1_AR2) == 0)
				{
					res = SetTimingCyclic("ThermMngmnt_EV_1_AR2", 1, tDelay, 1);
					setTimer (Timer_CPC_ThermMngmnt_EV_1_AR2, tDelay);
					@sysvar::CH_Nodes::CH__STPDU_CPC_ThermMngmnt_EV_1_AR2 = 2;
				}
			}
			else if (tDelay == 0)
			{
				if (isTimerActive(Timer_CPC_ThermMngmnt_EV_1_AR2) == 0)
				{
					res = EnableTimingCyclic("ThermMngmnt_EV_1_AR2", 0);
					res = EnableTimingEvtTrg("ThermMngmnt_EV_1_AR2", 0);
				}
			}
			break;
		case (2):
			break;
		default:
			Write("error: wrong parameter (%d)", @this);
			stop();
			break;
	}
}

on sysvar sysvar::CH_Nodes::CH__STPDU_CPC_VehPwrMngmnt_EMM_Stat2_AR2
{
	long res;
	long tDelay;
	switch (@this)
	{
		case (0):
			res = ResetTimingCyclic("VehPwrMngmnt_EMM_Stat2_AR2");
			res = ResetTimingEvtTrg("VehPwrMngmnt_EMM_Stat2_AR2");
			res = EnableTimingCyclic("VehPwrMngmnt_EMM_Stat2_AR2", 1);
			res = EnableTimingEvtTrg("VehPwrMngmnt_EMM_Stat2_AR2", 1);
			break;
		case (1):
			tDelay = @sysvar::CH_Nodes::CH__STPDU_T_CPC_VehPwrMngmnt_EMM_Stat2_AR2;
			if (tDelay > 0)
			{
				if (isTimerActive(Timer_CPC_VehPwrMngmnt_EMM_Stat2_AR2) == 0)
				{
					res = SetTimingCyclic("VehPwrMngmnt_EMM_Stat2_AR2", 1, tDelay, 1);
					setTimer (Timer_CPC_VehPwrMngmnt_EMM_Stat2_AR2, tDelay);
					@sysvar::CH_Nodes::CH__STPDU_CPC_VehPwrMngmnt_EMM_Stat2_AR2 = 2;
				}
			}
			else if (tDelay == 0)
			{
				if (isTimerActive(Timer_CPC_VehPwrMngmnt_EMM_Stat2_AR2) == 0)
				{
					res = EnableTimingCyclic("VehPwrMngmnt_EMM_Stat2_AR2", 0);
					res = EnableTimingEvtTrg("VehPwrMngmnt_EMM_Stat2_AR2", 0);
				}
			}
			break;
		case (2):
			break;
		default:
			Write("error: wrong parameter (%d)", @this);
			stop();
			break;
	}
}

on sysvar sysvar::CH_Nodes::CH__STPDU_CPC_VehPwrMngmnt_Rq_AR
{
	long res;
	long tDelay;
	switch (@this)
	{
		case (0):
			res = ResetTimingCyclic("VehPwrMngmnt_Rq_AR");
			res = ResetTimingEvtTrg("VehPwrMngmnt_Rq_AR");
			res = EnableTimingCyclic("VehPwrMngmnt_Rq_AR", 1);
			res = EnableTimingEvtTrg("VehPwrMngmnt_Rq_AR", 1);
			break;
		case (1):
			tDelay = @sysvar::CH_Nodes::CH__STPDU_T_CPC_VehPwrMngmnt_Rq_AR;
			if (tDelay > 0)
			{
				if (isTimerActive(Timer_CPC_VehPwrMngmnt_Rq_AR) == 0)
				{
					res = SetTimingCyclic("VehPwrMngmnt_Rq_AR", 1, tDelay, 1);
					setTimer (Timer_CPC_VehPwrMngmnt_Rq_AR, tDelay);
					@sysvar::CH_Nodes::CH__STPDU_CPC_VehPwrMngmnt_Rq_AR = 2;
				}
			}
			else if (tDelay == 0)
			{
				if (isTimerActive(Timer_CPC_VehPwrMngmnt_Rq_AR) == 0)
				{
					res = EnableTimingCyclic("VehPwrMngmnt_Rq_AR", 0);
					res = EnableTimingEvtTrg("VehPwrMngmnt_Rq_AR", 0);
				}
			}
			break;
		case (2):
			break;
		default:
			Write("error: wrong parameter (%d)", @this);
			stop();
			break;
	}
}

on sysvar sysvar::CH_Nodes::CH__STPDU_CPC_WIA_EngTrq_AR
{
	long res;
	long tDelay;
	switch (@this)
	{
		case (0):
			res = ResetTimingCyclic("WIA_EngTrq_AR");
			res = ResetTimingEvtTrg("WIA_EngTrq_AR");
			res = EnableTimingCyclic("WIA_EngTrq_AR", 1);
			res = EnableTimingEvtTrg("WIA_EngTrq_AR", 1);
			break;
		case (1):
			tDelay = @sysvar::CH_Nodes::CH__STPDU_T_CPC_WIA_EngTrq_AR;
			if (tDelay > 0)
			{
				if (isTimerActive(Timer_CPC_WIA_EngTrq_AR) == 0)
				{
					res = SetTimingCyclic("WIA_EngTrq_AR", 1, tDelay, 1);
					setTimer (Timer_CPC_WIA_EngTrq_AR, tDelay);
					@sysvar::CH_Nodes::CH__STPDU_CPC_WIA_EngTrq_AR = 2;
				}
			}
			else if (tDelay == 0)
			{
				if (isTimerActive(Timer_CPC_WIA_EngTrq_AR) == 0)
				{
					res = EnableTimingCyclic("WIA_EngTrq_AR", 0);
					res = EnableTimingEvtTrg("WIA_EngTrq_AR", 0);
				}
			}
			break;
		case (2):
			break;
		default:
			Write("error: wrong parameter (%d)", @this);
			stop();
			break;
	}
}

on sysvar sysvar::CH_Nodes::CH__STPDU_CPC_WPT_Stat2_AR2
{
	long res;
	long tDelay;
	switch (@this)
	{
		case (0):
			res = ResetTimingCyclic("WPT_Stat2_AR2");
			res = ResetTimingEvtTrg("WPT_Stat2_AR2");
			res = EnableTimingCyclic("WPT_Stat2_AR2", 1);
			res = EnableTimingEvtTrg("WPT_Stat2_AR2", 1);
			break;
		case (1):
			tDelay = @sysvar::CH_Nodes::CH__STPDU_T_CPC_WPT_Stat2_AR2;
			if (tDelay > 0)
			{
				if (isTimerActive(Timer_CPC_WPT_Stat2_AR2) == 0)
				{
					res = SetTimingCyclic("WPT_Stat2_AR2", 1, tDelay, 1);
					setTimer (Timer_CPC_WPT_Stat2_AR2, tDelay);
					@sysvar::CH_Nodes::CH__STPDU_CPC_WPT_Stat2_AR2 = 2;
				}
			}
			else if (tDelay == 0)
			{
				if (isTimerActive(Timer_CPC_WPT_Stat2_AR2) == 0)
				{
					res = EnableTimingCyclic("WPT_Stat2_AR2", 0);
					res = EnableTimingEvtTrg("WPT_Stat2_AR2", 0);
				}
			}
			break;
		case (2):
			break;
		default:
			Write("error: wrong parameter (%d)", @this);
			stop();
			break;
	}
}


on sysvar sysvar::CH_Nodes::CH_CPCAdblue_Disp_Rq_AR_UB_AU_01
{
	switch (@sysvar::CH_Nodes::CH_CPCAdblue_Disp_Rq_AR_UB_AU_01)
	{
		case (0):
			enableControl("Adblue_Disp_Rq_AR", "CH_CPCAdblue_Disp_Rq_AR_UB__01", 0); //1: enable; 0: disable
			@sysvar::CH_Nodes::CH_CPCAdblue_Disp_Rq_AR_UB__01 = 1;
			break;
		case (1):
			enableControl("Adblue_Disp_Rq_AR", "CH_CPCAdblue_Disp_Rq_AR_UB__01", 1); //1: enable; 0: disable
			break;
		case (2):
			enableControl("Adblue_Disp_Rq_AR", "CH_CPCAdblue_Disp_Rq_AR_UB__01", 0); //1: enable; 0: disable
			@sysvar::CH_Nodes::CH_CPCAdblue_Disp_Rq_AR_UB__01 = 1;
			break;
		case (3):
			enableControl("Adblue_Disp_Rq_AR", "CH_CPCAdblue_Disp_Rq_AR_UB__01", 0); //1: enable; 0: disable
			@sysvar::CH_Nodes::CH_CPCAdblue_Disp_Rq_AR_UB__01 = 0;
			break;
	}
}

on sysvar sysvar::CH_Nodes::CH_CPCCNG_Disp_Rq_AR2_UB_AUTO_01
{
	switch (@sysvar::CH_Nodes::CH_CPCCNG_Disp_Rq_AR2_UB_AUTO_01)
	{
		case (0):
			enableControl("CNG_Disp_Rq_AR2", "CH_CPCCNG_Disp_Rq_AR2_UB__01", 0); //1: enable; 0: disable
			@sysvar::CH_Nodes::CH_CPCCNG_Disp_Rq_AR2_UB__01 = 1;
			break;
		case (1):
			enableControl("CNG_Disp_Rq_AR2", "CH_CPCCNG_Disp_Rq_AR2_UB__01", 1); //1: enable; 0: disable
			break;
		case (2):
			enableControl("CNG_Disp_Rq_AR2", "CH_CPCCNG_Disp_Rq_AR2_UB__01", 0); //1: enable; 0: disable
			@sysvar::CH_Nodes::CH_CPCCNG_Disp_Rq_AR2_UB__01 = 1;
			break;
		case (3):
			enableControl("CNG_Disp_Rq_AR2", "CH_CPCCNG_Disp_Rq_AR2_UB__01", 0); //1: enable; 0: disable
			@sysvar::CH_Nodes::CH_CPCCNG_Disp_Rq_AR2_UB__01 = 0;
			break;
	}
}

on sysvar sysvar::CH_Nodes::CH_CPCEHC_CurrCPC_CHASSI_UB_AUTO
{
    switch (@sysvar::CH_Nodes::CH_CPCEHC_CurrCPC_CHASSI_UB_AUTO)
    {
		case (0):
        	EnableUB("CPC_CHASSIS_R1_AR2", 1);						// 1 = on, 0 = off
        	DisturbUB("CPC_CHASSIS_R1_AR2", "EHC_Curr_UB", -1, 0);	//Update-Bit immer gleich 0
					enableControl("CPC_CHASSIS_R1_AR2", "CH_CPCEHC_CurrCPC_CHASSIS_R1_UB__UB", 0); //1: enable; 0: disable
					break;
		case (1):
        	EnableUB("CPC_CHASSIS_R1_AR2", 0);						// 1 = on, 0 = off
					enableControl("CPC_CHASSIS_R1_AR2", "CH_CPCEHC_CurrCPC_CHASSIS_R1_UB__UB", 1); //1: enable; 0: disable
					break;
		case (2):
        	EnableUB("CPC_CHASSIS_R1_AR2", 1);						// 1 = on, 0 = off
        	DisturbUB("CPC_CHASSIS_R1_AR2", "EHC_Curr_UB", -1, 1);	//Update-Bit immer gleich 1
					enableControl("CPC_CHASSIS_R1_AR2", "CH_CPCEHC_CurrCPC_CHASSIS_R1_UB__UB", 0); //1: enable; 0: disable
					break;
		case (3):
        	EnableUB("CPC_CHASSIS_R1_AR2", 1);						// 1 = on, 0 = off
        	DisturbUB("CPC_CHASSIS_R1_AR2", "EHC_Curr_UB", -1, 0);	//Update-Bit immer gleich 0
					enableControl("CPC_CHASSIS_R1_AR2", "CH_CPCEHC_CurrCPC_CHASSIS_R1_UB__UB", 0); //1: enable; 0: disable
					break;
    }
}
on sysvar sysvar::CH_Nodes::CH_CPCAddWtrPmp_On_Rq_EC_UB_AUTO
{
    switch (@sysvar::CH_Nodes::CH_CPCAddWtrPmp_On_Rq_EC_UB_AUTO)
    {
		case (0):
        	EnableUB("CPC_CHASSIS_R1_AR2", 1);						// 1 = on, 0 = off
        	DisturbUB("CPC_CHASSIS_R1_AR2", "AddWtrPmp_On_Rq_ECM_UB", -1, 0);	//Update-Bit immer gleich 0
					enableControl("CPC_CHASSIS_R1_AR2", "CH_CPCAddWtrPmp_On_Rq_ECMCPC_UB__UB", 0); //1: enable; 0: disable
					break;
		case (1):
        	EnableUB("CPC_CHASSIS_R1_AR2", 0);						// 1 = on, 0 = off
					enableControl("CPC_CHASSIS_R1_AR2", "CH_CPCAddWtrPmp_On_Rq_ECMCPC_UB__UB", 1); //1: enable; 0: disable
					break;
		case (2):
        	EnableUB("CPC_CHASSIS_R1_AR2", 1);						// 1 = on, 0 = off
        	DisturbUB("CPC_CHASSIS_R1_AR2", "AddWtrPmp_On_Rq_ECM_UB", -1, 1);	//Update-Bit immer gleich 1
					enableControl("CPC_CHASSIS_R1_AR2", "CH_CPCAddWtrPmp_On_Rq_ECMCPC_UB__UB", 0); //1: enable; 0: disable
					break;
		case (3):
        	EnableUB("CPC_CHASSIS_R1_AR2", 1);						// 1 = on, 0 = off
        	DisturbUB("CPC_CHASSIS_R1_AR2", "AddWtrPmp_On_Rq_ECM_UB", -1, 0);	//Update-Bit immer gleich 0
					enableControl("CPC_CHASSIS_R1_AR2", "CH_CPCAddWtrPmp_On_Rq_ECMCPC_UB__UB", 0); //1: enable; 0: disable
					break;
    }
}
on sysvar sysvar::CH_Nodes::CH_CPCPNHV_Bat_VoltCPC_C_UB_AUTO
{
    switch (@sysvar::CH_Nodes::CH_CPCPNHV_Bat_VoltCPC_C_UB_AUTO)
    {
		case (0):
        	EnableUB("CPC_CHASSIS_R1_AR2", 1);						// 1 = on, 0 = off
        	DisturbUB("CPC_CHASSIS_R1_AR2", "PNHV_Bat_Volt_UB", -1, 0);	//Update-Bit immer gleich 0
					enableControl("CPC_CHASSIS_R1_AR2", "CH_CPCPNHV_Bat_VoltCPC_CHASS_UB__UB", 0); //1: enable; 0: disable
					break;
		case (1):
        	EnableUB("CPC_CHASSIS_R1_AR2", 0);						// 1 = on, 0 = off
					enableControl("CPC_CHASSIS_R1_AR2", "CH_CPCPNHV_Bat_VoltCPC_CHASS_UB__UB", 1); //1: enable; 0: disable
					break;
		case (2):
        	EnableUB("CPC_CHASSIS_R1_AR2", 1);						// 1 = on, 0 = off
        	DisturbUB("CPC_CHASSIS_R1_AR2", "PNHV_Bat_Volt_UB", -1, 1);	//Update-Bit immer gleich 1
					enableControl("CPC_CHASSIS_R1_AR2", "CH_CPCPNHV_Bat_VoltCPC_CHASS_UB__UB", 0); //1: enable; 0: disable
					break;
		case (3):
        	EnableUB("CPC_CHASSIS_R1_AR2", 1);						// 1 = on, 0 = off
        	DisturbUB("CPC_CHASSIS_R1_AR2", "PNHV_Bat_Volt_UB", -1, 0);	//Update-Bit immer gleich 0
					enableControl("CPC_CHASSIS_R1_AR2", "CH_CPCPNHV_Bat_VoltCPC_CHASS_UB__UB", 0); //1: enable; 0: disable
					break;
    }
}
on sysvar sysvar::CH_Nodes::CH_CPCDCDC1_MdCPC_CHASSI_UB_AUTO
{
    switch (@sysvar::CH_Nodes::CH_CPCDCDC1_MdCPC_CHASSI_UB_AUTO)
    {
		case (0):
        	EnableUB("CPC_CHASSIS_R1_AR2", 1);						// 1 = on, 0 = off
        	DisturbUB("CPC_CHASSIS_R1_AR2", "DCDC1_Md_UB", -1, 0);	//Update-Bit immer gleich 0
					enableControl("CPC_CHASSIS_R1_AR2", "CH_CPCDCDC1_MdCPC_CHASSIS_R1_UB__UB", 0); //1: enable; 0: disable
					break;
		case (1):
        	EnableUB("CPC_CHASSIS_R1_AR2", 0);						// 1 = on, 0 = off
					enableControl("CPC_CHASSIS_R1_AR2", "CH_CPCDCDC1_MdCPC_CHASSIS_R1_UB__UB", 1); //1: enable; 0: disable
					break;
		case (2):
        	EnableUB("CPC_CHASSIS_R1_AR2", 1);						// 1 = on, 0 = off
        	DisturbUB("CPC_CHASSIS_R1_AR2", "DCDC1_Md_UB", -1, 1);	//Update-Bit immer gleich 1
					enableControl("CPC_CHASSIS_R1_AR2", "CH_CPCDCDC1_MdCPC_CHASSIS_R1_UB__UB", 0); //1: enable; 0: disable
					break;
		case (3):
        	EnableUB("CPC_CHASSIS_R1_AR2", 1);						// 1 = on, 0 = off
        	DisturbUB("CPC_CHASSIS_R1_AR2", "DCDC1_Md_UB", -1, 0);	//Update-Bit immer gleich 0
					enableControl("CPC_CHASSIS_R1_AR2", "CH_CPCDCDC1_MdCPC_CHASSIS_R1_UB__UB", 0); //1: enable; 0: disable
					break;
    }
}
on sysvar sysvar::CH_Nodes::CH_CPCTherm_HiTempSTOut1_UB_AUTO
{
    switch (@sysvar::CH_Nodes::CH_CPCTherm_HiTempSTOut1_UB_AUTO)
    {
		case (0):
        	EnableUB("CPC_CHASSIS_R1_AR2", 1);						// 1 = on, 0 = off
        	DisturbUB("CPC_CHASSIS_R1_AR2", "Therm_HiTempSTOut1_UB", -1, 0);	//Update-Bit immer gleich 0
					enableControl("CPC_CHASSIS_R1_AR2", "CH_CPCTherm_HiTempSTOut1CPC__UB__UB", 0); //1: enable; 0: disable
					break;
		case (1):
        	EnableUB("CPC_CHASSIS_R1_AR2", 0);						// 1 = on, 0 = off
					enableControl("CPC_CHASSIS_R1_AR2", "CH_CPCTherm_HiTempSTOut1CPC__UB__UB", 1); //1: enable; 0: disable
					break;
		case (2):
        	EnableUB("CPC_CHASSIS_R1_AR2", 1);						// 1 = on, 0 = off
        	DisturbUB("CPC_CHASSIS_R1_AR2", "Therm_HiTempSTOut1_UB", -1, 1);	//Update-Bit immer gleich 1
					enableControl("CPC_CHASSIS_R1_AR2", "CH_CPCTherm_HiTempSTOut1CPC__UB__UB", 0); //1: enable; 0: disable
					break;
		case (3):
        	EnableUB("CPC_CHASSIS_R1_AR2", 1);						// 1 = on, 0 = off
        	DisturbUB("CPC_CHASSIS_R1_AR2", "Therm_HiTempSTOut1_UB", -1, 0);	//Update-Bit immer gleich 0
					enableControl("CPC_CHASSIS_R1_AR2", "CH_CPCTherm_HiTempSTOut1CPC__UB__UB", 0); //1: enable; 0: disable
					break;
    }
}
on sysvar sysvar::CH_Nodes::CH_CPCCPC_CHASSIS_R2_AR2_UB_A_01
{
	switch (@sysvar::CH_Nodes::CH_CPCCPC_CHASSIS_R2_AR2_UB_A_01)
	{
		case (0):
			enableControl("CPC_CHASSIS_R2_AR2", "CH_CPCCPC_CHASSIS_R2_AR2_UB__01", 0); //1: enable; 0: disable
			@sysvar::CH_Nodes::CH_CPCCPC_CHASSIS_R2_AR2_UB__01 = 1;
			break;
		case (1):
			enableControl("CPC_CHASSIS_R2_AR2", "CH_CPCCPC_CHASSIS_R2_AR2_UB__01", 1); //1: enable; 0: disable
			break;
		case (2):
			enableControl("CPC_CHASSIS_R2_AR2", "CH_CPCCPC_CHASSIS_R2_AR2_UB__01", 0); //1: enable; 0: disable
			@sysvar::CH_Nodes::CH_CPCCPC_CHASSIS_R2_AR2_UB__01 = 1;
			break;
		case (3):
			enableControl("CPC_CHASSIS_R2_AR2", "CH_CPCCPC_CHASSIS_R2_AR2_UB__01", 0); //1: enable; 0: disable
			@sysvar::CH_Nodes::CH_CPCCPC_CHASSIS_R2_AR2_UB__01 = 0;
			break;
	}
}

on sysvar sysvar::CH_Nodes::CH_CPCDCDC1_Rs1_AR2_UB_AUTO_01
{
	switch (@sysvar::CH_Nodes::CH_CPCDCDC1_Rs1_AR2_UB_AUTO_01)
	{
		case (0):
			enableControl("DCDC1_Rs1_AR2", "CH_CPCDCDC1_Rs1_AR2_UB__01", 0); //1: enable; 0: disable
			@sysvar::CH_Nodes::CH_CPCDCDC1_Rs1_AR2_UB__01 = 1;
			break;
		case (1):
			enableControl("DCDC1_Rs1_AR2", "CH_CPCDCDC1_Rs1_AR2_UB__01", 1); //1: enable; 0: disable
			break;
		case (2):
			enableControl("DCDC1_Rs1_AR2", "CH_CPCDCDC1_Rs1_AR2_UB__01", 0); //1: enable; 0: disable
			@sysvar::CH_Nodes::CH_CPCDCDC1_Rs1_AR2_UB__01 = 1;
			break;
		case (3):
			enableControl("DCDC1_Rs1_AR2", "CH_CPCDCDC1_Rs1_AR2_UB__01", 0); //1: enable; 0: disable
			@sysvar::CH_Nodes::CH_CPCDCDC1_Rs1_AR2_UB__01 = 0;
			break;
	}
}

on sysvar sysvar::CH_Nodes::CH_CPCCRC_DCDC1_Rs1_Pr2DCDC_AUTO
{
//	EnableCRC("DCDC1_Rs1_AR2",  "DCDC1_Rs1_Pr2", !@this); // 1 = on, 0 = off 
	enableControl("DCDC1_Rs1_AR2", "CH_CPCCRC_DCDC1_Rs1_Pr2DCDC1_Rs_", @this); //1: enable; 0: disable
	CRC_DCDC1_Rs1_Pr2 = @sysvar::CH_Nodes::CH_CPCCRC_DCDC1_Rs1_Pr2DCDC_AUTO;
}

on sysvar sysvar::CH_Nodes::CH_CPCSQC_DCDC1_Rs1_Pr2DCDC_AUTO
{
//	EnableSQC("DCDC1_Rs1_AR2",  "DCDC1_Rs1_Pr2", !@this); // 1 = on, 0 = off 
	enableControl("DCDC1_Rs1_AR2", "CH_CPCSQC_DCDC1_Rs1_Pr2DCDC1_Rs_", @this); //1: enable; 0: disable
	SQC_DCDC1_Rs1_Pr2 = @sysvar::CH_Nodes::CH_CPCSQC_DCDC1_Rs1_Pr2DCDC_AUTO;
}

on sysvar sysvar::CH_Nodes::CH_CPCECM_DAC4_AR_UB_AUTO_01
{
	switch (@sysvar::CH_Nodes::CH_CPCECM_DAC4_AR_UB_AUTO_01)
	{
		case (0):
			enableControl("ECM_DAC4_AR", "CH_CPCECM_DAC4_AR_UB__01", 0); //1: enable; 0: disable
			@sysvar::CH_Nodes::CH_CPCECM_DAC4_AR_UB__01 = 1;
			break;
		case (1):
			enableControl("ECM_DAC4_AR", "CH_CPCECM_DAC4_AR_UB__01", 1); //1: enable; 0: disable
			break;
		case (2):
			enableControl("ECM_DAC4_AR", "CH_CPCECM_DAC4_AR_UB__01", 0); //1: enable; 0: disable
			@sysvar::CH_Nodes::CH_CPCECM_DAC4_AR_UB__01 = 1;
			break;
		case (3):
			enableControl("ECM_DAC4_AR", "CH_CPCECM_DAC4_AR_UB__01", 0); //1: enable; 0: disable
			@sysvar::CH_Nodes::CH_CPCECM_DAC4_AR_UB__01 = 0;
			break;
	}
}

on sysvar sysvar::CH_Nodes::CH_CPCEM01_Stat1_AR2_UB_AUTO_01
{
	switch (@sysvar::CH_Nodes::CH_CPCEM01_Stat1_AR2_UB_AUTO_01)
	{
		case (0):
			enableControl("EM01_Stat1_AR2", "CH_CPCEM01_Stat1_AR2_UB__01", 0); //1: enable; 0: disable
			@sysvar::CH_Nodes::CH_CPCEM01_Stat1_AR2_UB__01 = 1;
			break;
		case (1):
			enableControl("EM01_Stat1_AR2", "CH_CPCEM01_Stat1_AR2_UB__01", 1); //1: enable; 0: disable
			break;
		case (2):
			enableControl("EM01_Stat1_AR2", "CH_CPCEM01_Stat1_AR2_UB__01", 0); //1: enable; 0: disable
			@sysvar::CH_Nodes::CH_CPCEM01_Stat1_AR2_UB__01 = 1;
			break;
		case (3):
			enableControl("EM01_Stat1_AR2", "CH_CPCEM01_Stat1_AR2_UB__01", 0); //1: enable; 0: disable
			@sysvar::CH_Nodes::CH_CPCEM01_Stat1_AR2_UB__01 = 0;
			break;
	}
}

on sysvar sysvar::CH_Nodes::CH_CPCCRC_EM01_Stat1_Pr2EM0_AUTO
{
//	EnableCRC("EM01_Stat1_AR2",  "EM01_Stat1_Pr2", !@this); // 1 = on, 0 = off 
	enableControl("EM01_Stat1_AR2", "CH_CPCCRC_EM01_Stat1_Pr2EM01_St_", @this); //1: enable; 0: disable
	CRC_EM01_Stat1_Pr2 = @sysvar::CH_Nodes::CH_CPCCRC_EM01_Stat1_Pr2EM0_AUTO;
}

on sysvar sysvar::CH_Nodes::CH_CPCSQC_EM01_Stat1_Pr2EM0_AUTO
{
//	EnableSQC("EM01_Stat1_AR2",  "EM01_Stat1_Pr2", !@this); // 1 = on, 0 = off 
	enableControl("EM01_Stat1_AR2", "CH_CPCSQC_EM01_Stat1_Pr2EM01_St_", @this); //1: enable; 0: disable
	SQC_EM01_Stat1_Pr2 = @sysvar::CH_Nodes::CH_CPCSQC_EM01_Stat1_Pr2EM0_AUTO;
}

on sysvar sysvar::CH_Nodes::CH_CPCEM01_Stat2_AR2_UB_AUTO_01
{
	switch (@sysvar::CH_Nodes::CH_CPCEM01_Stat2_AR2_UB_AUTO_01)
	{
		case (0):
			enableControl("EM01_Stat2_AR2", "CH_CPCEM01_Stat2_AR2_UB__01", 0); //1: enable; 0: disable
			@sysvar::CH_Nodes::CH_CPCEM01_Stat2_AR2_UB__01 = 1;
			break;
		case (1):
			enableControl("EM01_Stat2_AR2", "CH_CPCEM01_Stat2_AR2_UB__01", 1); //1: enable; 0: disable
			break;
		case (2):
			enableControl("EM01_Stat2_AR2", "CH_CPCEM01_Stat2_AR2_UB__01", 0); //1: enable; 0: disable
			@sysvar::CH_Nodes::CH_CPCEM01_Stat2_AR2_UB__01 = 1;
			break;
		case (3):
			enableControl("EM01_Stat2_AR2", "CH_CPCEM01_Stat2_AR2_UB__01", 0); //1: enable; 0: disable
			@sysvar::CH_Nodes::CH_CPCEM01_Stat2_AR2_UB__01 = 0;
			break;
	}
}

on sysvar sysvar::CH_Nodes::CH_CPCCRC_EM01_Stat2_Pr2EM0_AUTO
{
//	EnableCRC("EM01_Stat2_AR2",  "EM01_Stat2_Pr2", !@this); // 1 = on, 0 = off 
	enableControl("EM01_Stat2_AR2", "CH_CPCCRC_EM01_Stat2_Pr2EM01_St_", @this); //1: enable; 0: disable
	CRC_EM01_Stat2_Pr2 = @sysvar::CH_Nodes::CH_CPCCRC_EM01_Stat2_Pr2EM0_AUTO;
}

on sysvar sysvar::CH_Nodes::CH_CPCSQC_EM01_Stat2_Pr2EM0_AUTO
{
//	EnableSQC("EM01_Stat2_AR2",  "EM01_Stat2_Pr2", !@this); // 1 = on, 0 = off 
	enableControl("EM01_Stat2_AR2", "CH_CPCSQC_EM01_Stat2_Pr2EM01_St_", @this); //1: enable; 0: disable
	SQC_EM01_Stat2_Pr2 = @sysvar::CH_Nodes::CH_CPCSQC_EM01_Stat2_Pr2EM0_AUTO;
}

on sysvar sysvar::CH_Nodes::CH_CPCEM01_Trq_Rs_AR2_UB_AUTO_01
{
	switch (@sysvar::CH_Nodes::CH_CPCEM01_Trq_Rs_AR2_UB_AUTO_01)
	{
		case (0):
			enableControl("EM01_Trq_Rs_AR2", "CH_CPCEM01_Trq_Rs_AR2_UB__01", 0); //1: enable; 0: disable
			@sysvar::CH_Nodes::CH_CPCEM01_Trq_Rs_AR2_UB__01 = 1;
			break;
		case (1):
			enableControl("EM01_Trq_Rs_AR2", "CH_CPCEM01_Trq_Rs_AR2_UB__01", 1); //1: enable; 0: disable
			break;
		case (2):
			enableControl("EM01_Trq_Rs_AR2", "CH_CPCEM01_Trq_Rs_AR2_UB__01", 0); //1: enable; 0: disable
			@sysvar::CH_Nodes::CH_CPCEM01_Trq_Rs_AR2_UB__01 = 1;
			break;
		case (3):
			enableControl("EM01_Trq_Rs_AR2", "CH_CPCEM01_Trq_Rs_AR2_UB__01", 0); //1: enable; 0: disable
			@sysvar::CH_Nodes::CH_CPCEM01_Trq_Rs_AR2_UB__01 = 0;
			break;
	}
}

on sysvar sysvar::CH_Nodes::CH_CPCCRC_EM01_Trq_Rs_Pr2EM_AUTO
{
//	EnableCRC("EM01_Trq_Rs_AR2",  "EM01_Trq_Rs_Pr2", !@this); // 1 = on, 0 = off 
	enableControl("EM01_Trq_Rs_AR2", "CH_CPCCRC_EM01_Trq_Rs_Pr2EM01_T_", @this); //1: enable; 0: disable
	CRC_EM01_Trq_Rs_Pr2 = @sysvar::CH_Nodes::CH_CPCCRC_EM01_Trq_Rs_Pr2EM_AUTO;
}

on sysvar sysvar::CH_Nodes::CH_CPCSQC_EM01_Trq_Rs_Pr2EM_AUTO
{
//	EnableSQC("EM01_Trq_Rs_AR2",  "EM01_Trq_Rs_Pr2", !@this); // 1 = on, 0 = off 
	enableControl("EM01_Trq_Rs_AR2", "CH_CPCSQC_EM01_Trq_Rs_Pr2EM01_T_", @this); //1: enable; 0: disable
	SQC_EM01_Trq_Rs_Pr2 = @sysvar::CH_Nodes::CH_CPCSQC_EM01_Trq_Rs_Pr2EM_AUTO;
}

on sysvar sysvar::CH_Nodes::CH_CPCEM_DAC4_AR_UB_AUTO_01
{
	switch (@sysvar::CH_Nodes::CH_CPCEM_DAC4_AR_UB_AUTO_01)
	{
		case (0):
			enableControl("EM_DAC4_AR", "CH_CPCEM_DAC4_AR_UB__01", 0); //1: enable; 0: disable
			@sysvar::CH_Nodes::CH_CPCEM_DAC4_AR_UB__01 = 1;
			break;
		case (1):
			enableControl("EM_DAC4_AR", "CH_CPCEM_DAC4_AR_UB__01", 1); //1: enable; 0: disable
			break;
		case (2):
			enableControl("EM_DAC4_AR", "CH_CPCEM_DAC4_AR_UB__01", 0); //1: enable; 0: disable
			@sysvar::CH_Nodes::CH_CPCEM_DAC4_AR_UB__01 = 1;
			break;
		case (3):
			enableControl("EM_DAC4_AR", "CH_CPCEM_DAC4_AR_UB__01", 0); //1: enable; 0: disable
			@sysvar::CH_Nodes::CH_CPCEM_DAC4_AR_UB__01 = 0;
			break;
	}
}

on sysvar sysvar::CH_Nodes::CH_CPCEng_Rs_1_AR2_UB_AUTO_01
{
	switch (@sysvar::CH_Nodes::CH_CPCEng_Rs_1_AR2_UB_AUTO_01)
	{
		case (0):
			enableControl("Eng_Rs_1_AR2", "CH_CPCEng_Rs_1_AR2_UB__01", 0); //1: enable; 0: disable
			@sysvar::CH_Nodes::CH_CPCEng_Rs_1_AR2_UB__01 = 1;
			break;
		case (1):
			enableControl("Eng_Rs_1_AR2", "CH_CPCEng_Rs_1_AR2_UB__01", 1); //1: enable; 0: disable
			break;
		case (2):
			enableControl("Eng_Rs_1_AR2", "CH_CPCEng_Rs_1_AR2_UB__01", 0); //1: enable; 0: disable
			@sysvar::CH_Nodes::CH_CPCEng_Rs_1_AR2_UB__01 = 1;
			break;
		case (3):
			enableControl("Eng_Rs_1_AR2", "CH_CPCEng_Rs_1_AR2_UB__01", 0); //1: enable; 0: disable
			@sysvar::CH_Nodes::CH_CPCEng_Rs_1_AR2_UB__01 = 0;
			break;
	}
}

on sysvar sysvar::CH_Nodes::CH_CPCCRC_Eng_Rs1_Pr2Eng_Rs_AUTO
{
//	EnableCRC("Eng_Rs_1_AR2",  "Eng_Rs1_Pr2", !@this); // 1 = on, 0 = off 
	enableControl("Eng_Rs_1_AR2", "CH_CPCCRC_Eng_Rs1_Pr2Eng_Rs_1_A_", @this); //1: enable; 0: disable
	CRC_Eng_Rs1_Pr2 = @sysvar::CH_Nodes::CH_CPCCRC_Eng_Rs1_Pr2Eng_Rs_AUTO;
}

on sysvar sysvar::CH_Nodes::CH_CPCSQC_Eng_Rs1_Pr2Eng_Rs_AUTO
{
//	EnableSQC("Eng_Rs_1_AR2",  "Eng_Rs1_Pr2", !@this); // 1 = on, 0 = off 
	enableControl("Eng_Rs_1_AR2", "CH_CPCSQC_Eng_Rs1_Pr2Eng_Rs_1_A_", @this); //1: enable; 0: disable
	SQC_Eng_Rs1_Pr2 = @sysvar::CH_Nodes::CH_CPCSQC_Eng_Rs1_Pr2Eng_Rs_AUTO;
}

on sysvar sysvar::CH_Nodes::CH_CPCEng_Rs_2_AR2_UB_AUTO_01
{
	switch (@sysvar::CH_Nodes::CH_CPCEng_Rs_2_AR2_UB_AUTO_01)
	{
		case (0):
			enableControl("Eng_Rs_2_AR2", "CH_CPCEng_Rs_2_AR2_UB__01", 0); //1: enable; 0: disable
			@sysvar::CH_Nodes::CH_CPCEng_Rs_2_AR2_UB__01 = 1;
			break;
		case (1):
			enableControl("Eng_Rs_2_AR2", "CH_CPCEng_Rs_2_AR2_UB__01", 1); //1: enable; 0: disable
			break;
		case (2):
			enableControl("Eng_Rs_2_AR2", "CH_CPCEng_Rs_2_AR2_UB__01", 0); //1: enable; 0: disable
			@sysvar::CH_Nodes::CH_CPCEng_Rs_2_AR2_UB__01 = 1;
			break;
		case (3):
			enableControl("Eng_Rs_2_AR2", "CH_CPCEng_Rs_2_AR2_UB__01", 0); //1: enable; 0: disable
			@sysvar::CH_Nodes::CH_CPCEng_Rs_2_AR2_UB__01 = 0;
			break;
	}
}

on sysvar sysvar::CH_Nodes::CH_CPCCRC_Eng_Rs2_Pr2Eng_Rs_AUTO
{
//	EnableCRC("Eng_Rs_2_AR2",  "Eng_Rs2_Pr2", !@this); // 1 = on, 0 = off 
	enableControl("Eng_Rs_2_AR2", "CH_CPCCRC_Eng_Rs2_Pr2Eng_Rs_2_A_", @this); //1: enable; 0: disable
	CRC_Eng_Rs2_Pr2 = @sysvar::CH_Nodes::CH_CPCCRC_Eng_Rs2_Pr2Eng_Rs_AUTO;
}

on sysvar sysvar::CH_Nodes::CH_CPCSQC_Eng_Rs2_Pr2Eng_Rs_AUTO
{
//	EnableSQC("Eng_Rs_2_AR2",  "Eng_Rs2_Pr2", !@this); // 1 = on, 0 = off 
	enableControl("Eng_Rs_2_AR2", "CH_CPCSQC_Eng_Rs2_Pr2Eng_Rs_2_A_", @this); //1: enable; 0: disable
	SQC_Eng_Rs2_Pr2 = @sysvar::CH_Nodes::CH_CPCSQC_Eng_Rs2_Pr2Eng_Rs_AUTO;
}

on sysvar sysvar::CH_Nodes::CH_CPCEng_Rs_3_AR2_UB_AUTO_01
{
	switch (@sysvar::CH_Nodes::CH_CPCEng_Rs_3_AR2_UB_AUTO_01)
	{
		case (0):
			enableControl("Eng_Rs_3_AR2", "CH_CPCEng_Rs_3_AR2_UB__01", 0); //1: enable; 0: disable
			@sysvar::CH_Nodes::CH_CPCEng_Rs_3_AR2_UB__01 = 1;
			break;
		case (1):
			enableControl("Eng_Rs_3_AR2", "CH_CPCEng_Rs_3_AR2_UB__01", 1); //1: enable; 0: disable
			break;
		case (2):
			enableControl("Eng_Rs_3_AR2", "CH_CPCEng_Rs_3_AR2_UB__01", 0); //1: enable; 0: disable
			@sysvar::CH_Nodes::CH_CPCEng_Rs_3_AR2_UB__01 = 1;
			break;
		case (3):
			enableControl("Eng_Rs_3_AR2", "CH_CPCEng_Rs_3_AR2_UB__01", 0); //1: enable; 0: disable
			@sysvar::CH_Nodes::CH_CPCEng_Rs_3_AR2_UB__01 = 0;
			break;
	}
}

on sysvar sysvar::CH_Nodes::CH_CPCCRC_Eng_Rs3_Pr2Eng_Rs_AUTO
{
//	EnableCRC("Eng_Rs_3_AR2",  "Eng_Rs3_Pr2", !@this); // 1 = on, 0 = off 
	enableControl("Eng_Rs_3_AR2", "CH_CPCCRC_Eng_Rs3_Pr2Eng_Rs_3_A_", @this); //1: enable; 0: disable
	CRC_Eng_Rs3_Pr2 = @sysvar::CH_Nodes::CH_CPCCRC_Eng_Rs3_Pr2Eng_Rs_AUTO;
}

on sysvar sysvar::CH_Nodes::CH_CPCSQC_Eng_Rs3_Pr2Eng_Rs_AUTO
{
//	EnableSQC("Eng_Rs_3_AR2",  "Eng_Rs3_Pr2", !@this); // 1 = on, 0 = off 
	enableControl("Eng_Rs_3_AR2", "CH_CPCSQC_Eng_Rs3_Pr2Eng_Rs_3_A_", @this); //1: enable; 0: disable
	SQC_Eng_Rs3_Pr2 = @sysvar::CH_Nodes::CH_CPCSQC_Eng_Rs3_Pr2Eng_Rs_AUTO;
}

on sysvar sysvar::CH_Nodes::CH_CPCEng_Rs_EM_AR2_UB_AUTO_01
{
	switch (@sysvar::CH_Nodes::CH_CPCEng_Rs_EM_AR2_UB_AUTO_01)
	{
		case (0):
			enableControl("Eng_Rs_EM_AR2", "CH_CPCEng_Rs_EM_AR2_UB__01", 0); //1: enable; 0: disable
			@sysvar::CH_Nodes::CH_CPCEng_Rs_EM_AR2_UB__01 = 1;
			break;
		case (1):
			enableControl("Eng_Rs_EM_AR2", "CH_CPCEng_Rs_EM_AR2_UB__01", 1); //1: enable; 0: disable
			break;
		case (2):
			enableControl("Eng_Rs_EM_AR2", "CH_CPCEng_Rs_EM_AR2_UB__01", 0); //1: enable; 0: disable
			@sysvar::CH_Nodes::CH_CPCEng_Rs_EM_AR2_UB__01 = 1;
			break;
		case (3):
			enableControl("Eng_Rs_EM_AR2", "CH_CPCEng_Rs_EM_AR2_UB__01", 0); //1: enable; 0: disable
			@sysvar::CH_Nodes::CH_CPCEng_Rs_EM_AR2_UB__01 = 0;
			break;
	}
}

on sysvar sysvar::CH_Nodes::CH_CPCCRC_Eng_Rs_EM_Pr2Eng__AUTO
{
//	EnableCRC("Eng_Rs_EM_AR2",  "Eng_Rs_EM_Pr2", !@this); // 1 = on, 0 = off 
	enableControl("Eng_Rs_EM_AR2", "CH_CPCCRC_Eng_Rs_EM_Pr2Eng_Rs_E_", @this); //1: enable; 0: disable
	CRC_Eng_Rs_EM_Pr2 = @sysvar::CH_Nodes::CH_CPCCRC_Eng_Rs_EM_Pr2Eng__AUTO;
}

on sysvar sysvar::CH_Nodes::CH_CPCSQC_Eng_Rs_EM_Pr2Eng__AUTO
{
//	EnableSQC("Eng_Rs_EM_AR2",  "Eng_Rs_EM_Pr2", !@this); // 1 = on, 0 = off 
	enableControl("Eng_Rs_EM_AR2", "CH_CPCSQC_Eng_Rs_EM_Pr2Eng_Rs_E_", @this); //1: enable; 0: disable
	SQC_Eng_Rs_EM_Pr2 = @sysvar::CH_Nodes::CH_CPCSQC_Eng_Rs_EM_Pr2Eng__AUTO;
}

on sysvar sysvar::CH_Nodes::CH_CPCEng_Rs_EngCtrl_AR2_UB_A_01
{
	switch (@sysvar::CH_Nodes::CH_CPCEng_Rs_EngCtrl_AR2_UB_A_01)
	{
		case (0):
			enableControl("Eng_Rs_EngCtrl_AR2", "CH_CPCEng_Rs_EngCtrl_AR2_UB__01", 0); //1: enable; 0: disable
			@sysvar::CH_Nodes::CH_CPCEng_Rs_EngCtrl_AR2_UB__01 = 1;
			break;
		case (1):
			enableControl("Eng_Rs_EngCtrl_AR2", "CH_CPCEng_Rs_EngCtrl_AR2_UB__01", 1); //1: enable; 0: disable
			break;
		case (2):
			enableControl("Eng_Rs_EngCtrl_AR2", "CH_CPCEng_Rs_EngCtrl_AR2_UB__01", 0); //1: enable; 0: disable
			@sysvar::CH_Nodes::CH_CPCEng_Rs_EngCtrl_AR2_UB__01 = 1;
			break;
		case (3):
			enableControl("Eng_Rs_EngCtrl_AR2", "CH_CPCEng_Rs_EngCtrl_AR2_UB__01", 0); //1: enable; 0: disable
			@sysvar::CH_Nodes::CH_CPCEng_Rs_EngCtrl_AR2_UB__01 = 0;
			break;
	}
}

on sysvar sysvar::CH_Nodes::CH_CPCCRC_Eng_Rs_EngCtrl_Pr_AUTO
{
//	EnableCRC("Eng_Rs_EngCtrl_AR2",  "Eng_Rs_EngCtrl_Pr2", !@this); // 1 = on, 0 = off 
	enableControl("Eng_Rs_EngCtrl_AR2", "CH_CPCCRC_Eng_Rs_EngCtrl_Pr2Eng_", @this); //1: enable; 0: disable
	CRC_Eng_Rs_EngCtrl_Pr2 = @sysvar::CH_Nodes::CH_CPCCRC_Eng_Rs_EngCtrl_Pr_AUTO;
}

on sysvar sysvar::CH_Nodes::CH_CPCSQC_Eng_Rs_EngCtrl_Pr_AUTO
{
//	EnableSQC("Eng_Rs_EngCtrl_AR2",  "Eng_Rs_EngCtrl_Pr2", !@this); // 1 = on, 0 = off 
	enableControl("Eng_Rs_EngCtrl_AR2", "CH_CPCSQC_Eng_Rs_EngCtrl_Pr2Eng_", @this); //1: enable; 0: disable
	SQC_Eng_Rs_EngCtrl_Pr2 = @sysvar::CH_Nodes::CH_CPCSQC_Eng_Rs_EngCtrl_Pr_AUTO;
}

on sysvar sysvar::CH_Nodes::CH_CPCEngCtrl_Disp_Rq_AR_UB_A_01
{
	switch (@sysvar::CH_Nodes::CH_CPCEngCtrl_Disp_Rq_AR_UB_A_01)
	{
		case (0):
			enableControl("EngCtrl_Disp_Rq_AR2", "CH_CPCEngCtrl_Disp_Rq_AR2_UB__01", 0); //1: enable; 0: disable
			@sysvar::CH_Nodes::CH_CPCEngCtrl_Disp_Rq_AR2_UB__01 = 1;
			break;
		case (1):
			enableControl("EngCtrl_Disp_Rq_AR2", "CH_CPCEngCtrl_Disp_Rq_AR2_UB__01", 1); //1: enable; 0: disable
			break;
		case (2):
			enableControl("EngCtrl_Disp_Rq_AR2", "CH_CPCEngCtrl_Disp_Rq_AR2_UB__01", 0); //1: enable; 0: disable
			@sysvar::CH_Nodes::CH_CPCEngCtrl_Disp_Rq_AR2_UB__01 = 1;
			break;
		case (3):
			enableControl("EngCtrl_Disp_Rq_AR2", "CH_CPCEngCtrl_Disp_Rq_AR2_UB__01", 0); //1: enable; 0: disable
			@sysvar::CH_Nodes::CH_CPCEngCtrl_Disp_Rq_AR2_UB__01 = 0;
			break;
	}
}

on sysvar sysvar::CH_Nodes::CH_CPCEngCtrl_OBD1_AR_UB_AUTO_01
{
	switch (@sysvar::CH_Nodes::CH_CPCEngCtrl_OBD1_AR_UB_AUTO_01)
	{
		case (0):
			enableControl("EngCtrl_OBD1_AR", "CH_CPCEngCtrl_OBD1_AR_UB__01", 0); //1: enable; 0: disable
			@sysvar::CH_Nodes::CH_CPCEngCtrl_OBD1_AR_UB__01 = 1;
			break;
		case (1):
			enableControl("EngCtrl_OBD1_AR", "CH_CPCEngCtrl_OBD1_AR_UB__01", 1); //1: enable; 0: disable
			break;
		case (2):
			enableControl("EngCtrl_OBD1_AR", "CH_CPCEngCtrl_OBD1_AR_UB__01", 0); //1: enable; 0: disable
			@sysvar::CH_Nodes::CH_CPCEngCtrl_OBD1_AR_UB__01 = 1;
			break;
		case (3):
			enableControl("EngCtrl_OBD1_AR", "CH_CPCEngCtrl_OBD1_AR_UB__01", 0); //1: enable; 0: disable
			@sysvar::CH_Nodes::CH_CPCEngCtrl_OBD1_AR_UB__01 = 0;
			break;
	}
}

on sysvar sysvar::CH_Nodes::CH_CPCESP_OBD_Data_AR_UB_AUTO_01
{
	switch (@sysvar::CH_Nodes::CH_CPCESP_OBD_Data_AR_UB_AUTO_01)
	{
		case (0):
			enableControl("ESP_OBD_Data_AR", "CH_CPCESP_OBD_Data_AR_UB__01", 0); //1: enable; 0: disable
			@sysvar::CH_Nodes::CH_CPCESP_OBD_Data_AR_UB__01 = 1;
			break;
		case (1):
			enableControl("ESP_OBD_Data_AR", "CH_CPCESP_OBD_Data_AR_UB__01", 1); //1: enable; 0: disable
			break;
		case (2):
			enableControl("ESP_OBD_Data_AR", "CH_CPCESP_OBD_Data_AR_UB__01", 0); //1: enable; 0: disable
			@sysvar::CH_Nodes::CH_CPCESP_OBD_Data_AR_UB__01 = 1;
			break;
		case (3):
			enableControl("ESP_OBD_Data_AR", "CH_CPCESP_OBD_Data_AR_UB__01", 0); //1: enable; 0: disable
			@sysvar::CH_Nodes::CH_CPCESP_OBD_Data_AR_UB__01 = 0;
			break;
	}
}

on sysvar sysvar::CH_Nodes::CH_CPCFuel_Stat2_AR2_UB_AUTO
{
	switch (@sysvar::CH_Nodes::CH_CPCFuel_Stat2_AR2_UB_AUTO)
	{
		case (0):
			enableControl("Fuel_Stat2_AR2", "CH_CPCFuel_Stat2_AR2_UB_", 0); //1: enable; 0: disable
			@sysvar::CH_Nodes::CH_CPCFuel_Stat2_AR2_UB_ = 1;
			break;
		case (1):
			enableControl("Fuel_Stat2_AR2", "CH_CPCFuel_Stat2_AR2_UB_", 1); //1: enable; 0: disable
			break;
		case (2):
			enableControl("Fuel_Stat2_AR2", "CH_CPCFuel_Stat2_AR2_UB_", 0); //1: enable; 0: disable
			@sysvar::CH_Nodes::CH_CPCFuel_Stat2_AR2_UB_ = 1;
			break;
		case (3):
			enableControl("Fuel_Stat2_AR2", "CH_CPCFuel_Stat2_AR2_UB_", 0); //1: enable; 0: disable
			@sysvar::CH_Nodes::CH_CPCFuel_Stat2_AR2_UB_ = 0;
			break;
	}
}

on sysvar sysvar::CH_Nodes::CH_CPCHumanMachineIfc_AR_UB_A_01
{
	switch (@sysvar::CH_Nodes::CH_CPCHumanMachineIfc_AR_UB_A_01)
	{
		case (0):
			enableControl("HumanMachineIfc_AR2", "CH_CPCHumanMachineIfc_AR2_UB__01", 0); //1: enable; 0: disable
			@sysvar::CH_Nodes::CH_CPCHumanMachineIfc_AR2_UB__01 = 1;
			break;
		case (1):
			enableControl("HumanMachineIfc_AR2", "CH_CPCHumanMachineIfc_AR2_UB__01", 1); //1: enable; 0: disable
			break;
		case (2):
			enableControl("HumanMachineIfc_AR2", "CH_CPCHumanMachineIfc_AR2_UB__01", 0); //1: enable; 0: disable
			@sysvar::CH_Nodes::CH_CPCHumanMachineIfc_AR2_UB__01 = 1;
			break;
		case (3):
			enableControl("HumanMachineIfc_AR2", "CH_CPCHumanMachineIfc_AR2_UB__01", 0); //1: enable; 0: disable
			@sysvar::CH_Nodes::CH_CPCHumanMachineIfc_AR2_UB__01 = 0;
			break;
	}
}

on sysvar sysvar::CH_Nodes::CH_CPCISM_DAC4_AR_UB_AUTO_01
{
	switch (@sysvar::CH_Nodes::CH_CPCISM_DAC4_AR_UB_AUTO_01)
	{
		case (0):
			enableControl("ISM_DAC4_AR", "CH_CPCISM_DAC4_AR_UB__01", 0); //1: enable; 0: disable
			@sysvar::CH_Nodes::CH_CPCISM_DAC4_AR_UB__01 = 1;
			break;
		case (1):
			enableControl("ISM_DAC4_AR", "CH_CPCISM_DAC4_AR_UB__01", 1); //1: enable; 0: disable
			break;
		case (2):
			enableControl("ISM_DAC4_AR", "CH_CPCISM_DAC4_AR_UB__01", 0); //1: enable; 0: disable
			@sysvar::CH_Nodes::CH_CPCISM_DAC4_AR_UB__01 = 1;
			break;
		case (3):
			enableControl("ISM_DAC4_AR", "CH_CPCISM_DAC4_AR_UB__01", 0); //1: enable; 0: disable
			@sysvar::CH_Nodes::CH_CPCISM_DAC4_AR_UB__01 = 0;
			break;
	}
}

on sysvar sysvar::CH_Nodes::CH_CPCOBL_DC_Output_AR_UB_AUT_01
{
	switch (@sysvar::CH_Nodes::CH_CPCOBL_DC_Output_AR_UB_AUT_01)
	{
		case (0):
			enableControl("OBL_DC_Output_AR", "CH_CPCOBL_DC_Output_AR_UB__01", 0); //1: enable; 0: disable
			@sysvar::CH_Nodes::CH_CPCOBL_DC_Output_AR_UB__01 = 1;
			break;
		case (1):
			enableControl("OBL_DC_Output_AR", "CH_CPCOBL_DC_Output_AR_UB__01", 1); //1: enable; 0: disable
			break;
		case (2):
			enableControl("OBL_DC_Output_AR", "CH_CPCOBL_DC_Output_AR_UB__01", 0); //1: enable; 0: disable
			@sysvar::CH_Nodes::CH_CPCOBL_DC_Output_AR_UB__01 = 1;
			break;
		case (3):
			enableControl("OBL_DC_Output_AR", "CH_CPCOBL_DC_Output_AR_UB__01", 0); //1: enable; 0: disable
			@sysvar::CH_Nodes::CH_CPCOBL_DC_Output_AR_UB__01 = 0;
			break;
	}
}

on sysvar sysvar::CH_Nodes::CH_CPCPARK_Drv_Rs_TCM_AR_UB_A_01
{
	switch (@sysvar::CH_Nodes::CH_CPCPARK_Drv_Rs_TCM_AR_UB_A_01)
	{
		case (0):
			enableControl("PARK_Drv_Rs_TCM_AR2", "CH_CPCPARK_Drv_Rs_TCM_AR2_UB__01", 0); //1: enable; 0: disable
			@sysvar::CH_Nodes::CH_CPCPARK_Drv_Rs_TCM_AR2_UB__01 = 1;
			break;
		case (1):
			enableControl("PARK_Drv_Rs_TCM_AR2", "CH_CPCPARK_Drv_Rs_TCM_AR2_UB__01", 1); //1: enable; 0: disable
			break;
		case (2):
			enableControl("PARK_Drv_Rs_TCM_AR2", "CH_CPCPARK_Drv_Rs_TCM_AR2_UB__01", 0); //1: enable; 0: disable
			@sysvar::CH_Nodes::CH_CPCPARK_Drv_Rs_TCM_AR2_UB__01 = 1;
			break;
		case (3):
			enableControl("PARK_Drv_Rs_TCM_AR2", "CH_CPCPARK_Drv_Rs_TCM_AR2_UB__01", 0); //1: enable; 0: disable
			@sysvar::CH_Nodes::CH_CPCPARK_Drv_Rs_TCM_AR2_UB__01 = 0;
			break;
	}
}

on sysvar sysvar::CH_Nodes::CH_CPCCRC_PARK_Drv_Rs_TCM_P_AUTO
{
//	EnableCRC("PARK_Drv_Rs_TCM_AR2",  "PARK_Drv_Rs_TCM_Pr2", !@this); // 1 = on, 0 = off 
	enableControl("PARK_Drv_Rs_TCM_AR2", "CH_CPCCRC_PARK_Drv_Rs_TCM_Pr2PA_", @this); //1: enable; 0: disable
	CRC_PARK_Drv_Rs_TCM_Pr2 = @sysvar::CH_Nodes::CH_CPCCRC_PARK_Drv_Rs_TCM_P_AUTO;
}

on sysvar sysvar::CH_Nodes::CH_CPCSQC_PARK_Drv_Rs_TCM_P_AUTO
{
//	EnableSQC("PARK_Drv_Rs_TCM_AR2",  "PARK_Drv_Rs_TCM_Pr2", !@this); // 1 = on, 0 = off 
	enableControl("PARK_Drv_Rs_TCM_AR2", "CH_CPCSQC_PARK_Drv_Rs_TCM_Pr2PA_", @this); //1: enable; 0: disable
	SQC_PARK_Drv_Rs_TCM_Pr2 = @sysvar::CH_Nodes::CH_CPCSQC_PARK_Drv_Rs_TCM_P_AUTO;
}

on sysvar sysvar::CH_Nodes::CH_CPCPN14_Gen_Rs_AR_UB_AUTO_01
{
	switch (@sysvar::CH_Nodes::CH_CPCPN14_Gen_Rs_AR_UB_AUTO_01)
	{
		case (0):
			enableControl("PN14_Gen_Rs_AR", "CH_CPCPN14_Gen_Rs_AR_UB__01", 0); //1: enable; 0: disable
			@sysvar::CH_Nodes::CH_CPCPN14_Gen_Rs_AR_UB__01 = 1;
			break;
		case (1):
			enableControl("PN14_Gen_Rs_AR", "CH_CPCPN14_Gen_Rs_AR_UB__01", 1); //1: enable; 0: disable
			break;
		case (2):
			enableControl("PN14_Gen_Rs_AR", "CH_CPCPN14_Gen_Rs_AR_UB__01", 0); //1: enable; 0: disable
			@sysvar::CH_Nodes::CH_CPCPN14_Gen_Rs_AR_UB__01 = 1;
			break;
		case (3):
			enableControl("PN14_Gen_Rs_AR", "CH_CPCPN14_Gen_Rs_AR_UB__01", 0); //1: enable; 0: disable
			@sysvar::CH_Nodes::CH_CPCPN14_Gen_Rs_AR_UB__01 = 0;
			break;
	}
}

on sysvar sysvar::CH_Nodes::CH_CPCTerm61_ActvPNHV_En_UB_AUTO
{
    switch (@sysvar::CH_Nodes::CH_CPCTerm61_ActvPNHV_En_UB_AUTO)
    {
		case (0):
        	EnableUB("PNHV_EnergyMngmnt_Stat2_AR2", 1);						// 1 = on, 0 = off
        	DisturbUB("PNHV_EnergyMngmnt_Stat2_AR2", "Term61_Actv_UB", -1, 0);	//Update-Bit immer gleich 0
					enableControl("PNHV_EnergyMngmnt_Stat2_AR2", "CH_CPCTerm61_ActvPNHV_Energy_UB__UB", 0); //1: enable; 0: disable
					break;
		case (1):
        	EnableUB("PNHV_EnergyMngmnt_Stat2_AR2", 0);						// 1 = on, 0 = off
					enableControl("PNHV_EnergyMngmnt_Stat2_AR2", "CH_CPCTerm61_ActvPNHV_Energy_UB__UB", 1); //1: enable; 0: disable
					break;
		case (2):
        	EnableUB("PNHV_EnergyMngmnt_Stat2_AR2", 1);						// 1 = on, 0 = off
        	DisturbUB("PNHV_EnergyMngmnt_Stat2_AR2", "Term61_Actv_UB", -1, 1);	//Update-Bit immer gleich 1
					enableControl("PNHV_EnergyMngmnt_Stat2_AR2", "CH_CPCTerm61_ActvPNHV_Energy_UB__UB", 0); //1: enable; 0: disable
					break;
		case (3):
        	EnableUB("PNHV_EnergyMngmnt_Stat2_AR2", 1);						// 1 = on, 0 = off
        	DisturbUB("PNHV_EnergyMngmnt_Stat2_AR2", "Term61_Actv_UB", -1, 0);	//Update-Bit immer gleich 0
					enableControl("PNHV_EnergyMngmnt_Stat2_AR2", "CH_CPCTerm61_ActvPNHV_Energy_UB__UB", 0); //1: enable; 0: disable
					break;
    }
}
on sysvar sysvar::CH_Nodes::CH_CPCPNM_CALID_CVN_ErrNum__AUTO
{
//	EnableTGL("PNHV_EnergyMngmnt_Stat3_AR2",  "NM_CALID_CVN_ErrNum_", !@this); // 1 = on, 0 = off 
	enableControl("PNHV_EnergyMngmnt_Stat3_AR2", "CH_CPCPNM_CALID_CVN_ErrNum_TglP_", @this); //1: enable; 0: disable
	TGL_NM_CALID_CVN_ErrNum_ = @sysvar::CH_Nodes::CH_CPCPNM_CALID_CVN_ErrNum__AUTO;
}

on sysvar sysvar::CH_Nodes::CH_CPCPNHV_EnergyMngmntS_UB_A_02
{
	switch (@sysvar::CH_Nodes::CH_CPCPNHV_EnergyMngmntS_UB_A_02)
	{
		case (0):
			enableControl("PNHV_EnergyMngmntSet_Rs1_AR2", "CH_CPCPNHV_EnergyMngmntSet_R__02", 0); //1: enable; 0: disable
			@sysvar::CH_Nodes::CH_CPCPNHV_EnergyMngmntSet_R__02 = 1;
			break;
		case (1):
			enableControl("PNHV_EnergyMngmntSet_Rs1_AR2", "CH_CPCPNHV_EnergyMngmntSet_R__02", 1); //1: enable; 0: disable
			break;
		case (2):
			enableControl("PNHV_EnergyMngmntSet_Rs1_AR2", "CH_CPCPNHV_EnergyMngmntSet_R__02", 0); //1: enable; 0: disable
			@sysvar::CH_Nodes::CH_CPCPNHV_EnergyMngmntSet_R__02 = 1;
			break;
		case (3):
			enableControl("PNHV_EnergyMngmntSet_Rs1_AR2", "CH_CPCPNHV_EnergyMngmntSet_R__02", 0); //1: enable; 0: disable
			@sysvar::CH_Nodes::CH_CPCPNHV_EnergyMngmntSet_R__02 = 0;
			break;
	}
}

on sysvar sysvar::CH_Nodes::CH_CPCPNHV_EnergyMngmntS_UB_A_03
{
	switch (@sysvar::CH_Nodes::CH_CPCPNHV_EnergyMngmntS_UB_A_03)
	{
		case (0):
			enableControl("PNHV_EnergyMngmntSet_Rs2_AR", "CH_CPCPNHV_EnergyMngmntSet_R__03", 0); //1: enable; 0: disable
			@sysvar::CH_Nodes::CH_CPCPNHV_EnergyMngmntSet_R__03 = 1;
			break;
		case (1):
			enableControl("PNHV_EnergyMngmntSet_Rs2_AR", "CH_CPCPNHV_EnergyMngmntSet_R__03", 1); //1: enable; 0: disable
			break;
		case (2):
			enableControl("PNHV_EnergyMngmntSet_Rs2_AR", "CH_CPCPNHV_EnergyMngmntSet_R__03", 0); //1: enable; 0: disable
			@sysvar::CH_Nodes::CH_CPCPNHV_EnergyMngmntSet_R__03 = 1;
			break;
		case (3):
			enableControl("PNHV_EnergyMngmntSet_Rs2_AR", "CH_CPCPNHV_EnergyMngmntSet_R__03", 0); //1: enable; 0: disable
			@sysvar::CH_Nodes::CH_CPCPNHV_EnergyMngmntSet_R__03 = 0;
			break;
	}
}

on sysvar sysvar::CH_Nodes::CH_CPCPNHV_Stat_AR2_UB_AUTO_01
{
	switch (@sysvar::CH_Nodes::CH_CPCPNHV_Stat_AR2_UB_AUTO_01)
	{
		case (0):
			enableControl("PNHV_Stat_AR2", "CH_CPCPNHV_Stat_AR2_UB__01", 0); //1: enable; 0: disable
			@sysvar::CH_Nodes::CH_CPCPNHV_Stat_AR2_UB__01 = 1;
			break;
		case (1):
			enableControl("PNHV_Stat_AR2", "CH_CPCPNHV_Stat_AR2_UB__01", 1); //1: enable; 0: disable
			break;
		case (2):
			enableControl("PNHV_Stat_AR2", "CH_CPCPNHV_Stat_AR2_UB__01", 0); //1: enable; 0: disable
			@sysvar::CH_Nodes::CH_CPCPNHV_Stat_AR2_UB__01 = 1;
			break;
		case (3):
			enableControl("PNHV_Stat_AR2", "CH_CPCPNHV_Stat_AR2_UB__01", 0); //1: enable; 0: disable
			@sysvar::CH_Nodes::CH_CPCPNHV_Stat_AR2_UB__01 = 0;
			break;
	}
}

on sysvar sysvar::CH_Nodes::CH_CPCCRC_PNHV_Stat_Pr2PNHV_AUTO
{
//	EnableCRC("PNHV_Stat_AR2",  "PNHV_Stat_Pr2", !@this); // 1 = on, 0 = off 
	enableControl("PNHV_Stat_AR2", "CH_CPCCRC_PNHV_Stat_Pr2PNHV_Sta_", @this); //1: enable; 0: disable
	CRC_PNHV_Stat_Pr2 = @sysvar::CH_Nodes::CH_CPCCRC_PNHV_Stat_Pr2PNHV_AUTO;
}

on sysvar sysvar::CH_Nodes::CH_CPCSQC_PNHV_Stat_Pr2PNHV_AUTO
{
//	EnableSQC("PNHV_Stat_AR2",  "PNHV_Stat_Pr2", !@this); // 1 = on, 0 = off 
	enableControl("PNHV_Stat_AR2", "CH_CPCSQC_PNHV_Stat_Pr2PNHV_Sta_", @this); //1: enable; 0: disable
	SQC_PNHV_Stat_Pr2 = @sysvar::CH_Nodes::CH_CPCSQC_PNHV_Stat_Pr2PNHV_AUTO;
}

on sysvar sysvar::CH_Nodes::CH_CPCPtMngmnt_Rq_AR2_UB_AUTO_01
{
	switch (@sysvar::CH_Nodes::CH_CPCPtMngmnt_Rq_AR2_UB_AUTO_01)
	{
		case (0):
			enableControl("PtMngmnt_Rq_AR2", "CH_CPCPtMngmnt_Rq_AR2_UB__01", 0); //1: enable; 0: disable
			@sysvar::CH_Nodes::CH_CPCPtMngmnt_Rq_AR2_UB__01 = 1;
			break;
		case (1):
			enableControl("PtMngmnt_Rq_AR2", "CH_CPCPtMngmnt_Rq_AR2_UB__01", 1); //1: enable; 0: disable
			break;
		case (2):
			enableControl("PtMngmnt_Rq_AR2", "CH_CPCPtMngmnt_Rq_AR2_UB__01", 0); //1: enable; 0: disable
			@sysvar::CH_Nodes::CH_CPCPtMngmnt_Rq_AR2_UB__01 = 1;
			break;
		case (3):
			enableControl("PtMngmnt_Rq_AR2", "CH_CPCPtMngmnt_Rq_AR2_UB__01", 0); //1: enable; 0: disable
			@sysvar::CH_Nodes::CH_CPCPtMngmnt_Rq_AR2_UB__01 = 0;
			break;
	}
}

on sysvar sysvar::CH_Nodes::CH_CPCCRC_PtMngmnt_Rq_Pr2Pt_AUTO
{
//	EnableCRC("PtMngmnt_Rq_AR2",  "PtMngmnt_Rq_Pr2", !@this); // 1 = on, 0 = off 
	enableControl("PtMngmnt_Rq_AR2", "CH_CPCCRC_PtMngmnt_Rq_Pr2PtMngm_", @this); //1: enable; 0: disable
	CRC_PtMngmnt_Rq_Pr2 = @sysvar::CH_Nodes::CH_CPCCRC_PtMngmnt_Rq_Pr2Pt_AUTO;
}

on sysvar sysvar::CH_Nodes::CH_CPCSQC_PtMngmnt_Rq_Pr2Pt_AUTO
{
//	EnableSQC("PtMngmnt_Rq_AR2",  "PtMngmnt_Rq_Pr2", !@this); // 1 = on, 0 = off 
	enableControl("PtMngmnt_Rq_AR2", "CH_CPCSQC_PtMngmnt_Rq_Pr2PtMngm_", @this); //1: enable; 0: disable
	SQC_PtMngmnt_Rq_Pr2 = @sysvar::CH_Nodes::CH_CPCSQC_PtMngmnt_Rq_Pr2Pt_AUTO;
}

on sysvar sysvar::CH_Nodes::CH_CPCPtMngmnt_Stat2_AR2_UB_A_01
{
	switch (@sysvar::CH_Nodes::CH_CPCPtMngmnt_Stat2_AR2_UB_A_01)
	{
		case (0):
			enableControl("PtMngmnt_Stat2_AR2", "CH_CPCPtMngmnt_Stat2_AR2_UB__01", 0); //1: enable; 0: disable
			@sysvar::CH_Nodes::CH_CPCPtMngmnt_Stat2_AR2_UB__01 = 1;
			break;
		case (1):
			enableControl("PtMngmnt_Stat2_AR2", "CH_CPCPtMngmnt_Stat2_AR2_UB__01", 1); //1: enable; 0: disable
			break;
		case (2):
			enableControl("PtMngmnt_Stat2_AR2", "CH_CPCPtMngmnt_Stat2_AR2_UB__01", 0); //1: enable; 0: disable
			@sysvar::CH_Nodes::CH_CPCPtMngmnt_Stat2_AR2_UB__01 = 1;
			break;
		case (3):
			enableControl("PtMngmnt_Stat2_AR2", "CH_CPCPtMngmnt_Stat2_AR2_UB__01", 0); //1: enable; 0: disable
			@sysvar::CH_Nodes::CH_CPCPtMngmnt_Stat2_AR2_UB__01 = 0;
			break;
	}
}

on sysvar sysvar::CH_Nodes::CH_CPCCRC_PtMngmnt_Stat2_Pr_AUTO
{
//	EnableCRC("PtMngmnt_Stat2_AR2",  "PtMngmnt_Stat2_Pr2", !@this); // 1 = on, 0 = off 
	enableControl("PtMngmnt_Stat2_AR2", "CH_CPCCRC_PtMngmnt_Stat2_Pr2PtM_", @this); //1: enable; 0: disable
	CRC_PtMngmnt_Stat2_Pr2 = @sysvar::CH_Nodes::CH_CPCCRC_PtMngmnt_Stat2_Pr_AUTO;
}

on sysvar sysvar::CH_Nodes::CH_CPCSQC_PtMngmnt_Stat2_Pr_AUTO
{
//	EnableSQC("PtMngmnt_Stat2_AR2",  "PtMngmnt_Stat2_Pr2", !@this); // 1 = on, 0 = off 
	enableControl("PtMngmnt_Stat2_AR2", "CH_CPCSQC_PtMngmnt_Stat2_Pr2PtM_", @this); //1: enable; 0: disable
	SQC_PtMngmnt_Stat2_Pr2 = @sysvar::CH_Nodes::CH_CPCSQC_PtMngmnt_Stat2_Pr_AUTO;
}

on sysvar sysvar::CH_Nodes::CH_CPCPtMngmnt_Stat_AR2_UB_AU_01
{
	switch (@sysvar::CH_Nodes::CH_CPCPtMngmnt_Stat_AR2_UB_AU_01)
	{
		case (0):
			enableControl("PtMngmnt_Stat_AR2", "CH_CPCPtMngmnt_Stat_AR2_UB__01", 0); //1: enable; 0: disable
			@sysvar::CH_Nodes::CH_CPCPtMngmnt_Stat_AR2_UB__01 = 1;
			break;
		case (1):
			enableControl("PtMngmnt_Stat_AR2", "CH_CPCPtMngmnt_Stat_AR2_UB__01", 1); //1: enable; 0: disable
			break;
		case (2):
			enableControl("PtMngmnt_Stat_AR2", "CH_CPCPtMngmnt_Stat_AR2_UB__01", 0); //1: enable; 0: disable
			@sysvar::CH_Nodes::CH_CPCPtMngmnt_Stat_AR2_UB__01 = 1;
			break;
		case (3):
			enableControl("PtMngmnt_Stat_AR2", "CH_CPCPtMngmnt_Stat_AR2_UB__01", 0); //1: enable; 0: disable
			@sysvar::CH_Nodes::CH_CPCPtMngmnt_Stat_AR2_UB__01 = 0;
			break;
	}
}

on sysvar sysvar::CH_Nodes::CH_CPCCRC_PT_Stat_Pr2PtMngm_AUTO
{
//	EnableCRC("PtMngmnt_Stat_AR2",  "PT_Stat_Pr2", !@this); // 1 = on, 0 = off 
	enableControl("PtMngmnt_Stat_AR2", "CH_CPCCRC_PT_Stat_Pr2PtMngmnt_S_", @this); //1: enable; 0: disable
	CRC_PT_Stat_Pr2 = @sysvar::CH_Nodes::CH_CPCCRC_PT_Stat_Pr2PtMngm_AUTO;
}

on sysvar sysvar::CH_Nodes::CH_CPCSQC_PT_Stat_Pr2PtMngm_AUTO
{
//	EnableSQC("PtMngmnt_Stat_AR2",  "PT_Stat_Pr2", !@this); // 1 = on, 0 = off 
	enableControl("PtMngmnt_Stat_AR2", "CH_CPCSQC_PT_Stat_Pr2PtMngmnt_S_", @this); //1: enable; 0: disable
	SQC_PT_Stat_Pr2 = @sysvar::CH_Nodes::CH_CPCSQC_PT_Stat_Pr2PtMngm_AUTO;
}

on sysvar sysvar::CH_Nodes::CH_CPCSBW_DrvPosn_Disp_R_UB_A_02
{
	switch (@sysvar::CH_Nodes::CH_CPCSBW_DrvPosn_Disp_R_UB_A_02)
	{
		case (0):
			enableControl("SBW_DrvPosn_Disp_Rq_ISM_AR2", "CH_CPCSBW_DrvPosn_Disp_Rq_IS__01", 0); //1: enable; 0: disable
			@sysvar::CH_Nodes::CH_CPCSBW_DrvPosn_Disp_Rq_IS__01 = 1;
			break;
		case (1):
			enableControl("SBW_DrvPosn_Disp_Rq_ISM_AR2", "CH_CPCSBW_DrvPosn_Disp_Rq_IS__01", 1); //1: enable; 0: disable
			break;
		case (2):
			enableControl("SBW_DrvPosn_Disp_Rq_ISM_AR2", "CH_CPCSBW_DrvPosn_Disp_Rq_IS__01", 0); //1: enable; 0: disable
			@sysvar::CH_Nodes::CH_CPCSBW_DrvPosn_Disp_Rq_IS__01 = 1;
			break;
		case (3):
			enableControl("SBW_DrvPosn_Disp_Rq_ISM_AR2", "CH_CPCSBW_DrvPosn_Disp_Rq_IS__01", 0); //1: enable; 0: disable
			@sysvar::CH_Nodes::CH_CPCSBW_DrvPosn_Disp_Rq_IS__01 = 0;
			break;
	}
}

on sysvar sysvar::CH_Nodes::CH_CPCCRC_ISM_TxDrvPosn_Dis_AUTO
{
//	EnableCRC("SBW_DrvPosn_Disp_Rq_ISM_AR2",  "ISM_TxDrvPosn_Disp_Rq_Pr2", !@this); // 1 = on, 0 = off 
	enableControl("SBW_DrvPosn_Disp_Rq_ISM_AR2", "CH_CPCCRC_ISM_TxDrvPosn_Disp_Rq_", @this); //1: enable; 0: disable
	CRC_ISM_TxDrvPosn_Disp_Rq_Pr2 = @sysvar::CH_Nodes::CH_CPCCRC_ISM_TxDrvPosn_Dis_AUTO;
}

on sysvar sysvar::CH_Nodes::CH_CPCSQC_ISM_TxDrvPosn_Dis_AUTO
{
//	EnableSQC("SBW_DrvPosn_Disp_Rq_ISM_AR2",  "ISM_TxDrvPosn_Disp_Rq_Pr2", !@this); // 1 = on, 0 = off 
	enableControl("SBW_DrvPosn_Disp_Rq_ISM_AR2", "CH_CPCSQC_ISM_TxDrvPosn_Disp_Rq_", @this); //1: enable; 0: disable
	SQC_ISM_TxDrvPosn_Disp_Rq_Pr2 = @sysvar::CH_Nodes::CH_CPCSQC_ISM_TxDrvPosn_Dis_AUTO;
}

on sysvar sysvar::CH_Nodes::CH_CPCSBW_DrvPosn_Disp_R_UB_A_03
{
	switch (@sysvar::CH_Nodes::CH_CPCSBW_DrvPosn_Disp_R_UB_A_03)
	{
		case (0):
			enableControl("SBW_DrvPosn_Disp_Rq_TCM_AR2", "CH_CPCSBW_DrvPosn_Disp_Rq_TC__01", 0); //1: enable; 0: disable
			@sysvar::CH_Nodes::CH_CPCSBW_DrvPosn_Disp_Rq_TC__01 = 1;
			break;
		case (1):
			enableControl("SBW_DrvPosn_Disp_Rq_TCM_AR2", "CH_CPCSBW_DrvPosn_Disp_Rq_TC__01", 1); //1: enable; 0: disable
			break;
		case (2):
			enableControl("SBW_DrvPosn_Disp_Rq_TCM_AR2", "CH_CPCSBW_DrvPosn_Disp_Rq_TC__01", 0); //1: enable; 0: disable
			@sysvar::CH_Nodes::CH_CPCSBW_DrvPosn_Disp_Rq_TC__01 = 1;
			break;
		case (3):
			enableControl("SBW_DrvPosn_Disp_Rq_TCM_AR2", "CH_CPCSBW_DrvPosn_Disp_Rq_TC__01", 0); //1: enable; 0: disable
			@sysvar::CH_Nodes::CH_CPCSBW_DrvPosn_Disp_Rq_TC__01 = 0;
			break;
	}
}

on sysvar sysvar::CH_Nodes::CH_CPCCRC_SBW_Drv_Pk_Posn_T_AUTO
{
//	EnableCRC("SBW_DrvPosn_Disp_Rq_TCM_AR2",  "SBW_Drv_Pk_Posn_TCM_Pr2", !@this); // 1 = on, 0 = off 
	enableControl("SBW_DrvPosn_Disp_Rq_TCM_AR2", "CH_CPCCRC_SBW_Drv_Pk_Posn_TCM_P_", @this); //1: enable; 0: disable
	CRC_SBW_Drv_Pk_Posn_TCM_Pr2 = @sysvar::CH_Nodes::CH_CPCCRC_SBW_Drv_Pk_Posn_T_AUTO;
}

on sysvar sysvar::CH_Nodes::CH_CPCSQC_SBW_Drv_Pk_Posn_T_AUTO
{
//	EnableSQC("SBW_DrvPosn_Disp_Rq_TCM_AR2",  "SBW_Drv_Pk_Posn_TCM_Pr2", !@this); // 1 = on, 0 = off 
	enableControl("SBW_DrvPosn_Disp_Rq_TCM_AR2", "CH_CPCSQC_SBW_Drv_Pk_Posn_TCM_P_", @this); //1: enable; 0: disable
	SQC_SBW_Drv_Pk_Posn_TCM_Pr2 = @sysvar::CH_Nodes::CH_CPCSQC_SBW_Drv_Pk_Posn_T_AUTO;
}

on sysvar sysvar::CH_Nodes::CH_CPCSBW_Stat_AR2_UB_AUTO_01
{
	switch (@sysvar::CH_Nodes::CH_CPCSBW_Stat_AR2_UB_AUTO_01)
	{
		case (0):
			enableControl("SBW_Stat_AR2", "CH_CPCSBW_Stat_AR2_UB__01", 0); //1: enable; 0: disable
			@sysvar::CH_Nodes::CH_CPCSBW_Stat_AR2_UB__01 = 1;
			break;
		case (1):
			enableControl("SBW_Stat_AR2", "CH_CPCSBW_Stat_AR2_UB__01", 1); //1: enable; 0: disable
			break;
		case (2):
			enableControl("SBW_Stat_AR2", "CH_CPCSBW_Stat_AR2_UB__01", 0); //1: enable; 0: disable
			@sysvar::CH_Nodes::CH_CPCSBW_Stat_AR2_UB__01 = 1;
			break;
		case (3):
			enableControl("SBW_Stat_AR2", "CH_CPCSBW_Stat_AR2_UB__01", 0); //1: enable; 0: disable
			@sysvar::CH_Nodes::CH_CPCSBW_Stat_AR2_UB__01 = 0;
			break;
	}
}

on sysvar sysvar::CH_Nodes::CH_CPCCRC_SBW_Stat_Pr2SBW_S_AUTO
{
//	EnableCRC("SBW_Stat_AR2",  "SBW_Stat_Pr2", !@this); // 1 = on, 0 = off 
	enableControl("SBW_Stat_AR2", "CH_CPCCRC_SBW_Stat_Pr2SBW_Stat__", @this); //1: enable; 0: disable
	CRC_SBW_Stat_Pr2 = @sysvar::CH_Nodes::CH_CPCCRC_SBW_Stat_Pr2SBW_S_AUTO;
}

on sysvar sysvar::CH_Nodes::CH_CPCSQC_SBW_Stat_Pr2SBW_S_AUTO
{
//	EnableSQC("SBW_Stat_AR2",  "SBW_Stat_Pr2", !@this); // 1 = on, 0 = off 
	enableControl("SBW_Stat_AR2", "CH_CPCSQC_SBW_Stat_Pr2SBW_Stat__", @this); //1: enable; 0: disable
	SQC_SBW_Stat_Pr2 = @sysvar::CH_Nodes::CH_CPCSQC_SBW_Stat_Pr2SBW_S_AUTO;
}

on sysvar sysvar::CH_Nodes::CH_CPCTCM_DAC4_AR_UB_AUTO_01
{
	switch (@sysvar::CH_Nodes::CH_CPCTCM_DAC4_AR_UB_AUTO_01)
	{
		case (0):
			enableControl("TCM_DAC4_AR", "CH_CPCTCM_DAC4_AR_UB__01", 0); //1: enable; 0: disable
			@sysvar::CH_Nodes::CH_CPCTCM_DAC4_AR_UB__01 = 1;
			break;
		case (1):
			enableControl("TCM_DAC4_AR", "CH_CPCTCM_DAC4_AR_UB__01", 1); //1: enable; 0: disable
			break;
		case (2):
			enableControl("TCM_DAC4_AR", "CH_CPCTCM_DAC4_AR_UB__01", 0); //1: enable; 0: disable
			@sysvar::CH_Nodes::CH_CPCTCM_DAC4_AR_UB__01 = 1;
			break;
		case (3):
			enableControl("TCM_DAC4_AR", "CH_CPCTCM_DAC4_AR_UB__01", 0); //1: enable; 0: disable
			@sysvar::CH_Nodes::CH_CPCTCM_DAC4_AR_UB__01 = 0;
			break;
	}
}

on sysvar sysvar::CH_Nodes::CH_CPCTCM_Data2_AR2_UB_AUTO_01
{
	switch (@sysvar::CH_Nodes::CH_CPCTCM_Data2_AR2_UB_AUTO_01)
	{
		case (0):
			enableControl("TCM_Data2_AR2", "CH_CPCTCM_Data2_AR2_UB__01", 0); //1: enable; 0: disable
			@sysvar::CH_Nodes::CH_CPCTCM_Data2_AR2_UB__01 = 1;
			break;
		case (1):
			enableControl("TCM_Data2_AR2", "CH_CPCTCM_Data2_AR2_UB__01", 1); //1: enable; 0: disable
			break;
		case (2):
			enableControl("TCM_Data2_AR2", "CH_CPCTCM_Data2_AR2_UB__01", 0); //1: enable; 0: disable
			@sysvar::CH_Nodes::CH_CPCTCM_Data2_AR2_UB__01 = 1;
			break;
		case (3):
			enableControl("TCM_Data2_AR2", "CH_CPCTCM_Data2_AR2_UB__01", 0); //1: enable; 0: disable
			@sysvar::CH_Nodes::CH_CPCTCM_Data2_AR2_UB__01 = 0;
			break;
	}
}

on sysvar sysvar::CH_Nodes::CH_CPCCRC_TCM_Data2_Pr2TCM__AUTO
{
//	EnableCRC("TCM_Data2_AR2",  "TCM_Data2_Pr2", !@this); // 1 = on, 0 = off 
	enableControl("TCM_Data2_AR2", "CH_CPCCRC_TCM_Data2_Pr2TCM_Data_", @this); //1: enable; 0: disable
	CRC_TCM_Data2_Pr2 = @sysvar::CH_Nodes::CH_CPCCRC_TCM_Data2_Pr2TCM__AUTO;
}

on sysvar sysvar::CH_Nodes::CH_CPCSQC_TCM_Data2_Pr2TCM__AUTO
{
//	EnableSQC("TCM_Data2_AR2",  "TCM_Data2_Pr2", !@this); // 1 = on, 0 = off 
	enableControl("TCM_Data2_AR2", "CH_CPCSQC_TCM_Data2_Pr2TCM_Data_", @this); //1: enable; 0: disable
	SQC_TCM_Data2_Pr2 = @sysvar::CH_Nodes::CH_CPCSQC_TCM_Data2_Pr2TCM__AUTO;
}

on sysvar sysvar::CH_Nodes::CH_CPCTCM_Data3_AR2_UB_AUTO_01
{
	switch (@sysvar::CH_Nodes::CH_CPCTCM_Data3_AR2_UB_AUTO_01)
	{
		case (0):
			enableControl("TCM_Data3_AR2", "CH_CPCTCM_Data3_AR2_UB__01", 0); //1: enable; 0: disable
			@sysvar::CH_Nodes::CH_CPCTCM_Data3_AR2_UB__01 = 1;
			break;
		case (1):
			enableControl("TCM_Data3_AR2", "CH_CPCTCM_Data3_AR2_UB__01", 1); //1: enable; 0: disable
			break;
		case (2):
			enableControl("TCM_Data3_AR2", "CH_CPCTCM_Data3_AR2_UB__01", 0); //1: enable; 0: disable
			@sysvar::CH_Nodes::CH_CPCTCM_Data3_AR2_UB__01 = 1;
			break;
		case (3):
			enableControl("TCM_Data3_AR2", "CH_CPCTCM_Data3_AR2_UB__01", 0); //1: enable; 0: disable
			@sysvar::CH_Nodes::CH_CPCTCM_Data3_AR2_UB__01 = 0;
			break;
	}
}

on sysvar sysvar::CH_Nodes::CH_CPCCRC_TCM_Data3_Pr2TCM__AUTO
{
//	EnableCRC("TCM_Data3_AR2",  "TCM_Data3_Pr2", !@this); // 1 = on, 0 = off 
	enableControl("TCM_Data3_AR2", "CH_CPCCRC_TCM_Data3_Pr2TCM_Data_", @this); //1: enable; 0: disable
	CRC_TCM_Data3_Pr2 = @sysvar::CH_Nodes::CH_CPCCRC_TCM_Data3_Pr2TCM__AUTO;
}

on sysvar sysvar::CH_Nodes::CH_CPCSQC_TCM_Data3_Pr2TCM__AUTO
{
//	EnableSQC("TCM_Data3_AR2",  "TCM_Data3_Pr2", !@this); // 1 = on, 0 = off 
	enableControl("TCM_Data3_AR2", "CH_CPCSQC_TCM_Data3_Pr2TCM_Data_", @this); //1: enable; 0: disable
	SQC_TCM_Data3_Pr2 = @sysvar::CH_Nodes::CH_CPCSQC_TCM_Data3_Pr2TCM__AUTO;
}

on sysvar sysvar::CH_Nodes::CH_CPCTCM_Disp_Rq_AMG_AR_UB_A_01
{
	switch (@sysvar::CH_Nodes::CH_CPCTCM_Disp_Rq_AMG_AR_UB_A_01)
	{
		case (0):
			enableControl("TCM_Disp_Rq_AMG_AR", "CH_CPCTCM_Disp_Rq_AMG_AR_UB__01", 0); //1: enable; 0: disable
			@sysvar::CH_Nodes::CH_CPCTCM_Disp_Rq_AMG_AR_UB__01 = 1;
			break;
		case (1):
			enableControl("TCM_Disp_Rq_AMG_AR", "CH_CPCTCM_Disp_Rq_AMG_AR_UB__01", 1); //1: enable; 0: disable
			break;
		case (2):
			enableControl("TCM_Disp_Rq_AMG_AR", "CH_CPCTCM_Disp_Rq_AMG_AR_UB__01", 0); //1: enable; 0: disable
			@sysvar::CH_Nodes::CH_CPCTCM_Disp_Rq_AMG_AR_UB__01 = 1;
			break;
		case (3):
			enableControl("TCM_Disp_Rq_AMG_AR", "CH_CPCTCM_Disp_Rq_AMG_AR_UB__01", 0); //1: enable; 0: disable
			@sysvar::CH_Nodes::CH_CPCTCM_Disp_Rq_AMG_AR_UB__01 = 0;
			break;
	}
}

on sysvar sysvar::CH_Nodes::CH_CPCTCM_State3_AR2_UB_AUTO_01
{
	switch (@sysvar::CH_Nodes::CH_CPCTCM_State3_AR2_UB_AUTO_01)
	{
		case (0):
			enableControl("TCM_State3_AR2", "CH_CPCTCM_State3_AR2_UB__01", 0); //1: enable; 0: disable
			@sysvar::CH_Nodes::CH_CPCTCM_State3_AR2_UB__01 = 1;
			break;
		case (1):
			enableControl("TCM_State3_AR2", "CH_CPCTCM_State3_AR2_UB__01", 1); //1: enable; 0: disable
			break;
		case (2):
			enableControl("TCM_State3_AR2", "CH_CPCTCM_State3_AR2_UB__01", 0); //1: enable; 0: disable
			@sysvar::CH_Nodes::CH_CPCTCM_State3_AR2_UB__01 = 1;
			break;
		case (3):
			enableControl("TCM_State3_AR2", "CH_CPCTCM_State3_AR2_UB__01", 0); //1: enable; 0: disable
			@sysvar::CH_Nodes::CH_CPCTCM_State3_AR2_UB__01 = 0;
			break;
	}
}

on sysvar sysvar::CH_Nodes::CH_CPCTCU_Disp_Rq_AR2_UB_AUTO
{
	switch (@sysvar::CH_Nodes::CH_CPCTCU_Disp_Rq_AR2_UB_AUTO)
	{
		case (0):
			enableControl("TCU_Disp_Rq_AR2", "CH_CPCTCU_Disp_Rq_AR2_UB_", 0); //1: enable; 0: disable
			@sysvar::CH_Nodes::CH_CPCTCU_Disp_Rq_AR2_UB_ = 1;
			break;
		case (1):
			enableControl("TCU_Disp_Rq_AR2", "CH_CPCTCU_Disp_Rq_AR2_UB_", 1); //1: enable; 0: disable
			break;
		case (2):
			enableControl("TCU_Disp_Rq_AR2", "CH_CPCTCU_Disp_Rq_AR2_UB_", 0); //1: enable; 0: disable
			@sysvar::CH_Nodes::CH_CPCTCU_Disp_Rq_AR2_UB_ = 1;
			break;
		case (3):
			enableControl("TCU_Disp_Rq_AR2", "CH_CPCTCU_Disp_Rq_AR2_UB_", 0); //1: enable; 0: disable
			@sysvar::CH_Nodes::CH_CPCTCU_Disp_Rq_AR2_UB_ = 0;
			break;
	}
}

on sysvar sysvar::CH_Nodes::CH_CPCVehPwrMngmnt_EMM_S_UB_A_01
{
	switch (@sysvar::CH_Nodes::CH_CPCVehPwrMngmnt_EMM_S_UB_A_01)
	{
		case (0):
			enableControl("VehPwrMngmnt_EMM_Stat2_AR2", "CH_CPCVehPwrMngmnt_EMM_Stat2__01", 0); //1: enable; 0: disable
			@sysvar::CH_Nodes::CH_CPCVehPwrMngmnt_EMM_Stat2__01 = 1;
			break;
		case (1):
			enableControl("VehPwrMngmnt_EMM_Stat2_AR2", "CH_CPCVehPwrMngmnt_EMM_Stat2__01", 1); //1: enable; 0: disable
			break;
		case (2):
			enableControl("VehPwrMngmnt_EMM_Stat2_AR2", "CH_CPCVehPwrMngmnt_EMM_Stat2__01", 0); //1: enable; 0: disable
			@sysvar::CH_Nodes::CH_CPCVehPwrMngmnt_EMM_Stat2__01 = 1;
			break;
		case (3):
			enableControl("VehPwrMngmnt_EMM_Stat2_AR2", "CH_CPCVehPwrMngmnt_EMM_Stat2__01", 0); //1: enable; 0: disable
			@sysvar::CH_Nodes::CH_CPCVehPwrMngmnt_EMM_Stat2__01 = 0;
			break;
	}
}

on sysvar sysvar::CH_Nodes::CH_CPCCRC_EMM_Disp_Rq_Pr2Ve_AUTO
{
//	EnableCRC("VehPwrMngmnt_EMM_Stat2_AR2",  "EMM_Disp_Rq_Pr2", !@this); // 1 = on, 0 = off 
	enableControl("VehPwrMngmnt_EMM_Stat2_AR2", "CH_CPCCRC_EMM_Disp_Rq_Pr2VehPwr_", @this); //1: enable; 0: disable
	CRC_EMM_Disp_Rq_Pr2 = @sysvar::CH_Nodes::CH_CPCCRC_EMM_Disp_Rq_Pr2Ve_AUTO;
}

on sysvar sysvar::CH_Nodes::CH_CPCSQC_EMM_Disp_Rq_Pr2Ve_AUTO
{
//	EnableSQC("VehPwrMngmnt_EMM_Stat2_AR2",  "EMM_Disp_Rq_Pr2", !@this); // 1 = on, 0 = off 
	enableControl("VehPwrMngmnt_EMM_Stat2_AR2", "CH_CPCSQC_EMM_Disp_Rq_Pr2VehPwr_", @this); //1: enable; 0: disable
	SQC_EMM_Disp_Rq_Pr2 = @sysvar::CH_Nodes::CH_CPCSQC_EMM_Disp_Rq_Pr2Ve_AUTO;
}

on sysvar sysvar::CH_Nodes::CH_CPCVehPwrMngmnt_Rq_AR_UB_A_01
{
	switch (@sysvar::CH_Nodes::CH_CPCVehPwrMngmnt_Rq_AR_UB_A_01)
	{
		case (0):
			enableControl("VehPwrMngmnt_Rq_AR", "CH_CPCVehPwrMngmnt_Rq_AR_UB__01", 0); //1: enable; 0: disable
			@sysvar::CH_Nodes::CH_CPCVehPwrMngmnt_Rq_AR_UB__01 = 1;
			break;
		case (1):
			enableControl("VehPwrMngmnt_Rq_AR", "CH_CPCVehPwrMngmnt_Rq_AR_UB__01", 1); //1: enable; 0: disable
			break;
		case (2):
			enableControl("VehPwrMngmnt_Rq_AR", "CH_CPCVehPwrMngmnt_Rq_AR_UB__01", 0); //1: enable; 0: disable
			@sysvar::CH_Nodes::CH_CPCVehPwrMngmnt_Rq_AR_UB__01 = 1;
			break;
		case (3):
			enableControl("VehPwrMngmnt_Rq_AR", "CH_CPCVehPwrMngmnt_Rq_AR_UB__01", 0); //1: enable; 0: disable
			@sysvar::CH_Nodes::CH_CPCVehPwrMngmnt_Rq_AR_UB__01 = 0;
			break;
	}
}

on sysvar sysvar::CH_Nodes::CH_CPCWIA_EngTrq_AR_UB_AUTO_01
{
	switch (@sysvar::CH_Nodes::CH_CPCWIA_EngTrq_AR_UB_AUTO_01)
	{
		case (0):
			enableControl("WIA_EngTrq_AR", "CH_CPCWIA_EngTrq_AR_UB__01", 0); //1: enable; 0: disable
			@sysvar::CH_Nodes::CH_CPCWIA_EngTrq_AR_UB__01 = 1;
			break;
		case (1):
			enableControl("WIA_EngTrq_AR", "CH_CPCWIA_EngTrq_AR_UB__01", 1); //1: enable; 0: disable
			break;
		case (2):
			enableControl("WIA_EngTrq_AR", "CH_CPCWIA_EngTrq_AR_UB__01", 0); //1: enable; 0: disable
			@sysvar::CH_Nodes::CH_CPCWIA_EngTrq_AR_UB__01 = 1;
			break;
		case (3):
			enableControl("WIA_EngTrq_AR", "CH_CPCWIA_EngTrq_AR_UB__01", 0); //1: enable; 0: disable
			@sysvar::CH_Nodes::CH_CPCWIA_EngTrq_AR_UB__01 = 0;
			break;
	}
}

CH_CPCAdblue_Disp_Rq_AR()
{
	switch (@sysvar::CH_Nodes::CH_CPCAdblue_Disp_Rq_AR_UB_AU_01)
	{
		case (0):
			//Updatebit wird mit 1 gesendet; entspricht Standard
			break;
		case (1):
			//nur wenn manueller Wert gleich 0 ist, muss was gemacht werden
			if (@sysvar::CH_Nodes::CH_CPCAdblue_Disp_Rq_AR_UB_AU_01 == 0)
				DisturbPDUUB("Adblue_Disp_Rq_AR", 1, 0); //Updatebit wird einmal auf Null gesetzt
			break;
		case (2):
			//Updatebit wird mit 1 gesendet; entspricht Standard
			break;
		case (3):
			DisturbPDUUB("Adblue_Disp_Rq_AR", 1, 0); //Updatebit wird einmal auf Null gesetzt
			break;
	}
}

CH_CPCCNG_Disp_Rq_AR2()
{
	switch (@sysvar::CH_Nodes::CH_CPCCNG_Disp_Rq_AR2_UB_AUTO_01)
	{
		case (0):
			//Updatebit wird mit 1 gesendet; entspricht Standard
			break;
		case (1):
			//nur wenn manueller Wert gleich 0 ist, muss was gemacht werden
			if (@sysvar::CH_Nodes::CH_CPCCNG_Disp_Rq_AR2_UB_AUTO_01 == 0)
				DisturbPDUUB("CNG_Disp_Rq_AR2", 1, 0); //Updatebit wird einmal auf Null gesetzt
			break;
		case (2):
			//Updatebit wird mit 1 gesendet; entspricht Standard
			break;
		case (3):
			DisturbPDUUB("CNG_Disp_Rq_AR2", 1, 0); //Updatebit wird einmal auf Null gesetzt
			break;
	}
}

CH_CPCCPC_CHASSIS_R2_AR2()
{
	switch (@sysvar::CH_Nodes::CH_CPCCPC_CHASSIS_R2_AR2_UB_A_01)
	{
		case (0):
			//Updatebit wird mit 1 gesendet; entspricht Standard
			break;
		case (1):
			//nur wenn manueller Wert gleich 0 ist, muss was gemacht werden
			if (@sysvar::CH_Nodes::CH_CPCCPC_CHASSIS_R2_AR2_UB_A_01 == 0)
				DisturbPDUUB("CPC_CHASSIS_R2_AR2", 1, 0); //Updatebit wird einmal auf Null gesetzt
			break;
		case (2):
			//Updatebit wird mit 1 gesendet; entspricht Standard
			break;
		case (3):
			DisturbPDUUB("CPC_CHASSIS_R2_AR2", 1, 0); //Updatebit wird einmal auf Null gesetzt
			break;
	}
}

CH_CPCDCDC1_Rs1_AR2()
{
	switch (@sysvar::CH_Nodes::CH_CPCDCDC1_Rs1_AR2_UB_AUTO_01)
	{
		case (0):
			//Updatebit wird mit 1 gesendet; entspricht Standard
			break;
		case (1):
			//nur wenn manueller Wert gleich 0 ist, muss was gemacht werden
			if (@sysvar::CH_Nodes::CH_CPCDCDC1_Rs1_AR2_UB_AUTO_01 == 0)
				DisturbPDUUB("DCDC1_Rs1_AR2", 1, 0); //Updatebit wird einmal auf Null gesetzt
			break;
		case (2):
			//Updatebit wird mit 1 gesendet; entspricht Standard
			break;
		case (3):
			DisturbPDUUB("DCDC1_Rs1_AR2", 1, 0); //Updatebit wird einmal auf Null gesetzt
			break;
	}
}

CH_CPCECM_DAC4_AR()
{
	switch (@sysvar::CH_Nodes::CH_CPCECM_DAC4_AR_UB_AUTO_01)
	{
		case (0):
			//Updatebit wird mit 1 gesendet; entspricht Standard
			break;
		case (1):
			//nur wenn manueller Wert gleich 0 ist, muss was gemacht werden
			if (@sysvar::CH_Nodes::CH_CPCECM_DAC4_AR_UB_AUTO_01 == 0)
				DisturbPDUUB("ECM_DAC4_AR", 1, 0); //Updatebit wird einmal auf Null gesetzt
			break;
		case (2):
			//Updatebit wird mit 1 gesendet; entspricht Standard
			break;
		case (3):
			DisturbPDUUB("ECM_DAC4_AR", 1, 0); //Updatebit wird einmal auf Null gesetzt
			break;
	}
}

CH_CPCEM01_Stat1_AR2()
{
	switch (@sysvar::CH_Nodes::CH_CPCEM01_Stat1_AR2_UB_AUTO_01)
	{
		case (0):
			//Updatebit wird mit 1 gesendet; entspricht Standard
			break;
		case (1):
			//nur wenn manueller Wert gleich 0 ist, muss was gemacht werden
			if (@sysvar::CH_Nodes::CH_CPCEM01_Stat1_AR2_UB_AUTO_01 == 0)
				DisturbPDUUB("EM01_Stat1_AR2", 1, 0); //Updatebit wird einmal auf Null gesetzt
			break;
		case (2):
			//Updatebit wird mit 1 gesendet; entspricht Standard
			break;
		case (3):
			DisturbPDUUB("EM01_Stat1_AR2", 1, 0); //Updatebit wird einmal auf Null gesetzt
			break;
	}
}

CH_CPCEM01_Stat2_AR2()
{
	switch (@sysvar::CH_Nodes::CH_CPCEM01_Stat2_AR2_UB_AUTO_01)
	{
		case (0):
			//Updatebit wird mit 1 gesendet; entspricht Standard
			break;
		case (1):
			//nur wenn manueller Wert gleich 0 ist, muss was gemacht werden
			if (@sysvar::CH_Nodes::CH_CPCEM01_Stat2_AR2_UB_AUTO_01 == 0)
				DisturbPDUUB("EM01_Stat2_AR2", 1, 0); //Updatebit wird einmal auf Null gesetzt
			break;
		case (2):
			//Updatebit wird mit 1 gesendet; entspricht Standard
			break;
		case (3):
			DisturbPDUUB("EM01_Stat2_AR2", 1, 0); //Updatebit wird einmal auf Null gesetzt
			break;
	}
}

CH_CPCEM01_Trq_Rs_AR2()
{
	switch (@sysvar::CH_Nodes::CH_CPCEM01_Trq_Rs_AR2_UB_AUTO_01)
	{
		case (0):
			//Updatebit wird mit 1 gesendet; entspricht Standard
			break;
		case (1):
			//nur wenn manueller Wert gleich 0 ist, muss was gemacht werden
			if (@sysvar::CH_Nodes::CH_CPCEM01_Trq_Rs_AR2_UB_AUTO_01 == 0)
				DisturbPDUUB("EM01_Trq_Rs_AR2", 1, 0); //Updatebit wird einmal auf Null gesetzt
			break;
		case (2):
			//Updatebit wird mit 1 gesendet; entspricht Standard
			break;
		case (3):
			DisturbPDUUB("EM01_Trq_Rs_AR2", 1, 0); //Updatebit wird einmal auf Null gesetzt
			break;
	}
}

CH_CPCEM_DAC4_AR()
{
	switch (@sysvar::CH_Nodes::CH_CPCEM_DAC4_AR_UB_AUTO_01)
	{
		case (0):
			//Updatebit wird mit 1 gesendet; entspricht Standard
			break;
		case (1):
			//nur wenn manueller Wert gleich 0 ist, muss was gemacht werden
			if (@sysvar::CH_Nodes::CH_CPCEM_DAC4_AR_UB_AUTO_01 == 0)
				DisturbPDUUB("EM_DAC4_AR", 1, 0); //Updatebit wird einmal auf Null gesetzt
			break;
		case (2):
			//Updatebit wird mit 1 gesendet; entspricht Standard
			break;
		case (3):
			DisturbPDUUB("EM_DAC4_AR", 1, 0); //Updatebit wird einmal auf Null gesetzt
			break;
	}
}

CH_CPCEng_Rs_1_AR2()
{
	switch (@sysvar::CH_Nodes::CH_CPCEng_Rs_1_AR2_UB_AUTO_01)
	{
		case (0):
			//Updatebit wird mit 1 gesendet; entspricht Standard
			break;
		case (1):
			//nur wenn manueller Wert gleich 0 ist, muss was gemacht werden
			if (@sysvar::CH_Nodes::CH_CPCEng_Rs_1_AR2_UB_AUTO_01 == 0)
				DisturbPDUUB("Eng_Rs_1_AR2", 1, 0); //Updatebit wird einmal auf Null gesetzt
			break;
		case (2):
			//Updatebit wird mit 1 gesendet; entspricht Standard
			break;
		case (3):
			DisturbPDUUB("Eng_Rs_1_AR2", 1, 0); //Updatebit wird einmal auf Null gesetzt
			break;
	}
}

CH_CPCEng_Rs_2_AR2()
{
	switch (@sysvar::CH_Nodes::CH_CPCEng_Rs_2_AR2_UB_AUTO_01)
	{
		case (0):
			//Updatebit wird mit 1 gesendet; entspricht Standard
			break;
		case (1):
			//nur wenn manueller Wert gleich 0 ist, muss was gemacht werden
			if (@sysvar::CH_Nodes::CH_CPCEng_Rs_2_AR2_UB_AUTO_01 == 0)
				DisturbPDUUB("Eng_Rs_2_AR2", 1, 0); //Updatebit wird einmal auf Null gesetzt
			break;
		case (2):
			//Updatebit wird mit 1 gesendet; entspricht Standard
			break;
		case (3):
			DisturbPDUUB("Eng_Rs_2_AR2", 1, 0); //Updatebit wird einmal auf Null gesetzt
			break;
	}
}

CH_CPCEng_Rs_3_AR2()
{
	switch (@sysvar::CH_Nodes::CH_CPCEng_Rs_3_AR2_UB_AUTO_01)
	{
		case (0):
			//Updatebit wird mit 1 gesendet; entspricht Standard
			break;
		case (1):
			//nur wenn manueller Wert gleich 0 ist, muss was gemacht werden
			if (@sysvar::CH_Nodes::CH_CPCEng_Rs_3_AR2_UB_AUTO_01 == 0)
				DisturbPDUUB("Eng_Rs_3_AR2", 1, 0); //Updatebit wird einmal auf Null gesetzt
			break;
		case (2):
			//Updatebit wird mit 1 gesendet; entspricht Standard
			break;
		case (3):
			DisturbPDUUB("Eng_Rs_3_AR2", 1, 0); //Updatebit wird einmal auf Null gesetzt
			break;
	}
}

CH_CPCEng_Rs_EM_AR2()
{
	switch (@sysvar::CH_Nodes::CH_CPCEng_Rs_EM_AR2_UB_AUTO_01)
	{
		case (0):
			//Updatebit wird mit 1 gesendet; entspricht Standard
			break;
		case (1):
			//nur wenn manueller Wert gleich 0 ist, muss was gemacht werden
			if (@sysvar::CH_Nodes::CH_CPCEng_Rs_EM_AR2_UB_AUTO_01 == 0)
				DisturbPDUUB("Eng_Rs_EM_AR2", 1, 0); //Updatebit wird einmal auf Null gesetzt
			break;
		case (2):
			//Updatebit wird mit 1 gesendet; entspricht Standard
			break;
		case (3):
			DisturbPDUUB("Eng_Rs_EM_AR2", 1, 0); //Updatebit wird einmal auf Null gesetzt
			break;
	}
}

CH_CPCEng_Rs_EngCtrl_AR2()
{
	switch (@sysvar::CH_Nodes::CH_CPCEng_Rs_EngCtrl_AR2_UB_A_01)
	{
		case (0):
			//Updatebit wird mit 1 gesendet; entspricht Standard
			break;
		case (1):
			//nur wenn manueller Wert gleich 0 ist, muss was gemacht werden
			if (@sysvar::CH_Nodes::CH_CPCEng_Rs_EngCtrl_AR2_UB_A_01 == 0)
				DisturbPDUUB("Eng_Rs_EngCtrl_AR2", 1, 0); //Updatebit wird einmal auf Null gesetzt
			break;
		case (2):
			//Updatebit wird mit 1 gesendet; entspricht Standard
			break;
		case (3):
			DisturbPDUUB("Eng_Rs_EngCtrl_AR2", 1, 0); //Updatebit wird einmal auf Null gesetzt
			break;
	}
}

CH_CPCEngCtrl_Disp_Rq_AR2()
{
	switch (@sysvar::CH_Nodes::CH_CPCEngCtrl_Disp_Rq_AR_UB_A_01)
	{
		case (0):
			//Updatebit wird mit 1 gesendet; entspricht Standard
			break;
		case (1):
			//nur wenn manueller Wert gleich 0 ist, muss was gemacht werden
			if (@sysvar::CH_Nodes::CH_CPCEngCtrl_Disp_Rq_AR_UB_A_01 == 0)
				DisturbPDUUB("EngCtrl_Disp_Rq_AR2", 1, 0); //Updatebit wird einmal auf Null gesetzt
			break;
		case (2):
			//Updatebit wird mit 1 gesendet; entspricht Standard
			break;
		case (3):
			DisturbPDUUB("EngCtrl_Disp_Rq_AR2", 1, 0); //Updatebit wird einmal auf Null gesetzt
			break;
	}
}

CH_CPCEngCtrl_OBD1_AR()
{
	switch (@sysvar::CH_Nodes::CH_CPCEngCtrl_OBD1_AR_UB_AUTO_01)
	{
		case (0):
			//Updatebit wird mit 1 gesendet; entspricht Standard
			break;
		case (1):
			//nur wenn manueller Wert gleich 0 ist, muss was gemacht werden
			if (@sysvar::CH_Nodes::CH_CPCEngCtrl_OBD1_AR_UB_AUTO_01 == 0)
				DisturbPDUUB("EngCtrl_OBD1_AR", 1, 0); //Updatebit wird einmal auf Null gesetzt
			break;
		case (2):
			//Updatebit wird mit 1 gesendet; entspricht Standard
			break;
		case (3):
			DisturbPDUUB("EngCtrl_OBD1_AR", 1, 0); //Updatebit wird einmal auf Null gesetzt
			break;
	}
}

CH_CPCESP_OBD_Data_AR()
{
	switch (@sysvar::CH_Nodes::CH_CPCESP_OBD_Data_AR_UB_AUTO_01)
	{
		case (0):
			//Updatebit wird mit 1 gesendet; entspricht Standard
			break;
		case (1):
			//nur wenn manueller Wert gleich 0 ist, muss was gemacht werden
			if (@sysvar::CH_Nodes::CH_CPCESP_OBD_Data_AR_UB_AUTO_01 == 0)
				DisturbPDUUB("ESP_OBD_Data_AR", 1, 0); //Updatebit wird einmal auf Null gesetzt
			break;
		case (2):
			//Updatebit wird mit 1 gesendet; entspricht Standard
			break;
		case (3):
			DisturbPDUUB("ESP_OBD_Data_AR", 1, 0); //Updatebit wird einmal auf Null gesetzt
			break;
	}
}

CH_CPCFuel_Stat2_AR2()
{
	switch (@sysvar::CH_Nodes::CH_CPCFuel_Stat2_AR2_UB_AUTO)
	{
		case (0):
			//Updatebit wird mit 1 gesendet; entspricht Standard
			break;
		case (1):
			//nur wenn manueller Wert gleich 0 ist, muss was gemacht werden
			if (@sysvar::CH_Nodes::CH_CPCFuel_Stat2_AR2_UB_AUTO == 0)
				DisturbPDUUB("Fuel_Stat2_AR2", 1, 0); //Updatebit wird einmal auf Null gesetzt
			break;
		case (2):
			//Updatebit wird mit 1 gesendet; entspricht Standard
			break;
		case (3):
			DisturbPDUUB("Fuel_Stat2_AR2", 1, 0); //Updatebit wird einmal auf Null gesetzt
			break;
	}
}

CH_CPCHumanMachineIfc_AR2()
{
	switch (@sysvar::CH_Nodes::CH_CPCHumanMachineIfc_AR_UB_A_01)
	{
		case (0):
			//Updatebit wird mit 1 gesendet; entspricht Standard
			break;
		case (1):
			//nur wenn manueller Wert gleich 0 ist, muss was gemacht werden
			if (@sysvar::CH_Nodes::CH_CPCHumanMachineIfc_AR_UB_A_01 == 0)
				DisturbPDUUB("HumanMachineIfc_AR2", 1, 0); //Updatebit wird einmal auf Null gesetzt
			break;
		case (2):
			//Updatebit wird mit 1 gesendet; entspricht Standard
			break;
		case (3):
			DisturbPDUUB("HumanMachineIfc_AR2", 1, 0); //Updatebit wird einmal auf Null gesetzt
			break;
	}
}

CH_CPCISM_DAC4_AR()
{
	switch (@sysvar::CH_Nodes::CH_CPCISM_DAC4_AR_UB_AUTO_01)
	{
		case (0):
			//Updatebit wird mit 1 gesendet; entspricht Standard
			break;
		case (1):
			//nur wenn manueller Wert gleich 0 ist, muss was gemacht werden
			if (@sysvar::CH_Nodes::CH_CPCISM_DAC4_AR_UB_AUTO_01 == 0)
				DisturbPDUUB("ISM_DAC4_AR", 1, 0); //Updatebit wird einmal auf Null gesetzt
			break;
		case (2):
			//Updatebit wird mit 1 gesendet; entspricht Standard
			break;
		case (3):
			DisturbPDUUB("ISM_DAC4_AR", 1, 0); //Updatebit wird einmal auf Null gesetzt
			break;
	}
}

CH_CPCOBL_DC_Output_AR()
{
	switch (@sysvar::CH_Nodes::CH_CPCOBL_DC_Output_AR_UB_AUT_01)
	{
		case (0):
			//Updatebit wird mit 1 gesendet; entspricht Standard
			break;
		case (1):
			//nur wenn manueller Wert gleich 0 ist, muss was gemacht werden
			if (@sysvar::CH_Nodes::CH_CPCOBL_DC_Output_AR_UB_AUT_01 == 0)
				DisturbPDUUB("OBL_DC_Output_AR", 1, 0); //Updatebit wird einmal auf Null gesetzt
			break;
		case (2):
			//Updatebit wird mit 1 gesendet; entspricht Standard
			break;
		case (3):
			DisturbPDUUB("OBL_DC_Output_AR", 1, 0); //Updatebit wird einmal auf Null gesetzt
			break;
	}
}

CH_CPCPARK_Drv_Rs_TCM_AR2()
{
	switch (@sysvar::CH_Nodes::CH_CPCPARK_Drv_Rs_TCM_AR_UB_A_01)
	{
		case (0):
			//Updatebit wird mit 1 gesendet; entspricht Standard
			break;
		case (1):
			//nur wenn manueller Wert gleich 0 ist, muss was gemacht werden
			if (@sysvar::CH_Nodes::CH_CPCPARK_Drv_Rs_TCM_AR_UB_A_01 == 0)
				DisturbPDUUB("PARK_Drv_Rs_TCM_AR2", 1, 0); //Updatebit wird einmal auf Null gesetzt
			break;
		case (2):
			//Updatebit wird mit 1 gesendet; entspricht Standard
			break;
		case (3):
			DisturbPDUUB("PARK_Drv_Rs_TCM_AR2", 1, 0); //Updatebit wird einmal auf Null gesetzt
			break;
	}
}

CH_CPCPN14_Gen_Rs_AR()
{
	switch (@sysvar::CH_Nodes::CH_CPCPN14_Gen_Rs_AR_UB_AUTO_01)
	{
		case (0):
			//Updatebit wird mit 1 gesendet; entspricht Standard
			break;
		case (1):
			//nur wenn manueller Wert gleich 0 ist, muss was gemacht werden
			if (@sysvar::CH_Nodes::CH_CPCPN14_Gen_Rs_AR_UB_AUTO_01 == 0)
				DisturbPDUUB("PN14_Gen_Rs_AR", 1, 0); //Updatebit wird einmal auf Null gesetzt
			break;
		case (2):
			//Updatebit wird mit 1 gesendet; entspricht Standard
			break;
		case (3):
			DisturbPDUUB("PN14_Gen_Rs_AR", 1, 0); //Updatebit wird einmal auf Null gesetzt
			break;
	}
}

CH_CPCPNHV_EnergyMngmntSet_Rs1_AR2()
{
	switch (@sysvar::CH_Nodes::CH_CPCPNHV_EnergyMngmntS_UB_A_02)
	{
		case (0):
			//Updatebit wird mit 1 gesendet; entspricht Standard
			break;
		case (1):
			//nur wenn manueller Wert gleich 0 ist, muss was gemacht werden
			if (@sysvar::CH_Nodes::CH_CPCPNHV_EnergyMngmntS_UB_A_02 == 0)
				DisturbPDUUB("PNHV_EnergyMngmntSet_Rs1_AR2", 1, 0); //Updatebit wird einmal auf Null gesetzt
			break;
		case (2):
			//Updatebit wird mit 1 gesendet; entspricht Standard
			break;
		case (3):
			DisturbPDUUB("PNHV_EnergyMngmntSet_Rs1_AR2", 1, 0); //Updatebit wird einmal auf Null gesetzt
			break;
	}
}

CH_CPCPNHV_EnergyMngmntSet_Rs2_AR()
{
	switch (@sysvar::CH_Nodes::CH_CPCPNHV_EnergyMngmntS_UB_A_03)
	{
		case (0):
			//Updatebit wird mit 1 gesendet; entspricht Standard
			break;
		case (1):
			//nur wenn manueller Wert gleich 0 ist, muss was gemacht werden
			if (@sysvar::CH_Nodes::CH_CPCPNHV_EnergyMngmntS_UB_A_03 == 0)
				DisturbPDUUB("PNHV_EnergyMngmntSet_Rs2_AR", 1, 0); //Updatebit wird einmal auf Null gesetzt
			break;
		case (2):
			//Updatebit wird mit 1 gesendet; entspricht Standard
			break;
		case (3):
			DisturbPDUUB("PNHV_EnergyMngmntSet_Rs2_AR", 1, 0); //Updatebit wird einmal auf Null gesetzt
			break;
	}
}

CH_CPCPNHV_Stat_AR2()
{
	switch (@sysvar::CH_Nodes::CH_CPCPNHV_Stat_AR2_UB_AUTO_01)
	{
		case (0):
			//Updatebit wird mit 1 gesendet; entspricht Standard
			break;
		case (1):
			//nur wenn manueller Wert gleich 0 ist, muss was gemacht werden
			if (@sysvar::CH_Nodes::CH_CPCPNHV_Stat_AR2_UB_AUTO_01 == 0)
				DisturbPDUUB("PNHV_Stat_AR2", 1, 0); //Updatebit wird einmal auf Null gesetzt
			break;
		case (2):
			//Updatebit wird mit 1 gesendet; entspricht Standard
			break;
		case (3):
			DisturbPDUUB("PNHV_Stat_AR2", 1, 0); //Updatebit wird einmal auf Null gesetzt
			break;
	}
}

CH_CPCPtMngmnt_Rq_AR2()
{
	switch (@sysvar::CH_Nodes::CH_CPCPtMngmnt_Rq_AR2_UB_AUTO_01)
	{
		case (0):
			//Updatebit wird mit 1 gesendet; entspricht Standard
			break;
		case (1):
			//nur wenn manueller Wert gleich 0 ist, muss was gemacht werden
			if (@sysvar::CH_Nodes::CH_CPCPtMngmnt_Rq_AR2_UB_AUTO_01 == 0)
				DisturbPDUUB("PtMngmnt_Rq_AR2", 1, 0); //Updatebit wird einmal auf Null gesetzt
			break;
		case (2):
			//Updatebit wird mit 1 gesendet; entspricht Standard
			break;
		case (3):
			DisturbPDUUB("PtMngmnt_Rq_AR2", 1, 0); //Updatebit wird einmal auf Null gesetzt
			break;
	}
}

CH_CPCPtMngmnt_Stat2_AR2()
{
	switch (@sysvar::CH_Nodes::CH_CPCPtMngmnt_Stat2_AR2_UB_A_01)
	{
		case (0):
			//Updatebit wird mit 1 gesendet; entspricht Standard
			break;
		case (1):
			//nur wenn manueller Wert gleich 0 ist, muss was gemacht werden
			if (@sysvar::CH_Nodes::CH_CPCPtMngmnt_Stat2_AR2_UB_A_01 == 0)
				DisturbPDUUB("PtMngmnt_Stat2_AR2", 1, 0); //Updatebit wird einmal auf Null gesetzt
			break;
		case (2):
			//Updatebit wird mit 1 gesendet; entspricht Standard
			break;
		case (3):
			DisturbPDUUB("PtMngmnt_Stat2_AR2", 1, 0); //Updatebit wird einmal auf Null gesetzt
			break;
	}
}

CH_CPCPtMngmnt_Stat_AR2()
{
	switch (@sysvar::CH_Nodes::CH_CPCPtMngmnt_Stat_AR2_UB_AU_01)
	{
		case (0):
			//Updatebit wird mit 1 gesendet; entspricht Standard
			break;
		case (1):
			//nur wenn manueller Wert gleich 0 ist, muss was gemacht werden
			if (@sysvar::CH_Nodes::CH_CPCPtMngmnt_Stat_AR2_UB_AU_01 == 0)
				DisturbPDUUB("PtMngmnt_Stat_AR2", 1, 0); //Updatebit wird einmal auf Null gesetzt
			break;
		case (2):
			//Updatebit wird mit 1 gesendet; entspricht Standard
			break;
		case (3):
			DisturbPDUUB("PtMngmnt_Stat_AR2", 1, 0); //Updatebit wird einmal auf Null gesetzt
			break;
	}
}

CH_CPCSBW_DrvPosn_Disp_Rq_ISM_AR2()
{
	switch (@sysvar::CH_Nodes::CH_CPCSBW_DrvPosn_Disp_R_UB_A_02)
	{
		case (0):
			//Updatebit wird mit 1 gesendet; entspricht Standard
			break;
		case (1):
			//nur wenn manueller Wert gleich 0 ist, muss was gemacht werden
			if (@sysvar::CH_Nodes::CH_CPCSBW_DrvPosn_Disp_R_UB_A_02 == 0)
				DisturbPDUUB("SBW_DrvPosn_Disp_Rq_ISM_AR2", 1, 0); //Updatebit wird einmal auf Null gesetzt
			break;
		case (2):
			//Updatebit wird mit 1 gesendet; entspricht Standard
			break;
		case (3):
			DisturbPDUUB("SBW_DrvPosn_Disp_Rq_ISM_AR2", 1, 0); //Updatebit wird einmal auf Null gesetzt
			break;
	}
}

CH_CPCSBW_DrvPosn_Disp_Rq_TCM_AR2()
{
	switch (@sysvar::CH_Nodes::CH_CPCSBW_DrvPosn_Disp_R_UB_A_03)
	{
		case (0):
			//Updatebit wird mit 1 gesendet; entspricht Standard
			break;
		case (1):
			//nur wenn manueller Wert gleich 0 ist, muss was gemacht werden
			if (@sysvar::CH_Nodes::CH_CPCSBW_DrvPosn_Disp_R_UB_A_03 == 0)
				DisturbPDUUB("SBW_DrvPosn_Disp_Rq_TCM_AR2", 1, 0); //Updatebit wird einmal auf Null gesetzt
			break;
		case (2):
			//Updatebit wird mit 1 gesendet; entspricht Standard
			break;
		case (3):
			DisturbPDUUB("SBW_DrvPosn_Disp_Rq_TCM_AR2", 1, 0); //Updatebit wird einmal auf Null gesetzt
			break;
	}
}

CH_CPCSBW_Stat_AR2()
{
	switch (@sysvar::CH_Nodes::CH_CPCSBW_Stat_AR2_UB_AUTO_01)
	{
		case (0):
			//Updatebit wird mit 1 gesendet; entspricht Standard
			break;
		case (1):
			//nur wenn manueller Wert gleich 0 ist, muss was gemacht werden
			if (@sysvar::CH_Nodes::CH_CPCSBW_Stat_AR2_UB_AUTO_01 == 0)
				DisturbPDUUB("SBW_Stat_AR2", 1, 0); //Updatebit wird einmal auf Null gesetzt
			break;
		case (2):
			//Updatebit wird mit 1 gesendet; entspricht Standard
			break;
		case (3):
			DisturbPDUUB("SBW_Stat_AR2", 1, 0); //Updatebit wird einmal auf Null gesetzt
			break;
	}
}

CH_CPCTCM_DAC4_AR()
{
	switch (@sysvar::CH_Nodes::CH_CPCTCM_DAC4_AR_UB_AUTO_01)
	{
		case (0):
			//Updatebit wird mit 1 gesendet; entspricht Standard
			break;
		case (1):
			//nur wenn manueller Wert gleich 0 ist, muss was gemacht werden
			if (@sysvar::CH_Nodes::CH_CPCTCM_DAC4_AR_UB_AUTO_01 == 0)
				DisturbPDUUB("TCM_DAC4_AR", 1, 0); //Updatebit wird einmal auf Null gesetzt
			break;
		case (2):
			//Updatebit wird mit 1 gesendet; entspricht Standard
			break;
		case (3):
			DisturbPDUUB("TCM_DAC4_AR", 1, 0); //Updatebit wird einmal auf Null gesetzt
			break;
	}
}

CH_CPCTCM_Data2_AR2()
{
	switch (@sysvar::CH_Nodes::CH_CPCTCM_Data2_AR2_UB_AUTO_01)
	{
		case (0):
			//Updatebit wird mit 1 gesendet; entspricht Standard
			break;
		case (1):
			//nur wenn manueller Wert gleich 0 ist, muss was gemacht werden
			if (@sysvar::CH_Nodes::CH_CPCTCM_Data2_AR2_UB_AUTO_01 == 0)
				DisturbPDUUB("TCM_Data2_AR2", 1, 0); //Updatebit wird einmal auf Null gesetzt
			break;
		case (2):
			//Updatebit wird mit 1 gesendet; entspricht Standard
			break;
		case (3):
			DisturbPDUUB("TCM_Data2_AR2", 1, 0); //Updatebit wird einmal auf Null gesetzt
			break;
	}
}

CH_CPCTCM_Data3_AR2()
{
	switch (@sysvar::CH_Nodes::CH_CPCTCM_Data3_AR2_UB_AUTO_01)
	{
		case (0):
			//Updatebit wird mit 1 gesendet; entspricht Standard
			break;
		case (1):
			//nur wenn manueller Wert gleich 0 ist, muss was gemacht werden
			if (@sysvar::CH_Nodes::CH_CPCTCM_Data3_AR2_UB_AUTO_01 == 0)
				DisturbPDUUB("TCM_Data3_AR2", 1, 0); //Updatebit wird einmal auf Null gesetzt
			break;
		case (2):
			//Updatebit wird mit 1 gesendet; entspricht Standard
			break;
		case (3):
			DisturbPDUUB("TCM_Data3_AR2", 1, 0); //Updatebit wird einmal auf Null gesetzt
			break;
	}
}

CH_CPCTCM_Disp_Rq_AMG_AR()
{
	switch (@sysvar::CH_Nodes::CH_CPCTCM_Disp_Rq_AMG_AR_UB_A_01)
	{
		case (0):
			//Updatebit wird mit 1 gesendet; entspricht Standard
			break;
		case (1):
			//nur wenn manueller Wert gleich 0 ist, muss was gemacht werden
			if (@sysvar::CH_Nodes::CH_CPCTCM_Disp_Rq_AMG_AR_UB_A_01 == 0)
				DisturbPDUUB("TCM_Disp_Rq_AMG_AR", 1, 0); //Updatebit wird einmal auf Null gesetzt
			break;
		case (2):
			//Updatebit wird mit 1 gesendet; entspricht Standard
			break;
		case (3):
			DisturbPDUUB("TCM_Disp_Rq_AMG_AR", 1, 0); //Updatebit wird einmal auf Null gesetzt
			break;
	}
}

CH_CPCTCM_State3_AR2()
{
	switch (@sysvar::CH_Nodes::CH_CPCTCM_State3_AR2_UB_AUTO_01)
	{
		case (0):
			//Updatebit wird mit 1 gesendet; entspricht Standard
			break;
		case (1):
			//nur wenn manueller Wert gleich 0 ist, muss was gemacht werden
			if (@sysvar::CH_Nodes::CH_CPCTCM_State3_AR2_UB_AUTO_01 == 0)
				DisturbPDUUB("TCM_State3_AR2", 1, 0); //Updatebit wird einmal auf Null gesetzt
			break;
		case (2):
			//Updatebit wird mit 1 gesendet; entspricht Standard
			break;
		case (3):
			DisturbPDUUB("TCM_State3_AR2", 1, 0); //Updatebit wird einmal auf Null gesetzt
			break;
	}
}

CH_CPCTCU_Disp_Rq_AR2()
{
	switch (@sysvar::CH_Nodes::CH_CPCTCU_Disp_Rq_AR2_UB_AUTO)
	{
		case (0):
			//Updatebit wird mit 1 gesendet; entspricht Standard
			break;
		case (1):
			//nur wenn manueller Wert gleich 0 ist, muss was gemacht werden
			if (@sysvar::CH_Nodes::CH_CPCTCU_Disp_Rq_AR2_UB_AUTO == 0)
				DisturbPDUUB("TCU_Disp_Rq_AR2", 1, 0); //Updatebit wird einmal auf Null gesetzt
			break;
		case (2):
			//Updatebit wird mit 1 gesendet; entspricht Standard
			break;
		case (3):
			DisturbPDUUB("TCU_Disp_Rq_AR2", 1, 0); //Updatebit wird einmal auf Null gesetzt
			break;
	}
}

CH_CPCVehPwrMngmnt_EMM_Stat2_AR2()
{
	switch (@sysvar::CH_Nodes::CH_CPCVehPwrMngmnt_EMM_S_UB_A_01)
	{
		case (0):
			//Updatebit wird mit 1 gesendet; entspricht Standard
			break;
		case (1):
			//nur wenn manueller Wert gleich 0 ist, muss was gemacht werden
			if (@sysvar::CH_Nodes::CH_CPCVehPwrMngmnt_EMM_S_UB_A_01 == 0)
				DisturbPDUUB("VehPwrMngmnt_EMM_Stat2_AR2", 1, 0); //Updatebit wird einmal auf Null gesetzt
			break;
		case (2):
			//Updatebit wird mit 1 gesendet; entspricht Standard
			break;
		case (3):
			DisturbPDUUB("VehPwrMngmnt_EMM_Stat2_AR2", 1, 0); //Updatebit wird einmal auf Null gesetzt
			break;
	}
}

CH_CPCVehPwrMngmnt_Rq_AR()
{
	switch (@sysvar::CH_Nodes::CH_CPCVehPwrMngmnt_Rq_AR_UB_A_01)
	{
		case (0):
			//Updatebit wird mit 1 gesendet; entspricht Standard
			break;
		case (1):
			//nur wenn manueller Wert gleich 0 ist, muss was gemacht werden
			if (@sysvar::CH_Nodes::CH_CPCVehPwrMngmnt_Rq_AR_UB_A_01 == 0)
				DisturbPDUUB("VehPwrMngmnt_Rq_AR", 1, 0); //Updatebit wird einmal auf Null gesetzt
			break;
		case (2):
			//Updatebit wird mit 1 gesendet; entspricht Standard
			break;
		case (3):
			DisturbPDUUB("VehPwrMngmnt_Rq_AR", 1, 0); //Updatebit wird einmal auf Null gesetzt
			break;
	}
}

CH_CPCWIA_EngTrq_AR()
{
	switch (@sysvar::CH_Nodes::CH_CPCWIA_EngTrq_AR_UB_AUTO_01)
	{
		case (0):
			//Updatebit wird mit 1 gesendet; entspricht Standard
			break;
		case (1):
			//nur wenn manueller Wert gleich 0 ist, muss was gemacht werden
			if (@sysvar::CH_Nodes::CH_CPCWIA_EngTrq_AR_UB_AUTO_01 == 0)
				DisturbPDUUB("WIA_EngTrq_AR", 1, 0); //Updatebit wird einmal auf Null gesetzt
			break;
		case (2):
			//Updatebit wird mit 1 gesendet; entspricht Standard
			break;
		case (3):
			DisturbPDUUB("WIA_EngTrq_AR", 1, 0); //Updatebit wird einmal auf Null gesetzt
			break;
	}
}

void FrILTxPending(char pduName[], long len, byte payload[], long TxAck)
{
	byte crc;
	dword SQC;
	dword MC;
	dword Tgl;
	dword i;

	if (strncmp (pduName, "Adblue_Disp_Rq_AR", strLen(pduName)+strLen("Adblue_Disp_Rq_AR")) == 0)
	{
		if (TxAck == 1)
		{
		}
		else
		{
			CH_CPCAdblue_Disp_Rq_AR();
		}
	}
	if (strncmp (pduName, "Adblue_Disp_Warn_Rq_AR", strLen(pduName)+strLen("Adblue_Disp_Warn_Rq_AR")) == 0)
	{
		if (TxAck == 1)
		{
		}
		else
		{
		}
	}
	if (strncmp (pduName, "Assyst_Stat2_AR", strLen(pduName)+strLen("Assyst_Stat2_AR")) == 0)
	{
		if (TxAck == 1)
		{
		}
		else
		{
		}
	}
	if (strncmp (pduName, "Assyst_Stat3_AR2", strLen(pduName)+strLen("Assyst_Stat3_AR2")) == 0)
	{
		if (TxAck == 1)
		{
		}
		else
		{
		}
	}
	if (strncmp (pduName, "Assyst_Stat_AR", strLen(pduName)+strLen("Assyst_Stat_AR")) == 0)
	{
		if (TxAck == 1)
		{
		}
		else
		{
		}
	}
	if (strncmp (pduName, "CNG_Disp_Rq_AR2", strLen(pduName)+strLen("CNG_Disp_Rq_AR2")) == 0)
	{
		if (TxAck == 1)
		{
		}
		else
		{
			CH_CPCTCM_Disp_Rq_AMG_AR();
			CH_CPCCNG_Disp_Rq_AR2();
		}
	}
	if (strncmp (pduName, "CPC_CHASSIS_R1_AR2", strLen(pduName)+strLen("CPC_CHASSIS_R1_AR2")) == 0)
	{
		if (TxAck == 1)
		{
		}
		else
		{
		}
	}
	if (strncmp (pduName, "CPC_CHASSIS_R2_AR2", strLen(pduName)+strLen("CPC_CHASSIS_R2_AR2")) == 0)
	{
		if (TxAck == 1)
		{
		}
		else
		{
			CH_CPCCPC_CHASSIS_R2_AR2();
			CH_CPCPARK_Drv_Rs_TCM_AR2();
		}
	}
	if (strncmp (pduName, "DCDC1_Rs1_AR2", strLen(pduName)+strLen("DCDC1_Rs1_AR2")) == 0)
	{
		if (TxAck == 1)
		{
			if (@sysvar::CH_Nodes::CH_CPCSQC_DCDC1_Rs1_Pr2DCDC_AUTO == 0)
			{
				//SQC automatisch ändern
				SQC_VAL_DCDC1_Rs1_Pr2 = (SQC_VAL_DCDC1_Rs1_Pr2 + 1) % 16;
			}
			else
			{
				//SQC manuel veränderbar
			}

		}
		else
		{
			if (@sysvar::CH_Nodes::CH_CPCSQC_DCDC1_Rs1_Pr2DCDC_AUTO == 0)
			{
				//SQC automatisch ändern
				//SQC für CRC speichern
				CounterValForCRC_DCDC1_Rs1_Pr2 = SQC_VAL_DCDC1_Rs1_Pr2;
				//SQC in Byte schreiben
				payload[1] = (payload[1] & ~0x0F) |  SQC_VAL_DCDC1_Rs1_Pr2;
			}
			else
			{
				//SQC manuel veränderbar
			}

			if (@sysvar::CH_Nodes::CH_CPCCRC_DCDC1_Rs1_Pr2DCDC_AUTO == 0)
			{
				//CRC automatisch berechnen
				crc = 0xFF;
				crc = crctableProfTwo[crc ^ payload[1]];
				crc = crctableProfTwo[crc ^ payload[2]];
				crc = crctableProfTwo[crc ^ payload[3]];
				crc = crctableProfTwo[crc ^ payload[4]];
				crc = crctableProfTwo[crc ^ payload[5]];
				crc = crctableProfTwo[crc ^ payload[6]];
				crc = crctableProfTwo[crc ^ payload[7]];
				switch (CounterValForCRC_DCDC1_Rs1_Pr2)
				{
					case(0) :
						crc = crctableProfTwo[crc ^ 30];
						break;
					case(1) :
						crc = crctableProfTwo[crc ^ 172];
						break;
					case(2) :
						crc = crctableProfTwo[crc ^ 63];
						break;
					case(3) :
						crc = crctableProfTwo[crc ^ 205];
						break;
					case(4) :
						crc = crctableProfTwo[crc ^ 96];
						break;
					case(5) :
						crc = crctableProfTwo[crc ^ 238];
						break;
					case(6) :
						crc = crctableProfTwo[crc ^ 129];
						break;
					case(7) :
						crc = crctableProfTwo[crc ^ 20];
						break;
					case(8) :
						crc = crctableProfTwo[crc ^ 162];
						break;
					case(9) :
						crc = crctableProfTwo[crc ^ 53];
						break;
					case(10) :
						crc = crctableProfTwo[crc ^ 195];
						break;
					case(11) :
						crc = crctableProfTwo[crc ^ 86];
						break;
					case(12) :
						crc = crctableProfTwo[crc ^ 228];
						break;
					case(13) :
						crc = crctableProfTwo[crc ^ 119];
						break;
					case(14) :
						crc = crctableProfTwo[crc ^ 10];
						break;
					case(15) :
						crc = crctableProfTwo[crc ^ 152];
						break;
					default :
//						write("error: wrong parameter (%d)",CounterValForCRC_DCDC1_Rs1_Pr2); stop();
						break;
				}
				crc = (crc ^ 0xFF);
				payload[0] = crc;
			}
			else
			{
				//CRC manuel veränderbar
			}

			CH_CPCDCDC1_Rs1_AR2();
			CH_CPCOBL_DC_Output_AR();
		}
	}
	if (strncmp (pduName, "DPC_PT_Rs_AR", strLen(pduName)+strLen("DPC_PT_Rs_AR")) == 0)
	{
		if (TxAck == 1)
		{
		}
		else
		{
		}
	}
	if (strncmp (pduName, "ECM_DAC4_AR", strLen(pduName)+strLen("ECM_DAC4_AR")) == 0)
	{
		if (TxAck == 1)
		{
		}
		else
		{
			CH_CPCEM_DAC4_AR();
			CH_CPCTCM_DAC4_AR();
			CH_CPCECM_DAC4_AR();
			CH_CPCISM_DAC4_AR();
		}
	}
	if (strncmp (pduName, "ECO_Homepage_Data", strLen(pduName)+strLen("ECO_Homepage_Data")) == 0)
	{
		if (TxAck == 1)
		{
		}
		else
		{
		}
	}
	if (strncmp (pduName, "ECO_Score_Disp_Rq_AR", strLen(pduName)+strLen("ECO_Score_Disp_Rq_AR")) == 0)
	{
		if (TxAck == 1)
		{
		}
		else
		{
		}
	}
	if (strncmp (pduName, "EM01_Stat1_AR2", strLen(pduName)+strLen("EM01_Stat1_AR2")) == 0)
	{
		if (TxAck == 1)
		{
			if (@sysvar::CH_Nodes::CH_CPCSQC_EM01_Stat1_Pr2EM0_AUTO == 0)
			{
				//SQC automatisch ändern
				SQC_VAL_EM01_Stat1_Pr2 = (SQC_VAL_EM01_Stat1_Pr2 + 1) % 16;
			}
			else
			{
				//SQC manuel veränderbar
			}

		}
		else
		{
			if (@sysvar::CH_Nodes::CH_CPCSQC_EM01_Stat1_Pr2EM0_AUTO == 0)
			{
				//SQC automatisch ändern
				//SQC für CRC speichern
				CounterValForCRC_EM01_Stat1_Pr2 = SQC_VAL_EM01_Stat1_Pr2;
				//SQC in Byte schreiben
				payload[1] = (payload[1] & ~0x0F) |  SQC_VAL_EM01_Stat1_Pr2;
			}
			else
			{
				//SQC manuel veränderbar
			}

			if (@sysvar::CH_Nodes::CH_CPCCRC_EM01_Stat1_Pr2EM0_AUTO == 0)
			{
				//CRC automatisch berechnen
				crc = 0xFF;
				crc = crctableProfTwo[crc ^ payload[1]];
				crc = crctableProfTwo[crc ^ payload[2]];
				crc = crctableProfTwo[crc ^ payload[3]];
				crc = crctableProfTwo[crc ^ payload[4]];
				crc = crctableProfTwo[crc ^ payload[5]];
				crc = crctableProfTwo[crc ^ payload[6]];
				crc = crctableProfTwo[crc ^ payload[7]];
				switch (CounterValForCRC_EM01_Stat1_Pr2)
				{
					case(0) :
						crc = crctableProfTwo[crc ^ 117];
						break;
					case(1) :
						crc = crctableProfTwo[crc ^ 59];
						break;
					case(2) :
						crc = crctableProfTwo[crc ^ 252];
						break;
					case(3) :
						crc = crctableProfTwo[crc ^ 194];
						break;
					case(4) :
						crc = crctableProfTwo[crc ^ 136];
						break;
					case(5) :
						crc = crctableProfTwo[crc ^ 78];
						break;
					case(6) :
						crc = crctableProfTwo[crc ^ 20];
						break;
					case(7) :
						crc = crctableProfTwo[crc ^ 213];
						break;
					case(8) :
						crc = crctableProfTwo[crc ^ 155];
						break;
					case(9) :
						crc = crctableProfTwo[crc ^ 97];
						break;
					case(10) :
						crc = crctableProfTwo[crc ^ 39];
						break;
					case(11) :
						crc = crctableProfTwo[crc ^ 232];
						break;
					case(12) :
						crc = crctableProfTwo[crc ^ 174];
						break;
					case(13) :
						crc = crctableProfTwo[crc ^ 116];
						break;
					case(14) :
						crc = crctableProfTwo[crc ^ 58];
						break;
					case(15) :
						crc = crctableProfTwo[crc ^ 251];
						break;
					default :
//						write("error: wrong parameter (%d)",CounterValForCRC_EM01_Stat1_Pr2); stop();
						break;
				}
				crc = (crc ^ 0xFF);
				payload[0] = crc;
			}
			else
			{
				//CRC manuel veränderbar
			}

			CH_CPCEM01_Stat1_AR2();
			CH_CPCEM01_Stat2_AR2();
		}
	}
	if (strncmp (pduName, "EM01_Stat2_AR2", strLen(pduName)+strLen("EM01_Stat2_AR2")) == 0)
	{
		if (TxAck == 1)
		{
			if (@sysvar::CH_Nodes::CH_CPCSQC_EM01_Stat2_Pr2EM0_AUTO == 0)
			{
				//SQC automatisch ändern
				SQC_VAL_EM01_Stat2_Pr2 = (SQC_VAL_EM01_Stat2_Pr2 + 1) % 16;
			}
			else
			{
				//SQC manuel veränderbar
			}

		}
		else
		{
			if (@sysvar::CH_Nodes::CH_CPCSQC_EM01_Stat2_Pr2EM0_AUTO == 0)
			{
				//SQC automatisch ändern
				//SQC für CRC speichern
				CounterValForCRC_EM01_Stat2_Pr2 = SQC_VAL_EM01_Stat2_Pr2;
				//SQC in Byte schreiben
				payload[1] = (payload[1] & ~0x0F) |  SQC_VAL_EM01_Stat2_Pr2;
			}
			else
			{
				//SQC manuel veränderbar
			}

			if (@sysvar::CH_Nodes::CH_CPCCRC_EM01_Stat2_Pr2EM0_AUTO == 0)
			{
				//CRC automatisch berechnen
				crc = 0xFF;
				crc = crctableProfTwo[crc ^ payload[1]];
				crc = crctableProfTwo[crc ^ payload[2]];
				crc = crctableProfTwo[crc ^ payload[3]];
				crc = crctableProfTwo[crc ^ payload[4]];
				crc = crctableProfTwo[crc ^ payload[5]];
				crc = crctableProfTwo[crc ^ payload[6]];
				crc = crctableProfTwo[crc ^ payload[7]];
				switch (CounterValForCRC_EM01_Stat2_Pr2)
				{
					case(0) :
						crc = crctableProfTwo[crc ^ 205];
						break;
					case(1) :
						crc = crctableProfTwo[crc ^ 22];
						break;
					case(2) :
						crc = crctableProfTwo[crc ^ 90];
						break;
					case(3) :
						crc = crctableProfTwo[crc ^ 158];
						break;
					case(4) :
						crc = crctableProfTwo[crc ^ 226];
						break;
					case(5) :
						crc = crctableProfTwo[crc ^ 43];
						break;
					case(6) :
						crc = crctableProfTwo[crc ^ 111];
						break;
					case(7) :
						crc = crctableProfTwo[crc ^ 179];
						break;
					case(8) :
						crc = crctableProfTwo[crc ^ 247];
						break;
					case(9) :
						crc = crctableProfTwo[crc ^ 64];
						break;
					case(10) :
						crc = crctableProfTwo[crc ^ 132];
						break;
					case(11) :
						crc = crctableProfTwo[crc ^ 200];
						break;
					case(12) :
						crc = crctableProfTwo[crc ^ 17];
						break;
					case(13) :
						crc = crctableProfTwo[crc ^ 85];
						break;
					case(14) :
						crc = crctableProfTwo[crc ^ 153];
						break;
					case(15) :
						crc = crctableProfTwo[crc ^ 221];
						break;
					default :
//						write("error: wrong parameter (%d)",CounterValForCRC_EM01_Stat2_Pr2); stop();
						break;
				}
				crc = (crc ^ 0xFF);
				payload[0] = crc;
			}
			else
			{
				//CRC manuel veränderbar
			}

			CH_CPCEM01_Stat1_AR2();
			CH_CPCEM01_Stat2_AR2();
		}
	}
	if (strncmp (pduName, "EM01_Trq_Rs_AR2", strLen(pduName)+strLen("EM01_Trq_Rs_AR2")) == 0)
	{
		if (TxAck == 1)
		{
			if (@sysvar::CH_Nodes::CH_CPCSQC_EM01_Trq_Rs_Pr2EM_AUTO == 0)
			{
				//SQC automatisch ändern
				SQC_VAL_EM01_Trq_Rs_Pr2 = (SQC_VAL_EM01_Trq_Rs_Pr2 + 1) % 16;
			}
			else
			{
				//SQC manuel veränderbar
			}

		}
		else
		{
			if (@sysvar::CH_Nodes::CH_CPCSQC_EM01_Trq_Rs_Pr2EM_AUTO == 0)
			{
				//SQC automatisch ändern
				//SQC für CRC speichern
				CounterValForCRC_EM01_Trq_Rs_Pr2 = SQC_VAL_EM01_Trq_Rs_Pr2;
				//SQC in Byte schreiben
				payload[1] = (payload[1] & ~0x0F) |  SQC_VAL_EM01_Trq_Rs_Pr2;
			}
			else
			{
				//SQC manuel veränderbar
			}

			if (@sysvar::CH_Nodes::CH_CPCCRC_EM01_Trq_Rs_Pr2EM_AUTO == 0)
			{
				//CRC automatisch berechnen
				crc = 0xFF;
				crc = crctableProfTwo[crc ^ payload[1]];
				crc = crctableProfTwo[crc ^ payload[2]];
				crc = crctableProfTwo[crc ^ payload[3]];
				crc = crctableProfTwo[crc ^ payload[4]];
				crc = crctableProfTwo[crc ^ payload[5]];
				crc = crctableProfTwo[crc ^ payload[6]];
				crc = crctableProfTwo[crc ^ payload[7]];
				switch (CounterValForCRC_EM01_Trq_Rs_Pr2)
				{
					case(0) :
						crc = crctableProfTwo[crc ^ 114];
						break;
					case(1) :
						crc = crctableProfTwo[crc ^ 16];
						break;
					case(2) :
						crc = crctableProfTwo[crc ^ 169];
						break;
					case(3) :
						crc = crctableProfTwo[crc ^ 71];
						break;
					case(4) :
						crc = crctableProfTwo[crc ^ 224];
						break;
					case(5) :
						crc = crctableProfTwo[crc ^ 126];
						break;
					case(6) :
						crc = crctableProfTwo[crc ^ 28];
						break;
					case(7) :
						crc = crctableProfTwo[crc ^ 181];
						break;
					case(8) :
						crc = crctableProfTwo[crc ^ 83];
						break;
					case(9) :
						crc = crctableProfTwo[crc ^ 236];
						break;
					case(10) :
						crc = crctableProfTwo[crc ^ 138];
						break;
					case(11) :
						crc = crctableProfTwo[crc ^ 40];
						break;
					case(12) :
						crc = crctableProfTwo[crc ^ 193];
						break;
					case(13) :
						crc = crctableProfTwo[crc ^ 95];
						break;
					case(14) :
						crc = crctableProfTwo[crc ^ 248];
						break;
					case(15) :
						crc = crctableProfTwo[crc ^ 150];
						break;
					default :
//						write("error: wrong parameter (%d)",CounterValForCRC_EM01_Trq_Rs_Pr2); stop();
						break;
				}
				crc = (crc ^ 0xFF);
				payload[0] = crc;
			}
			else
			{
				//CRC manuel veränderbar
			}

			CH_CPCEM01_Trq_Rs_AR2();
			CH_CPCPtMngmnt_Stat2_AR2();
		}
	}
	if (strncmp (pduName, "EM_DAC4_AR", strLen(pduName)+strLen("EM_DAC4_AR")) == 0)
	{
		if (TxAck == 1)
		{
		}
		else
		{
			CH_CPCEM_DAC4_AR();
			CH_CPCTCM_DAC4_AR();
			CH_CPCECM_DAC4_AR();
			CH_CPCISM_DAC4_AR();
		}
	}
	if (strncmp (pduName, "EMM_Data1_AR2", strLen(pduName)+strLen("EMM_Data1_AR2")) == 0)
	{
		if (TxAck == 1)
		{
		}
		else
		{
		}
	}
	if (strncmp (pduName, "EnergyMngmnt_PreCond_Stat_AR2", strLen(pduName)+strLen("EnergyMngmnt_PreCond_Stat_AR2")) == 0)
	{
		if (TxAck == 1)
		{
		}
		else
		{
		}
	}
	if (strncmp (pduName, "Eng_Rs_1_AR2", strLen(pduName)+strLen("Eng_Rs_1_AR2")) == 0)
	{
		if (TxAck == 1)
		{
			if (@sysvar::CH_Nodes::CH_CPCSQC_Eng_Rs1_Pr2Eng_Rs_AUTO == 0)
			{
				//SQC automatisch ändern
				SQC_VAL_Eng_Rs1_Pr2 = (SQC_VAL_Eng_Rs1_Pr2 + 1) % 16;
			}
			else
			{
				//SQC manuel veränderbar
			}

		}
		else
		{
			if (@sysvar::CH_Nodes::CH_CPCSQC_Eng_Rs1_Pr2Eng_Rs_AUTO == 0)
			{
				//SQC automatisch ändern
				//SQC für CRC speichern
				CounterValForCRC_Eng_Rs1_Pr2 = SQC_VAL_Eng_Rs1_Pr2;
				//SQC in Byte schreiben
				payload[1] = (payload[1] & ~0x0F) |  SQC_VAL_Eng_Rs1_Pr2;
			}
			else
			{
				//SQC manuel veränderbar
			}

			if (@sysvar::CH_Nodes::CH_CPCCRC_Eng_Rs1_Pr2Eng_Rs_AUTO == 0)
			{
				//CRC automatisch berechnen
				crc = 0xFF;
				crc = crctableProfTwo[crc ^ payload[1]];
				crc = crctableProfTwo[crc ^ payload[2]];
				crc = crctableProfTwo[crc ^ payload[3]];
				crc = crctableProfTwo[crc ^ payload[4]];
				crc = crctableProfTwo[crc ^ payload[5]];
				crc = crctableProfTwo[crc ^ payload[6]];
				crc = crctableProfTwo[crc ^ payload[7]];
				switch (CounterValForCRC_Eng_Rs1_Pr2)
				{
					case(0) :
						crc = crctableProfTwo[crc ^ 39];
						break;
					case(1) :
						crc = crctableProfTwo[crc ^ 232];
						break;
					case(2) :
						crc = crctableProfTwo[crc ^ 174];
						break;
					case(3) :
						crc = crctableProfTwo[crc ^ 116];
						break;
					case(4) :
						crc = crctableProfTwo[crc ^ 58];
						break;
					case(5) :
						crc = crctableProfTwo[crc ^ 251];
						break;
					case(6) :
						crc = crctableProfTwo[crc ^ 193];
						break;
					case(7) :
						crc = crctableProfTwo[crc ^ 135];
						break;
					case(8) :
						crc = crctableProfTwo[crc ^ 77];
						break;
					case(9) :
						crc = crctableProfTwo[crc ^ 19];
						break;
					case(10) :
						crc = crctableProfTwo[crc ^ 212];
						break;
					case(11) :
						crc = crctableProfTwo[crc ^ 154];
						break;
					case(12) :
						crc = crctableProfTwo[crc ^ 96];
						break;
					case(13) :
						crc = crctableProfTwo[crc ^ 38];
						break;
					case(14) :
						crc = crctableProfTwo[crc ^ 231];
						break;
					case(15) :
						crc = crctableProfTwo[crc ^ 173];
						break;
					default :
//						write("error: wrong parameter (%d)",CounterValForCRC_Eng_Rs1_Pr2); stop();
						break;
				}
				crc = (crc ^ 0xFF);
				payload[0] = crc;
			}
			else
			{
				//CRC manuel veränderbar
			}

			CH_CPCEng_Rs_1_AR2();
			CH_CPCEng_Rs_2_AR2();
		}
	}
	if (strncmp (pduName, "Eng_Rs_2_AR2", strLen(pduName)+strLen("Eng_Rs_2_AR2")) == 0)
	{
		if (TxAck == 1)
		{
			if (@sysvar::CH_Nodes::CH_CPCSQC_Eng_Rs2_Pr2Eng_Rs_AUTO == 0)
			{
				//SQC automatisch ändern
				SQC_VAL_Eng_Rs2_Pr2 = (SQC_VAL_Eng_Rs2_Pr2 + 1) % 16;
			}
			else
			{
				//SQC manuel veränderbar
			}

		}
		else
		{
			if (@sysvar::CH_Nodes::CH_CPCSQC_Eng_Rs2_Pr2Eng_Rs_AUTO == 0)
			{
				//SQC automatisch ändern
				//SQC für CRC speichern
				CounterValForCRC_Eng_Rs2_Pr2 = SQC_VAL_Eng_Rs2_Pr2;
				//SQC in Byte schreiben
				payload[1] = (payload[1] & ~0x0F) |  SQC_VAL_Eng_Rs2_Pr2;
			}
			else
			{
				//SQC manuel veränderbar
			}

			if (@sysvar::CH_Nodes::CH_CPCCRC_Eng_Rs2_Pr2Eng_Rs_AUTO == 0)
			{
				//CRC automatisch berechnen
				crc = 0xFF;
				crc = crctableProfTwo[crc ^ payload[1]];
				crc = crctableProfTwo[crc ^ payload[2]];
				crc = crctableProfTwo[crc ^ payload[3]];
				crc = crctableProfTwo[crc ^ payload[4]];
				crc = crctableProfTwo[crc ^ payload[5]];
				crc = crctableProfTwo[crc ^ payload[6]];
				crc = crctableProfTwo[crc ^ payload[7]];
				switch (CounterValForCRC_Eng_Rs2_Pr2)
				{
					case(0) :
						crc = crctableProfTwo[crc ^ 88];
						break;
					case(1) :
						crc = crctableProfTwo[crc ^ 240];
						break;
					case(2) :
						crc = crctableProfTwo[crc ^ 141];
						break;
					case(3) :
						crc = crctableProfTwo[crc ^ 42];
						break;
					case(4) :
						crc = crctableProfTwo[crc ^ 194];
						break;
					case(5) :
						crc = crctableProfTwo[crc ^ 95];
						break;
					case(6) :
						crc = crctableProfTwo[crc ^ 247];
						break;
					case(7) :
						crc = crctableProfTwo[crc ^ 148];
						break;
					case(8) :
						crc = crctableProfTwo[crc ^ 49];
						break;
					case(9) :
						crc = crctableProfTwo[crc ^ 201];
						break;
					case(10) :
						crc = crctableProfTwo[crc ^ 102];
						break;
					case(11) :
						crc = crctableProfTwo[crc ^ 3];
						break;
					case(12) :
						crc = crctableProfTwo[crc ^ 155];
						break;
					case(13) :
						crc = crctableProfTwo[crc ^ 56];
						break;
					case(14) :
						crc = crctableProfTwo[crc ^ 208];
						break;
					case(15) :
						crc = crctableProfTwo[crc ^ 109];
						break;
					default :
//						write("error: wrong parameter (%d)",CounterValForCRC_Eng_Rs2_Pr2); stop();
						break;
				}
				crc = (crc ^ 0xFF);
				payload[0] = crc;
			}
			else
			{
				//CRC manuel veränderbar
			}

			CH_CPCEng_Rs_1_AR2();
			CH_CPCEng_Rs_2_AR2();
		}
	}
	if (strncmp (pduName, "Eng_Rs_3_AR2", strLen(pduName)+strLen("Eng_Rs_3_AR2")) == 0)
	{
		if (TxAck == 1)
		{
			if (@sysvar::CH_Nodes::CH_CPCSQC_Eng_Rs3_Pr2Eng_Rs_AUTO == 0)
			{
				//SQC automatisch ändern
				SQC_VAL_Eng_Rs3_Pr2 = (SQC_VAL_Eng_Rs3_Pr2 + 1) % 16;
			}
			else
			{
				//SQC manuel veränderbar
			}

		}
		else
		{
			if (@sysvar::CH_Nodes::CH_CPCSQC_Eng_Rs3_Pr2Eng_Rs_AUTO == 0)
			{
				//SQC automatisch ändern
				//SQC für CRC speichern
				CounterValForCRC_Eng_Rs3_Pr2 = SQC_VAL_Eng_Rs3_Pr2;
				//SQC in Byte schreiben
				payload[1] = (payload[1] & ~0x0F) |  SQC_VAL_Eng_Rs3_Pr2;
			}
			else
			{
				//SQC manuel veränderbar
			}

			if (@sysvar::CH_Nodes::CH_CPCCRC_Eng_Rs3_Pr2Eng_Rs_AUTO == 0)
			{
				//CRC automatisch berechnen
				crc = 0xFF;
				crc = crctableProfTwo[crc ^ payload[1]];
				crc = crctableProfTwo[crc ^ payload[2]];
				crc = crctableProfTwo[crc ^ payload[3]];
				crc = crctableProfTwo[crc ^ payload[4]];
				switch (CounterValForCRC_Eng_Rs3_Pr2)
				{
					case(0) :
						crc = crctableProfTwo[crc ^ 185];
						break;
					case(1) :
						crc = crctableProfTwo[crc ^ 143];
						break;
					case(2) :
						crc = crctableProfTwo[crc ^ 101];
						break;
					case(3) :
						crc = crctableProfTwo[crc ^ 59];
						break;
					case(4) :
						crc = crctableProfTwo[crc ^ 17];
						break;
					case(5) :
						crc = crctableProfTwo[crc ^ 226];
						break;
					case(6) :
						crc = crctableProfTwo[crc ^ 184];
						break;
					case(7) :
						crc = crctableProfTwo[crc ^ 142];
						break;
					case(8) :
						crc = crctableProfTwo[crc ^ 100];
						break;
					case(9) :
						crc = crctableProfTwo[crc ^ 58];
						break;
					case(10) :
						crc = crctableProfTwo[crc ^ 16];
						break;
					case(11) :
						crc = crctableProfTwo[crc ^ 225];
						break;
					case(12) :
						crc = crctableProfTwo[crc ^ 183];
						break;
					case(13) :
						crc = crctableProfTwo[crc ^ 141];
						break;
					case(14) :
						crc = crctableProfTwo[crc ^ 99];
						break;
					case(15) :
						crc = crctableProfTwo[crc ^ 57];
						break;
					default :
//						write("error: wrong parameter (%d)",CounterValForCRC_Eng_Rs3_Pr2); stop();
						break;
				}
				crc = (crc ^ 0xFF);
				payload[0] = crc;
			}
			else
			{
				//CRC manuel veränderbar
			}

			CH_CPCEng_Rs_EngCtrl_AR2();
			CH_CPCEng_Rs_3_AR2();
		}
	}
	if (strncmp (pduName, "Eng_Rs_EM_AR2", strLen(pduName)+strLen("Eng_Rs_EM_AR2")) == 0)
	{
		if (TxAck == 1)
		{
			if (@sysvar::CH_Nodes::CH_CPCSQC_Eng_Rs_EM_Pr2Eng__AUTO == 0)
			{
				//SQC automatisch ändern
				SQC_VAL_Eng_Rs_EM_Pr2 = (SQC_VAL_Eng_Rs_EM_Pr2 + 1) % 16;
			}
			else
			{
				//SQC manuel veränderbar
			}

		}
		else
		{
			if (@sysvar::CH_Nodes::CH_CPCSQC_Eng_Rs_EM_Pr2Eng__AUTO == 0)
			{
				//SQC automatisch ändern
				//SQC für CRC speichern
				CounterValForCRC_Eng_Rs_EM_Pr2 = SQC_VAL_Eng_Rs_EM_Pr2;
				//SQC in Byte schreiben
				payload[1] = (payload[1] & ~0x0F) |  SQC_VAL_Eng_Rs_EM_Pr2;
			}
			else
			{
				//SQC manuel veränderbar
			}

			if (@sysvar::CH_Nodes::CH_CPCCRC_Eng_Rs_EM_Pr2Eng__AUTO == 0)
			{
				//CRC automatisch berechnen
				crc = 0xFF;
				crc = crctableProfTwo[crc ^ payload[1]];
				crc = crctableProfTwo[crc ^ payload[2]];
				crc = crctableProfTwo[crc ^ payload[3]];
				crc = crctableProfTwo[crc ^ payload[4]];
				crc = crctableProfTwo[crc ^ payload[5]];
				crc = crctableProfTwo[crc ^ payload[6]];
				crc = crctableProfTwo[crc ^ payload[7]];
				switch (CounterValForCRC_Eng_Rs_EM_Pr2)
				{
					case(0) :
						crc = crctableProfTwo[crc ^ 171];
						break;
					case(1) :
						crc = crctableProfTwo[crc ^ 219];
						break;
					case(2) :
						crc = crctableProfTwo[crc ^ 16];
						break;
					case(3) :
						crc = crctableProfTwo[crc ^ 64];
						break;
					case(4) :
						crc = crctableProfTwo[crc ^ 112];
						break;
					case(5) :
						crc = crctableProfTwo[crc ^ 160];
						break;
					case(6) :
						crc = crctableProfTwo[crc ^ 208];
						break;
					case(7) :
						crc = crctableProfTwo[crc ^ 5];
						break;
					case(8) :
						crc = crctableProfTwo[crc ^ 53];
						break;
					case(9) :
						crc = crctableProfTwo[crc ^ 101];
						break;
					case(10) :
						crc = crctableProfTwo[crc ^ 149];
						break;
					case(11) :
						crc = crctableProfTwo[crc ^ 197];
						break;
					case(12) :
						crc = crctableProfTwo[crc ^ 245];
						break;
					case(13) :
						crc = crctableProfTwo[crc ^ 42];
						break;
					case(14) :
						crc = crctableProfTwo[crc ^ 90];
						break;
					case(15) :
						crc = crctableProfTwo[crc ^ 138];
						break;
					default :
//						write("error: wrong parameter (%d)",CounterValForCRC_Eng_Rs_EM_Pr2); stop();
						break;
				}
				crc = (crc ^ 0xFF);
				payload[0] = crc;
			}
			else
			{
				//CRC manuel veränderbar
			}

			CH_CPCEng_Rs_EM_AR2();
		}
	}
	if (strncmp (pduName, "Eng_Rs_EngCtrl_AR2", strLen(pduName)+strLen("Eng_Rs_EngCtrl_AR2")) == 0)
	{
		if (TxAck == 1)
		{
			if (@sysvar::CH_Nodes::CH_CPCSQC_Eng_Rs_EngCtrl_Pr_AUTO == 0)
			{
				//SQC automatisch ändern
				SQC_VAL_Eng_Rs_EngCtrl_Pr2 = (SQC_VAL_Eng_Rs_EngCtrl_Pr2 + 1) % 16;
			}
			else
			{
				//SQC manuel veränderbar
			}

		}
		else
		{
			if (@sysvar::CH_Nodes::CH_CPCSQC_Eng_Rs_EngCtrl_Pr_AUTO == 0)
			{
				//SQC automatisch ändern
				//SQC für CRC speichern
				CounterValForCRC_Eng_Rs_EngCtrl_Pr2 = SQC_VAL_Eng_Rs_EngCtrl_Pr2;
				//SQC in Byte schreiben
				payload[1] = (payload[1] & ~0x0F) |  SQC_VAL_Eng_Rs_EngCtrl_Pr2;
			}
			else
			{
				//SQC manuel veränderbar
			}

			if (@sysvar::CH_Nodes::CH_CPCCRC_Eng_Rs_EngCtrl_Pr_AUTO == 0)
			{
				//CRC automatisch berechnen
				crc = 0xFF;
				crc = crctableProfTwo[crc ^ payload[1]];
				crc = crctableProfTwo[crc ^ payload[2]];
				crc = crctableProfTwo[crc ^ payload[3]];
				crc = crctableProfTwo[crc ^ payload[4]];
				crc = crctableProfTwo[crc ^ payload[5]];
				crc = crctableProfTwo[crc ^ payload[6]];
				crc = crctableProfTwo[crc ^ payload[7]];
				switch (CounterValForCRC_Eng_Rs_EngCtrl_Pr2)
				{
					case(0) :
						crc = crctableProfTwo[crc ^ 199];
						break;
					case(1) :
						crc = crctableProfTwo[crc ^ 227];
						break;
					case(2) :
						crc = crctableProfTwo[crc ^ 4];
						break;
					case(3) :
						crc = crctableProfTwo[crc ^ 32];
						break;
					case(4) :
						crc = crctableProfTwo[crc ^ 60];
						break;
					case(5) :
						crc = crctableProfTwo[crc ^ 88];
						break;
					case(6) :
						crc = crctableProfTwo[crc ^ 116];
						break;
					case(7) :
						crc = crctableProfTwo[crc ^ 144];
						break;
					case(8) :
						crc = crctableProfTwo[crc ^ 172];
						break;
					case(9) :
						crc = crctableProfTwo[crc ^ 200];
						break;
					case(10) :
						crc = crctableProfTwo[crc ^ 228];
						break;
					case(11) :
						crc = crctableProfTwo[crc ^ 5];
						break;
					case(12) :
						crc = crctableProfTwo[crc ^ 33];
						break;
					case(13) :
						crc = crctableProfTwo[crc ^ 61];
						break;
					case(14) :
						crc = crctableProfTwo[crc ^ 89];
						break;
					case(15) :
						crc = crctableProfTwo[crc ^ 117];
						break;
					default :
//						write("error: wrong parameter (%d)",CounterValForCRC_Eng_Rs_EngCtrl_Pr2); stop();
						break;
				}
				crc = (crc ^ 0xFF);
				payload[0] = crc;
			}
			else
			{
				//CRC manuel veränderbar
			}

			CH_CPCEng_Rs_EngCtrl_AR2();
			CH_CPCEng_Rs_3_AR2();
		}
	}
	if (strncmp (pduName, "EngCtrl_Disp_Rq_AR2", strLen(pduName)+strLen("EngCtrl_Disp_Rq_AR2")) == 0)
	{
		if (TxAck == 1)
		{
		}
		else
		{
			CH_CPCSBW_DrvPosn_Disp_Rq_TCM_AR2();
			CH_CPCHumanMachineIfc_AR2();
			CH_CPCSBW_DrvPosn_Disp_Rq_ISM_AR2();
			CH_CPCEngCtrl_Disp_Rq_AR2();
		}
	}
	if (strncmp (pduName, "EngCtrl_OBD1_AR", strLen(pduName)+strLen("EngCtrl_OBD1_AR")) == 0)
	{
		if (TxAck == 1)
		{
		}
		else
		{
			CH_CPCEngCtrl_OBD1_AR();
		}
	}
	if (strncmp (pduName, "EngCtrl_Stat_AR2", strLen(pduName)+strLen("EngCtrl_Stat_AR2")) == 0)
	{
		if (TxAck == 1)
		{
		}
		else
		{
		}
	}
	if (strncmp (pduName, "ESP_OBD_Data_AR", strLen(pduName)+strLen("ESP_OBD_Data_AR")) == 0)
	{
		if (TxAck == 1)
		{
		}
		else
		{
		}
	}
	if (strncmp (pduName, "Fuel_Stat2_AR2", strLen(pduName)+strLen("Fuel_Stat2_AR2")) == 0)
	{
		if (TxAck == 1)
		{
		}
		else
		{
			CH_CPCPNHV_EnergyMngmntSet_Rs1_AR2();
			CH_CPCFuel_Stat2_AR2();
			CH_CPCWIA_EngTrq_AR();
			CH_CPCPNHV_EnergyMngmntSet_Rs2_AR();
		}
	}
	if (strncmp (pduName, "FuelLvl_Stat_AR2", strLen(pduName)+strLen("FuelLvl_Stat_AR2")) == 0)
	{
		if (TxAck == 1)
		{
		}
		else
		{
		}
	}
	if (strncmp (pduName, "HumanMachineIfc_AR2", strLen(pduName)+strLen("HumanMachineIfc_AR2")) == 0)
	{
		if (TxAck == 1)
		{
		}
		else
		{
			CH_CPCSBW_DrvPosn_Disp_Rq_TCM_AR2();
			CH_CPCHumanMachineIfc_AR2();
			CH_CPCSBW_DrvPosn_Disp_Rq_ISM_AR2();
			CH_CPCEngCtrl_Disp_Rq_AR2();
		}
	}
	if (strncmp (pduName, "HumanMachineIfc_Rq_AR", strLen(pduName)+strLen("HumanMachineIfc_Rq_AR")) == 0)
	{
		if (TxAck == 1)
		{
		}
		else
		{
		}
	}
	if (strncmp (pduName, "ISM_DAC4_AR", strLen(pduName)+strLen("ISM_DAC4_AR")) == 0)
	{
		if (TxAck == 1)
		{
		}
		else
		{
			CH_CPCEM_DAC4_AR();
			CH_CPCTCM_DAC4_AR();
			CH_CPCECM_DAC4_AR();
			CH_CPCISM_DAC4_AR();
		}
	}
	if (strncmp (pduName, "OBL_DC_Output_AR", strLen(pduName)+strLen("OBL_DC_Output_AR")) == 0)
	{
		if (TxAck == 1)
		{
		}
		else
		{
			CH_CPCDCDC1_Rs1_AR2();
			CH_CPCOBL_DC_Output_AR();
		}
	}
	if (strncmp (pduName, "PARK_Drv_Rs_TCM_AR2", strLen(pduName)+strLen("PARK_Drv_Rs_TCM_AR2")) == 0)
	{
		if (TxAck == 1)
		{
			if (@sysvar::CH_Nodes::CH_CPCSQC_PARK_Drv_Rs_TCM_P_AUTO == 0)
			{
				//SQC automatisch ändern
				SQC_VAL_PARK_Drv_Rs_TCM_Pr2 = (SQC_VAL_PARK_Drv_Rs_TCM_Pr2 + 1) % 16;
			}
			else
			{
				//SQC manuel veränderbar
			}

		}
		else
		{
			if (@sysvar::CH_Nodes::CH_CPCSQC_PARK_Drv_Rs_TCM_P_AUTO == 0)
			{
				//SQC automatisch ändern
				//SQC für CRC speichern
				CounterValForCRC_PARK_Drv_Rs_TCM_Pr2 = SQC_VAL_PARK_Drv_Rs_TCM_Pr2;
				//SQC in Byte schreiben
				payload[1] = (payload[1] & ~0x0F) |  SQC_VAL_PARK_Drv_Rs_TCM_Pr2;
			}
			else
			{
				//SQC manuel veränderbar
			}

			if (@sysvar::CH_Nodes::CH_CPCCRC_PARK_Drv_Rs_TCM_P_AUTO == 0)
			{
				//CRC automatisch berechnen
				crc = 0xFF;
				crc = crctableProfTwo[crc ^ payload[1]];
				crc = crctableProfTwo[crc ^ payload[2]];
				crc = crctableProfTwo[crc ^ payload[3]];
				crc = crctableProfTwo[crc ^ payload[4]];
				switch (CounterValForCRC_PARK_Drv_Rs_TCM_Pr2)
				{
					case(0) :
						crc = crctableProfTwo[crc ^ 205];
						break;
					case(1) :
						crc = crctableProfTwo[crc ^ 189];
						break;
					case(2) :
						crc = crctableProfTwo[crc ^ 173];
						break;
					case(3) :
						crc = crctableProfTwo[crc ^ 157];
						break;
					case(4) :
						crc = crctableProfTwo[crc ^ 141];
						break;
					case(5) :
						crc = crctableProfTwo[crc ^ 125];
						break;
					case(6) :
						crc = crctableProfTwo[crc ^ 109];
						break;
					case(7) :
						crc = crctableProfTwo[crc ^ 93];
						break;
					case(8) :
						crc = crctableProfTwo[crc ^ 77];
						break;
					case(9) :
						crc = crctableProfTwo[crc ^ 61];
						break;
					case(10) :
						crc = crctableProfTwo[crc ^ 45];
						break;
					case(11) :
						crc = crctableProfTwo[crc ^ 29];
						break;
					case(12) :
						crc = crctableProfTwo[crc ^ 13];
						break;
					case(13) :
						crc = crctableProfTwo[crc ^ 248];
						break;
					case(14) :
						crc = crctableProfTwo[crc ^ 232];
						break;
					case(15) :
						crc = crctableProfTwo[crc ^ 216];
						break;
					default :
//						write("error: wrong parameter (%d)",CounterValForCRC_PARK_Drv_Rs_TCM_Pr2); stop();
						break;
				}
				crc = (crc ^ 0xFF);
				payload[0] = crc;
			}
			else
			{
				//CRC manuel veränderbar
			}

			CH_CPCCPC_CHASSIS_R2_AR2();
			CH_CPCPARK_Drv_Rs_TCM_AR2();
		}
	}
	if (strncmp (pduName, "PN14_Gen_Rs_AR", strLen(pduName)+strLen("PN14_Gen_Rs_AR")) == 0)
	{
		if (TxAck == 1)
		{
		}
		else
		{
			CH_CPCPN14_Gen_Rs_AR();
			CH_CPCVehPwrMngmnt_Rq_AR();
		}
	}
	if (strncmp (pduName, "PNHV_BMS_Stat_AR2", strLen(pduName)+strLen("PNHV_BMS_Stat_AR2")) == 0)
	{
		if (TxAck == 1)
		{
		}
		else
		{
		}
	}
	if (strncmp (pduName, "PNHV_EnergyMngmnt_Disp_Rq_AR", strLen(pduName)+strLen("PNHV_EnergyMngmnt_Disp_Rq_AR")) == 0)
	{
		if (TxAck == 1)
		{
		}
		else
		{
		}
	}
	if (strncmp (pduName, "PNHV_EnergyMngmnt_Stat2_AR2", strLen(pduName)+strLen("PNHV_EnergyMngmnt_Stat2_AR2")) == 0)
	{
		if (TxAck == 1)
		{
		}
		else
		{
		}
	}
	if (strncmp (pduName, "PNHV_EnergyMngmnt_Stat3_AR2", strLen(pduName)+strLen("PNHV_EnergyMngmnt_Stat3_AR2")) == 0)
	{
		if (TxAck == 1)
		{
			if (@sysvar::CH_Nodes::CH_CPCPNM_CALID_CVN_ErrNum__AUTO == 0)
			{
				//TGL automatisch ändern
				TGL_VAL_NM_CALID_CVN_ErrNum_ = (TGL_VAL_NM_CALID_CVN_ErrNum_ + 1) % 2;
			}
			else
			{
				//TGL manuel veränderbar
			}

		}
		else
		{
			if (@sysvar::CH_Nodes::CH_CPCPNM_CALID_CVN_ErrNum__AUTO == 0)
			{
				//TGL automatisch ändern
				//TGL an richtige Position 'schieben'
				for (i = 0; i < 7; i++)
				{
					TGL_VAL_NM_CALID_CVN_ErrNum_ = TGL_VAL_NM_CALID_CVN_ErrNum_ << 1;
				}
				//TGL in Byte schreiben
				payload[3] = (payload[3] & ~0x80) |  TGL_VAL_NM_CALID_CVN_ErrNum_;
				//TGL wieder zurück 'schieben'
				for (i = 0; i < 7; i++)
				{
					TGL_VAL_NM_CALID_CVN_ErrNum_ = TGL_VAL_NM_CALID_CVN_ErrNum_ >> 1;
				}
			}
			else
			{
				//TGL manuel veränderbar
			}

		}
	}
	if (strncmp (pduName, "PNHV_EnergyMngmntSet_Rs1_AR2", strLen(pduName)+strLen("PNHV_EnergyMngmntSet_Rs1_AR2")) == 0)
	{
		if (TxAck == 1)
		{
		}
		else
		{
			CH_CPCPNHV_EnergyMngmntSet_Rs1_AR2();
			CH_CPCFuel_Stat2_AR2();
			CH_CPCWIA_EngTrq_AR();
			CH_CPCPNHV_EnergyMngmntSet_Rs2_AR();
		}
	}
	if (strncmp (pduName, "PNHV_EnergyMngmntSet_Rs2_AR", strLen(pduName)+strLen("PNHV_EnergyMngmntSet_Rs2_AR")) == 0)
	{
		if (TxAck == 1)
		{
		}
		else
		{
			CH_CPCPNHV_EnergyMngmntSet_Rs1_AR2();
			CH_CPCFuel_Stat2_AR2();
			CH_CPCWIA_EngTrq_AR();
			CH_CPCPNHV_EnergyMngmntSet_Rs2_AR();
		}
	}
	if (strncmp (pduName, "PNHV_Stat_AR2", strLen(pduName)+strLen("PNHV_Stat_AR2")) == 0)
	{
		if (TxAck == 1)
		{
			if (@sysvar::CH_Nodes::CH_CPCSQC_PNHV_Stat_Pr2PNHV_AUTO == 0)
			{
				//SQC automatisch ändern
				SQC_VAL_PNHV_Stat_Pr2 = (SQC_VAL_PNHV_Stat_Pr2 + 1) % 16;
			}
			else
			{
				//SQC manuel veränderbar
			}

		}
		else
		{
			if (@sysvar::CH_Nodes::CH_CPCSQC_PNHV_Stat_Pr2PNHV_AUTO == 0)
			{
				//SQC automatisch ändern
				//SQC für CRC speichern
				CounterValForCRC_PNHV_Stat_Pr2 = SQC_VAL_PNHV_Stat_Pr2;
				//SQC in Byte schreiben
				payload[1] = (payload[1] & ~0x0F) |  SQC_VAL_PNHV_Stat_Pr2;
			}
			else
			{
				//SQC manuel veränderbar
			}

			if (@sysvar::CH_Nodes::CH_CPCCRC_PNHV_Stat_Pr2PNHV_AUTO == 0)
			{
				//CRC automatisch berechnen
				crc = 0xFF;
				crc = crctableProfTwo[crc ^ payload[1]];
				crc = crctableProfTwo[crc ^ payload[2]];
				crc = crctableProfTwo[crc ^ payload[3]];
				crc = crctableProfTwo[crc ^ payload[4]];
				crc = crctableProfTwo[crc ^ payload[5]];
				switch (CounterValForCRC_PNHV_Stat_Pr2)
				{
					case(0) :
						crc = crctableProfTwo[crc ^ 61];
						break;
					case(1) :
						crc = crctableProfTwo[crc ^ 190];
						break;
					case(2) :
						crc = crctableProfTwo[crc ^ 68];
						break;
					case(3) :
						crc = crctableProfTwo[crc ^ 197];
						break;
					case(4) :
						crc = crctableProfTwo[crc ^ 75];
						break;
					case(5) :
						crc = crctableProfTwo[crc ^ 204];
						break;
					case(6) :
						crc = crctableProfTwo[crc ^ 82];
						break;
					case(7) :
						crc = crctableProfTwo[crc ^ 211];
						break;
					case(8) :
						crc = crctableProfTwo[crc ^ 89];
						break;
					case(9) :
						crc = crctableProfTwo[crc ^ 218];
						break;
					case(10) :
						crc = crctableProfTwo[crc ^ 96];
						break;
					case(11) :
						crc = crctableProfTwo[crc ^ 225];
						break;
					case(12) :
						crc = crctableProfTwo[crc ^ 103];
						break;
					case(13) :
						crc = crctableProfTwo[crc ^ 232];
						break;
					case(14) :
						crc = crctableProfTwo[crc ^ 110];
						break;
					case(15) :
						crc = crctableProfTwo[crc ^ 239];
						break;
					default :
//						write("error: wrong parameter (%d)",CounterValForCRC_PNHV_Stat_Pr2); stop();
						break;
				}
				crc = (crc ^ 0xFF);
				payload[0] = crc;
			}
			else
			{
				//CRC manuel veränderbar
			}

			CH_CPCVehPwrMngmnt_EMM_Stat2_AR2();
			CH_CPCPNHV_Stat_AR2();
		}
	}
	if (strncmp (pduName, "PNHV_WeekDepTmTbl_Stat_AR2", strLen(pduName)+strLen("PNHV_WeekDepTmTbl_Stat_AR2")) == 0)
	{
		if (TxAck == 1)
		{
		}
		else
		{
		}
	}
	if (strncmp (pduName, "PT_DataContain_Rq_AR2", strLen(pduName)+strLen("PT_DataContain_Rq_AR2")) == 0)
	{
		if (TxAck == 1)
		{
		}
		else
		{
		}
	}
	if (strncmp (pduName, "PT_Disp_Rq2_AR", strLen(pduName)+strLen("PT_Disp_Rq2_AR")) == 0)
	{
		if (TxAck == 1)
		{
		}
		else
		{
		}
	}
	if (strncmp (pduName, "PT_ThermM_AR2", strLen(pduName)+strLen("PT_ThermM_AR2")) == 0)
	{
		if (TxAck == 1)
		{
		}
		else
		{
		}
	}
	if (strncmp (pduName, "PT_ThermM_Rq_AR2", strLen(pduName)+strLen("PT_ThermM_Rq_AR2")) == 0)
	{
		if (TxAck == 1)
		{
		}
		else
		{
		}
	}
	if (strncmp (pduName, "PtHyb_Mngmnt_Rq1_AR", strLen(pduName)+strLen("PtHyb_Mngmnt_Rq1_AR")) == 0)
	{
		if (TxAck == 1)
		{
		}
		else
		{
		}
	}
	if (strncmp (pduName, "PtMngmnt_Disp_Rq_AR2", strLen(pduName)+strLen("PtMngmnt_Disp_Rq_AR2")) == 0)
	{
		if (TxAck == 1)
		{
		}
		else
		{
		}
	}
	if (strncmp (pduName, "PtMngmnt_Rq_AR2", strLen(pduName)+strLen("PtMngmnt_Rq_AR2")) == 0)
	{
		if (TxAck == 1)
		{
			if (@sysvar::CH_Nodes::CH_CPCSQC_PtMngmnt_Rq_Pr2Pt_AUTO == 0)
			{
				//SQC automatisch ändern
				SQC_VAL_PtMngmnt_Rq_Pr2 = (SQC_VAL_PtMngmnt_Rq_Pr2 + 1) % 16;
			}
			else
			{
				//SQC manuel veränderbar
			}

		}
		else
		{
			if (@sysvar::CH_Nodes::CH_CPCSQC_PtMngmnt_Rq_Pr2Pt_AUTO == 0)
			{
				//SQC automatisch ändern
				//SQC für CRC speichern
				CounterValForCRC_PtMngmnt_Rq_Pr2 = SQC_VAL_PtMngmnt_Rq_Pr2;
				//SQC in Byte schreiben
				payload[1] = (payload[1] & ~0x0F) |  SQC_VAL_PtMngmnt_Rq_Pr2;
			}
			else
			{
				//SQC manuel veränderbar
			}

			if (@sysvar::CH_Nodes::CH_CPCCRC_PtMngmnt_Rq_Pr2Pt_AUTO == 0)
			{
				//CRC automatisch berechnen
				crc = 0xFF;
				crc = crctableProfTwo[crc ^ payload[1]];
				crc = crctableProfTwo[crc ^ payload[2]];
				crc = crctableProfTwo[crc ^ payload[3]];
				crc = crctableProfTwo[crc ^ payload[4]];
				switch (CounterValForCRC_PtMngmnt_Rq_Pr2)
				{
					case(0) :
						crc = crctableProfTwo[crc ^ 93];
						break;
					case(1) :
						crc = crctableProfTwo[crc ^ 49];
						break;
					case(2) :
						crc = crctableProfTwo[crc ^ 5];
						break;
					case(3) :
						crc = crctableProfTwo[crc ^ 212];
						break;
					case(4) :
						crc = crctableProfTwo[crc ^ 168];
						break;
					case(5) :
						crc = crctableProfTwo[crc ^ 124];
						break;
					case(6) :
						crc = crctableProfTwo[crc ^ 80];
						break;
					case(7) :
						crc = crctableProfTwo[crc ^ 36];
						break;
					case(8) :
						crc = crctableProfTwo[crc ^ 243];
						break;
					case(9) :
						crc = crctableProfTwo[crc ^ 199];
						break;
					case(10) :
						crc = crctableProfTwo[crc ^ 155];
						break;
					case(11) :
						crc = crctableProfTwo[crc ^ 111];
						break;
					case(12) :
						crc = crctableProfTwo[crc ^ 67];
						break;
					case(13) :
						crc = crctableProfTwo[crc ^ 23];
						break;
					case(14) :
						crc = crctableProfTwo[crc ^ 230];
						break;
					case(15) :
						crc = crctableProfTwo[crc ^ 186];
						break;
					default :
//						write("error: wrong parameter (%d)",CounterValForCRC_PtMngmnt_Rq_Pr2); stop();
						break;
				}
				crc = (crc ^ 0xFF);
				payload[0] = crc;
			}
			else
			{
				//CRC manuel veränderbar
			}

			CH_CPCTCM_State3_AR2();
			CH_CPCPtMngmnt_Rq_AR2();
		}
	}
	if (strncmp (pduName, "PtMngmnt_Stat2_AR2", strLen(pduName)+strLen("PtMngmnt_Stat2_AR2")) == 0)
	{
		if (TxAck == 1)
		{
			if (@sysvar::CH_Nodes::CH_CPCSQC_PtMngmnt_Stat2_Pr_AUTO == 0)
			{
				//SQC automatisch ändern
				SQC_VAL_PtMngmnt_Stat2_Pr2 = (SQC_VAL_PtMngmnt_Stat2_Pr2 + 1) % 16;
			}
			else
			{
				//SQC manuel veränderbar
			}

		}
		else
		{
			if (@sysvar::CH_Nodes::CH_CPCSQC_PtMngmnt_Stat2_Pr_AUTO == 0)
			{
				//SQC automatisch ändern
				//SQC für CRC speichern
				CounterValForCRC_PtMngmnt_Stat2_Pr2 = SQC_VAL_PtMngmnt_Stat2_Pr2;
				//SQC in Byte schreiben
				payload[1] = (payload[1] & ~0x0F) |  SQC_VAL_PtMngmnt_Stat2_Pr2;
			}
			else
			{
				//SQC manuel veränderbar
			}

			if (@sysvar::CH_Nodes::CH_CPCCRC_PtMngmnt_Stat2_Pr_AUTO == 0)
			{
				//CRC automatisch berechnen
				crc = 0xFF;
				crc = crctableProfTwo[crc ^ payload[1]];
				crc = crctableProfTwo[crc ^ payload[2]];
				crc = crctableProfTwo[crc ^ payload[3]];
				crc = crctableProfTwo[crc ^ payload[4]];
				crc = crctableProfTwo[crc ^ payload[5]];
				switch (CounterValForCRC_PtMngmnt_Stat2_Pr2)
				{
					case(0) :
						crc = crctableProfTwo[crc ^ 214];
						break;
					case(1) :
						crc = crctableProfTwo[crc ^ 144];
						break;
					case(2) :
						crc = crctableProfTwo[crc ^ 74];
						break;
					case(3) :
						crc = crctableProfTwo[crc ^ 4];
						break;
					case(4) :
						crc = crctableProfTwo[crc ^ 185];
						break;
					case(5) :
						crc = crctableProfTwo[crc ^ 115];
						break;
					case(6) :
						crc = crctableProfTwo[crc ^ 45];
						break;
					case(7) :
						crc = crctableProfTwo[crc ^ 226];
						break;
					case(8) :
						crc = crctableProfTwo[crc ^ 156];
						break;
					case(9) :
						crc = crctableProfTwo[crc ^ 86];
						break;
					case(10) :
						crc = crctableProfTwo[crc ^ 16];
						break;
					case(11) :
						crc = crctableProfTwo[crc ^ 197];
						break;
					case(12) :
						crc = crctableProfTwo[crc ^ 127];
						break;
					case(13) :
						crc = crctableProfTwo[crc ^ 57];
						break;
					case(14) :
						crc = crctableProfTwo[crc ^ 238];
						break;
					case(15) :
						crc = crctableProfTwo[crc ^ 168];
						break;
					default :
//						write("error: wrong parameter (%d)",CounterValForCRC_PtMngmnt_Stat2_Pr2); stop();
						break;
				}
				crc = (crc ^ 0xFF);
				payload[0] = crc;
			}
			else
			{
				//CRC manuel veränderbar
			}

			CH_CPCEM01_Trq_Rs_AR2();
			CH_CPCPtMngmnt_Stat2_AR2();
		}
	}
	if (strncmp (pduName, "PtMngmnt_Stat_AR2", strLen(pduName)+strLen("PtMngmnt_Stat_AR2")) == 0)
	{
		if (TxAck == 1)
		{
			if (@sysvar::CH_Nodes::CH_CPCSQC_PT_Stat_Pr2PtMngm_AUTO == 0)
			{
				//SQC automatisch ändern
				SQC_VAL_PT_Stat_Pr2 = (SQC_VAL_PT_Stat_Pr2 + 1) % 16;
			}
			else
			{
				//SQC manuel veränderbar
			}

		}
		else
		{
			if (@sysvar::CH_Nodes::CH_CPCSQC_PT_Stat_Pr2PtMngm_AUTO == 0)
			{
				//SQC automatisch ändern
				//SQC für CRC speichern
				CounterValForCRC_PT_Stat_Pr2 = SQC_VAL_PT_Stat_Pr2;
				//SQC in Byte schreiben
				payload[7] = (payload[7] & ~0x0F) |  SQC_VAL_PT_Stat_Pr2;
			}
			else
			{
				//SQC manuel veränderbar
			}

			if (@sysvar::CH_Nodes::CH_CPCCRC_PT_Stat_Pr2PtMngm_AUTO == 0)
			{
				//CRC automatisch berechnen
				crc = 0xFF;
				crc = crctableProfTwo[crc ^ payload[7]];
				switch (CounterValForCRC_PT_Stat_Pr2)
				{
					case(0) :
						crc = crctableProfTwo[crc ^ 18];
						break;
					case(1) :
						crc = crctableProfTwo[crc ^ 46];
						break;
					case(2) :
						crc = crctableProfTwo[crc ^ 74];
						break;
					case(3) :
						crc = crctableProfTwo[crc ^ 102];
						break;
					case(4) :
						crc = crctableProfTwo[crc ^ 130];
						break;
					case(5) :
						crc = crctableProfTwo[crc ^ 158];
						break;
					case(6) :
						crc = crctableProfTwo[crc ^ 186];
						break;
					case(7) :
						crc = crctableProfTwo[crc ^ 214];
						break;
					case(8) :
						crc = crctableProfTwo[crc ^ 242];
						break;
					case(9) :
						crc = crctableProfTwo[crc ^ 19];
						break;
					case(10) :
						crc = crctableProfTwo[crc ^ 47];
						break;
					case(11) :
						crc = crctableProfTwo[crc ^ 75];
						break;
					case(12) :
						crc = crctableProfTwo[crc ^ 103];
						break;
					case(13) :
						crc = crctableProfTwo[crc ^ 131];
						break;
					case(14) :
						crc = crctableProfTwo[crc ^ 159];
						break;
					case(15) :
						crc = crctableProfTwo[crc ^ 187];
						break;
					default :
//						write("error: wrong parameter (%d)",CounterValForCRC_PT_Stat_Pr2); stop();
						break;
				}
				crc = (crc ^ 0xFF);
				payload[6] = crc;
			}
			else
			{
				//CRC manuel veränderbar
			}

			CH_CPCPtMngmnt_Stat_AR2();
		}
	}
	if (strncmp (pduName, "SBW_DrvPosn_Disp_Rq_ISM_AR2", strLen(pduName)+strLen("SBW_DrvPosn_Disp_Rq_ISM_AR2")) == 0)
	{
		if (TxAck == 1)
		{
			if (@sysvar::CH_Nodes::CH_CPCSQC_ISM_TxDrvPosn_Dis_AUTO == 0)
			{
				//SQC automatisch ändern
				SQC_VAL_ISM_TxDrvPosn_Disp_Rq_Pr2 = (SQC_VAL_ISM_TxDrvPosn_Disp_Rq_Pr2 + 1) % 16;
			}
			else
			{
				//SQC manuel veränderbar
			}

		}
		else
		{
			if (@sysvar::CH_Nodes::CH_CPCSQC_ISM_TxDrvPosn_Dis_AUTO == 0)
			{
				//SQC automatisch ändern
				//SQC für CRC speichern
				CounterValForCRC_ISM_TxDrvPosn_Disp_Rq_Pr2 = SQC_VAL_ISM_TxDrvPosn_Disp_Rq_Pr2;
				//SQC in Byte schreiben
				payload[1] = (payload[1] & ~0x0F) |  SQC_VAL_ISM_TxDrvPosn_Disp_Rq_Pr2;
			}
			else
			{
				//SQC manuel veränderbar
			}

			if (@sysvar::CH_Nodes::CH_CPCCRC_ISM_TxDrvPosn_Dis_AUTO == 0)
			{
				//CRC automatisch berechnen
				crc = 0xFF;
				crc = crctableProfTwo[crc ^ payload[1]];
				crc = crctableProfTwo[crc ^ payload[2]];
				switch (CounterValForCRC_ISM_TxDrvPosn_Disp_Rq_Pr2)
				{
					case(0) :
						crc = crctableProfTwo[crc ^ 97];
						break;
					case(1) :
						crc = crctableProfTwo[crc ^ 226];
						break;
					case(2) :
						crc = crctableProfTwo[crc ^ 104];
						break;
					case(3) :
						crc = crctableProfTwo[crc ^ 233];
						break;
					case(4) :
						crc = crctableProfTwo[crc ^ 111];
						break;
					case(5) :
						crc = crctableProfTwo[crc ^ 240];
						break;
					case(6) :
						crc = crctableProfTwo[crc ^ 118];
						break;
					case(7) :
						crc = crctableProfTwo[crc ^ 247];
						break;
					case(8) :
						crc = crctableProfTwo[crc ^ 125];
						break;
					case(9) :
						crc = crctableProfTwo[crc ^ 3];
						break;
					case(10) :
						crc = crctableProfTwo[crc ^ 132];
						break;
					case(11) :
						crc = crctableProfTwo[crc ^ 10];
						break;
					case(12) :
						crc = crctableProfTwo[crc ^ 139];
						break;
					case(13) :
						crc = crctableProfTwo[crc ^ 17];
						break;
					case(14) :
						crc = crctableProfTwo[crc ^ 146];
						break;
					case(15) :
						crc = crctableProfTwo[crc ^ 24];
						break;
					default :
//						write("error: wrong parameter (%d)",CounterValForCRC_ISM_TxDrvPosn_Disp_Rq_Pr2); stop();
						break;
				}
				crc = (crc ^ 0xFF);
				payload[0] = crc;
			}
			else
			{
				//CRC manuel veränderbar
			}

			CH_CPCSBW_DrvPosn_Disp_Rq_TCM_AR2();
			CH_CPCHumanMachineIfc_AR2();
			CH_CPCSBW_DrvPosn_Disp_Rq_ISM_AR2();
			CH_CPCEngCtrl_Disp_Rq_AR2();
		}
	}
	if (strncmp (pduName, "SBW_DrvPosn_Disp_Rq_TCM_AR2", strLen(pduName)+strLen("SBW_DrvPosn_Disp_Rq_TCM_AR2")) == 0)
	{
		if (TxAck == 1)
		{
			if (@sysvar::CH_Nodes::CH_CPCSQC_SBW_Drv_Pk_Posn_T_AUTO == 0)
			{
				//SQC automatisch ändern
				SQC_VAL_SBW_Drv_Pk_Posn_TCM_Pr2 = (SQC_VAL_SBW_Drv_Pk_Posn_TCM_Pr2 + 1) % 16;
			}
			else
			{
				//SQC manuel veränderbar
			}

		}
		else
		{
			if (@sysvar::CH_Nodes::CH_CPCSQC_SBW_Drv_Pk_Posn_T_AUTO == 0)
			{
				//SQC automatisch ändern
				//SQC für CRC speichern
				CounterValForCRC_SBW_Drv_Pk_Posn_TCM_Pr2 = SQC_VAL_SBW_Drv_Pk_Posn_TCM_Pr2;
				//SQC in Byte schreiben
				payload[1] = (payload[1] & ~0x0F) |  SQC_VAL_SBW_Drv_Pk_Posn_TCM_Pr2;
			}
			else
			{
				//SQC manuel veränderbar
			}

			if (@sysvar::CH_Nodes::CH_CPCCRC_SBW_Drv_Pk_Posn_T_AUTO == 0)
			{
				//CRC automatisch berechnen
				crc = 0xFF;
				crc = crctableProfTwo[crc ^ payload[1]];
				crc = crctableProfTwo[crc ^ payload[2]];
				switch (CounterValForCRC_SBW_Drv_Pk_Posn_TCM_Pr2)
				{
					case(0) :
						crc = crctableProfTwo[crc ^ 239];
						break;
					case(1) :
						crc = crctableProfTwo[crc ^ 121];
						break;
					case(2) :
						crc = crctableProfTwo[crc ^ 3];
						break;
					case(3) :
						crc = crctableProfTwo[crc ^ 136];
						break;
					case(4) :
						crc = crctableProfTwo[crc ^ 18];
						break;
					case(5) :
						crc = crctableProfTwo[crc ^ 151];
						break;
					case(6) :
						crc = crctableProfTwo[crc ^ 33];
						break;
					case(7) :
						crc = crctableProfTwo[crc ^ 166];
						break;
					case(8) :
						crc = crctableProfTwo[crc ^ 48];
						break;
					case(9) :
						crc = crctableProfTwo[crc ^ 181];
						break;
					case(10) :
						crc = crctableProfTwo[crc ^ 63];
						break;
					case(11) :
						crc = crctableProfTwo[crc ^ 196];
						break;
					case(12) :
						crc = crctableProfTwo[crc ^ 78];
						break;
					case(13) :
						crc = crctableProfTwo[crc ^ 211];
						break;
					case(14) :
						crc = crctableProfTwo[crc ^ 93];
						break;
					case(15) :
						crc = crctableProfTwo[crc ^ 226];
						break;
					default :
//						write("error: wrong parameter (%d)",CounterValForCRC_SBW_Drv_Pk_Posn_TCM_Pr2); stop();
						break;
				}
				crc = (crc ^ 0xFF);
				payload[0] = crc;
			}
			else
			{
				//CRC manuel veränderbar
			}

			CH_CPCSBW_DrvPosn_Disp_Rq_TCM_AR2();
			CH_CPCHumanMachineIfc_AR2();
			CH_CPCSBW_DrvPosn_Disp_Rq_ISM_AR2();
			CH_CPCEngCtrl_Disp_Rq_AR2();
		}
	}
	if (strncmp (pduName, "SBW_Stat_AR2", strLen(pduName)+strLen("SBW_Stat_AR2")) == 0)
	{
		if (TxAck == 1)
		{
			if (@sysvar::CH_Nodes::CH_CPCSQC_SBW_Stat_Pr2SBW_S_AUTO == 0)
			{
				//SQC automatisch ändern
				SQC_VAL_SBW_Stat_Pr2 = (SQC_VAL_SBW_Stat_Pr2 + 1) % 16;
			}
			else
			{
				//SQC manuel veränderbar
			}

		}
		else
		{
			if (@sysvar::CH_Nodes::CH_CPCSQC_SBW_Stat_Pr2SBW_S_AUTO == 0)
			{
				//SQC automatisch ändern
				//SQC für CRC speichern
				CounterValForCRC_SBW_Stat_Pr2 = SQC_VAL_SBW_Stat_Pr2;
				//SQC in Byte schreiben
				payload[1] = (payload[1] & ~0x0F) |  SQC_VAL_SBW_Stat_Pr2;
			}
			else
			{
				//SQC manuel veränderbar
			}

			if (@sysvar::CH_Nodes::CH_CPCCRC_SBW_Stat_Pr2SBW_S_AUTO == 0)
			{
				//CRC automatisch berechnen
				crc = 0xFF;
				crc = crctableProfTwo[crc ^ payload[1]];
				crc = crctableProfTwo[crc ^ payload[2]];
				crc = crctableProfTwo[crc ^ payload[3]];
				crc = crctableProfTwo[crc ^ payload[4]];
				crc = crctableProfTwo[crc ^ payload[5]];
				crc = crctableProfTwo[crc ^ payload[6]];
				crc = crctableProfTwo[crc ^ payload[7]];
				switch (CounterValForCRC_SBW_Stat_Pr2)
				{
					case(0) :
						crc = crctableProfTwo[crc ^ 216];
						break;
					case(1) :
						crc = crctableProfTwo[crc ^ 66];
						break;
					case(2) :
						crc = crctableProfTwo[crc ^ 167];
						break;
					case(3) :
						crc = crctableProfTwo[crc ^ 17];
						break;
					case(4) :
						crc = crctableProfTwo[crc ^ 118];
						break;
					case(5) :
						crc = crctableProfTwo[crc ^ 219];
						break;
					case(6) :
						crc = crctableProfTwo[crc ^ 69];
						break;
					case(7) :
						crc = crctableProfTwo[crc ^ 170];
						break;
					case(8) :
						crc = crctableProfTwo[crc ^ 20];
						break;
					case(9) :
						crc = crctableProfTwo[crc ^ 121];
						break;
					case(10) :
						crc = crctableProfTwo[crc ^ 222];
						break;
					case(11) :
						crc = crctableProfTwo[crc ^ 72];
						break;
					case(12) :
						crc = crctableProfTwo[crc ^ 173];
						break;
					case(13) :
						crc = crctableProfTwo[crc ^ 23];
						break;
					case(14) :
						crc = crctableProfTwo[crc ^ 124];
						break;
					case(15) :
						crc = crctableProfTwo[crc ^ 225];
						break;
					default :
//						write("error: wrong parameter (%d)",CounterValForCRC_SBW_Stat_Pr2); stop();
						break;
				}
				crc = (crc ^ 0xFF);
				payload[0] = crc;
			}
			else
			{
				//CRC manuel veränderbar
			}

			CH_CPCSBW_Stat_AR2();
			CH_CPCTCM_Data2_AR2();
		}
	}
	if (strncmp (pduName, "SND_GEN_Stat_AR", strLen(pduName)+strLen("SND_GEN_Stat_AR")) == 0)
	{
		if (TxAck == 1)
		{
		}
		else
		{
		}
	}
	if (strncmp (pduName, "TC_Disp_Rq_ECM_AR", strLen(pduName)+strLen("TC_Disp_Rq_ECM_AR")) == 0)
	{
		if (TxAck == 1)
		{
		}
		else
		{
		}
	}
	if (strncmp (pduName, "TC_EBBC_Disp_Rq_ECM_AR", strLen(pduName)+strLen("TC_EBBC_Disp_Rq_ECM_AR")) == 0)
	{
		if (TxAck == 1)
		{
		}
		else
		{
		}
	}
	if (strncmp (pduName, "TC_EEBBC_Disp_Rq_AR", strLen(pduName)+strLen("TC_EEBBC_Disp_Rq_AR")) == 0)
	{
		if (TxAck == 1)
		{
		}
		else
		{
		}
	}
	if (strncmp (pduName, "TCM_DAC4_AR", strLen(pduName)+strLen("TCM_DAC4_AR")) == 0)
	{
		if (TxAck == 1)
		{
		}
		else
		{
			CH_CPCEM_DAC4_AR();
			CH_CPCTCM_DAC4_AR();
			CH_CPCECM_DAC4_AR();
			CH_CPCISM_DAC4_AR();
		}
	}
	if (strncmp (pduName, "TCM_Data2_AR2", strLen(pduName)+strLen("TCM_Data2_AR2")) == 0)
	{
		if (TxAck == 1)
		{
			if (@sysvar::CH_Nodes::CH_CPCSQC_TCM_Data2_Pr2TCM__AUTO == 0)
			{
				//SQC automatisch ändern
				SQC_VAL_TCM_Data2_Pr2 = (SQC_VAL_TCM_Data2_Pr2 + getValue(VSys_SQC_Jump_TCM_Data2)) % 16;
			}
			else
			{
				//SQC manuel veränderbar
			}

		}
		else
		{
			if (@sysvar::CH_Nodes::CH_CPCSQC_TCM_Data2_Pr2TCM__AUTO == 0)
			{
				//SQC automatisch ändern
				//SQC für CRC speichern
				CounterValForCRC_TCM_Data2_Pr2 = SQC_VAL_TCM_Data2_Pr2;
				//SQC in Byte schreiben
				payload[1] = (payload[1] & ~0x0F) |  SQC_VAL_TCM_Data2_Pr2;
			}
			else
			{
				//SQC manuel veränderbar
			}

			if (@sysvar::CH_Nodes::CH_CPCCRC_TCM_Data2_Pr2TCM__AUTO == 0)
			{
				//CRC automatisch berechnen
				crc = 0xFF;
				crc = crctableProfTwo[crc ^ payload[1]];
				crc = crctableProfTwo[crc ^ payload[2]];
				crc = crctableProfTwo[crc ^ payload[3]];
				crc = crctableProfTwo[crc ^ payload[4]];
				crc = crctableProfTwo[crc ^ payload[5]];
				crc = crctableProfTwo[crc ^ payload[6]];
				crc = crctableProfTwo[crc ^ payload[7]];
				switch (CounterValForCRC_TCM_Data2_Pr2)
				{
					case(0) :
						crc = crctableProfTwo[crc ^ 54];
						break;
					case(1) :
						crc = crctableProfTwo[crc ^ 199];
						break;
					case(2) :
						crc = crctableProfTwo[crc ^ 93];
						break;
					case(3) :
						crc = crctableProfTwo[crc ^ 238];
						break;
					case(4) :
						crc = crctableProfTwo[crc ^ 132];
						break;
					case(5) :
						crc = crctableProfTwo[crc ^ 26];
						break;
					case(6) :
						crc = crctableProfTwo[crc ^ 171];
						break;
					case(7) :
						crc = crctableProfTwo[crc ^ 65];
						break;
					case(8) :
						crc = crctableProfTwo[crc ^ 210];
						break;
					case(9) :
						crc = crctableProfTwo[crc ^ 104];
						break;
					case(10) :
						crc = crctableProfTwo[crc ^ 249];
						break;
					case(11) :
						crc = crctableProfTwo[crc ^ 143];
						break;
					case(12) :
						crc = crctableProfTwo[crc ^ 37];
						break;
					case(13) :
						crc = crctableProfTwo[crc ^ 182];
						break;
					case(14) :
						crc = crctableProfTwo[crc ^ 76];
						break;
					case(15) :
						crc = crctableProfTwo[crc ^ 221];
						break;
					default :
//						write("error: wrong parameter (%d)",CounterValForCRC_TCM_Data2_Pr2); stop();
						break;
				}
				crc = (crc ^ 0xFF);
				payload[0] = crc;
			}
			else
			{
				//CRC manuel veränderbar
			}

			CH_CPCSBW_Stat_AR2();
			CH_CPCTCM_Data2_AR2();
		}
	}
	if (strncmp (pduName, "TCM_Data3_AR2", strLen(pduName)+strLen("TCM_Data3_AR2")) == 0)
	{
		if (TxAck == 1)
		{
			if (@sysvar::CH_Nodes::CH_CPCSQC_TCM_Data3_Pr2TCM__AUTO == 0)
			{
				//SQC automatisch ändern
				SQC_VAL_TCM_Data3_Pr2 = (SQC_VAL_TCM_Data3_Pr2 + 1) % 16;
			}
			else
			{
				//SQC manuel veränderbar
			}

		}
		else
		{
			if (@sysvar::CH_Nodes::CH_CPCSQC_TCM_Data3_Pr2TCM__AUTO == 0)
			{
				//SQC automatisch ändern
				//SQC für CRC speichern
				CounterValForCRC_TCM_Data3_Pr2 = SQC_VAL_TCM_Data3_Pr2;
				//SQC in Byte schreiben
				payload[1] = (payload[1] & ~0x0F) |  SQC_VAL_TCM_Data3_Pr2;
			}
			else
			{
				//SQC manuel veränderbar
			}

			if (@sysvar::CH_Nodes::CH_CPCCRC_TCM_Data3_Pr2TCM__AUTO == 0)
			{
				//CRC automatisch berechnen
				crc = 0xFF;
				crc = crctableProfTwo[crc ^ payload[1]];
				crc = crctableProfTwo[crc ^ payload[2]];
				crc = crctableProfTwo[crc ^ payload[3]];
				crc = crctableProfTwo[crc ^ payload[4]];
				switch (CounterValForCRC_TCM_Data3_Pr2)
				{
					case(0) :
						crc = crctableProfTwo[crc ^ 246];
						break;
					case(1) :
						crc = crctableProfTwo[crc ^ 18];
						break;
					case(2) :
						crc = crctableProfTwo[crc ^ 41];
						break;
					case(3) :
						crc = crctableProfTwo[crc ^ 64];
						break;
					case(4) :
						crc = crctableProfTwo[crc ^ 87];
						break;
					case(5) :
						crc = crctableProfTwo[crc ^ 110];
						break;
					case(6) :
						crc = crctableProfTwo[crc ^ 133];
						break;
					case(7) :
						crc = crctableProfTwo[crc ^ 156];
						break;
					case(8) :
						crc = crctableProfTwo[crc ^ 179];
						break;
					case(9) :
						crc = crctableProfTwo[crc ^ 202];
						break;
					case(10) :
						crc = crctableProfTwo[crc ^ 225];
						break;
					case(11) :
						crc = crctableProfTwo[crc ^ 248];
						break;
					case(12) :
						crc = crctableProfTwo[crc ^ 20];
						break;
					case(13) :
						crc = crctableProfTwo[crc ^ 43];
						break;
					case(14) :
						crc = crctableProfTwo[crc ^ 66];
						break;
					case(15) :
						crc = crctableProfTwo[crc ^ 89];
						break;
					default :
//						write("error: wrong parameter (%d)",CounterValForCRC_TCM_Data3_Pr2); stop();
						break;
				}
				crc = (crc ^ 0xFF);
				payload[0] = crc;
			}
			else
			{
				//CRC manuel veränderbar
			}

			CH_CPCTCM_Data3_AR2();
		}
	}
	if (strncmp (pduName, "TCM_Disp_Rq_AMG_AR", strLen(pduName)+strLen("TCM_Disp_Rq_AMG_AR")) == 0)
	{
		if (TxAck == 1)
		{
		}
		else
		{
			CH_CPCTCM_Disp_Rq_AMG_AR();
			CH_CPCCNG_Disp_Rq_AR2();
		}
	}
	if (strncmp (pduName, "TCM_State3_AR2", strLen(pduName)+strLen("TCM_State3_AR2")) == 0)
	{
		if (TxAck == 1)
		{
		}
		else
		{
			CH_CPCTCM_State3_AR2();
			CH_CPCPtMngmnt_Rq_AR2();
		}
	}
	if (strncmp (pduName, "TCU_Disp_Rq_AR2", strLen(pduName)+strLen("TCU_Disp_Rq_AR2")) == 0)
	{
		if (TxAck == 1)
		{
		}
		else
		{
			CH_CPCTCU_Disp_Rq_AR2();
		}
	}
	if (strncmp (pduName, "ThermMngmnt_1_AR2", strLen(pduName)+strLen("ThermMngmnt_1_AR2")) == 0)
	{
		if (TxAck == 1)
		{
		}
		else
		{
		}
	}
	if (strncmp (pduName, "ThermMngmnt_4_AR", strLen(pduName)+strLen("ThermMngmnt_4_AR")) == 0)
	{
		if (TxAck == 1)
		{
		}
		else
		{
		}
	}
	if (strncmp (pduName, "ThermMngmnt_EV_1_AR2", strLen(pduName)+strLen("ThermMngmnt_EV_1_AR2")) == 0)
	{
		if (TxAck == 1)
		{
		}
		else
		{
		}
	}
	if (strncmp (pduName, "VehPwrMngmnt_EMM_Stat2_AR2", strLen(pduName)+strLen("VehPwrMngmnt_EMM_Stat2_AR2")) == 0)
	{
		if (TxAck == 1)
		{
			if (@sysvar::CH_Nodes::CH_CPCSQC_EMM_Disp_Rq_Pr2Ve_AUTO == 0)
			{
				//SQC automatisch ändern
				SQC_VAL_EMM_Disp_Rq_Pr2 = (SQC_VAL_EMM_Disp_Rq_Pr2 + 1) % 16;
			}
			else
			{
				//SQC manuel veränderbar
			}

		}
		else
		{
			if (@sysvar::CH_Nodes::CH_CPCSQC_EMM_Disp_Rq_Pr2Ve_AUTO == 0)
			{
				//SQC automatisch ändern
				//SQC für CRC speichern
				CounterValForCRC_EMM_Disp_Rq_Pr2 = SQC_VAL_EMM_Disp_Rq_Pr2;
				//SQC in Byte schreiben
				payload[6] = (payload[6] & ~0x0F) |  SQC_VAL_EMM_Disp_Rq_Pr2;
			}
			else
			{
				//SQC manuel veränderbar
			}

			if (@sysvar::CH_Nodes::CH_CPCCRC_EMM_Disp_Rq_Pr2Ve_AUTO == 0)
			{
				//CRC automatisch berechnen
				crc = 0xFF;
				crc = crctableProfTwo[crc ^ payload[6]];
				switch (CounterValForCRC_EMM_Disp_Rq_Pr2)
				{
					case(0) :
						crc = crctableProfTwo[crc ^ 18];
						break;
					case(1) :
						crc = crctableProfTwo[crc ^ 90];
						break;
					case(2) :
						crc = crctableProfTwo[crc ^ 162];
						break;
					case(3) :
						crc = crctableProfTwo[crc ^ 234];
						break;
					case(4) :
						crc = crctableProfTwo[crc ^ 55];
						break;
					case(5) :
						crc = crctableProfTwo[crc ^ 127];
						break;
					case(6) :
						crc = crctableProfTwo[crc ^ 199];
						break;
					case(7) :
						crc = crctableProfTwo[crc ^ 20];
						break;
					case(8) :
						crc = crctableProfTwo[crc ^ 92];
						break;
					case(9) :
						crc = crctableProfTwo[crc ^ 164];
						break;
					case(10) :
						crc = crctableProfTwo[crc ^ 236];
						break;
					case(11) :
						crc = crctableProfTwo[crc ^ 57];
						break;
					case(12) :
						crc = crctableProfTwo[crc ^ 129];
						break;
					case(13) :
						crc = crctableProfTwo[crc ^ 201];
						break;
					case(14) :
						crc = crctableProfTwo[crc ^ 22];
						break;
					case(15) :
						crc = crctableProfTwo[crc ^ 94];
						break;
					default :
//						write("error: wrong parameter (%d)",CounterValForCRC_EMM_Disp_Rq_Pr2); stop();
						break;
				}
				crc = (crc ^ 0xFF);
				payload[5] = crc;
			}
			else
			{
				//CRC manuel veränderbar
			}

			CH_CPCVehPwrMngmnt_EMM_Stat2_AR2();
			CH_CPCPNHV_Stat_AR2();
		}
	}
	if (strncmp (pduName, "VehPwrMngmnt_Rq_AR", strLen(pduName)+strLen("VehPwrMngmnt_Rq_AR")) == 0)
	{
		if (TxAck == 1)
		{
		}
		else
		{
			CH_CPCPN14_Gen_Rs_AR();
			CH_CPCVehPwrMngmnt_Rq_AR();
		}
	}
	if (strncmp (pduName, "WIA_EngTrq_AR", strLen(pduName)+strLen("WIA_EngTrq_AR")) == 0)
	{
		if (TxAck == 1)
		{
		}
		else
		{
			CH_CPCPNHV_EnergyMngmntSet_Rs1_AR2();
			CH_CPCFuel_Stat2_AR2();
			CH_CPCWIA_EngTrq_AR();
			CH_CPCPNHV_EnergyMngmntSet_Rs2_AR();
		}
	}
	if (strncmp (pduName, "WPT_Stat2_AR2", strLen(pduName)+strLen("WPT_Stat2_AR2")) == 0)
	{
		if (TxAck == 1)
		{
		}
		else
		{
		}
	}
}

StartSim(int BusAktiv)
{
	result = EnableCRC("", 0); // 1 = on, 0 = off
	result = EnableTGL("", 0); // 1 = on, 0 = off 
	result = EnableSQC("", 0); // 1 = on, 0 = off 
	result = EnableMC("", 0); // 1 = on, 0 = off 
	switch (@sysvar::CH_Nodes::CH_CPCAdblue_Disp_Rq_AR_UB_AU_01)
	{
		case (0):
			enableControl("Adblue_Disp_Rq_AR", "CH_CPCAdblue_Disp_Rq_AR_UB__01", 0); //1: enable; 0: disable
			@sysvar::CH_Nodes::CH_CPCAdblue_Disp_Rq_AR_UB__01 = 1;
			break;
		case (1):
			enableControl("Adblue_Disp_Rq_AR", "CH_CPCAdblue_Disp_Rq_AR_UB__01", 1); //1: enable; 0: disable
			break;
		case (2):
			enableControl("Adblue_Disp_Rq_AR", "CH_CPCAdblue_Disp_Rq_AR_UB__01", 0); //1: enable; 0: disable
			@sysvar::CH_Nodes::CH_CPCAdblue_Disp_Rq_AR_UB__01 = 1;
			break;
		case (3):
			enableControl("Adblue_Disp_Rq_AR", "CH_CPCAdblue_Disp_Rq_AR_UB__01", 0); //1: enable; 0: disable
			@sysvar::CH_Nodes::CH_CPCAdblue_Disp_Rq_AR_UB__01 = 0;
			break;
	}

	switch (@sysvar::CH_Nodes::CH_CPCCNG_Disp_Rq_AR2_UB_AUTO_01)
	{
		case (0):
			enableControl("CNG_Disp_Rq_AR2", "CH_CPCCNG_Disp_Rq_AR2_UB__01", 0); //1: enable; 0: disable
			@sysvar::CH_Nodes::CH_CPCCNG_Disp_Rq_AR2_UB__01 = 1;
			break;
		case (1):
			enableControl("CNG_Disp_Rq_AR2", "CH_CPCCNG_Disp_Rq_AR2_UB__01", 1); //1: enable; 0: disable
			break;
		case (2):
			enableControl("CNG_Disp_Rq_AR2", "CH_CPCCNG_Disp_Rq_AR2_UB__01", 0); //1: enable; 0: disable
			@sysvar::CH_Nodes::CH_CPCCNG_Disp_Rq_AR2_UB__01 = 1;
			break;
		case (3):
			enableControl("CNG_Disp_Rq_AR2", "CH_CPCCNG_Disp_Rq_AR2_UB__01", 0); //1: enable; 0: disable
			@sysvar::CH_Nodes::CH_CPCCNG_Disp_Rq_AR2_UB__01 = 0;
			break;
	}

	OldVal_EHC_Curr = $EHC_Curr;
	OldVal_AddWtrPmp_On_Rq_ECM = $AddWtrPmp_On_Rq_ECM;
	OldVal_PNHV_Bat_Volt = $PNHV_Bat_Volt;
	OldVal_DCDC1_Md = $DCDC1_Md;
	OldVal_Therm_HiTempSTOut1 = $Therm_HiTempSTOut1;
	switch (@sysvar::CH_Nodes::CH_CPCCPC_CHASSIS_R2_AR2_UB_A_01)
	{
		case (0):
			enableControl("CPC_CHASSIS_R2_AR2", "CH_CPCCPC_CHASSIS_R2_AR2_UB__01", 0); //1: enable; 0: disable
			@sysvar::CH_Nodes::CH_CPCCPC_CHASSIS_R2_AR2_UB__01 = 1;
			break;
		case (1):
			enableControl("CPC_CHASSIS_R2_AR2", "CH_CPCCPC_CHASSIS_R2_AR2_UB__01", 1); //1: enable; 0: disable
			break;
		case (2):
			enableControl("CPC_CHASSIS_R2_AR2", "CH_CPCCPC_CHASSIS_R2_AR2_UB__01", 0); //1: enable; 0: disable
			@sysvar::CH_Nodes::CH_CPCCPC_CHASSIS_R2_AR2_UB__01 = 1;
			break;
		case (3):
			enableControl("CPC_CHASSIS_R2_AR2", "CH_CPCCPC_CHASSIS_R2_AR2_UB__01", 0); //1: enable; 0: disable
			@sysvar::CH_Nodes::CH_CPCCPC_CHASSIS_R2_AR2_UB__01 = 0;
			break;
	}

	switch (@sysvar::CH_Nodes::CH_CPCDCDC1_Rs1_AR2_UB_AUTO_01)
	{
		case (0):
			enableControl("DCDC1_Rs1_AR2", "CH_CPCDCDC1_Rs1_AR2_UB__01", 0); //1: enable; 0: disable
			@sysvar::CH_Nodes::CH_CPCDCDC1_Rs1_AR2_UB__01 = 1;
			break;
		case (1):
			enableControl("DCDC1_Rs1_AR2", "CH_CPCDCDC1_Rs1_AR2_UB__01", 1); //1: enable; 0: disable
			break;
		case (2):
			enableControl("DCDC1_Rs1_AR2", "CH_CPCDCDC1_Rs1_AR2_UB__01", 0); //1: enable; 0: disable
			@sysvar::CH_Nodes::CH_CPCDCDC1_Rs1_AR2_UB__01 = 1;
			break;
		case (3):
			enableControl("DCDC1_Rs1_AR2", "CH_CPCDCDC1_Rs1_AR2_UB__01", 0); //1: enable; 0: disable
			@sysvar::CH_Nodes::CH_CPCDCDC1_Rs1_AR2_UB__01 = 0;
			break;
	}

	CRC_DCDC1_Rs1_Pr2 = 0;
	SQC_VAL_DCDC1_Rs1_Pr2 = 0;
	SQC_DCDC1_Rs1_Pr2 = 0;
	switch (@sysvar::CH_Nodes::CH_CPCECM_DAC4_AR_UB_AUTO_01)
	{
		case (0):
			enableControl("ECM_DAC4_AR", "CH_CPCECM_DAC4_AR_UB__01", 0); //1: enable; 0: disable
			@sysvar::CH_Nodes::CH_CPCECM_DAC4_AR_UB__01 = 1;
			break;
		case (1):
			enableControl("ECM_DAC4_AR", "CH_CPCECM_DAC4_AR_UB__01", 1); //1: enable; 0: disable
			break;
		case (2):
			enableControl("ECM_DAC4_AR", "CH_CPCECM_DAC4_AR_UB__01", 0); //1: enable; 0: disable
			@sysvar::CH_Nodes::CH_CPCECM_DAC4_AR_UB__01 = 1;
			break;
		case (3):
			enableControl("ECM_DAC4_AR", "CH_CPCECM_DAC4_AR_UB__01", 0); //1: enable; 0: disable
			@sysvar::CH_Nodes::CH_CPCECM_DAC4_AR_UB__01 = 0;
			break;
	}

	switch (@sysvar::CH_Nodes::CH_CPCEM01_Stat1_AR2_UB_AUTO_01)
	{
		case (0):
			enableControl("EM01_Stat1_AR2", "CH_CPCEM01_Stat1_AR2_UB__01", 0); //1: enable; 0: disable
			@sysvar::CH_Nodes::CH_CPCEM01_Stat1_AR2_UB__01 = 1;
			break;
		case (1):
			enableControl("EM01_Stat1_AR2", "CH_CPCEM01_Stat1_AR2_UB__01", 1); //1: enable; 0: disable
			break;
		case (2):
			enableControl("EM01_Stat1_AR2", "CH_CPCEM01_Stat1_AR2_UB__01", 0); //1: enable; 0: disable
			@sysvar::CH_Nodes::CH_CPCEM01_Stat1_AR2_UB__01 = 1;
			break;
		case (3):
			enableControl("EM01_Stat1_AR2", "CH_CPCEM01_Stat1_AR2_UB__01", 0); //1: enable; 0: disable
			@sysvar::CH_Nodes::CH_CPCEM01_Stat1_AR2_UB__01 = 0;
			break;
	}

	CRC_EM01_Stat1_Pr2 = 0;
	SQC_VAL_EM01_Stat1_Pr2 = 0;
	SQC_EM01_Stat1_Pr2 = 0;
	switch (@sysvar::CH_Nodes::CH_CPCEM01_Stat2_AR2_UB_AUTO_01)
	{
		case (0):
			enableControl("EM01_Stat2_AR2", "CH_CPCEM01_Stat2_AR2_UB__01", 0); //1: enable; 0: disable
			@sysvar::CH_Nodes::CH_CPCEM01_Stat2_AR2_UB__01 = 1;
			break;
		case (1):
			enableControl("EM01_Stat2_AR2", "CH_CPCEM01_Stat2_AR2_UB__01", 1); //1: enable; 0: disable
			break;
		case (2):
			enableControl("EM01_Stat2_AR2", "CH_CPCEM01_Stat2_AR2_UB__01", 0); //1: enable; 0: disable
			@sysvar::CH_Nodes::CH_CPCEM01_Stat2_AR2_UB__01 = 1;
			break;
		case (3):
			enableControl("EM01_Stat2_AR2", "CH_CPCEM01_Stat2_AR2_UB__01", 0); //1: enable; 0: disable
			@sysvar::CH_Nodes::CH_CPCEM01_Stat2_AR2_UB__01 = 0;
			break;
	}

	CRC_EM01_Stat2_Pr2 = 0;
	SQC_VAL_EM01_Stat2_Pr2 = 0;
	SQC_EM01_Stat2_Pr2 = 0;
	switch (@sysvar::CH_Nodes::CH_CPCEM01_Trq_Rs_AR2_UB_AUTO_01)
	{
		case (0):
			enableControl("EM01_Trq_Rs_AR2", "CH_CPCEM01_Trq_Rs_AR2_UB__01", 0); //1: enable; 0: disable
			@sysvar::CH_Nodes::CH_CPCEM01_Trq_Rs_AR2_UB__01 = 1;
			break;
		case (1):
			enableControl("EM01_Trq_Rs_AR2", "CH_CPCEM01_Trq_Rs_AR2_UB__01", 1); //1: enable; 0: disable
			break;
		case (2):
			enableControl("EM01_Trq_Rs_AR2", "CH_CPCEM01_Trq_Rs_AR2_UB__01", 0); //1: enable; 0: disable
			@sysvar::CH_Nodes::CH_CPCEM01_Trq_Rs_AR2_UB__01 = 1;
			break;
		case (3):
			enableControl("EM01_Trq_Rs_AR2", "CH_CPCEM01_Trq_Rs_AR2_UB__01", 0); //1: enable; 0: disable
			@sysvar::CH_Nodes::CH_CPCEM01_Trq_Rs_AR2_UB__01 = 0;
			break;
	}

	CRC_EM01_Trq_Rs_Pr2 = 0;
	SQC_VAL_EM01_Trq_Rs_Pr2 = 0;
	SQC_EM01_Trq_Rs_Pr2 = 0;
	switch (@sysvar::CH_Nodes::CH_CPCEM_DAC4_AR_UB_AUTO_01)
	{
		case (0):
			enableControl("EM_DAC4_AR", "CH_CPCEM_DAC4_AR_UB__01", 0); //1: enable; 0: disable
			@sysvar::CH_Nodes::CH_CPCEM_DAC4_AR_UB__01 = 1;
			break;
		case (1):
			enableControl("EM_DAC4_AR", "CH_CPCEM_DAC4_AR_UB__01", 1); //1: enable; 0: disable
			break;
		case (2):
			enableControl("EM_DAC4_AR", "CH_CPCEM_DAC4_AR_UB__01", 0); //1: enable; 0: disable
			@sysvar::CH_Nodes::CH_CPCEM_DAC4_AR_UB__01 = 1;
			break;
		case (3):
			enableControl("EM_DAC4_AR", "CH_CPCEM_DAC4_AR_UB__01", 0); //1: enable; 0: disable
			@sysvar::CH_Nodes::CH_CPCEM_DAC4_AR_UB__01 = 0;
			break;
	}

	switch (@sysvar::CH_Nodes::CH_CPCEng_Rs_1_AR2_UB_AUTO_01)
	{
		case (0):
			enableControl("Eng_Rs_1_AR2", "CH_CPCEng_Rs_1_AR2_UB__01", 0); //1: enable; 0: disable
			@sysvar::CH_Nodes::CH_CPCEng_Rs_1_AR2_UB__01 = 1;
			break;
		case (1):
			enableControl("Eng_Rs_1_AR2", "CH_CPCEng_Rs_1_AR2_UB__01", 1); //1: enable; 0: disable
			break;
		case (2):
			enableControl("Eng_Rs_1_AR2", "CH_CPCEng_Rs_1_AR2_UB__01", 0); //1: enable; 0: disable
			@sysvar::CH_Nodes::CH_CPCEng_Rs_1_AR2_UB__01 = 1;
			break;
		case (3):
			enableControl("Eng_Rs_1_AR2", "CH_CPCEng_Rs_1_AR2_UB__01", 0); //1: enable; 0: disable
			@sysvar::CH_Nodes::CH_CPCEng_Rs_1_AR2_UB__01 = 0;
			break;
	}

	CRC_Eng_Rs1_Pr2 = 0;
	SQC_VAL_Eng_Rs1_Pr2 = 0;
	SQC_Eng_Rs1_Pr2 = 0;
	switch (@sysvar::CH_Nodes::CH_CPCEng_Rs_2_AR2_UB_AUTO_01)
	{
		case (0):
			enableControl("Eng_Rs_2_AR2", "CH_CPCEng_Rs_2_AR2_UB__01", 0); //1: enable; 0: disable
			@sysvar::CH_Nodes::CH_CPCEng_Rs_2_AR2_UB__01 = 1;
			break;
		case (1):
			enableControl("Eng_Rs_2_AR2", "CH_CPCEng_Rs_2_AR2_UB__01", 1); //1: enable; 0: disable
			break;
		case (2):
			enableControl("Eng_Rs_2_AR2", "CH_CPCEng_Rs_2_AR2_UB__01", 0); //1: enable; 0: disable
			@sysvar::CH_Nodes::CH_CPCEng_Rs_2_AR2_UB__01 = 1;
			break;
		case (3):
			enableControl("Eng_Rs_2_AR2", "CH_CPCEng_Rs_2_AR2_UB__01", 0); //1: enable; 0: disable
			@sysvar::CH_Nodes::CH_CPCEng_Rs_2_AR2_UB__01 = 0;
			break;
	}

	CRC_Eng_Rs2_Pr2 = 0;
	SQC_VAL_Eng_Rs2_Pr2 = 0;
	SQC_Eng_Rs2_Pr2 = 0;
	switch (@sysvar::CH_Nodes::CH_CPCEng_Rs_3_AR2_UB_AUTO_01)
	{
		case (0):
			enableControl("Eng_Rs_3_AR2", "CH_CPCEng_Rs_3_AR2_UB__01", 0); //1: enable; 0: disable
			@sysvar::CH_Nodes::CH_CPCEng_Rs_3_AR2_UB__01 = 1;
			break;
		case (1):
			enableControl("Eng_Rs_3_AR2", "CH_CPCEng_Rs_3_AR2_UB__01", 1); //1: enable; 0: disable
			break;
		case (2):
			enableControl("Eng_Rs_3_AR2", "CH_CPCEng_Rs_3_AR2_UB__01", 0); //1: enable; 0: disable
			@sysvar::CH_Nodes::CH_CPCEng_Rs_3_AR2_UB__01 = 1;
			break;
		case (3):
			enableControl("Eng_Rs_3_AR2", "CH_CPCEng_Rs_3_AR2_UB__01", 0); //1: enable; 0: disable
			@sysvar::CH_Nodes::CH_CPCEng_Rs_3_AR2_UB__01 = 0;
			break;
	}

	CRC_Eng_Rs3_Pr2 = 0;
	SQC_VAL_Eng_Rs3_Pr2 = 0;
	SQC_Eng_Rs3_Pr2 = 0;
	switch (@sysvar::CH_Nodes::CH_CPCEng_Rs_EM_AR2_UB_AUTO_01)
	{
		case (0):
			enableControl("Eng_Rs_EM_AR2", "CH_CPCEng_Rs_EM_AR2_UB__01", 0); //1: enable; 0: disable
			@sysvar::CH_Nodes::CH_CPCEng_Rs_EM_AR2_UB__01 = 1;
			break;
		case (1):
			enableControl("Eng_Rs_EM_AR2", "CH_CPCEng_Rs_EM_AR2_UB__01", 1); //1: enable; 0: disable
			break;
		case (2):
			enableControl("Eng_Rs_EM_AR2", "CH_CPCEng_Rs_EM_AR2_UB__01", 0); //1: enable; 0: disable
			@sysvar::CH_Nodes::CH_CPCEng_Rs_EM_AR2_UB__01 = 1;
			break;
		case (3):
			enableControl("Eng_Rs_EM_AR2", "CH_CPCEng_Rs_EM_AR2_UB__01", 0); //1: enable; 0: disable
			@sysvar::CH_Nodes::CH_CPCEng_Rs_EM_AR2_UB__01 = 0;
			break;
	}

	CRC_Eng_Rs_EM_Pr2 = 0;
	SQC_VAL_Eng_Rs_EM_Pr2 = 0;
	SQC_Eng_Rs_EM_Pr2 = 0;
	switch (@sysvar::CH_Nodes::CH_CPCEng_Rs_EngCtrl_AR2_UB_A_01)
	{
		case (0):
			enableControl("Eng_Rs_EngCtrl_AR2", "CH_CPCEng_Rs_EngCtrl_AR2_UB__01", 0); //1: enable; 0: disable
			@sysvar::CH_Nodes::CH_CPCEng_Rs_EngCtrl_AR2_UB__01 = 1;
			break;
		case (1):
			enableControl("Eng_Rs_EngCtrl_AR2", "CH_CPCEng_Rs_EngCtrl_AR2_UB__01", 1); //1: enable; 0: disable
			break;
		case (2):
			enableControl("Eng_Rs_EngCtrl_AR2", "CH_CPCEng_Rs_EngCtrl_AR2_UB__01", 0); //1: enable; 0: disable
			@sysvar::CH_Nodes::CH_CPCEng_Rs_EngCtrl_AR2_UB__01 = 1;
			break;
		case (3):
			enableControl("Eng_Rs_EngCtrl_AR2", "CH_CPCEng_Rs_EngCtrl_AR2_UB__01", 0); //1: enable; 0: disable
			@sysvar::CH_Nodes::CH_CPCEng_Rs_EngCtrl_AR2_UB__01 = 0;
			break;
	}

	CRC_Eng_Rs_EngCtrl_Pr2 = 0;
	SQC_VAL_Eng_Rs_EngCtrl_Pr2 = 0;
	SQC_Eng_Rs_EngCtrl_Pr2 = 0;
	switch (@sysvar::CH_Nodes::CH_CPCEngCtrl_Disp_Rq_AR_UB_A_01)
	{
		case (0):
			enableControl("EngCtrl_Disp_Rq_AR2", "CH_CPCEngCtrl_Disp_Rq_AR2_UB__01", 0); //1: enable; 0: disable
			@sysvar::CH_Nodes::CH_CPCEngCtrl_Disp_Rq_AR2_UB__01 = 1;
			break;
		case (1):
			enableControl("EngCtrl_Disp_Rq_AR2", "CH_CPCEngCtrl_Disp_Rq_AR2_UB__01", 1); //1: enable; 0: disable
			break;
		case (2):
			enableControl("EngCtrl_Disp_Rq_AR2", "CH_CPCEngCtrl_Disp_Rq_AR2_UB__01", 0); //1: enable; 0: disable
			@sysvar::CH_Nodes::CH_CPCEngCtrl_Disp_Rq_AR2_UB__01 = 1;
			break;
		case (3):
			enableControl("EngCtrl_Disp_Rq_AR2", "CH_CPCEngCtrl_Disp_Rq_AR2_UB__01", 0); //1: enable; 0: disable
			@sysvar::CH_Nodes::CH_CPCEngCtrl_Disp_Rq_AR2_UB__01 = 0;
			break;
	}

	switch (@sysvar::CH_Nodes::CH_CPCEngCtrl_OBD1_AR_UB_AUTO_01)
	{
		case (0):
			enableControl("EngCtrl_OBD1_AR", "CH_CPCEngCtrl_OBD1_AR_UB__01", 0); //1: enable; 0: disable
			@sysvar::CH_Nodes::CH_CPCEngCtrl_OBD1_AR_UB__01 = 1;
			break;
		case (1):
			enableControl("EngCtrl_OBD1_AR", "CH_CPCEngCtrl_OBD1_AR_UB__01", 1); //1: enable; 0: disable
			break;
		case (2):
			enableControl("EngCtrl_OBD1_AR", "CH_CPCEngCtrl_OBD1_AR_UB__01", 0); //1: enable; 0: disable
			@sysvar::CH_Nodes::CH_CPCEngCtrl_OBD1_AR_UB__01 = 1;
			break;
		case (3):
			enableControl("EngCtrl_OBD1_AR", "CH_CPCEngCtrl_OBD1_AR_UB__01", 0); //1: enable; 0: disable
			@sysvar::CH_Nodes::CH_CPCEngCtrl_OBD1_AR_UB__01 = 0;
			break;
	}

	switch (@sysvar::CH_Nodes::CH_CPCESP_OBD_Data_AR_UB_AUTO_01)
	{
		case (0):
			enableControl("ESP_OBD_Data_AR", "CH_CPCESP_OBD_Data_AR_UB__01", 0); //1: enable; 0: disable
			@sysvar::CH_Nodes::CH_CPCESP_OBD_Data_AR_UB__01 = 1;
			break;
		case (1):
			enableControl("ESP_OBD_Data_AR", "CH_CPCESP_OBD_Data_AR_UB__01", 1); //1: enable; 0: disable
			break;
		case (2):
			enableControl("ESP_OBD_Data_AR", "CH_CPCESP_OBD_Data_AR_UB__01", 0); //1: enable; 0: disable
			@sysvar::CH_Nodes::CH_CPCESP_OBD_Data_AR_UB__01 = 1;
			break;
		case (3):
			enableControl("ESP_OBD_Data_AR", "CH_CPCESP_OBD_Data_AR_UB__01", 0); //1: enable; 0: disable
			@sysvar::CH_Nodes::CH_CPCESP_OBD_Data_AR_UB__01 = 0;
			break;
	}

	switch (@sysvar::CH_Nodes::CH_CPCFuel_Stat2_AR2_UB_AUTO)
	{
		case (0):
			enableControl("Fuel_Stat2_AR2", "CH_CPCFuel_Stat2_AR2_UB_", 0); //1: enable; 0: disable
			@sysvar::CH_Nodes::CH_CPCFuel_Stat2_AR2_UB_ = 1;
			break;
		case (1):
			enableControl("Fuel_Stat2_AR2", "CH_CPCFuel_Stat2_AR2_UB_", 1); //1: enable; 0: disable
			break;
		case (2):
			enableControl("Fuel_Stat2_AR2", "CH_CPCFuel_Stat2_AR2_UB_", 0); //1: enable; 0: disable
			@sysvar::CH_Nodes::CH_CPCFuel_Stat2_AR2_UB_ = 1;
			break;
		case (3):
			enableControl("Fuel_Stat2_AR2", "CH_CPCFuel_Stat2_AR2_UB_", 0); //1: enable; 0: disable
			@sysvar::CH_Nodes::CH_CPCFuel_Stat2_AR2_UB_ = 0;
			break;
	}

	switch (@sysvar::CH_Nodes::CH_CPCHumanMachineIfc_AR_UB_A_01)
	{
		case (0):
			enableControl("HumanMachineIfc_AR2", "CH_CPCHumanMachineIfc_AR2_UB__01", 0); //1: enable; 0: disable
			@sysvar::CH_Nodes::CH_CPCHumanMachineIfc_AR2_UB__01 = 1;
			break;
		case (1):
			enableControl("HumanMachineIfc_AR2", "CH_CPCHumanMachineIfc_AR2_UB__01", 1); //1: enable; 0: disable
			break;
		case (2):
			enableControl("HumanMachineIfc_AR2", "CH_CPCHumanMachineIfc_AR2_UB__01", 0); //1: enable; 0: disable
			@sysvar::CH_Nodes::CH_CPCHumanMachineIfc_AR2_UB__01 = 1;
			break;
		case (3):
			enableControl("HumanMachineIfc_AR2", "CH_CPCHumanMachineIfc_AR2_UB__01", 0); //1: enable; 0: disable
			@sysvar::CH_Nodes::CH_CPCHumanMachineIfc_AR2_UB__01 = 0;
			break;
	}

	switch (@sysvar::CH_Nodes::CH_CPCISM_DAC4_AR_UB_AUTO_01)
	{
		case (0):
			enableControl("ISM_DAC4_AR", "CH_CPCISM_DAC4_AR_UB__01", 0); //1: enable; 0: disable
			@sysvar::CH_Nodes::CH_CPCISM_DAC4_AR_UB__01 = 1;
			break;
		case (1):
			enableControl("ISM_DAC4_AR", "CH_CPCISM_DAC4_AR_UB__01", 1); //1: enable; 0: disable
			break;
		case (2):
			enableControl("ISM_DAC4_AR", "CH_CPCISM_DAC4_AR_UB__01", 0); //1: enable; 0: disable
			@sysvar::CH_Nodes::CH_CPCISM_DAC4_AR_UB__01 = 1;
			break;
		case (3):
			enableControl("ISM_DAC4_AR", "CH_CPCISM_DAC4_AR_UB__01", 0); //1: enable; 0: disable
			@sysvar::CH_Nodes::CH_CPCISM_DAC4_AR_UB__01 = 0;
			break;
	}

	switch (@sysvar::CH_Nodes::CH_CPCOBL_DC_Output_AR_UB_AUT_01)
	{
		case (0):
			enableControl("OBL_DC_Output_AR", "CH_CPCOBL_DC_Output_AR_UB__01", 0); //1: enable; 0: disable
			@sysvar::CH_Nodes::CH_CPCOBL_DC_Output_AR_UB__01 = 1;
			break;
		case (1):
			enableControl("OBL_DC_Output_AR", "CH_CPCOBL_DC_Output_AR_UB__01", 1); //1: enable; 0: disable
			break;
		case (2):
			enableControl("OBL_DC_Output_AR", "CH_CPCOBL_DC_Output_AR_UB__01", 0); //1: enable; 0: disable
			@sysvar::CH_Nodes::CH_CPCOBL_DC_Output_AR_UB__01 = 1;
			break;
		case (3):
			enableControl("OBL_DC_Output_AR", "CH_CPCOBL_DC_Output_AR_UB__01", 0); //1: enable; 0: disable
			@sysvar::CH_Nodes::CH_CPCOBL_DC_Output_AR_UB__01 = 0;
			break;
	}

	switch (@sysvar::CH_Nodes::CH_CPCPARK_Drv_Rs_TCM_AR_UB_A_01)
	{
		case (0):
			enableControl("PARK_Drv_Rs_TCM_AR2", "CH_CPCPARK_Drv_Rs_TCM_AR2_UB__01", 0); //1: enable; 0: disable
			@sysvar::CH_Nodes::CH_CPCPARK_Drv_Rs_TCM_AR2_UB__01 = 1;
			break;
		case (1):
			enableControl("PARK_Drv_Rs_TCM_AR2", "CH_CPCPARK_Drv_Rs_TCM_AR2_UB__01", 1); //1: enable; 0: disable
			break;
		case (2):
			enableControl("PARK_Drv_Rs_TCM_AR2", "CH_CPCPARK_Drv_Rs_TCM_AR2_UB__01", 0); //1: enable; 0: disable
			@sysvar::CH_Nodes::CH_CPCPARK_Drv_Rs_TCM_AR2_UB__01 = 1;
			break;
		case (3):
			enableControl("PARK_Drv_Rs_TCM_AR2", "CH_CPCPARK_Drv_Rs_TCM_AR2_UB__01", 0); //1: enable; 0: disable
			@sysvar::CH_Nodes::CH_CPCPARK_Drv_Rs_TCM_AR2_UB__01 = 0;
			break;
	}

	CRC_PARK_Drv_Rs_TCM_Pr2 = 0;
	SQC_VAL_PARK_Drv_Rs_TCM_Pr2 = 0;
	SQC_PARK_Drv_Rs_TCM_Pr2 = 0;
	switch (@sysvar::CH_Nodes::CH_CPCPN14_Gen_Rs_AR_UB_AUTO_01)
	{
		case (0):
			enableControl("PN14_Gen_Rs_AR", "CH_CPCPN14_Gen_Rs_AR_UB__01", 0); //1: enable; 0: disable
			@sysvar::CH_Nodes::CH_CPCPN14_Gen_Rs_AR_UB__01 = 1;
			break;
		case (1):
			enableControl("PN14_Gen_Rs_AR", "CH_CPCPN14_Gen_Rs_AR_UB__01", 1); //1: enable; 0: disable
			break;
		case (2):
			enableControl("PN14_Gen_Rs_AR", "CH_CPCPN14_Gen_Rs_AR_UB__01", 0); //1: enable; 0: disable
			@sysvar::CH_Nodes::CH_CPCPN14_Gen_Rs_AR_UB__01 = 1;
			break;
		case (3):
			enableControl("PN14_Gen_Rs_AR", "CH_CPCPN14_Gen_Rs_AR_UB__01", 0); //1: enable; 0: disable
			@sysvar::CH_Nodes::CH_CPCPN14_Gen_Rs_AR_UB__01 = 0;
			break;
	}

	OldVal_Term61_Actv = $Term61_Actv;
	TGL_VAL_NM_CALID_CVN_ErrNum_ = 0;
	TGL_NM_CALID_CVN_ErrNum_ = 0;
	switch (@sysvar::CH_Nodes::CH_CPCPNHV_EnergyMngmntS_UB_A_02)
	{
		case (0):
			enableControl("PNHV_EnergyMngmntSet_Rs1_AR2", "CH_CPCPNHV_EnergyMngmntSet_R__02", 0); //1: enable; 0: disable
			@sysvar::CH_Nodes::CH_CPCPNHV_EnergyMngmntSet_R__02 = 1;
			break;
		case (1):
			enableControl("PNHV_EnergyMngmntSet_Rs1_AR2", "CH_CPCPNHV_EnergyMngmntSet_R__02", 1); //1: enable; 0: disable
			break;
		case (2):
			enableControl("PNHV_EnergyMngmntSet_Rs1_AR2", "CH_CPCPNHV_EnergyMngmntSet_R__02", 0); //1: enable; 0: disable
			@sysvar::CH_Nodes::CH_CPCPNHV_EnergyMngmntSet_R__02 = 1;
			break;
		case (3):
			enableControl("PNHV_EnergyMngmntSet_Rs1_AR2", "CH_CPCPNHV_EnergyMngmntSet_R__02", 0); //1: enable; 0: disable
			@sysvar::CH_Nodes::CH_CPCPNHV_EnergyMngmntSet_R__02 = 0;
			break;
	}

	switch (@sysvar::CH_Nodes::CH_CPCPNHV_EnergyMngmntS_UB_A_03)
	{
		case (0):
			enableControl("PNHV_EnergyMngmntSet_Rs2_AR", "CH_CPCPNHV_EnergyMngmntSet_R__03", 0); //1: enable; 0: disable
			@sysvar::CH_Nodes::CH_CPCPNHV_EnergyMngmntSet_R__03 = 1;
			break;
		case (1):
			enableControl("PNHV_EnergyMngmntSet_Rs2_AR", "CH_CPCPNHV_EnergyMngmntSet_R__03", 1); //1: enable; 0: disable
			break;
		case (2):
			enableControl("PNHV_EnergyMngmntSet_Rs2_AR", "CH_CPCPNHV_EnergyMngmntSet_R__03", 0); //1: enable; 0: disable
			@sysvar::CH_Nodes::CH_CPCPNHV_EnergyMngmntSet_R__03 = 1;
			break;
		case (3):
			enableControl("PNHV_EnergyMngmntSet_Rs2_AR", "CH_CPCPNHV_EnergyMngmntSet_R__03", 0); //1: enable; 0: disable
			@sysvar::CH_Nodes::CH_CPCPNHV_EnergyMngmntSet_R__03 = 0;
			break;
	}

	switch (@sysvar::CH_Nodes::CH_CPCPNHV_Stat_AR2_UB_AUTO_01)
	{
		case (0):
			enableControl("PNHV_Stat_AR2", "CH_CPCPNHV_Stat_AR2_UB__01", 0); //1: enable; 0: disable
			@sysvar::CH_Nodes::CH_CPCPNHV_Stat_AR2_UB__01 = 1;
			break;
		case (1):
			enableControl("PNHV_Stat_AR2", "CH_CPCPNHV_Stat_AR2_UB__01", 1); //1: enable; 0: disable
			break;
		case (2):
			enableControl("PNHV_Stat_AR2", "CH_CPCPNHV_Stat_AR2_UB__01", 0); //1: enable; 0: disable
			@sysvar::CH_Nodes::CH_CPCPNHV_Stat_AR2_UB__01 = 1;
			break;
		case (3):
			enableControl("PNHV_Stat_AR2", "CH_CPCPNHV_Stat_AR2_UB__01", 0); //1: enable; 0: disable
			@sysvar::CH_Nodes::CH_CPCPNHV_Stat_AR2_UB__01 = 0;
			break;
	}

	CRC_PNHV_Stat_Pr2 = 0;
	SQC_VAL_PNHV_Stat_Pr2 = 0;
	SQC_PNHV_Stat_Pr2 = 0;
	switch (@sysvar::CH_Nodes::CH_CPCPtMngmnt_Rq_AR2_UB_AUTO_01)
	{
		case (0):
			enableControl("PtMngmnt_Rq_AR2", "CH_CPCPtMngmnt_Rq_AR2_UB__01", 0); //1: enable; 0: disable
			@sysvar::CH_Nodes::CH_CPCPtMngmnt_Rq_AR2_UB__01 = 1;
			break;
		case (1):
			enableControl("PtMngmnt_Rq_AR2", "CH_CPCPtMngmnt_Rq_AR2_UB__01", 1); //1: enable; 0: disable
			break;
		case (2):
			enableControl("PtMngmnt_Rq_AR2", "CH_CPCPtMngmnt_Rq_AR2_UB__01", 0); //1: enable; 0: disable
			@sysvar::CH_Nodes::CH_CPCPtMngmnt_Rq_AR2_UB__01 = 1;
			break;
		case (3):
			enableControl("PtMngmnt_Rq_AR2", "CH_CPCPtMngmnt_Rq_AR2_UB__01", 0); //1: enable; 0: disable
			@sysvar::CH_Nodes::CH_CPCPtMngmnt_Rq_AR2_UB__01 = 0;
			break;
	}

	CRC_PtMngmnt_Rq_Pr2 = 0;
	SQC_VAL_PtMngmnt_Rq_Pr2 = 0;
	SQC_PtMngmnt_Rq_Pr2 = 0;
	switch (@sysvar::CH_Nodes::CH_CPCPtMngmnt_Stat2_AR2_UB_A_01)
	{
		case (0):
			enableControl("PtMngmnt_Stat2_AR2", "CH_CPCPtMngmnt_Stat2_AR2_UB__01", 0); //1: enable; 0: disable
			@sysvar::CH_Nodes::CH_CPCPtMngmnt_Stat2_AR2_UB__01 = 1;
			break;
		case (1):
			enableControl("PtMngmnt_Stat2_AR2", "CH_CPCPtMngmnt_Stat2_AR2_UB__01", 1); //1: enable; 0: disable
			break;
		case (2):
			enableControl("PtMngmnt_Stat2_AR2", "CH_CPCPtMngmnt_Stat2_AR2_UB__01", 0); //1: enable; 0: disable
			@sysvar::CH_Nodes::CH_CPCPtMngmnt_Stat2_AR2_UB__01 = 1;
			break;
		case (3):
			enableControl("PtMngmnt_Stat2_AR2", "CH_CPCPtMngmnt_Stat2_AR2_UB__01", 0); //1: enable; 0: disable
			@sysvar::CH_Nodes::CH_CPCPtMngmnt_Stat2_AR2_UB__01 = 0;
			break;
	}

	CRC_PtMngmnt_Stat2_Pr2 = 0;
	SQC_VAL_PtMngmnt_Stat2_Pr2 = 0;
	SQC_PtMngmnt_Stat2_Pr2 = 0;
	switch (@sysvar::CH_Nodes::CH_CPCPtMngmnt_Stat_AR2_UB_AU_01)
	{
		case (0):
			enableControl("PtMngmnt_Stat_AR2", "CH_CPCPtMngmnt_Stat_AR2_UB__01", 0); //1: enable; 0: disable
			@sysvar::CH_Nodes::CH_CPCPtMngmnt_Stat_AR2_UB__01 = 1;
			break;
		case (1):
			enableControl("PtMngmnt_Stat_AR2", "CH_CPCPtMngmnt_Stat_AR2_UB__01", 1); //1: enable; 0: disable
			break;
		case (2):
			enableControl("PtMngmnt_Stat_AR2", "CH_CPCPtMngmnt_Stat_AR2_UB__01", 0); //1: enable; 0: disable
			@sysvar::CH_Nodes::CH_CPCPtMngmnt_Stat_AR2_UB__01 = 1;
			break;
		case (3):
			enableControl("PtMngmnt_Stat_AR2", "CH_CPCPtMngmnt_Stat_AR2_UB__01", 0); //1: enable; 0: disable
			@sysvar::CH_Nodes::CH_CPCPtMngmnt_Stat_AR2_UB__01 = 0;
			break;
	}

	CRC_PT_Stat_Pr2 = 0;
	SQC_VAL_PT_Stat_Pr2 = 0;
	SQC_PT_Stat_Pr2 = 0;
	switch (@sysvar::CH_Nodes::CH_CPCSBW_DrvPosn_Disp_R_UB_A_02)
	{
		case (0):
			enableControl("SBW_DrvPosn_Disp_Rq_ISM_AR2", "CH_CPCSBW_DrvPosn_Disp_Rq_IS__01", 0); //1: enable; 0: disable
			@sysvar::CH_Nodes::CH_CPCSBW_DrvPosn_Disp_Rq_IS__01 = 1;
			break;
		case (1):
			enableControl("SBW_DrvPosn_Disp_Rq_ISM_AR2", "CH_CPCSBW_DrvPosn_Disp_Rq_IS__01", 1); //1: enable; 0: disable
			break;
		case (2):
			enableControl("SBW_DrvPosn_Disp_Rq_ISM_AR2", "CH_CPCSBW_DrvPosn_Disp_Rq_IS__01", 0); //1: enable; 0: disable
			@sysvar::CH_Nodes::CH_CPCSBW_DrvPosn_Disp_Rq_IS__01 = 1;
			break;
		case (3):
			enableControl("SBW_DrvPosn_Disp_Rq_ISM_AR2", "CH_CPCSBW_DrvPosn_Disp_Rq_IS__01", 0); //1: enable; 0: disable
			@sysvar::CH_Nodes::CH_CPCSBW_DrvPosn_Disp_Rq_IS__01 = 0;
			break;
	}

	CRC_ISM_TxDrvPosn_Disp_Rq_Pr2 = 0;
	SQC_VAL_ISM_TxDrvPosn_Disp_Rq_Pr2 = 0;
	SQC_ISM_TxDrvPosn_Disp_Rq_Pr2 = 0;
	switch (@sysvar::CH_Nodes::CH_CPCSBW_DrvPosn_Disp_R_UB_A_03)
	{
		case (0):
			enableControl("SBW_DrvPosn_Disp_Rq_TCM_AR2", "CH_CPCSBW_DrvPosn_Disp_Rq_TC__01", 0); //1: enable; 0: disable
			@sysvar::CH_Nodes::CH_CPCSBW_DrvPosn_Disp_Rq_TC__01 = 1;
			break;
		case (1):
			enableControl("SBW_DrvPosn_Disp_Rq_TCM_AR2", "CH_CPCSBW_DrvPosn_Disp_Rq_TC__01", 1); //1: enable; 0: disable
			break;
		case (2):
			enableControl("SBW_DrvPosn_Disp_Rq_TCM_AR2", "CH_CPCSBW_DrvPosn_Disp_Rq_TC__01", 0); //1: enable; 0: disable
			@sysvar::CH_Nodes::CH_CPCSBW_DrvPosn_Disp_Rq_TC__01 = 1;
			break;
		case (3):
			enableControl("SBW_DrvPosn_Disp_Rq_TCM_AR2", "CH_CPCSBW_DrvPosn_Disp_Rq_TC__01", 0); //1: enable; 0: disable
			@sysvar::CH_Nodes::CH_CPCSBW_DrvPosn_Disp_Rq_TC__01 = 0;
			break;
	}

	CRC_SBW_Drv_Pk_Posn_TCM_Pr2 = 0;
	SQC_VAL_SBW_Drv_Pk_Posn_TCM_Pr2 = 0;
	SQC_SBW_Drv_Pk_Posn_TCM_Pr2 = 0;
	switch (@sysvar::CH_Nodes::CH_CPCSBW_Stat_AR2_UB_AUTO_01)
	{
		case (0):
			enableControl("SBW_Stat_AR2", "CH_CPCSBW_Stat_AR2_UB__01", 0); //1: enable; 0: disable
			@sysvar::CH_Nodes::CH_CPCSBW_Stat_AR2_UB__01 = 1;
			break;
		case (1):
			enableControl("SBW_Stat_AR2", "CH_CPCSBW_Stat_AR2_UB__01", 1); //1: enable; 0: disable
			break;
		case (2):
			enableControl("SBW_Stat_AR2", "CH_CPCSBW_Stat_AR2_UB__01", 0); //1: enable; 0: disable
			@sysvar::CH_Nodes::CH_CPCSBW_Stat_AR2_UB__01 = 1;
			break;
		case (3):
			enableControl("SBW_Stat_AR2", "CH_CPCSBW_Stat_AR2_UB__01", 0); //1: enable; 0: disable
			@sysvar::CH_Nodes::CH_CPCSBW_Stat_AR2_UB__01 = 0;
			break;
	}

	CRC_SBW_Stat_Pr2 = 0;
	SQC_VAL_SBW_Stat_Pr2 = 0;
	SQC_SBW_Stat_Pr2 = 0;
	switch (@sysvar::CH_Nodes::CH_CPCTCM_DAC4_AR_UB_AUTO_01)
	{
		case (0):
			enableControl("TCM_DAC4_AR", "CH_CPCTCM_DAC4_AR_UB__01", 0); //1: enable; 0: disable
			@sysvar::CH_Nodes::CH_CPCTCM_DAC4_AR_UB__01 = 1;
			break;
		case (1):
			enableControl("TCM_DAC4_AR", "CH_CPCTCM_DAC4_AR_UB__01", 1); //1: enable; 0: disable
			break;
		case (2):
			enableControl("TCM_DAC4_AR", "CH_CPCTCM_DAC4_AR_UB__01", 0); //1: enable; 0: disable
			@sysvar::CH_Nodes::CH_CPCTCM_DAC4_AR_UB__01 = 1;
			break;
		case (3):
			enableControl("TCM_DAC4_AR", "CH_CPCTCM_DAC4_AR_UB__01", 0); //1: enable; 0: disable
			@sysvar::CH_Nodes::CH_CPCTCM_DAC4_AR_UB__01 = 0;
			break;
	}

	switch (@sysvar::CH_Nodes::CH_CPCTCM_Data2_AR2_UB_AUTO_01)
	{
		case (0):
			enableControl("TCM_Data2_AR2", "CH_CPCTCM_Data2_AR2_UB__01", 0); //1: enable; 0: disable
			@sysvar::CH_Nodes::CH_CPCTCM_Data2_AR2_UB__01 = 1;
			break;
		case (1):
			enableControl("TCM_Data2_AR2", "CH_CPCTCM_Data2_AR2_UB__01", 1); //1: enable; 0: disable
			break;
		case (2):
			enableControl("TCM_Data2_AR2", "CH_CPCTCM_Data2_AR2_UB__01", 0); //1: enable; 0: disable
			@sysvar::CH_Nodes::CH_CPCTCM_Data2_AR2_UB__01 = 1;
			break;
		case (3):
			enableControl("TCM_Data2_AR2", "CH_CPCTCM_Data2_AR2_UB__01", 0); //1: enable; 0: disable
			@sysvar::CH_Nodes::CH_CPCTCM_Data2_AR2_UB__01 = 0;
			break;
	}

	CRC_TCM_Data2_Pr2 = 0;
	SQC_VAL_TCM_Data2_Pr2 = 0;
	SQC_TCM_Data2_Pr2 = 0;
	switch (@sysvar::CH_Nodes::CH_CPCTCM_Data3_AR2_UB_AUTO_01)
	{
		case (0):
			enableControl("TCM_Data3_AR2", "CH_CPCTCM_Data3_AR2_UB__01", 0); //1: enable; 0: disable
			@sysvar::CH_Nodes::CH_CPCTCM_Data3_AR2_UB__01 = 1;
			break;
		case (1):
			enableControl("TCM_Data3_AR2", "CH_CPCTCM_Data3_AR2_UB__01", 1); //1: enable; 0: disable
			break;
		case (2):
			enableControl("TCM_Data3_AR2", "CH_CPCTCM_Data3_AR2_UB__01", 0); //1: enable; 0: disable
			@sysvar::CH_Nodes::CH_CPCTCM_Data3_AR2_UB__01 = 1;
			break;
		case (3):
			enableControl("TCM_Data3_AR2", "CH_CPCTCM_Data3_AR2_UB__01", 0); //1: enable; 0: disable
			@sysvar::CH_Nodes::CH_CPCTCM_Data3_AR2_UB__01 = 0;
			break;
	}

	CRC_TCM_Data3_Pr2 = 0;
	SQC_VAL_TCM_Data3_Pr2 = 0;
	SQC_TCM_Data3_Pr2 = 0;
	switch (@sysvar::CH_Nodes::CH_CPCTCM_Disp_Rq_AMG_AR_UB_A_01)
	{
		case (0):
			enableControl("TCM_Disp_Rq_AMG_AR", "CH_CPCTCM_Disp_Rq_AMG_AR_UB__01", 0); //1: enable; 0: disable
			@sysvar::CH_Nodes::CH_CPCTCM_Disp_Rq_AMG_AR_UB__01 = 1;
			break;
		case (1):
			enableControl("TCM_Disp_Rq_AMG_AR", "CH_CPCTCM_Disp_Rq_AMG_AR_UB__01", 1); //1: enable; 0: disable
			break;
		case (2):
			enableControl("TCM_Disp_Rq_AMG_AR", "CH_CPCTCM_Disp_Rq_AMG_AR_UB__01", 0); //1: enable; 0: disable
			@sysvar::CH_Nodes::CH_CPCTCM_Disp_Rq_AMG_AR_UB__01 = 1;
			break;
		case (3):
			enableControl("TCM_Disp_Rq_AMG_AR", "CH_CPCTCM_Disp_Rq_AMG_AR_UB__01", 0); //1: enable; 0: disable
			@sysvar::CH_Nodes::CH_CPCTCM_Disp_Rq_AMG_AR_UB__01 = 0;
			break;
	}

	switch (@sysvar::CH_Nodes::CH_CPCTCM_State3_AR2_UB_AUTO_01)
	{
		case (0):
			enableControl("TCM_State3_AR2", "CH_CPCTCM_State3_AR2_UB__01", 0); //1: enable; 0: disable
			@sysvar::CH_Nodes::CH_CPCTCM_State3_AR2_UB__01 = 1;
			break;
		case (1):
			enableControl("TCM_State3_AR2", "CH_CPCTCM_State3_AR2_UB__01", 1); //1: enable; 0: disable
			break;
		case (2):
			enableControl("TCM_State3_AR2", "CH_CPCTCM_State3_AR2_UB__01", 0); //1: enable; 0: disable
			@sysvar::CH_Nodes::CH_CPCTCM_State3_AR2_UB__01 = 1;
			break;
		case (3):
			enableControl("TCM_State3_AR2", "CH_CPCTCM_State3_AR2_UB__01", 0); //1: enable; 0: disable
			@sysvar::CH_Nodes::CH_CPCTCM_State3_AR2_UB__01 = 0;
			break;
	}

	switch (@sysvar::CH_Nodes::CH_CPCTCU_Disp_Rq_AR2_UB_AUTO)
	{
		case (0):
			enableControl("TCU_Disp_Rq_AR2", "CH_CPCTCU_Disp_Rq_AR2_UB_", 0); //1: enable; 0: disable
			@sysvar::CH_Nodes::CH_CPCTCU_Disp_Rq_AR2_UB_ = 1;
			break;
		case (1):
			enableControl("TCU_Disp_Rq_AR2", "CH_CPCTCU_Disp_Rq_AR2_UB_", 1); //1: enable; 0: disable
			break;
		case (2):
			enableControl("TCU_Disp_Rq_AR2", "CH_CPCTCU_Disp_Rq_AR2_UB_", 0); //1: enable; 0: disable
			@sysvar::CH_Nodes::CH_CPCTCU_Disp_Rq_AR2_UB_ = 1;
			break;
		case (3):
			enableControl("TCU_Disp_Rq_AR2", "CH_CPCTCU_Disp_Rq_AR2_UB_", 0); //1: enable; 0: disable
			@sysvar::CH_Nodes::CH_CPCTCU_Disp_Rq_AR2_UB_ = 0;
			break;
	}

	switch (@sysvar::CH_Nodes::CH_CPCVehPwrMngmnt_EMM_S_UB_A_01)
	{
		case (0):
			enableControl("VehPwrMngmnt_EMM_Stat2_AR2", "CH_CPCVehPwrMngmnt_EMM_Stat2__01", 0); //1: enable; 0: disable
			@sysvar::CH_Nodes::CH_CPCVehPwrMngmnt_EMM_Stat2__01 = 1;
			break;
		case (1):
			enableControl("VehPwrMngmnt_EMM_Stat2_AR2", "CH_CPCVehPwrMngmnt_EMM_Stat2__01", 1); //1: enable; 0: disable
			break;
		case (2):
			enableControl("VehPwrMngmnt_EMM_Stat2_AR2", "CH_CPCVehPwrMngmnt_EMM_Stat2__01", 0); //1: enable; 0: disable
			@sysvar::CH_Nodes::CH_CPCVehPwrMngmnt_EMM_Stat2__01 = 1;
			break;
		case (3):
			enableControl("VehPwrMngmnt_EMM_Stat2_AR2", "CH_CPCVehPwrMngmnt_EMM_Stat2__01", 0); //1: enable; 0: disable
			@sysvar::CH_Nodes::CH_CPCVehPwrMngmnt_EMM_Stat2__01 = 0;
			break;
	}

	CRC_EMM_Disp_Rq_Pr2 = 0;
	SQC_VAL_EMM_Disp_Rq_Pr2 = 0;
	SQC_EMM_Disp_Rq_Pr2 = 0;
	switch (@sysvar::CH_Nodes::CH_CPCVehPwrMngmnt_Rq_AR_UB_A_01)
	{
		case (0):
			enableControl("VehPwrMngmnt_Rq_AR", "CH_CPCVehPwrMngmnt_Rq_AR_UB__01", 0); //1: enable; 0: disable
			@sysvar::CH_Nodes::CH_CPCVehPwrMngmnt_Rq_AR_UB__01 = 1;
			break;
		case (1):
			enableControl("VehPwrMngmnt_Rq_AR", "CH_CPCVehPwrMngmnt_Rq_AR_UB__01", 1); //1: enable; 0: disable
			break;
		case (2):
			enableControl("VehPwrMngmnt_Rq_AR", "CH_CPCVehPwrMngmnt_Rq_AR_UB__01", 0); //1: enable; 0: disable
			@sysvar::CH_Nodes::CH_CPCVehPwrMngmnt_Rq_AR_UB__01 = 1;
			break;
		case (3):
			enableControl("VehPwrMngmnt_Rq_AR", "CH_CPCVehPwrMngmnt_Rq_AR_UB__01", 0); //1: enable; 0: disable
			@sysvar::CH_Nodes::CH_CPCVehPwrMngmnt_Rq_AR_UB__01 = 0;
			break;
	}

	switch (@sysvar::CH_Nodes::CH_CPCWIA_EngTrq_AR_UB_AUTO_01)
	{
		case (0):
			enableControl("WIA_EngTrq_AR", "CH_CPCWIA_EngTrq_AR_UB__01", 0); //1: enable; 0: disable
			@sysvar::CH_Nodes::CH_CPCWIA_EngTrq_AR_UB__01 = 1;
			break;
		case (1):
			enableControl("WIA_EngTrq_AR", "CH_CPCWIA_EngTrq_AR_UB__01", 1); //1: enable; 0: disable
			break;
		case (2):
			enableControl("WIA_EngTrq_AR", "CH_CPCWIA_EngTrq_AR_UB__01", 0); //1: enable; 0: disable
			@sysvar::CH_Nodes::CH_CPCWIA_EngTrq_AR_UB__01 = 1;
			break;
		case (3):
			enableControl("WIA_EngTrq_AR", "CH_CPCWIA_EngTrq_AR_UB__01", 0); //1: enable; 0: disable
			@sysvar::CH_Nodes::CH_CPCWIA_EngTrq_AR_UB__01 = 0;
			break;
	}

}

StopSim()
{
}


callback_PNHV_WeekDepTmTbl_Stat_AR2PNHV_WeekDepTmTbl_TxActv (double value)
{
	PDU_PNHV_WeekDepTmTbl_Stat_AR2.PNHV_WeekDepTmTbl_TxActv.phys = value;
	frUpdatePDU(PDU_PNHV_WeekDepTmTbl_Stat_AR2,1,1);
}

callback_PNHV_WeekDepTmTbl_Stat_AR2PNHV_WeekDepTmTbl_New (double value)
{
	PDU_PNHV_WeekDepTmTbl_Stat_AR2.PNHV_WeekDepTmTbl_New.phys = value;
	frUpdatePDU(PDU_PNHV_WeekDepTmTbl_Stat_AR2,1,1);
}

callback_PNHV_WeekDepTmTbl_Stat_AR2PNHV_WeekDepTmTbl_PartId (double value)
{
	PDU_PNHV_WeekDepTmTbl_Stat_AR2.PNHV_WeekDepTmTbl_PartId.phys = value;
	frUpdatePDU(PDU_PNHV_WeekDepTmTbl_Stat_AR2,1,1);
}

callback_PNHV_WeekDepTmTbl_Stat_AR2PNHV_DepTmUpdtCnt_1To4 (double value)
{
	PDU_PNHV_WeekDepTmTbl_Stat_AR2.PNHV_DepTmUpdtCnt_1To4.phys = value;
	frUpdatePDU(PDU_PNHV_WeekDepTmTbl_Stat_AR2,1,1);
}

callback_PNHV_WeekDepTmTbl_Stat_AR2PNHV_DepTm01 (double value)
{
	PDU_PNHV_WeekDepTmTbl_Stat_AR2.PNHV_DepTm01.phys = value;
	frUpdatePDU(PDU_PNHV_WeekDepTmTbl_Stat_AR2,1,1);
}

callback_PNHV_WeekDepTmTbl_Stat_AR2PNHV_DepTm02 (double value)
{
	PDU_PNHV_WeekDepTmTbl_Stat_AR2.PNHV_DepTm02.phys = value;
	frUpdatePDU(PDU_PNHV_WeekDepTmTbl_Stat_AR2,1,1);
}

callback_PNHV_WeekDepTmTbl_Stat_AR2PNHV_DepTm03 (double value)
{
	PDU_PNHV_WeekDepTmTbl_Stat_AR2.PNHV_DepTm03.phys = value;
	frUpdatePDU(PDU_PNHV_WeekDepTmTbl_Stat_AR2,1,1);
}

callback_PNHV_WeekDepTmTbl_Stat_AR2PNHV_DepTm04 (double value)
{
	PDU_PNHV_WeekDepTmTbl_Stat_AR2.PNHV_DepTm04.phys = value;
	frUpdatePDU(PDU_PNHV_WeekDepTmTbl_Stat_AR2,1,1);
}

callback_PNHV_WeekDepTmTbl_Stat_AR2PNHV_DepTmUpdtCnt_5To8 (double value)
{
	PDU_PNHV_WeekDepTmTbl_Stat_AR2.PNHV_DepTmUpdtCnt_5To8.phys = value;
	frUpdatePDU(PDU_PNHV_WeekDepTmTbl_Stat_AR2,1,1);
}

callback_PNHV_WeekDepTmTbl_Stat_AR2PNHV_DepTm05 (double value)
{
	PDU_PNHV_WeekDepTmTbl_Stat_AR2.PNHV_DepTm05.phys = value;
	frUpdatePDU(PDU_PNHV_WeekDepTmTbl_Stat_AR2,1,1);
}

callback_PNHV_WeekDepTmTbl_Stat_AR2PNHV_DepTm06 (double value)
{
	PDU_PNHV_WeekDepTmTbl_Stat_AR2.PNHV_DepTm06.phys = value;
	frUpdatePDU(PDU_PNHV_WeekDepTmTbl_Stat_AR2,1,1);
}

callback_PNHV_WeekDepTmTbl_Stat_AR2PNHV_DepTm07 (double value)
{
	PDU_PNHV_WeekDepTmTbl_Stat_AR2.PNHV_DepTm07.phys = value;
	frUpdatePDU(PDU_PNHV_WeekDepTmTbl_Stat_AR2,1,1);
}

callback_PNHV_WeekDepTmTbl_Stat_AR2PNHV_DepTm08 (double value)
{
	PDU_PNHV_WeekDepTmTbl_Stat_AR2.PNHV_DepTm08.phys = value;
	frUpdatePDU(PDU_PNHV_WeekDepTmTbl_Stat_AR2,1,1);
}

callback_PNHV_WeekDepTmTbl_Stat_AR2PNHV_DepTmUpdtCnt_9To12 (double value)
{
	PDU_PNHV_WeekDepTmTbl_Stat_AR2.PNHV_DepTmUpdtCnt_9To12.phys = value;
	frUpdatePDU(PDU_PNHV_WeekDepTmTbl_Stat_AR2,1,1);
}

callback_PNHV_WeekDepTmTbl_Stat_AR2PNHV_DepTm09 (double value)
{
	PDU_PNHV_WeekDepTmTbl_Stat_AR2.PNHV_DepTm09.phys = value;
	frUpdatePDU(PDU_PNHV_WeekDepTmTbl_Stat_AR2,1,1);
}

callback_PNHV_WeekDepTmTbl_Stat_AR2PNHV_DepTm10 (double value)
{
	PDU_PNHV_WeekDepTmTbl_Stat_AR2.PNHV_DepTm10.phys = value;
	frUpdatePDU(PDU_PNHV_WeekDepTmTbl_Stat_AR2,1,1);
}

callback_PNHV_WeekDepTmTbl_Stat_AR2PNHV_DepTm11 (double value)
{
	PDU_PNHV_WeekDepTmTbl_Stat_AR2.PNHV_DepTm11.phys = value;
	frUpdatePDU(PDU_PNHV_WeekDepTmTbl_Stat_AR2,1,1);
}

callback_PNHV_WeekDepTmTbl_Stat_AR2PNHV_DepTm12 (double value)
{
	PDU_PNHV_WeekDepTmTbl_Stat_AR2.PNHV_DepTm12.phys = value;
	frUpdatePDU(PDU_PNHV_WeekDepTmTbl_Stat_AR2,1,1);
}

callback_PNHV_WeekDepTmTbl_Stat_AR2PNHV_DepTmUpdtCnt_13To16 (double value)
{
	PDU_PNHV_WeekDepTmTbl_Stat_AR2.PNHV_DepTmUpdtCnt_13To16.phys = value;
	frUpdatePDU(PDU_PNHV_WeekDepTmTbl_Stat_AR2,1,1);
}

callback_PNHV_WeekDepTmTbl_Stat_AR2PNHV_DepTm13 (double value)
{
	PDU_PNHV_WeekDepTmTbl_Stat_AR2.PNHV_DepTm13.phys = value;
	frUpdatePDU(PDU_PNHV_WeekDepTmTbl_Stat_AR2,1,1);
}

callback_PNHV_WeekDepTmTbl_Stat_AR2PNHV_DepTm14 (double value)
{
	PDU_PNHV_WeekDepTmTbl_Stat_AR2.PNHV_DepTm14.phys = value;
	frUpdatePDU(PDU_PNHV_WeekDepTmTbl_Stat_AR2,1,1);
}

callback_PNHV_WeekDepTmTbl_Stat_AR2PNHV_DepTm15 (double value)
{
	PDU_PNHV_WeekDepTmTbl_Stat_AR2.PNHV_DepTm15.phys = value;
	frUpdatePDU(PDU_PNHV_WeekDepTmTbl_Stat_AR2,1,1);
}

callback_PNHV_WeekDepTmTbl_Stat_AR2PNHV_DepTm16 (double value)
{
	PDU_PNHV_WeekDepTmTbl_Stat_AR2.PNHV_DepTm16.phys = value;
	frUpdatePDU(PDU_PNHV_WeekDepTmTbl_Stat_AR2,1,1);
}

callback_PNHV_WeekDepTmTbl_Stat_AR2PNHV_DepTmUpdtCnt_17To20 (double value)
{
	PDU_PNHV_WeekDepTmTbl_Stat_AR2.PNHV_DepTmUpdtCnt_17To20.phys = value;
	frUpdatePDU(PDU_PNHV_WeekDepTmTbl_Stat_AR2,1,1);
}

callback_PNHV_WeekDepTmTbl_Stat_AR2PNHV_DepTm17 (double value)
{
	PDU_PNHV_WeekDepTmTbl_Stat_AR2.PNHV_DepTm17.phys = value;
	frUpdatePDU(PDU_PNHV_WeekDepTmTbl_Stat_AR2,1,1);
}

callback_PNHV_WeekDepTmTbl_Stat_AR2PNHV_DepTm18 (double value)
{
	PDU_PNHV_WeekDepTmTbl_Stat_AR2.PNHV_DepTm18.phys = value;
	frUpdatePDU(PDU_PNHV_WeekDepTmTbl_Stat_AR2,1,1);
}

callback_PNHV_WeekDepTmTbl_Stat_AR2PNHV_DepTm19 (double value)
{
	PDU_PNHV_WeekDepTmTbl_Stat_AR2.PNHV_DepTm19.phys = value;
	frUpdatePDU(PDU_PNHV_WeekDepTmTbl_Stat_AR2,1,1);
}

callback_PNHV_WeekDepTmTbl_Stat_AR2PNHV_DepTm20 (double value)
{
	PDU_PNHV_WeekDepTmTbl_Stat_AR2.PNHV_DepTm20.phys = value;
	frUpdatePDU(PDU_PNHV_WeekDepTmTbl_Stat_AR2,1,1);
}

callback_PNHV_WeekDepTmTbl_Stat_AR2PNHV_DepTmUpdtCnt_21 (double value)
{
	PDU_PNHV_WeekDepTmTbl_Stat_AR2.PNHV_DepTmUpdtCnt_21.phys = value;
	frUpdatePDU(PDU_PNHV_WeekDepTmTbl_Stat_AR2,1,1);
}

callback_PNHV_WeekDepTmTbl_Stat_AR2PNHV_DepTm21 (double value)
{
	PDU_PNHV_WeekDepTmTbl_Stat_AR2.PNHV_DepTm21.phys = value;
	frUpdatePDU(PDU_PNHV_WeekDepTmTbl_Stat_AR2,1,1);
}

callback_TC_Disp_Rq_ECM_ARTC_PN14_RecupPwr (double value)
{
	PDU_TC_Disp_Rq_ECM_AR.TC_PN14_RecupPwr.phys = value;
	frUpdatePDU(PDU_TC_Disp_Rq_ECM_AR,1,1);
}

callback_TC_Disp_Rq_ECM_ARZeroEmission_Actv (double value)
{
	PDU_TC_Disp_Rq_ECM_AR.ZeroEmission_Actv.phys = value;
	frUpdatePDU(PDU_TC_Disp_Rq_ECM_AR,1,1);
}

callback_TC_Disp_Rq_ECM_ARTC_GasFuelConsRecup (double value)
{
	PDU_TC_Disp_Rq_ECM_AR.TC_GasFuelConsRecup.phys = value;
	frUpdatePDU(PDU_TC_Disp_Rq_ECM_AR,1,1);
}

callback_TC_Disp_Rq_ECM_ARTC_GasFuelCons (double value)
{
	PDU_TC_Disp_Rq_ECM_AR.TC_GasFuelCons.phys = value;
	frUpdatePDU(PDU_TC_Disp_Rq_ECM_AR,1,1);
}

callback_TC_Disp_Rq_ECM_ARTC_GasFuelCons_Reset (double value)
{
	PDU_TC_Disp_Rq_ECM_AR.TC_GasFuelCons_Reset.phys = value;
	frUpdatePDU(PDU_TC_Disp_Rq_ECM_AR,1,1);
}

callback_TC_Disp_Rq_ECM_ARTC_GasFuelCons_Start (double value)
{
	PDU_TC_Disp_Rq_ECM_AR.TC_GasFuelCons_Start.phys = value;
	frUpdatePDU(PDU_TC_Disp_Rq_ECM_AR,1,1);
}

callback_TC_Disp_Rq_ECM_ARTC_GasFuelTankRng (double value)
{
	PDU_TC_Disp_Rq_ECM_AR.TC_GasFuelTankRng.phys = value;
	frUpdatePDU(PDU_TC_Disp_Rq_ECM_AR,1,1);
}

callback_TC_Disp_Rq_ECM_ARTC_GasFuelTankLvl_Min_50 (double value)
{
	PDU_TC_Disp_Rq_ECM_AR.TC_GasFuelTankLvl_Min_50.phys = value;
	frUpdatePDU(PDU_TC_Disp_Rq_ECM_AR,1,1);
}

callback_TC_Disp_Rq_ECM_ARTC_LiquidFuelConsRecup (double value)
{
	PDU_TC_Disp_Rq_ECM_AR.TC_LiquidFuelConsRecup.phys = value;
	frUpdatePDU(PDU_TC_Disp_Rq_ECM_AR,1,1);
}

callback_TC_Disp_Rq_ECM_ARTC_LiquidFuelCons (double value)
{
	PDU_TC_Disp_Rq_ECM_AR.TC_LiquidFuelCons.phys = value;
	frUpdatePDU(PDU_TC_Disp_Rq_ECM_AR,1,1);
}

callback_TC_Disp_Rq_ECM_ARTC_LiquidFuelCons_Reset (double value)
{
	PDU_TC_Disp_Rq_ECM_AR.TC_LiquidFuelCons_Reset.phys = value;
	frUpdatePDU(PDU_TC_Disp_Rq_ECM_AR,1,1);
}

callback_TC_Disp_Rq_ECM_ARTC_LiquidFuelCons_Start (double value)
{
	PDU_TC_Disp_Rq_ECM_AR.TC_LiquidFuelCons_Start.phys = value;
	frUpdatePDU(PDU_TC_Disp_Rq_ECM_AR,1,1);
}

callback_TC_Disp_Rq_ECM_ARTC_LiquidFuelTankRng (double value)
{
	PDU_TC_Disp_Rq_ECM_AR.TC_LiquidFuelTankRng.phys = value;
	frUpdatePDU(PDU_TC_Disp_Rq_ECM_AR,1,1);
}

callback_TC_Disp_Rq_ECM_ARTC_LiquidFuelTankLvl_Min_50 (double value)
{
	PDU_TC_Disp_Rq_ECM_AR.TC_LiquidFuelTankLvl_Min_50.phys = value;
	frUpdatePDU(PDU_TC_Disp_Rq_ECM_AR,1,1);
}

callback_TC_Disp_Rq_ECM_ARTC_SkipRng_Disp_Rq (double value)
{
	PDU_TC_Disp_Rq_ECM_AR.TC_SkipRng_Disp_Rq.phys = value;
	frUpdatePDU(PDU_TC_Disp_Rq_ECM_AR,1,1);
}

callback_TC_Disp_Rq_ECM_ARTC_ElecEnergyCons (double value)
{
	PDU_TC_Disp_Rq_ECM_AR.TC_ElecEnergyCons.phys = value;
	frUpdatePDU(PDU_TC_Disp_Rq_ECM_AR,1,1);
}

callback_TC_Disp_Rq_ECM_ARTC_ElecEnergyCons_Reset (double value)
{
	PDU_TC_Disp_Rq_ECM_AR.TC_ElecEnergyCons_Reset.phys = value;
	frUpdatePDU(PDU_TC_Disp_Rq_ECM_AR,1,1);
}

callback_TC_Disp_Rq_ECM_ARTC_ElecEnergyCons_Start (double value)
{
	PDU_TC_Disp_Rq_ECM_AR.TC_ElecEnergyCons_Start.phys = value;
	frUpdatePDU(PDU_TC_Disp_Rq_ECM_AR,1,1);
}

callback_TC_Disp_Rq_ECM_ARTC_ElecEnergyRng (double value)
{
	PDU_TC_Disp_Rq_ECM_AR.TC_ElecEnergyRng.phys = value;
	frUpdatePDU(PDU_TC_Disp_Rq_ECM_AR,1,1);
}

callback_TC_Disp_Rq_ECM_ARTC_ElecEnergyLvl_Min_50 (double value)
{
	PDU_TC_Disp_Rq_ECM_AR.TC_ElecEnergyLvl_Min_50.phys = value;
	frUpdatePDU(PDU_TC_Disp_Rq_ECM_AR,1,1);
}

callback_TC_Disp_Rq_ECM_ARTC_FuelType_TC_DISP_RQ (double value)
{
	PDU_TC_Disp_Rq_ECM_AR.TC_FuelType_TC_DISP_RQ.phys = value;
	frUpdatePDU(PDU_TC_Disp_Rq_ECM_AR,1,1);
}
on frPDU MsgChannel1.CHASSIS::Adblue_Disp_Rq_AR
{
}

on frPDU MsgChannel1.CHASSIS::Adblue_Disp_Warn_Rq_AR
{
}

on frPDU MsgChannel1.CHASSIS::Assyst_Stat2_AR
{
}

on frPDU MsgChannel1.CHASSIS::Assyst_Stat3_AR2
{
}

on frPDU MsgChannel1.CHASSIS::Assyst_Stat_AR
{
}

on frPDU MsgChannel1.CHASSIS::CNG_Disp_Rq_AR2
{
}

on frPDU MsgChannel1.CHASSIS::CPC_CHASSIS_R1_AR2
{
	if (@sysvar::CH_Nodes::CH_CPCEHC_CurrCPC_CHASSI_UB_AUTO == 0)
	{
		if ($EHC_Curr != OldVal_EHC_Curr)
		{
			DisturbUB("CPC_CHASSIS_R1_AR2", "EHC_Curr_UB", 1, 1);
			OldVal_EHC_Curr = $EHC_Curr;
		}
		else
		{
			DisturbUB("CPC_CHASSIS_R1_AR2", "EHC_Curr_UB", -1, 0);
		}
	}	if (@sysvar::CH_Nodes::CH_CPCAddWtrPmp_On_Rq_EC_UB_AUTO == 0)
	{
		if ($AddWtrPmp_On_Rq_ECM != OldVal_AddWtrPmp_On_Rq_ECM)
		{
			DisturbUB("CPC_CHASSIS_R1_AR2", "AddWtrPmp_On_Rq_ECM_UB", 1, 1);
			OldVal_AddWtrPmp_On_Rq_ECM = $AddWtrPmp_On_Rq_ECM;
		}
		else
		{
			DisturbUB("CPC_CHASSIS_R1_AR2", "AddWtrPmp_On_Rq_ECM_UB", -1, 0);
		}
	}	if (@sysvar::CH_Nodes::CH_CPCPNHV_Bat_VoltCPC_C_UB_AUTO == 0)
	{
		if ($PNHV_Bat_Volt != OldVal_PNHV_Bat_Volt)
		{
			DisturbUB("CPC_CHASSIS_R1_AR2", "PNHV_Bat_Volt_UB", 1, 1);
			OldVal_PNHV_Bat_Volt = $PNHV_Bat_Volt;
		}
		else
		{
			DisturbUB("CPC_CHASSIS_R1_AR2", "PNHV_Bat_Volt_UB", -1, 0);
		}
	}	if (@sysvar::CH_Nodes::CH_CPCDCDC1_MdCPC_CHASSI_UB_AUTO == 0)
	{
		if ($DCDC1_Md != OldVal_DCDC1_Md)
		{
			DisturbUB("CPC_CHASSIS_R1_AR2", "DCDC1_Md_UB", 1, 1);
			OldVal_DCDC1_Md = $DCDC1_Md;
		}
		else
		{
			DisturbUB("CPC_CHASSIS_R1_AR2", "DCDC1_Md_UB", -1, 0);
		}
	}	if (@sysvar::CH_Nodes::CH_CPCTherm_HiTempSTOut1_UB_AUTO == 0)
	{
		if ($Therm_HiTempSTOut1 != OldVal_Therm_HiTempSTOut1)
		{
			DisturbUB("CPC_CHASSIS_R1_AR2", "Therm_HiTempSTOut1_UB", 1, 1);
			OldVal_Therm_HiTempSTOut1 = $Therm_HiTempSTOut1;
		}
		else
		{
			DisturbUB("CPC_CHASSIS_R1_AR2", "Therm_HiTempSTOut1_UB", -1, 0);
		}
	}}

on frPDU MsgChannel1.CHASSIS::CPC_CHASSIS_R2_AR2
{
}

on frPDU MsgChannel1.CHASSIS::DCDC1_Rs1_AR2
{
}

on frPDU MsgChannel1.CHASSIS::DPC_PT_Rs_AR
{
}

on frPDU MsgChannel1.CHASSIS::ECM_DAC4_AR
{
}

on frPDU MsgChannel1.CHASSIS::ECO_Homepage_Data
{
}

on frPDU MsgChannel1.CHASSIS::ECO_Score_Disp_Rq_AR
{
}

on frPDU MsgChannel1.CHASSIS::EM01_Stat1_AR2
{
}

on frPDU MsgChannel1.CHASSIS::EM01_Stat2_AR2
{
}

on frPDU MsgChannel1.CHASSIS::EM01_Trq_Rs_AR2
{
}

on frPDU MsgChannel1.CHASSIS::EM_DAC4_AR
{
}

on frPDU MsgChannel1.CHASSIS::EMM_Data1_AR2
{
}

on frPDU MsgChannel1.CHASSIS::EnergyMngmnt_PreCond_Stat_AR2
{
}

on frPDU MsgChannel1.CHASSIS::Eng_Rs_1_AR2
{
}

on frPDU MsgChannel1.CHASSIS::Eng_Rs_2_AR2
{
}

on frPDU MsgChannel1.CHASSIS::Eng_Rs_3_AR2
{
}

on frPDU MsgChannel1.CHASSIS::Eng_Rs_EM_AR2
{
}

on frPDU MsgChannel1.CHASSIS::Eng_Rs_EngCtrl_AR2
{
}

on frPDU MsgChannel1.CHASSIS::EngCtrl_Disp_Rq_AR2
{
}

on frPDU MsgChannel1.CHASSIS::EngCtrl_OBD1_AR
{
}

on frPDU MsgChannel1.CHASSIS::EngCtrl_Stat_AR2
{
}

on frPDU MsgChannel1.CHASSIS::ESP_OBD_Data_AR
{
}

on frPDU MsgChannel1.CHASSIS::Fuel_Stat2_AR2
{
}

on frPDU MsgChannel1.CHASSIS::FuelLvl_Stat_AR2
{
}

on frPDU MsgChannel1.CHASSIS::HumanMachineIfc_AR2
{
}

on frPDU MsgChannel1.CHASSIS::HumanMachineIfc_Rq_AR
{
}

on frPDU MsgChannel1.CHASSIS::ISM_DAC4_AR
{
}

on frPDU MsgChannel1.CHASSIS::OBL_DC_Output_AR
{
}

on frPDU MsgChannel1.CHASSIS::PARK_Drv_Rs_TCM_AR2
{
}

on frPDU MsgChannel1.CHASSIS::PN14_Gen_Rs_AR
{
}

on frPDU MsgChannel1.CHASSIS::PNHV_BMS_Stat_AR2
{
}

on frPDU MsgChannel1.CHASSIS::PNHV_EnergyMngmnt_Disp_Rq_AR
{
}

on frPDU MsgChannel1.CHASSIS::PNHV_EnergyMngmnt_Stat2_AR2
{
	if (@sysvar::CH_Nodes::CH_CPCTerm61_ActvPNHV_En_UB_AUTO == 0)
	{
		if ($Term61_Actv != OldVal_Term61_Actv)
		{
			DisturbUB("PNHV_EnergyMngmnt_Stat2_AR2", "Term61_Actv_UB", 1, 1);
			OldVal_Term61_Actv = $Term61_Actv;
		}
		else
		{
			DisturbUB("PNHV_EnergyMngmnt_Stat2_AR2", "Term61_Actv_UB", -1, 0);
		}
	}}

on frPDU MsgChannel1.CHASSIS::PNHV_EnergyMngmnt_Stat3_AR2
{
}

on frPDU MsgChannel1.CHASSIS::PNHV_EnergyMngmntSet_Rs1_AR2
{
}

on frPDU MsgChannel1.CHASSIS::PNHV_EnergyMngmntSet_Rs2_AR
{
}

on frPDU MsgChannel1.CHASSIS::PNHV_Stat_AR2
{
}

on frPDU MsgChannel1.CHASSIS::PNHV_WeekDepTmTbl_Stat_AR2
{
}

on frPDU MsgChannel1.CHASSIS::PT_DataContain_Rq_AR2
{
}

on frPDU MsgChannel1.CHASSIS::PT_Disp_Rq2_AR
{
}

on frPDU MsgChannel1.CHASSIS::PT_ThermM_AR2
{
}

on frPDU MsgChannel1.CHASSIS::PT_ThermM_Rq_AR2
{
}

on frPDU MsgChannel1.CHASSIS::PtHyb_Mngmnt_Rq1_AR
{
}

on frPDU MsgChannel1.CHASSIS::PtMngmnt_Disp_Rq_AR2
{
}

on frPDU MsgChannel1.CHASSIS::PtMngmnt_Rq_AR2
{
}

on frPDU MsgChannel1.CHASSIS::PtMngmnt_Stat2_AR2
{
}

on frPDU MsgChannel1.CHASSIS::PtMngmnt_Stat_AR2
{
}

on frPDU MsgChannel1.CHASSIS::SBW_DrvPosn_Disp_Rq_ISM_AR2
{
}

on frPDU MsgChannel1.CHASSIS::SBW_DrvPosn_Disp_Rq_TCM_AR2
{
}

on frPDU MsgChannel1.CHASSIS::SBW_Stat_AR2
{
}

on frPDU MsgChannel1.CHASSIS::SND_GEN_Stat_AR
{
}

on frPDU MsgChannel1.CHASSIS::TC_Disp_Rq_ECM_AR
{
}

on frPDU MsgChannel1.CHASSIS::TC_EBBC_Disp_Rq_ECM_AR
{
}

on frPDU MsgChannel1.CHASSIS::TC_EEBBC_Disp_Rq_AR
{
}

on frPDU MsgChannel1.CHASSIS::TCM_DAC4_AR
{
}

on frPDU MsgChannel1.CHASSIS::TCM_Data2_AR2
{
}

on frPDU MsgChannel1.CHASSIS::TCM_Data3_AR2
{
}

on frPDU MsgChannel1.CHASSIS::TCM_Disp_Rq_AMG_AR
{
}

on frPDU MsgChannel1.CHASSIS::TCM_State3_AR2
{
}

on frPDU MsgChannel1.CHASSIS::TCU_Disp_Rq_AR2
{
}

on frPDU MsgChannel1.CHASSIS::ThermMngmnt_1_AR2
{
}

on frPDU MsgChannel1.CHASSIS::ThermMngmnt_4_AR
{
}

on frPDU MsgChannel1.CHASSIS::ThermMngmnt_EV_1_AR2
{
}

on frPDU MsgChannel1.CHASSIS::VehPwrMngmnt_EMM_Stat2_AR2
{
}

on frPDU MsgChannel1.CHASSIS::VehPwrMngmnt_Rq_AR
{
}

on frPDU MsgChannel1.CHASSIS::WIA_EngTrq_AR
{
}

on frPDU MsgChannel1.CHASSIS::WPT_Stat2_AR2
{
}

