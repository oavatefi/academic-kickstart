/*@@includes:*/
includes
{
	#include "ASR_FR_NM_IL.CIN"
}
/*@@end*/

/*@@var:*/
/*
|==========================================================================================|
|                                                                                          |
|                                                                                          |
|                                         COPYRIGHT                                        |
|                                                                                          |
|                   Copyright (c) by Daimler AG Abt. RD/EEV 2015                           |
|                                                                                          |
|                                                                                          |
|==========================================================================================|
|                                                                                          |
|                                   CAPL AUTHOR IDENTITY                                   |
|                                   --------------------                                   |
|                                                                                          |
| Initials   | Name                 | Company                                              |
| -----------+----------------------+----------------------------------------------------- |
| BH         | Björn Haßelkus       | Firma TZM (EXTERN im Auftrag der Daimler AG)         |
| RS         | Rainer Schulte       | Firma TZM (EXTERN im Auftrag der Daimler AG)         |
|            |                      |                                                      |
|                                                                                          |
|==========================================================================================|
|                                                                                          |
|                                     REVISION HISTORY                                     |
|                                     ----------------                                     |
|                                                                                          |
| Date       | Ver   | Author       | Description                                          |
| -----------+-------+--------------+----------------------------------------------------- |
| 27.04.15   | 1.0   | RS           | creation                                             |
|            |       |              |                                                      |
|                                                                                          |
|------------------------------------------------------------------------------------------|
*/

variables
{
	long ret_Register;
	// global variable for getting (showing) results auf dll-Functions
	long result;

	int CRC_LDC_Rq_StWhl_Pr2;
	dword CounterValForCRC_LDC_Rq_StWhl_Pr2;
	int SQC_VAL_LDC_Rq_StWhl_Pr2;
	int SQC_LDC_Rq_StWhl_Pr2;
	int CRC_LDC_Rq_SCCM_Pr2;
	dword CounterValForCRC_LDC_Rq_SCCM_Pr2;
	int SQC_VAL_LDC_Rq_SCCM_Pr2;
	int SQC_LDC_Rq_SCCM_Pr2;
	int CRC_SBW_Rq_SCCM_Pr2;
	dword CounterValForCRC_SBW_Rq_SCCM_Pr2;
	int SQC_VAL_SBW_Rq_SCCM_Pr2;
	int SQC_SBW_Rq_SCCM_Pr2;
	int CRC_SCCM_Lvr_Stat_Pr2;
	dword CounterValForCRC_SCCM_Lvr_Stat_Pr2;
	int SQC_VAL_SCCM_Lvr_Stat_Pr2;
	int SQC_SCCM_Lvr_Stat_Pr2;
	int CRC_WprWashSw_Stat_Pr2;
	dword CounterValForCRC_WprWashSw_Stat_Pr2;
	int SQC_VAL_WprWashSw_Stat_Pr2;
	int SQC_WprWashSw_Stat_Pr2;
	int OldVal_StWhl_Cond_Disp_Rq = 0;
	int OldVal_HMSW_Act_Stat = 0;
	int CRC_StWhl_Angl_Stat_Pr2;
	dword CounterValForCRC_StWhl_Angl_Stat_Pr2;
	int SQC_VAL_StWhl_Angl_Stat_Pr2;
	int SQC_StWhl_Angl_Stat_Pr2;
	int OldVal_ALDW_VibMot_Stat = 0;
	int OldVal_ALDW_VibMot_Avl = 0;
	int CRC_StWhl_Sw_Ok1_Ok2_Psd_Pr2;
	dword CounterValForCRC_StWhl_Sw_Ok1_Ok2_Psd_Pr2;
	int SQC_VAL_StWhl_Sw_Ok1_Ok2_Psd_Pr2;
	int SQC_StWhl_Sw_Ok1_Ok2_Psd_Pr2;

	msTimer Timer_SCCM_LDC_Rq_StWhl_AR2;
	msTimer Timer_SCCM_LDC_SBW_Rq_SCCM_AR2;
	msTimer Timer_SCCM_ROE_SCCM;
	msTimer Timer_SCCM_ROE_SWSP;
	msTimer Timer_SCCM_SCCM_Sw_Stat_AR2;
	msTimer Timer_SCCM_StWhl_Angl_Stat_AR2;
	msTimer Timer_SCCM_StWhl_OFN_Stat_AR2;
	msTimer Timer_SCCM_StWhl_Sw_Stat_AR2;
	msTimer Timer_SCCM_WUDOP_SCCM_FR;

   byte  crctable[256] = {
      0x00, 0x1D, 0x3A, 0x27, 0x74, 0x69, 0x4E, 0x53,
      0xE8, 0xF5, 0xD2, 0xCF, 0x9C, 0x81, 0xA6, 0xBB,
      0xCD, 0xD0, 0xF7, 0xEA, 0xB9, 0xA4, 0x83, 0x9E,
      0x25, 0x38, 0x1F, 0x02, 0x51, 0x4C, 0x6B, 0x76,
      0x87, 0x9A, 0xBD, 0xA0, 0xF3, 0xEE, 0xC9, 0xD4,
      0x6F, 0x72, 0x55, 0x48, 0x1B, 0x06, 0x21, 0x3C,
      0x4A, 0x57, 0x70, 0x6D, 0x3E, 0x23, 0x04, 0x19,
      0xA2, 0xBF, 0x98, 0x85, 0xD6, 0xCB, 0xEC, 0xF1,
      0x13, 0x0E, 0x29, 0x34, 0x67, 0x7A, 0x5D, 0x40,
      0xFB, 0xE6, 0xC1, 0xDC, 0x8F, 0x92, 0xB5, 0xA8,
      0xDE, 0xC3, 0xE4, 0xF9, 0xAA, 0xB7, 0x90, 0x8D,
      0x36, 0x2B, 0x0C, 0x11, 0x42, 0x5F, 0x78, 0x65,
      0x94, 0x89, 0xAE, 0xB3, 0xE0, 0xFD, 0xDA, 0xC7,
      0x7C, 0x61, 0x46, 0x5B, 0x08, 0x15, 0x32, 0x2F,
      0x59, 0x44, 0x63, 0x7E, 0x2D, 0x30, 0x17, 0x0A,
      0xB1, 0xAC, 0x8B, 0x96, 0xC5, 0xD8, 0xFF, 0xE2,
      0x26, 0x3B, 0x1C, 0x01, 0x52, 0x4F, 0x68, 0x75,
      0xCE, 0xD3, 0xF4, 0xE9, 0xBA, 0xA7, 0x80, 0x9D,
      0xEB, 0xF6, 0xD1, 0xCC, 0x9F, 0x82, 0xA5, 0xB8,
      0x03, 0x1E, 0x39, 0x24, 0x77, 0x6A, 0x4D, 0x50,
      0xA1, 0xBC, 0x9B, 0x86, 0xD5, 0xC8, 0xEF, 0xF2,
      0x49, 0x54, 0x73, 0x6E, 0x3D, 0x20, 0x07, 0x1A,
      0x6C, 0x71, 0x56, 0x4B, 0x18, 0x05, 0x22, 0x3F,
      0x84, 0x99, 0xBE, 0xA3, 0xF0, 0xED, 0xCA, 0xD7,
      0x35, 0x28, 0x0F, 0x12, 0x41, 0x5C, 0x7B, 0x66,
      0xDD, 0xC0, 0xE7, 0xFA, 0xA9, 0xB4, 0x93, 0x8E,
      0xF8, 0xE5, 0xC2, 0xDF, 0x8C, 0x91, 0xB6, 0xAB,
      0x10, 0x0D, 0x2A, 0x37, 0x64, 0x79, 0x5E, 0x43,
      0xB2, 0xAF, 0x88, 0x95, 0xC6, 0xDB, 0xFC, 0xE1,
      0x5A, 0x47, 0x60, 0x7D, 0x2E, 0x33, 0x14, 0x09,
      0x7F, 0x62, 0x45, 0x58, 0x0B, 0x16, 0x31, 0x2C,
      0x97, 0x8A, 0xAD, 0xB0, 0xE3, 0xFE, 0xD9, 0xC4
   };

   byte  crctableProfTwo[256] = {
			0x00, 0x2F, 0x5E, 0x71, 0xBC, 0x93, 0xE2, 0xCD,
			0x57, 0x78, 0x09, 0x26, 0xEB, 0xC4, 0xB5, 0x9A,
			0xAE, 0x81, 0xF0, 0xDF, 0x12, 0x3D, 0x4C, 0x63,
			0xF9, 0xD6, 0xA7, 0x88, 0x45, 0x6A, 0x1B, 0x34,
			0x73, 0x5C, 0x2D, 0x02, 0xCF, 0xE0, 0x91, 0xBE,
			0x24, 0x0B, 0x7A, 0x55, 0x98, 0xB7, 0xC6, 0xE9,
			0xDD, 0xF2, 0x83, 0xAC, 0x61, 0x4E, 0x3F, 0x10,
			0x8A, 0xA5, 0xD4, 0xFB, 0x36, 0x19, 0x68, 0x47,
			0xE6, 0xC9, 0xB8, 0x97, 0x5A, 0x75, 0x04, 0x2B,
			0xB1, 0x9E, 0xEF, 0xC0, 0x0D, 0x22, 0x53, 0x7C,
			0x48, 0x67, 0x16, 0x39, 0xF4, 0xDB, 0xAA, 0x85,
			0x1F, 0x30, 0x41, 0x6E, 0xA3, 0x8C, 0xFD, 0xD2,
			0x95, 0xBA, 0xCB, 0xE4, 0x29, 0x06, 0x77, 0x58,
			0xC2, 0xED, 0x9C, 0xB3, 0x7E, 0x51, 0x20, 0x0F,
			0x3B, 0x14, 0x65, 0x4A, 0x87, 0xA8, 0xD9, 0xF6,
			0x6C, 0x43, 0x32, 0x1D, 0xD0, 0xFF, 0x8E, 0xA1,
			0xE3, 0xCC, 0xBD, 0x92, 0x5F, 0x70, 0x01, 0x2E,
			0xB4, 0x9B, 0xEA, 0xC5, 0x08, 0x27, 0x56, 0x79,
			0x4D, 0x62, 0x13, 0x3C, 0xF1, 0xDE, 0xAF, 0x80,
			0x1A, 0x35, 0x44, 0x6B, 0xA6, 0x89, 0xF8, 0xD7,
			0x90, 0xBF, 0xCE, 0xE1, 0x2C, 0x03, 0x72, 0x5D,
			0xC7, 0xE8, 0x99, 0xB6, 0x7B, 0x54, 0x25, 0x0A,
			0x3E, 0x11, 0x60, 0x4F, 0x82, 0xAD, 0xDC, 0xF3,
			0x69, 0x46, 0x37, 0x18, 0xD5, 0xFA, 0x8B, 0xA4,
			0x05, 0x2A, 0x5B, 0x74, 0xB9, 0x96, 0xE7, 0xC8,
			0x52, 0x7D, 0x0C, 0x23, 0xEE, 0xC1, 0xB0, 0x9F,
			0xAB, 0x84, 0xF5, 0xDA, 0x17, 0x38, 0x49, 0x66,
			0xFC, 0xD3, 0xA2, 0x8D, 0x40, 0x6F, 0x1E, 0x31,
			0x76, 0x59, 0x28, 0x07, 0xCA, 0xE5, 0x94, 0xBB,
			0x21, 0x0E, 0x7F, 0x50, 0x9D, 0xB2, 0xC3, 0xEC,
			0xD8, 0xF7, 0x86, 0xA9, 0x64, 0x4B, 0x3A, 0x15,
			0x8F, 0xA0, 0xD1, 0xFE, 0x33, 0x1C, 0x6D, 0x42
   };
}
/*@@end*/

/*@@startStart:Start:*/
on start
{
	result = EnableCRC("", 0); // 1 = on, 0 = off
	result = EnableTGL("", 0); // 1 = on, 0 = off 
	result = EnableSQC("", 0); // 1 = on, 0 = off 
	result = EnableMC("", 0); // 1 = on, 0 = off 

	if (@sysvar::CH_Nodes::CH_SCCMCRC_LDC_Rq_StWhl_Pr2_AUTO == 0)
	{
		//Automatisch
		enableControl("LDC_Rq_StWhl_AR2", "CH_SCCMCRC_LDC_Rq_StWhl_Pr2LDC__", 0); //1: enable; 0: disable
	}
	else
	{
		//Manuel
		enableControl("LDC_Rq_StWhl_AR2", "CH_SCCMCRC_LDC_Rq_StWhl_Pr2LDC__", 1); //1: enable; 0: disable
	}
	if (@sysvar::CH_Nodes::CH_SCCMSQC_LDC_Rq_StWhl_Pr2_AUTO == 0)
	{
		//Automatisch
		enableControl("LDC_Rq_StWhl_AR2", "CH_SCCMSQC_LDC_Rq_StWhl_Pr2LDC__", 0); //1: enable; 0: disable
	}
	else
	{
		//Manuel
		enableControl("LDC_Rq_StWhl_AR2", "CH_SCCMSQC_LDC_Rq_StWhl_Pr2LDC__", 1); //1: enable; 0: disable
	}
	@sysvar::CH_Nodes::CH__PDURECEIPT_SIM_SCCM_LDC_Rq_StWhl_AR2 = 1;
	if (@sysvar::CH_Nodes::CH_SCCMCRC_LDC_Rq_SCCM_Pr2L_AUTO == 0)
	{
		//Automatisch
		enableControl("LDC_SBW_Rq_SCCM_AR2", "CH_SCCMCRC_LDC_Rq_SCCM_Pr2LDC_S_", 0); //1: enable; 0: disable
	}
	else
	{
		//Manuel
		enableControl("LDC_SBW_Rq_SCCM_AR2", "CH_SCCMCRC_LDC_Rq_SCCM_Pr2LDC_S_", 1); //1: enable; 0: disable
	}
	if (@sysvar::CH_Nodes::CH_SCCMSQC_LDC_Rq_SCCM_Pr2L_AUTO == 0)
	{
		//Automatisch
		enableControl("LDC_SBW_Rq_SCCM_AR2", "CH_SCCMSQC_LDC_Rq_SCCM_Pr2LDC_S_", 0); //1: enable; 0: disable
	}
	else
	{
		//Manuel
		enableControl("LDC_SBW_Rq_SCCM_AR2", "CH_SCCMSQC_LDC_Rq_SCCM_Pr2LDC_S_", 1); //1: enable; 0: disable
	}
	if (@sysvar::CH_Nodes::CH_SCCMCRC_SBW_Rq_SCCM_Pr2L_AUTO == 0)
	{
		//Automatisch
		enableControl("LDC_SBW_Rq_SCCM_AR2", "CH_SCCMCRC_SBW_Rq_SCCM_Pr2LDC_S_", 0); //1: enable; 0: disable
	}
	else
	{
		//Manuel
		enableControl("LDC_SBW_Rq_SCCM_AR2", "CH_SCCMCRC_SBW_Rq_SCCM_Pr2LDC_S_", 1); //1: enable; 0: disable
	}
	if (@sysvar::CH_Nodes::CH_SCCMSQC_SBW_Rq_SCCM_Pr2L_AUTO == 0)
	{
		//Automatisch
		enableControl("LDC_SBW_Rq_SCCM_AR2", "CH_SCCMSQC_SBW_Rq_SCCM_Pr2LDC_S_", 0); //1: enable; 0: disable
	}
	else
	{
		//Manuel
		enableControl("LDC_SBW_Rq_SCCM_AR2", "CH_SCCMSQC_SBW_Rq_SCCM_Pr2LDC_S_", 1); //1: enable; 0: disable
	}
	@sysvar::CH_Nodes::CH__PDURECEIPT_SIM_SCCM_LDC_SBW_Rq_SCCM_AR2 = 1;
	@sysvar::CH_Nodes::CH__PDURECEIPT_SIM_SCCM_ROE_SCCM = 1;
	@sysvar::CH_Nodes::CH__PDURECEIPT_SIM_SCCM_ROE_SWSP = 1;
	if (@sysvar::CH_Nodes::CH_SCCMCRC_SCCM_Lvr_Stat_Pr_AUTO == 0)
	{
		//Automatisch
		enableControl("SCCM_Sw_Stat_AR2", "CH_SCCMCRC_SCCM_Lvr_Stat_Pr2SCC_", 0); //1: enable; 0: disable
	}
	else
	{
		//Manuel
		enableControl("SCCM_Sw_Stat_AR2", "CH_SCCMCRC_SCCM_Lvr_Stat_Pr2SCC_", 1); //1: enable; 0: disable
	}
	if (@sysvar::CH_Nodes::CH_SCCMSQC_SCCM_Lvr_Stat_Pr_AUTO == 0)
	{
		//Automatisch
		enableControl("SCCM_Sw_Stat_AR2", "CH_SCCMSQC_SCCM_Lvr_Stat_Pr2SCC_", 0); //1: enable; 0: disable
	}
	else
	{
		//Manuel
		enableControl("SCCM_Sw_Stat_AR2", "CH_SCCMSQC_SCCM_Lvr_Stat_Pr2SCC_", 1); //1: enable; 0: disable
	}
	if (@sysvar::CH_Nodes::CH_SCCMCRC_WprWashSw_Stat_P_AUTO == 0)
	{
		//Automatisch
		enableControl("SCCM_Sw_Stat_AR2", "CH_SCCMCRC_WprWashSw_Stat_Pr2SC_", 0); //1: enable; 0: disable
	}
	else
	{
		//Manuel
		enableControl("SCCM_Sw_Stat_AR2", "CH_SCCMCRC_WprWashSw_Stat_Pr2SC_", 1); //1: enable; 0: disable
	}
	if (@sysvar::CH_Nodes::CH_SCCMSQC_WprWashSw_Stat_P_AUTO == 0)
	{
		//Automatisch
		enableControl("SCCM_Sw_Stat_AR2", "CH_SCCMSQC_WprWashSw_Stat_Pr2SC_", 0); //1: enable; 0: disable
	}
	else
	{
		//Manuel
		enableControl("SCCM_Sw_Stat_AR2", "CH_SCCMSQC_WprWashSw_Stat_Pr2SC_", 1); //1: enable; 0: disable
	}
	switch (@sysvar::CH_Nodes::CH_SCCMStWhl_Cond_Disp_R_UB_AUTO)
	{
		case (0):
			enableControl("SCCM_Sw_Stat_AR2", "CH_SCCMStWhl_Cond_Disp_RqSCC_UB__UB", 0); //1: enable; 0: disable
			break;
		case (1):
			enableControl("SCCM_Sw_Stat_AR2", "CH_SCCMStWhl_Cond_Disp_RqSCC_UB__UB", 1); //1: enable; 0: disable
	 		break;
		case (2):
			enableControl("SCCM_Sw_Stat_AR2", "CH_SCCMStWhl_Cond_Disp_RqSCC_UB__UB", 0); //1: enable; 0: disable
			break;
		case (3):
			enableControl("SCCM_Sw_Stat_AR2", "CH_SCCMStWhl_Cond_Disp_RqSCC_UB__UB", 0); //1: enable; 0: disable
			break;
	}
	switch (@sysvar::CH_Nodes::CH_SCCMHMSW_Act_StatSCCM_UB_AUTO)
	{
		case (0):
			enableControl("SCCM_Sw_Stat_AR2", "CH_SCCMHMSW_Act_StatSCCM_Sw__UB__UB", 0); //1: enable; 0: disable
			break;
		case (1):
			enableControl("SCCM_Sw_Stat_AR2", "CH_SCCMHMSW_Act_StatSCCM_Sw__UB__UB", 1); //1: enable; 0: disable
	 		break;
		case (2):
			enableControl("SCCM_Sw_Stat_AR2", "CH_SCCMHMSW_Act_StatSCCM_Sw__UB__UB", 0); //1: enable; 0: disable
			break;
		case (3):
			enableControl("SCCM_Sw_Stat_AR2", "CH_SCCMHMSW_Act_StatSCCM_Sw__UB__UB", 0); //1: enable; 0: disable
			break;
	}
	@sysvar::CH_Nodes::CH__PDURECEIPT_SIM_SCCM_SCCM_Sw_Stat_AR2 = 1;
	if (@sysvar::CH_Nodes::CH_SCCMCRC_StWhl_Angl_Stat__AUTO == 0)
	{
		//Automatisch
		enableControl("StWhl_Angl_Stat_AR2", "CH_SCCMCRC_StWhl_Angl_Stat_Pr2S_", 0); //1: enable; 0: disable
	}
	else
	{
		//Manuel
		enableControl("StWhl_Angl_Stat_AR2", "CH_SCCMCRC_StWhl_Angl_Stat_Pr2S_", 1); //1: enable; 0: disable
	}
	if (@sysvar::CH_Nodes::CH_SCCMSQC_StWhl_Angl_Stat__AUTO == 0)
	{
		//Automatisch
		enableControl("StWhl_Angl_Stat_AR2", "CH_SCCMSQC_StWhl_Angl_Stat_Pr2S_", 0); //1: enable; 0: disable
	}
	else
	{
		//Manuel
		enableControl("StWhl_Angl_Stat_AR2", "CH_SCCMSQC_StWhl_Angl_Stat_Pr2S_", 1); //1: enable; 0: disable
	}
	@sysvar::CH_Nodes::CH__PDURECEIPT_SIM_SCCM_StWhl_Angl_Stat_AR2 = 1;
	@sysvar::CH_Nodes::CH__PDURECEIPT_SIM_SCCM_StWhl_OFN_Stat_AR2 = 1;
	switch (@sysvar::CH_Nodes::CH_SCCMALDW_VibMot_StatS_UB_AUTO)
	{
		case (0):
			enableControl("StWhl_Sw_Stat_AR2", "CH_SCCMALDW_VibMot_StatStWhl_UB__UB", 0); //1: enable; 0: disable
			break;
		case (1):
			enableControl("StWhl_Sw_Stat_AR2", "CH_SCCMALDW_VibMot_StatStWhl_UB__UB", 1); //1: enable; 0: disable
	 		break;
		case (2):
			enableControl("StWhl_Sw_Stat_AR2", "CH_SCCMALDW_VibMot_StatStWhl_UB__UB", 0); //1: enable; 0: disable
			break;
		case (3):
			enableControl("StWhl_Sw_Stat_AR2", "CH_SCCMALDW_VibMot_StatStWhl_UB__UB", 0); //1: enable; 0: disable
			break;
	}
	switch (@sysvar::CH_Nodes::CH_SCCMALDW_VibMot_AvlSt_UB_AUTO)
	{
		case (0):
			enableControl("StWhl_Sw_Stat_AR2", "CH_SCCMALDW_VibMot_AvlStWhl__UB__UB", 0); //1: enable; 0: disable
			break;
		case (1):
			enableControl("StWhl_Sw_Stat_AR2", "CH_SCCMALDW_VibMot_AvlStWhl__UB__UB", 1); //1: enable; 0: disable
	 		break;
		case (2):
			enableControl("StWhl_Sw_Stat_AR2", "CH_SCCMALDW_VibMot_AvlStWhl__UB__UB", 0); //1: enable; 0: disable
			break;
		case (3):
			enableControl("StWhl_Sw_Stat_AR2", "CH_SCCMALDW_VibMot_AvlStWhl__UB__UB", 0); //1: enable; 0: disable
			break;
	}
	if (@sysvar::CH_Nodes::CH_SCCMCRC_StWhl_Sw_Ok1_Ok2_AUTO == 0)
	{
		//Automatisch
		enableControl("StWhl_Sw_Stat_AR2", "CH_SCCMCRC_StWhl_Sw_Ok1_Ok2_Psd_", 0); //1: enable; 0: disable
	}
	else
	{
		//Manuel
		enableControl("StWhl_Sw_Stat_AR2", "CH_SCCMCRC_StWhl_Sw_Ok1_Ok2_Psd_", 1); //1: enable; 0: disable
	}
	if (@sysvar::CH_Nodes::CH_SCCMSQC_StWhl_Sw_Ok1_Ok2_AUTO == 0)
	{
		//Automatisch
		enableControl("StWhl_Sw_Stat_AR2", "CH_SCCMSQC_StWhl_Sw_Ok1_Ok2_Psd_", 0); //1: enable; 0: disable
	}
	else
	{
		//Manuel
		enableControl("StWhl_Sw_Stat_AR2", "CH_SCCMSQC_StWhl_Sw_Ok1_Ok2_Psd_", 1); //1: enable; 0: disable
	}
	@sysvar::CH_Nodes::CH__PDURECEIPT_SIM_SCCM_StWhl_Sw_Stat_AR2 = 1;
	@sysvar::CH_Nodes::CH__PDURECEIPT_SIM_SCCM_WUDOP_SCCM_FR = 1;
	// netzwerk management

	enableControl("CHASSIS_FR Netzmanagement", "CH__NMActive_SCCM", 1);
}
/*@@end*/

/*@@preStart:PreStart:*/
on preStart
{


}
/*@@end*/

/*@@timer:Timer_SCCM_LDC_Rq_StWhl_AR2:*/
on timer Timer_SCCM_LDC_Rq_StWhl_AR2
{
	@sysvar::CH_Nodes::CH__STPDU_SCCM_LDC_Rq_StWhl_AR2 = 0;
}
/*@@end*/

/*@@timer:Timer_SCCM_LDC_SBW_Rq_SCCM_AR2:*/
on timer Timer_SCCM_LDC_SBW_Rq_SCCM_AR2
{
	@sysvar::CH_Nodes::CH__STPDU_SCCM_LDC_SBW_Rq_SCCM_AR2 = 0;
}
/*@@end*/

/*@@timer:Timer_SCCM_ROE_SCCM:*/
on timer Timer_SCCM_ROE_SCCM
{
	@sysvar::CH_Nodes::CH__STPDU_SCCM_ROE_SCCM = 0;
}
/*@@end*/

/*@@timer:Timer_SCCM_ROE_SWSP:*/
on timer Timer_SCCM_ROE_SWSP
{
	@sysvar::CH_Nodes::CH__STPDU_SCCM_ROE_SWSP = 0;
}
/*@@end*/

/*@@timer:Timer_SCCM_SCCM_Sw_Stat_AR2:*/
on timer Timer_SCCM_SCCM_Sw_Stat_AR2
{
	@sysvar::CH_Nodes::CH__STPDU_SCCM_SCCM_Sw_Stat_AR2 = 0;
}
/*@@end*/

/*@@timer:Timer_SCCM_StWhl_Angl_Stat_AR2:*/
on timer Timer_SCCM_StWhl_Angl_Stat_AR2
{
	@sysvar::CH_Nodes::CH__STPDU_SCCM_StWhl_Angl_Stat_AR2 = 0;
}
/*@@end*/

/*@@timer:Timer_SCCM_StWhl_OFN_Stat_AR2:*/
on timer Timer_SCCM_StWhl_OFN_Stat_AR2
{
	@sysvar::CH_Nodes::CH__STPDU_SCCM_StWhl_OFN_Stat_AR2 = 0;
}
/*@@end*/

/*@@timer:Timer_SCCM_StWhl_Sw_Stat_AR2:*/
on timer Timer_SCCM_StWhl_Sw_Stat_AR2
{
	@sysvar::CH_Nodes::CH__STPDU_SCCM_StWhl_Sw_Stat_AR2 = 0;
}
/*@@end*/

/*@@timer:Timer_SCCM_WUDOP_SCCM_FR:*/
on timer Timer_SCCM_WUDOP_SCCM_FR
{
	@sysvar::CH_Nodes::CH__STPDU_SCCM_WUDOP_SCCM_FR = 0;
}
/*@@end*/



/*@@sysvarChange:CH_Nodes::CH__STPDU_SCCM_LDC_Rq_StWhl_AR2:*/
on sysvar sysvar::CH_Nodes::CH__STPDU_SCCM_LDC_Rq_StWhl_AR2
{
	long res;
	long tDelay;
	switch (@this)
	{
		case (0):
			res = ResetTimingCyclic("LDC_Rq_StWhl_AR2");
			res = ResetTimingEvtTrg("LDC_Rq_StWhl_AR2");
			res = EnableTimingCyclic("LDC_Rq_StWhl_AR2", 1);
			res = EnableTimingEvtTrg("LDC_Rq_StWhl_AR2", 1);
			break;
		case (1):
			tDelay = @sysvar::CH_Nodes::CH__STPDU_T_SCCM_LDC_Rq_StWhl_AR2;
			if (tDelay > 0)
			{
				if (isTimerActive(Timer_SCCM_LDC_Rq_StWhl_AR2) == 0)
				{
					res = SetTimingCyclic("LDC_Rq_StWhl_AR2", 1, tDelay, 1);
					setTimer (Timer_SCCM_LDC_Rq_StWhl_AR2, tDelay);
					@sysvar::CH_Nodes::CH__STPDU_SCCM_LDC_Rq_StWhl_AR2 = 2;
				}
			}
			else if (tDelay == 0)
			{
				if (isTimerActive(Timer_SCCM_LDC_Rq_StWhl_AR2) == 0)
				{
					res = EnableTimingCyclic("LDC_Rq_StWhl_AR2", 0);
					res = EnableTimingEvtTrg("LDC_Rq_StWhl_AR2", 0);
				}
			}
			break;
		case (2):
			break;
		default:
			Write("error: wrong parameter (%d)", @this);
			stop();
			break;
	}
}
/*@@end*/

/*@@sysvarChange:CH_Nodes::CH__STPDU_SCCM_LDC_SBW_Rq_SCCM_AR2:*/
on sysvar sysvar::CH_Nodes::CH__STPDU_SCCM_LDC_SBW_Rq_SCCM_AR2
{
	long res;
	long tDelay;
	switch (@this)
	{
		case (0):
			res = ResetTimingCyclic("LDC_SBW_Rq_SCCM_AR2");
			res = ResetTimingEvtTrg("LDC_SBW_Rq_SCCM_AR2");
			res = EnableTimingCyclic("LDC_SBW_Rq_SCCM_AR2", 1);
			res = EnableTimingEvtTrg("LDC_SBW_Rq_SCCM_AR2", 1);
			break;
		case (1):
			tDelay = @sysvar::CH_Nodes::CH__STPDU_T_SCCM_LDC_SBW_Rq_SCCM_AR2;
			if (tDelay > 0)
			{
				if (isTimerActive(Timer_SCCM_LDC_SBW_Rq_SCCM_AR2) == 0)
				{
					res = SetTimingCyclic("LDC_SBW_Rq_SCCM_AR2", 1, tDelay, 1);
					setTimer (Timer_SCCM_LDC_SBW_Rq_SCCM_AR2, tDelay);
					@sysvar::CH_Nodes::CH__STPDU_SCCM_LDC_SBW_Rq_SCCM_AR2 = 2;
				}
			}
			else if (tDelay == 0)
			{
				if (isTimerActive(Timer_SCCM_LDC_SBW_Rq_SCCM_AR2) == 0)
				{
					res = EnableTimingCyclic("LDC_SBW_Rq_SCCM_AR2", 0);
					res = EnableTimingEvtTrg("LDC_SBW_Rq_SCCM_AR2", 0);
				}
			}
			break;
		case (2):
			break;
		default:
			Write("error: wrong parameter (%d)", @this);
			stop();
			break;
	}
}
/*@@end*/

/*@@sysvarChange:CH_Nodes::CH__STPDU_SCCM_ROE_SCCM:*/
on sysvar sysvar::CH_Nodes::CH__STPDU_SCCM_ROE_SCCM
{
	long res;
	long tDelay;
	switch (@this)
	{
		case (0):
			res = ResetTimingCyclic("ROE_SCCM");
			res = ResetTimingEvtTrg("ROE_SCCM");
			res = EnableTimingCyclic("ROE_SCCM", 1);
			res = EnableTimingEvtTrg("ROE_SCCM", 1);
			break;
		case (1):
			tDelay = @sysvar::CH_Nodes::CH__STPDU_T_SCCM_ROE_SCCM;
			if (tDelay > 0)
			{
				if (isTimerActive(Timer_SCCM_ROE_SCCM) == 0)
				{
					res = SetTimingCyclic("ROE_SCCM", 1, tDelay, 1);
					setTimer (Timer_SCCM_ROE_SCCM, tDelay);
					@sysvar::CH_Nodes::CH__STPDU_SCCM_ROE_SCCM = 2;
				}
			}
			else if (tDelay == 0)
			{
				if (isTimerActive(Timer_SCCM_ROE_SCCM) == 0)
				{
					res = EnableTimingCyclic("ROE_SCCM", 0);
					res = EnableTimingEvtTrg("ROE_SCCM", 0);
				}
			}
			break;
		case (2):
			break;
		default:
			Write("error: wrong parameter (%d)", @this);
			stop();
			break;
	}
}
/*@@end*/

/*@@sysvarChange:CH_Nodes::CH__STPDU_SCCM_ROE_SWSP:*/
on sysvar sysvar::CH_Nodes::CH__STPDU_SCCM_ROE_SWSP
{
	long res;
	long tDelay;
	switch (@this)
	{
		case (0):
			res = ResetTimingCyclic("ROE_SWSP");
			res = ResetTimingEvtTrg("ROE_SWSP");
			res = EnableTimingCyclic("ROE_SWSP", 1);
			res = EnableTimingEvtTrg("ROE_SWSP", 1);
			break;
		case (1):
			tDelay = @sysvar::CH_Nodes::CH__STPDU_T_SCCM_ROE_SWSP;
			if (tDelay > 0)
			{
				if (isTimerActive(Timer_SCCM_ROE_SWSP) == 0)
				{
					res = SetTimingCyclic("ROE_SWSP", 1, tDelay, 1);
					setTimer (Timer_SCCM_ROE_SWSP, tDelay);
					@sysvar::CH_Nodes::CH__STPDU_SCCM_ROE_SWSP = 2;
				}
			}
			else if (tDelay == 0)
			{
				if (isTimerActive(Timer_SCCM_ROE_SWSP) == 0)
				{
					res = EnableTimingCyclic("ROE_SWSP", 0);
					res = EnableTimingEvtTrg("ROE_SWSP", 0);
				}
			}
			break;
		case (2):
			break;
		default:
			Write("error: wrong parameter (%d)", @this);
			stop();
			break;
	}
}
/*@@end*/

/*@@sysvarChange:CH_Nodes::CH__STPDU_SCCM_SCCM_Sw_Stat_AR2:*/
on sysvar sysvar::CH_Nodes::CH__STPDU_SCCM_SCCM_Sw_Stat_AR2
{
	long res;
	long tDelay;
	switch (@this)
	{
		case (0):
			res = ResetTimingCyclic("SCCM_Sw_Stat_AR2");
			res = ResetTimingEvtTrg("SCCM_Sw_Stat_AR2");
			res = EnableTimingCyclic("SCCM_Sw_Stat_AR2", 1);
			res = EnableTimingEvtTrg("SCCM_Sw_Stat_AR2", 1);
			break;
		case (1):
			tDelay = @sysvar::CH_Nodes::CH__STPDU_T_SCCM_SCCM_Sw_Stat_AR2;
			if (tDelay > 0)
			{
				if (isTimerActive(Timer_SCCM_SCCM_Sw_Stat_AR2) == 0)
				{
					res = SetTimingCyclic("SCCM_Sw_Stat_AR2", 1, tDelay, 1);
					setTimer (Timer_SCCM_SCCM_Sw_Stat_AR2, tDelay);
					@sysvar::CH_Nodes::CH__STPDU_SCCM_SCCM_Sw_Stat_AR2 = 2;
				}
			}
			else if (tDelay == 0)
			{
				if (isTimerActive(Timer_SCCM_SCCM_Sw_Stat_AR2) == 0)
				{
					res = EnableTimingCyclic("SCCM_Sw_Stat_AR2", 0);
					res = EnableTimingEvtTrg("SCCM_Sw_Stat_AR2", 0);
				}
			}
			break;
		case (2):
			break;
		default:
			Write("error: wrong parameter (%d)", @this);
			stop();
			break;
	}
}
/*@@end*/

/*@@sysvarChange:CH_Nodes::CH__STPDU_SCCM_StWhl_Angl_Stat_AR2:*/
on sysvar sysvar::CH_Nodes::CH__STPDU_SCCM_StWhl_Angl_Stat_AR2
{
	long res;
	long tDelay;
	switch (@this)
	{
		case (0):
			res = ResetTimingCyclic("StWhl_Angl_Stat_AR2");
			res = ResetTimingEvtTrg("StWhl_Angl_Stat_AR2");
			res = EnableTimingCyclic("StWhl_Angl_Stat_AR2", 1);
			res = EnableTimingEvtTrg("StWhl_Angl_Stat_AR2", 1);
			break;
		case (1):
			tDelay = @sysvar::CH_Nodes::CH__STPDU_T_SCCM_StWhl_Angl_Stat_AR2;
			if (tDelay > 0)
			{
				if (isTimerActive(Timer_SCCM_StWhl_Angl_Stat_AR2) == 0)
				{
					res = SetTimingCyclic("StWhl_Angl_Stat_AR2", 1, tDelay, 1);
					setTimer (Timer_SCCM_StWhl_Angl_Stat_AR2, tDelay);
					@sysvar::CH_Nodes::CH__STPDU_SCCM_StWhl_Angl_Stat_AR2 = 2;
				}
			}
			else if (tDelay == 0)
			{
				if (isTimerActive(Timer_SCCM_StWhl_Angl_Stat_AR2) == 0)
				{
					res = EnableTimingCyclic("StWhl_Angl_Stat_AR2", 0);
					res = EnableTimingEvtTrg("StWhl_Angl_Stat_AR2", 0);
				}
			}
			break;
		case (2):
			break;
		default:
			Write("error: wrong parameter (%d)", @this);
			stop();
			break;
	}
}
/*@@end*/

/*@@sysvarChange:CH_Nodes::CH__STPDU_SCCM_StWhl_OFN_Stat_AR2:*/
on sysvar sysvar::CH_Nodes::CH__STPDU_SCCM_StWhl_OFN_Stat_AR2
{
	long res;
	long tDelay;
	switch (@this)
	{
		case (0):
			res = ResetTimingCyclic("StWhl_OFN_Stat_AR2");
			res = ResetTimingEvtTrg("StWhl_OFN_Stat_AR2");
			res = EnableTimingCyclic("StWhl_OFN_Stat_AR2", 1);
			res = EnableTimingEvtTrg("StWhl_OFN_Stat_AR2", 1);
			break;
		case (1):
			tDelay = @sysvar::CH_Nodes::CH__STPDU_T_SCCM_StWhl_OFN_Stat_AR2;
			if (tDelay > 0)
			{
				if (isTimerActive(Timer_SCCM_StWhl_OFN_Stat_AR2) == 0)
				{
					res = SetTimingCyclic("StWhl_OFN_Stat_AR2", 1, tDelay, 1);
					setTimer (Timer_SCCM_StWhl_OFN_Stat_AR2, tDelay);
					@sysvar::CH_Nodes::CH__STPDU_SCCM_StWhl_OFN_Stat_AR2 = 2;
				}
			}
			else if (tDelay == 0)
			{
				if (isTimerActive(Timer_SCCM_StWhl_OFN_Stat_AR2) == 0)
				{
					res = EnableTimingCyclic("StWhl_OFN_Stat_AR2", 0);
					res = EnableTimingEvtTrg("StWhl_OFN_Stat_AR2", 0);
				}
			}
			break;
		case (2):
			break;
		default:
			Write("error: wrong parameter (%d)", @this);
			stop();
			break;
	}
}
/*@@end*/

/*@@sysvarChange:CH_Nodes::CH__STPDU_SCCM_StWhl_Sw_Stat_AR2:*/
on sysvar sysvar::CH_Nodes::CH__STPDU_SCCM_StWhl_Sw_Stat_AR2
{
	long res;
	long tDelay;
	switch (@this)
	{
		case (0):
			res = ResetTimingCyclic("StWhl_Sw_Stat_AR2");
			res = ResetTimingEvtTrg("StWhl_Sw_Stat_AR2");
			res = EnableTimingCyclic("StWhl_Sw_Stat_AR2", 1);
			res = EnableTimingEvtTrg("StWhl_Sw_Stat_AR2", 1);
			break;
		case (1):
			tDelay = @sysvar::CH_Nodes::CH__STPDU_T_SCCM_StWhl_Sw_Stat_AR2;
			if (tDelay > 0)
			{
				if (isTimerActive(Timer_SCCM_StWhl_Sw_Stat_AR2) == 0)
				{
					res = SetTimingCyclic("StWhl_Sw_Stat_AR2", 1, tDelay, 1);
					setTimer (Timer_SCCM_StWhl_Sw_Stat_AR2, tDelay);
					@sysvar::CH_Nodes::CH__STPDU_SCCM_StWhl_Sw_Stat_AR2 = 2;
				}
			}
			else if (tDelay == 0)
			{
				if (isTimerActive(Timer_SCCM_StWhl_Sw_Stat_AR2) == 0)
				{
					res = EnableTimingCyclic("StWhl_Sw_Stat_AR2", 0);
					res = EnableTimingEvtTrg("StWhl_Sw_Stat_AR2", 0);
				}
			}
			break;
		case (2):
			break;
		default:
			Write("error: wrong parameter (%d)", @this);
			stop();
			break;
	}
}
/*@@end*/

/*@@sysvarChange:CH_Nodes::CH__STPDU_SCCM_WUDOP_SCCM_FR:*/
on sysvar sysvar::CH_Nodes::CH__STPDU_SCCM_WUDOP_SCCM_FR
{
	long res;
	long tDelay;
	switch (@this)
	{
		case (0):
			res = ResetTimingCyclic("WUDOP_SCCM_FR");
			res = ResetTimingEvtTrg("WUDOP_SCCM_FR");
			res = EnableTimingCyclic("WUDOP_SCCM_FR", 1);
			res = EnableTimingEvtTrg("WUDOP_SCCM_FR", 1);
			break;
		case (1):
			tDelay = @sysvar::CH_Nodes::CH__STPDU_T_SCCM_WUDOP_SCCM_FR;
			if (tDelay > 0)
			{
				if (isTimerActive(Timer_SCCM_WUDOP_SCCM_FR) == 0)
				{
					res = SetTimingCyclic("WUDOP_SCCM_FR", 1, tDelay, 1);
					setTimer (Timer_SCCM_WUDOP_SCCM_FR, tDelay);
					@sysvar::CH_Nodes::CH__STPDU_SCCM_WUDOP_SCCM_FR = 2;
				}
			}
			else if (tDelay == 0)
			{
				if (isTimerActive(Timer_SCCM_WUDOP_SCCM_FR) == 0)
				{
					res = EnableTimingCyclic("WUDOP_SCCM_FR", 0);
					res = EnableTimingEvtTrg("WUDOP_SCCM_FR", 0);
				}
			}
			break;
		case (2):
			break;
		default:
			Write("error: wrong parameter (%d)", @this);
			stop();
			break;
	}
}
/*@@end*/


/*@@sysvarChange:CH_Nodes::CH_SCCMLDC_Rq_StWhl_AR2_UB_AUTO:*/
on sysvar sysvar::CH_Nodes::CH_SCCMLDC_Rq_StWhl_AR2_UB_AUTO
{
	switch (@sysvar::CH_Nodes::CH_SCCMLDC_Rq_StWhl_AR2_UB_AUTO)
	{
		case (0):
			enableControl("LDC_Rq_StWhl_AR2", "CH_SCCMLDC_Rq_StWhl_AR2_UB_", 0); //1: enable; 0: disable
			@sysvar::CH_Nodes::CH_SCCMLDC_Rq_StWhl_AR2_UB_ = 1;
			break;
		case (1):
			enableControl("LDC_Rq_StWhl_AR2", "CH_SCCMLDC_Rq_StWhl_AR2_UB_", 1); //1: enable; 0: disable
			break;
		case (2):
			enableControl("LDC_Rq_StWhl_AR2", "CH_SCCMLDC_Rq_StWhl_AR2_UB_", 0); //1: enable; 0: disable
			@sysvar::CH_Nodes::CH_SCCMLDC_Rq_StWhl_AR2_UB_ = 1;
			break;
		case (3):
			enableControl("LDC_Rq_StWhl_AR2", "CH_SCCMLDC_Rq_StWhl_AR2_UB_", 0); //1: enable; 0: disable
			@sysvar::CH_Nodes::CH_SCCMLDC_Rq_StWhl_AR2_UB_ = 0;
			break;
	}
}
/*@@end*/

/*@@sysvarChange:CH_Nodes::CH_SCCMCRC_LDC_Rq_StWhl_Pr2_AUTO:*/
on sysvar sysvar::CH_Nodes::CH_SCCMCRC_LDC_Rq_StWhl_Pr2_AUTO
{
//	EnableCRC("LDC_Rq_StWhl_AR2",  "LDC_Rq_StWhl_Pr2", !@this); // 1 = on, 0 = off 
	enableControl("LDC_Rq_StWhl_AR2", "CH_SCCMCRC_LDC_Rq_StWhl_Pr2LDC__", @this); //1: enable; 0: disable
	CRC_LDC_Rq_StWhl_Pr2 = @sysvar::CH_Nodes::CH_SCCMCRC_LDC_Rq_StWhl_Pr2_AUTO;
}
/*@@end*/

/*@@sysvarChange:CH_Nodes::CH_SCCMSQC_LDC_Rq_StWhl_Pr2_AUTO:*/
on sysvar sysvar::CH_Nodes::CH_SCCMSQC_LDC_Rq_StWhl_Pr2_AUTO
{
//	EnableSQC("LDC_Rq_StWhl_AR2",  "LDC_Rq_StWhl_Pr2", !@this); // 1 = on, 0 = off 
	enableControl("LDC_Rq_StWhl_AR2", "CH_SCCMSQC_LDC_Rq_StWhl_Pr2LDC__", @this); //1: enable; 0: disable
	SQC_LDC_Rq_StWhl_Pr2 = @sysvar::CH_Nodes::CH_SCCMSQC_LDC_Rq_StWhl_Pr2_AUTO;
}
/*@@end*/

/*@@sysvarChange:CH_Nodes::CH_SCCMLDC_SBW_Rq_SCCM_A_UB_AUTO:*/
on sysvar sysvar::CH_Nodes::CH_SCCMLDC_SBW_Rq_SCCM_A_UB_AUTO
{
	switch (@sysvar::CH_Nodes::CH_SCCMLDC_SBW_Rq_SCCM_A_UB_AUTO)
	{
		case (0):
			enableControl("LDC_SBW_Rq_SCCM_AR2", "CH_SCCMLDC_SBW_Rq_SCCM_AR2_UB_", 0); //1: enable; 0: disable
			@sysvar::CH_Nodes::CH_SCCMLDC_SBW_Rq_SCCM_AR2_UB_ = 1;
			break;
		case (1):
			enableControl("LDC_SBW_Rq_SCCM_AR2", "CH_SCCMLDC_SBW_Rq_SCCM_AR2_UB_", 1); //1: enable; 0: disable
			break;
		case (2):
			enableControl("LDC_SBW_Rq_SCCM_AR2", "CH_SCCMLDC_SBW_Rq_SCCM_AR2_UB_", 0); //1: enable; 0: disable
			@sysvar::CH_Nodes::CH_SCCMLDC_SBW_Rq_SCCM_AR2_UB_ = 1;
			break;
		case (3):
			enableControl("LDC_SBW_Rq_SCCM_AR2", "CH_SCCMLDC_SBW_Rq_SCCM_AR2_UB_", 0); //1: enable; 0: disable
			@sysvar::CH_Nodes::CH_SCCMLDC_SBW_Rq_SCCM_AR2_UB_ = 0;
			break;
	}
}
/*@@end*/

/*@@sysvarChange:CH_Nodes::CH_SCCMCRC_LDC_Rq_SCCM_Pr2L_AUTO:*/
on sysvar sysvar::CH_Nodes::CH_SCCMCRC_LDC_Rq_SCCM_Pr2L_AUTO
{
//	EnableCRC("LDC_SBW_Rq_SCCM_AR2",  "LDC_Rq_SCCM_Pr2", !@this); // 1 = on, 0 = off 
	enableControl("LDC_SBW_Rq_SCCM_AR2", "CH_SCCMCRC_LDC_Rq_SCCM_Pr2LDC_S_", @this); //1: enable; 0: disable
	CRC_LDC_Rq_SCCM_Pr2 = @sysvar::CH_Nodes::CH_SCCMCRC_LDC_Rq_SCCM_Pr2L_AUTO;
}
/*@@end*/

/*@@sysvarChange:CH_Nodes::CH_SCCMSQC_LDC_Rq_SCCM_Pr2L_AUTO:*/
on sysvar sysvar::CH_Nodes::CH_SCCMSQC_LDC_Rq_SCCM_Pr2L_AUTO
{
//	EnableSQC("LDC_SBW_Rq_SCCM_AR2",  "LDC_Rq_SCCM_Pr2", !@this); // 1 = on, 0 = off 
	enableControl("LDC_SBW_Rq_SCCM_AR2", "CH_SCCMSQC_LDC_Rq_SCCM_Pr2LDC_S_", @this); //1: enable; 0: disable
	SQC_LDC_Rq_SCCM_Pr2 = @sysvar::CH_Nodes::CH_SCCMSQC_LDC_Rq_SCCM_Pr2L_AUTO;
}
/*@@end*/

/*@@sysvarChange:CH_Nodes::CH_SCCMCRC_SBW_Rq_SCCM_Pr2L_AUTO:*/
on sysvar sysvar::CH_Nodes::CH_SCCMCRC_SBW_Rq_SCCM_Pr2L_AUTO
{
//	EnableCRC("LDC_SBW_Rq_SCCM_AR2",  "SBW_Rq_SCCM_Pr2", !@this); // 1 = on, 0 = off 
	enableControl("LDC_SBW_Rq_SCCM_AR2", "CH_SCCMCRC_SBW_Rq_SCCM_Pr2LDC_S_", @this); //1: enable; 0: disable
	CRC_SBW_Rq_SCCM_Pr2 = @sysvar::CH_Nodes::CH_SCCMCRC_SBW_Rq_SCCM_Pr2L_AUTO;
}
/*@@end*/

/*@@sysvarChange:CH_Nodes::CH_SCCMSQC_SBW_Rq_SCCM_Pr2L_AUTO:*/
on sysvar sysvar::CH_Nodes::CH_SCCMSQC_SBW_Rq_SCCM_Pr2L_AUTO
{
//	EnableSQC("LDC_SBW_Rq_SCCM_AR2",  "SBW_Rq_SCCM_Pr2", !@this); // 1 = on, 0 = off 
	enableControl("LDC_SBW_Rq_SCCM_AR2", "CH_SCCMSQC_SBW_Rq_SCCM_Pr2LDC_S_", @this); //1: enable; 0: disable
	SQC_SBW_Rq_SCCM_Pr2 = @sysvar::CH_Nodes::CH_SCCMSQC_SBW_Rq_SCCM_Pr2L_AUTO;
}
/*@@end*/

/*@@sysvarChange:CH_Nodes::CH_SCCMSCCM_Sw_Stat_AR2_UB_AUTO:*/
on sysvar sysvar::CH_Nodes::CH_SCCMSCCM_Sw_Stat_AR2_UB_AUTO
{
	switch (@sysvar::CH_Nodes::CH_SCCMSCCM_Sw_Stat_AR2_UB_AUTO)
	{
		case (0):
			enableControl("SCCM_Sw_Stat_AR2", "CH_SCCMSCCM_Sw_Stat_AR2_UB_", 0); //1: enable; 0: disable
			@sysvar::CH_Nodes::CH_SCCMSCCM_Sw_Stat_AR2_UB_ = 1;
			break;
		case (1):
			enableControl("SCCM_Sw_Stat_AR2", "CH_SCCMSCCM_Sw_Stat_AR2_UB_", 1); //1: enable; 0: disable
			break;
		case (2):
			enableControl("SCCM_Sw_Stat_AR2", "CH_SCCMSCCM_Sw_Stat_AR2_UB_", 0); //1: enable; 0: disable
			@sysvar::CH_Nodes::CH_SCCMSCCM_Sw_Stat_AR2_UB_ = 1;
			break;
		case (3):
			enableControl("SCCM_Sw_Stat_AR2", "CH_SCCMSCCM_Sw_Stat_AR2_UB_", 0); //1: enable; 0: disable
			@sysvar::CH_Nodes::CH_SCCMSCCM_Sw_Stat_AR2_UB_ = 0;
			break;
	}
}
/*@@end*/

/*@@sysvarChange:CH_Nodes::CH_SCCMCRC_SCCM_Lvr_Stat_Pr_AUTO:*/
on sysvar sysvar::CH_Nodes::CH_SCCMCRC_SCCM_Lvr_Stat_Pr_AUTO
{
//	EnableCRC("SCCM_Sw_Stat_AR2",  "SCCM_Lvr_Stat_Pr2", !@this); // 1 = on, 0 = off 
	enableControl("SCCM_Sw_Stat_AR2", "CH_SCCMCRC_SCCM_Lvr_Stat_Pr2SCC_", @this); //1: enable; 0: disable
	CRC_SCCM_Lvr_Stat_Pr2 = @sysvar::CH_Nodes::CH_SCCMCRC_SCCM_Lvr_Stat_Pr_AUTO;
}
/*@@end*/

/*@@sysvarChange:CH_Nodes::CH_SCCMSQC_SCCM_Lvr_Stat_Pr_AUTO:*/
on sysvar sysvar::CH_Nodes::CH_SCCMSQC_SCCM_Lvr_Stat_Pr_AUTO
{
//	EnableSQC("SCCM_Sw_Stat_AR2",  "SCCM_Lvr_Stat_Pr2", !@this); // 1 = on, 0 = off 
	enableControl("SCCM_Sw_Stat_AR2", "CH_SCCMSQC_SCCM_Lvr_Stat_Pr2SCC_", @this); //1: enable; 0: disable
	SQC_SCCM_Lvr_Stat_Pr2 = @sysvar::CH_Nodes::CH_SCCMSQC_SCCM_Lvr_Stat_Pr_AUTO;
}
/*@@end*/

/*@@sysvarChange:CH_Nodes::CH_SCCMCRC_WprWashSw_Stat_P_AUTO:*/
on sysvar sysvar::CH_Nodes::CH_SCCMCRC_WprWashSw_Stat_P_AUTO
{
//	EnableCRC("SCCM_Sw_Stat_AR2",  "WprWashSw_Stat_Pr2", !@this); // 1 = on, 0 = off 
	enableControl("SCCM_Sw_Stat_AR2", "CH_SCCMCRC_WprWashSw_Stat_Pr2SC_", @this); //1: enable; 0: disable
	CRC_WprWashSw_Stat_Pr2 = @sysvar::CH_Nodes::CH_SCCMCRC_WprWashSw_Stat_P_AUTO;
}
/*@@end*/

/*@@sysvarChange:CH_Nodes::CH_SCCMSQC_WprWashSw_Stat_P_AUTO:*/
on sysvar sysvar::CH_Nodes::CH_SCCMSQC_WprWashSw_Stat_P_AUTO
{
//	EnableSQC("SCCM_Sw_Stat_AR2",  "WprWashSw_Stat_Pr2", !@this); // 1 = on, 0 = off 
	enableControl("SCCM_Sw_Stat_AR2", "CH_SCCMSQC_WprWashSw_Stat_Pr2SC_", @this); //1: enable; 0: disable
	SQC_WprWashSw_Stat_Pr2 = @sysvar::CH_Nodes::CH_SCCMSQC_WprWashSw_Stat_P_AUTO;
}
/*@@end*/

/*@@sysvarChange:CH_Nodes::CH_SCCMStWhl_Cond_Disp_R_UB_AUTO:*/
on sysvar sysvar::CH_Nodes::CH_SCCMStWhl_Cond_Disp_R_UB_AUTO
{
    switch (@sysvar::CH_Nodes::CH_SCCMStWhl_Cond_Disp_R_UB_AUTO)
    {
		case (0):
        	EnableUB("SCCM_Sw_Stat_AR2", 1);						// 1 = on, 0 = off
					DisturbUB("SCCM_Sw_Stat_AR2", "StWhl_Cond_Disp_Rq_UB", -1, 0);	//Update-Bit immer gleich 0
					enableControl("SCCM_Sw_Stat_AR2", "CH_SCCMStWhl_Cond_Disp_RqSCC_UB__UB", 0); //1: enable; 0: disable
					break;
		case (1):
        	EnableUB("SCCM_Sw_Stat_AR2", 0);						// 1 = on, 0 = off
					enableControl("SCCM_Sw_Stat_AR2", "CH_SCCMStWhl_Cond_Disp_RqSCC_UB__UB", 1); //1: enable; 0: disable
					break;
		case (2):
        	EnableUB("SCCM_Sw_Stat_AR2", 1);						// 1 = on, 0 = off
        	DisturbUB("SCCM_Sw_Stat_AR2", "StWhl_Cond_Disp_Rq_UB", -1, 1);	//Update-Bit immer gleich 1
					enableControl("SCCM_Sw_Stat_AR2", "CH_SCCMStWhl_Cond_Disp_RqSCC_UB__UB", 0); //1: enable; 0: disable
					break;
		case (3):
        	EnableUB("SCCM_Sw_Stat_AR2", 1);						// 1 = on, 0 = off
        	DisturbUB("SCCM_Sw_Stat_AR2", "StWhl_Cond_Disp_Rq_UB", -1, 0);	//Update-Bit immer gleich 0
					enableControl("SCCM_Sw_Stat_AR2", "CH_SCCMStWhl_Cond_Disp_RqSCC_UB__UB", 0); //1: enable; 0: disable
					break;
    }
}
/*@@end*/
/*@@sysvarChange:CH_Nodes::CH_SCCMHMSW_Act_StatSCCM_UB_AUTO:*/
on sysvar sysvar::CH_Nodes::CH_SCCMHMSW_Act_StatSCCM_UB_AUTO
{
    switch (@sysvar::CH_Nodes::CH_SCCMHMSW_Act_StatSCCM_UB_AUTO)
    {
		case (0):
        	EnableUB("SCCM_Sw_Stat_AR2", 1);						// 1 = on, 0 = off
					DisturbUB("SCCM_Sw_Stat_AR2", "HMSW_Act_Stat_UB", -1, 0);	//Update-Bit immer gleich 0
					enableControl("SCCM_Sw_Stat_AR2", "CH_SCCMHMSW_Act_StatSCCM_Sw__UB__UB", 0); //1: enable; 0: disable
					break;
		case (1):
        	EnableUB("SCCM_Sw_Stat_AR2", 0);						// 1 = on, 0 = off
					enableControl("SCCM_Sw_Stat_AR2", "CH_SCCMHMSW_Act_StatSCCM_Sw__UB__UB", 1); //1: enable; 0: disable
					break;
		case (2):
        	EnableUB("SCCM_Sw_Stat_AR2", 1);						// 1 = on, 0 = off
        	DisturbUB("SCCM_Sw_Stat_AR2", "HMSW_Act_Stat_UB", -1, 1);	//Update-Bit immer gleich 1
					enableControl("SCCM_Sw_Stat_AR2", "CH_SCCMHMSW_Act_StatSCCM_Sw__UB__UB", 0); //1: enable; 0: disable
					break;
		case (3):
        	EnableUB("SCCM_Sw_Stat_AR2", 1);						// 1 = on, 0 = off
        	DisturbUB("SCCM_Sw_Stat_AR2", "HMSW_Act_Stat_UB", -1, 0);	//Update-Bit immer gleich 0
					enableControl("SCCM_Sw_Stat_AR2", "CH_SCCMHMSW_Act_StatSCCM_Sw__UB__UB", 0); //1: enable; 0: disable
					break;
    }
}
/*@@end*/
/*@@sysvarChange:CH_Nodes::CH_SCCMStWhl_Angl_Stat_A_UB_AUTO:*/
on sysvar sysvar::CH_Nodes::CH_SCCMStWhl_Angl_Stat_A_UB_AUTO
{
	switch (@sysvar::CH_Nodes::CH_SCCMStWhl_Angl_Stat_A_UB_AUTO)
	{
		case (0):
			enableControl("StWhl_Angl_Stat_AR2", "CH_SCCMStWhl_Angl_Stat_AR2_UB_", 0); //1: enable; 0: disable
			@sysvar::CH_Nodes::CH_SCCMStWhl_Angl_Stat_AR2_UB_ = 1;
			break;
		case (1):
			enableControl("StWhl_Angl_Stat_AR2", "CH_SCCMStWhl_Angl_Stat_AR2_UB_", 1); //1: enable; 0: disable
			break;
		case (2):
			enableControl("StWhl_Angl_Stat_AR2", "CH_SCCMStWhl_Angl_Stat_AR2_UB_", 0); //1: enable; 0: disable
			@sysvar::CH_Nodes::CH_SCCMStWhl_Angl_Stat_AR2_UB_ = 1;
			break;
		case (3):
			enableControl("StWhl_Angl_Stat_AR2", "CH_SCCMStWhl_Angl_Stat_AR2_UB_", 0); //1: enable; 0: disable
			@sysvar::CH_Nodes::CH_SCCMStWhl_Angl_Stat_AR2_UB_ = 0;
			break;
	}
}
/*@@end*/

/*@@sysvarChange:CH_Nodes::CH_SCCMCRC_StWhl_Angl_Stat__AUTO:*/
on sysvar sysvar::CH_Nodes::CH_SCCMCRC_StWhl_Angl_Stat__AUTO
{
//	EnableCRC("StWhl_Angl_Stat_AR2",  "StWhl_Angl_Stat_Pr2", !@this); // 1 = on, 0 = off 
	enableControl("StWhl_Angl_Stat_AR2", "CH_SCCMCRC_StWhl_Angl_Stat_Pr2S_", @this); //1: enable; 0: disable
	CRC_StWhl_Angl_Stat_Pr2 = @sysvar::CH_Nodes::CH_SCCMCRC_StWhl_Angl_Stat__AUTO;
}
/*@@end*/

/*@@sysvarChange:CH_Nodes::CH_SCCMSQC_StWhl_Angl_Stat__AUTO:*/
on sysvar sysvar::CH_Nodes::CH_SCCMSQC_StWhl_Angl_Stat__AUTO
{
//	EnableSQC("StWhl_Angl_Stat_AR2",  "StWhl_Angl_Stat_Pr2", !@this); // 1 = on, 0 = off 
	enableControl("StWhl_Angl_Stat_AR2", "CH_SCCMSQC_StWhl_Angl_Stat_Pr2S_", @this); //1: enable; 0: disable
	SQC_StWhl_Angl_Stat_Pr2 = @sysvar::CH_Nodes::CH_SCCMSQC_StWhl_Angl_Stat__AUTO;
}
/*@@end*/

/*@@sysvarChange:CH_Nodes::CH_SCCMStWhl_OFN_Stat_AR_UB_AUTO:*/
on sysvar sysvar::CH_Nodes::CH_SCCMStWhl_OFN_Stat_AR_UB_AUTO
{
	switch (@sysvar::CH_Nodes::CH_SCCMStWhl_OFN_Stat_AR_UB_AUTO)
	{
		case (0):
			enableControl("StWhl_OFN_Stat_AR2", "CH_SCCMStWhl_OFN_Stat_AR2_UB_", 0); //1: enable; 0: disable
			@sysvar::CH_Nodes::CH_SCCMStWhl_OFN_Stat_AR2_UB_ = 1;
			break;
		case (1):
			enableControl("StWhl_OFN_Stat_AR2", "CH_SCCMStWhl_OFN_Stat_AR2_UB_", 1); //1: enable; 0: disable
			break;
		case (2):
			enableControl("StWhl_OFN_Stat_AR2", "CH_SCCMStWhl_OFN_Stat_AR2_UB_", 0); //1: enable; 0: disable
			@sysvar::CH_Nodes::CH_SCCMStWhl_OFN_Stat_AR2_UB_ = 1;
			break;
		case (3):
			enableControl("StWhl_OFN_Stat_AR2", "CH_SCCMStWhl_OFN_Stat_AR2_UB_", 0); //1: enable; 0: disable
			@sysvar::CH_Nodes::CH_SCCMStWhl_OFN_Stat_AR2_UB_ = 0;
			break;
	}
}
/*@@end*/

/*@@sysvarChange:CH_Nodes::CH_SCCMStWhl_Sw_Stat_AR2_UB_AUTO:*/
on sysvar sysvar::CH_Nodes::CH_SCCMStWhl_Sw_Stat_AR2_UB_AUTO
{
	switch (@sysvar::CH_Nodes::CH_SCCMStWhl_Sw_Stat_AR2_UB_AUTO)
	{
		case (0):
			enableControl("StWhl_Sw_Stat_AR2", "CH_SCCMStWhl_Sw_Stat_AR2_UB_", 0); //1: enable; 0: disable
			@sysvar::CH_Nodes::CH_SCCMStWhl_Sw_Stat_AR2_UB_ = 1;
			break;
		case (1):
			enableControl("StWhl_Sw_Stat_AR2", "CH_SCCMStWhl_Sw_Stat_AR2_UB_", 1); //1: enable; 0: disable
			break;
		case (2):
			enableControl("StWhl_Sw_Stat_AR2", "CH_SCCMStWhl_Sw_Stat_AR2_UB_", 0); //1: enable; 0: disable
			@sysvar::CH_Nodes::CH_SCCMStWhl_Sw_Stat_AR2_UB_ = 1;
			break;
		case (3):
			enableControl("StWhl_Sw_Stat_AR2", "CH_SCCMStWhl_Sw_Stat_AR2_UB_", 0); //1: enable; 0: disable
			@sysvar::CH_Nodes::CH_SCCMStWhl_Sw_Stat_AR2_UB_ = 0;
			break;
	}
}
/*@@end*/

/*@@sysvarChange:CH_Nodes::CH_SCCMALDW_VibMot_StatS_UB_AUTO:*/
on sysvar sysvar::CH_Nodes::CH_SCCMALDW_VibMot_StatS_UB_AUTO
{
    switch (@sysvar::CH_Nodes::CH_SCCMALDW_VibMot_StatS_UB_AUTO)
    {
		case (0):
        	EnableUB("StWhl_Sw_Stat_AR2", 1);						// 1 = on, 0 = off
					DisturbUB("StWhl_Sw_Stat_AR2", "ALDW_VibMot_Stat_UB", -1, 0);	//Update-Bit immer gleich 0
					enableControl("StWhl_Sw_Stat_AR2", "CH_SCCMALDW_VibMot_StatStWhl_UB__UB", 0); //1: enable; 0: disable
					break;
		case (1):
        	EnableUB("StWhl_Sw_Stat_AR2", 0);						// 1 = on, 0 = off
					enableControl("StWhl_Sw_Stat_AR2", "CH_SCCMALDW_VibMot_StatStWhl_UB__UB", 1); //1: enable; 0: disable
					break;
		case (2):
        	EnableUB("StWhl_Sw_Stat_AR2", 1);						// 1 = on, 0 = off
        	DisturbUB("StWhl_Sw_Stat_AR2", "ALDW_VibMot_Stat_UB", -1, 1);	//Update-Bit immer gleich 1
					enableControl("StWhl_Sw_Stat_AR2", "CH_SCCMALDW_VibMot_StatStWhl_UB__UB", 0); //1: enable; 0: disable
					break;
		case (3):
        	EnableUB("StWhl_Sw_Stat_AR2", 1);						// 1 = on, 0 = off
        	DisturbUB("StWhl_Sw_Stat_AR2", "ALDW_VibMot_Stat_UB", -1, 0);	//Update-Bit immer gleich 0
					enableControl("StWhl_Sw_Stat_AR2", "CH_SCCMALDW_VibMot_StatStWhl_UB__UB", 0); //1: enable; 0: disable
					break;
    }
}
/*@@end*/
/*@@sysvarChange:CH_Nodes::CH_SCCMALDW_VibMot_AvlSt_UB_AUTO:*/
on sysvar sysvar::CH_Nodes::CH_SCCMALDW_VibMot_AvlSt_UB_AUTO
{
    switch (@sysvar::CH_Nodes::CH_SCCMALDW_VibMot_AvlSt_UB_AUTO)
    {
		case (0):
        	EnableUB("StWhl_Sw_Stat_AR2", 1);						// 1 = on, 0 = off
					DisturbUB("StWhl_Sw_Stat_AR2", "ALDW_VibMot_Avl_UB", -1, 0);	//Update-Bit immer gleich 0
					enableControl("StWhl_Sw_Stat_AR2", "CH_SCCMALDW_VibMot_AvlStWhl__UB__UB", 0); //1: enable; 0: disable
					break;
		case (1):
        	EnableUB("StWhl_Sw_Stat_AR2", 0);						// 1 = on, 0 = off
					enableControl("StWhl_Sw_Stat_AR2", "CH_SCCMALDW_VibMot_AvlStWhl__UB__UB", 1); //1: enable; 0: disable
					break;
		case (2):
        	EnableUB("StWhl_Sw_Stat_AR2", 1);						// 1 = on, 0 = off
        	DisturbUB("StWhl_Sw_Stat_AR2", "ALDW_VibMot_Avl_UB", -1, 1);	//Update-Bit immer gleich 1
					enableControl("StWhl_Sw_Stat_AR2", "CH_SCCMALDW_VibMot_AvlStWhl__UB__UB", 0); //1: enable; 0: disable
					break;
		case (3):
        	EnableUB("StWhl_Sw_Stat_AR2", 1);						// 1 = on, 0 = off
        	DisturbUB("StWhl_Sw_Stat_AR2", "ALDW_VibMot_Avl_UB", -1, 0);	//Update-Bit immer gleich 0
					enableControl("StWhl_Sw_Stat_AR2", "CH_SCCMALDW_VibMot_AvlStWhl__UB__UB", 0); //1: enable; 0: disable
					break;
    }
}
/*@@end*/
/*@@sysvarChange:CH_Nodes::CH_SCCMCRC_StWhl_Sw_Ok1_Ok2_AUTO:*/
on sysvar sysvar::CH_Nodes::CH_SCCMCRC_StWhl_Sw_Ok1_Ok2_AUTO
{
//	EnableCRC("StWhl_Sw_Stat_AR2",  "StWhl_Sw_Ok1_Ok2_Psd_Pr2", !@this); // 1 = on, 0 = off 
	enableControl("StWhl_Sw_Stat_AR2", "CH_SCCMCRC_StWhl_Sw_Ok1_Ok2_Psd_", @this); //1: enable; 0: disable
	CRC_StWhl_Sw_Ok1_Ok2_Psd_Pr2 = @sysvar::CH_Nodes::CH_SCCMCRC_StWhl_Sw_Ok1_Ok2_AUTO;
}
/*@@end*/

/*@@sysvarChange:CH_Nodes::CH_SCCMSQC_StWhl_Sw_Ok1_Ok2_AUTO:*/
on sysvar sysvar::CH_Nodes::CH_SCCMSQC_StWhl_Sw_Ok1_Ok2_AUTO
{
//	EnableSQC("StWhl_Sw_Stat_AR2",  "StWhl_Sw_Ok1_Ok2_Psd_Pr2", !@this); // 1 = on, 0 = off 
	enableControl("StWhl_Sw_Stat_AR2", "CH_SCCMSQC_StWhl_Sw_Ok1_Ok2_Psd_", @this); //1: enable; 0: disable
	SQC_StWhl_Sw_Ok1_Ok2_Psd_Pr2 = @sysvar::CH_Nodes::CH_SCCMSQC_StWhl_Sw_Ok1_Ok2_AUTO;
}
/*@@end*/

/*@@caplFunc:CH_SCCMLDC_Rq_StWhl_AR2():*///function
CH_SCCMLDC_Rq_StWhl_AR2()
{
	switch (@sysvar::CH_Nodes::CH_SCCMLDC_Rq_StWhl_AR2_UB_AUTO)
	{
		case (0):
			//Updatebit wird mit 1 gesendet; entspricht Standard
			break;
		case (1):
			//nur wenn manueller Wert gleich 0 ist, muss was gemacht werden
			if (@sysvar::CH_Nodes::CH_SCCMLDC_Rq_StWhl_AR2_UB_AUTO == 0)
				DisturbPDUUB("LDC_Rq_StWhl_AR2", 1, 0); //Updatebit wird einmal auf Null gesetzt
			break;
		case (2):
			//Updatebit wird mit 1 gesendet; entspricht Standard
			break;
		case (3):
			DisturbPDUUB("LDC_Rq_StWhl_AR2", 1, 0); //Updatebit wird einmal auf Null gesetzt
			break;
	}
}
/*@@end*/

/*@@caplFunc:CH_SCCMLDC_SBW_Rq_SCCM_AR2():*///function
CH_SCCMLDC_SBW_Rq_SCCM_AR2()
{
	switch (@sysvar::CH_Nodes::CH_SCCMLDC_SBW_Rq_SCCM_A_UB_AUTO)
	{
		case (0):
			//Updatebit wird mit 1 gesendet; entspricht Standard
			break;
		case (1):
			//nur wenn manueller Wert gleich 0 ist, muss was gemacht werden
			if (@sysvar::CH_Nodes::CH_SCCMLDC_SBW_Rq_SCCM_A_UB_AUTO == 0)
				DisturbPDUUB("LDC_SBW_Rq_SCCM_AR2", 1, 0); //Updatebit wird einmal auf Null gesetzt
			break;
		case (2):
			//Updatebit wird mit 1 gesendet; entspricht Standard
			break;
		case (3):
			DisturbPDUUB("LDC_SBW_Rq_SCCM_AR2", 1, 0); //Updatebit wird einmal auf Null gesetzt
			break;
	}
}
/*@@end*/

/*@@caplFunc:CH_SCCMSCCM_Sw_Stat_AR2():*///function
CH_SCCMSCCM_Sw_Stat_AR2()
{
	switch (@sysvar::CH_Nodes::CH_SCCMSCCM_Sw_Stat_AR2_UB_AUTO)
	{
		case (0):
			//Updatebit wird mit 1 gesendet; entspricht Standard
			break;
		case (1):
			//nur wenn manueller Wert gleich 0 ist, muss was gemacht werden
			if (@sysvar::CH_Nodes::CH_SCCMSCCM_Sw_Stat_AR2_UB_AUTO == 0)
				DisturbPDUUB("SCCM_Sw_Stat_AR2", 1, 0); //Updatebit wird einmal auf Null gesetzt
			break;
		case (2):
			//Updatebit wird mit 1 gesendet; entspricht Standard
			break;
		case (3):
			DisturbPDUUB("SCCM_Sw_Stat_AR2", 1, 0); //Updatebit wird einmal auf Null gesetzt
			break;
	}
}
/*@@end*/

/*@@caplFunc:CH_SCCMStWhl_Angl_Stat_AR2():*///function
CH_SCCMStWhl_Angl_Stat_AR2()
{
	switch (@sysvar::CH_Nodes::CH_SCCMStWhl_Angl_Stat_A_UB_AUTO)
	{
		case (0):
			//Updatebit wird mit 1 gesendet; entspricht Standard
			break;
		case (1):
			//nur wenn manueller Wert gleich 0 ist, muss was gemacht werden
			if (@sysvar::CH_Nodes::CH_SCCMStWhl_Angl_Stat_A_UB_AUTO == 0)
				DisturbPDUUB("StWhl_Angl_Stat_AR2", 1, 0); //Updatebit wird einmal auf Null gesetzt
			break;
		case (2):
			//Updatebit wird mit 1 gesendet; entspricht Standard
			break;
		case (3):
			DisturbPDUUB("StWhl_Angl_Stat_AR2", 1, 0); //Updatebit wird einmal auf Null gesetzt
			break;
	}
}
/*@@end*/

/*@@caplFunc:CH_SCCMStWhl_OFN_Stat_AR2():*///function
CH_SCCMStWhl_OFN_Stat_AR2()
{
	switch (@sysvar::CH_Nodes::CH_SCCMStWhl_OFN_Stat_AR_UB_AUTO)
	{
		case (0):
			//Updatebit wird mit 1 gesendet; entspricht Standard
			break;
		case (1):
			//nur wenn manueller Wert gleich 0 ist, muss was gemacht werden
			if (@sysvar::CH_Nodes::CH_SCCMStWhl_OFN_Stat_AR_UB_AUTO == 0)
				DisturbPDUUB("StWhl_OFN_Stat_AR2", 1, 0); //Updatebit wird einmal auf Null gesetzt
			break;
		case (2):
			//Updatebit wird mit 1 gesendet; entspricht Standard
			break;
		case (3):
			DisturbPDUUB("StWhl_OFN_Stat_AR2", 1, 0); //Updatebit wird einmal auf Null gesetzt
			break;
	}
}
/*@@end*/

/*@@caplFunc:CH_SCCMStWhl_Sw_Stat_AR2():*///function
CH_SCCMStWhl_Sw_Stat_AR2()
{
	switch (@sysvar::CH_Nodes::CH_SCCMStWhl_Sw_Stat_AR2_UB_AUTO)
	{
		case (0):
			//Updatebit wird mit 1 gesendet; entspricht Standard
			break;
		case (1):
			//nur wenn manueller Wert gleich 0 ist, muss was gemacht werden
			if (@sysvar::CH_Nodes::CH_SCCMStWhl_Sw_Stat_AR2_UB_AUTO == 0)
				DisturbPDUUB("StWhl_Sw_Stat_AR2", 1, 0); //Updatebit wird einmal auf Null gesetzt
			break;
		case (2):
			//Updatebit wird mit 1 gesendet; entspricht Standard
			break;
		case (3):
			DisturbPDUUB("StWhl_Sw_Stat_AR2", 1, 0); //Updatebit wird einmal auf Null gesetzt
			break;
	}
}
/*@@end*/

/*@@caplFunc:FrILTxPending(char[],long,byte[],long):*///callback
void FrILTxPending(char pduName[], long len, byte payload[], long TxAck)
{
	byte crc;
	dword SQC;
	dword MC;
	dword Tgl;
	dword i;

	if (strncmp (pduName, "LDC_Rq_StWhl_AR2", strLen(pduName)+strLen("LDC_Rq_StWhl_AR2")) == 0)
	{
		if (TxAck == 1)
		{
			if (@sysvar::CH_Nodes::CH_SCCMSQC_LDC_Rq_StWhl_Pr2_AUTO == 0)
			{
				//SQC automatisch ändern
				SQC_VAL_LDC_Rq_StWhl_Pr2 = (SQC_VAL_LDC_Rq_StWhl_Pr2 + 1) % 16;
			}
			else
			{
				//SQC manuel veränderbar
			}

		}
		else
		{
			if (@sysvar::CH_Nodes::CH_SCCMSQC_LDC_Rq_StWhl_Pr2_AUTO == 0)
			{
				//SQC automatisch ändern
				//SQC für CRC speichern
				CounterValForCRC_LDC_Rq_StWhl_Pr2 = SQC_VAL_LDC_Rq_StWhl_Pr2;
				//SQC in Byte schreiben
				payload[1] = (payload[1] & ~0x0F) |  SQC_VAL_LDC_Rq_StWhl_Pr2;
			}
			else
			{
				//SQC manuel veränderbar
			}

			if (@sysvar::CH_Nodes::CH_SCCMCRC_LDC_Rq_StWhl_Pr2_AUTO == 0)
			{
				//CRC automatisch berechnen
				crc = 0xFF;
				crc = crctableProfTwo[crc ^ payload[1]];
				crc = crctableProfTwo[crc ^ payload[2]];
				crc = crctableProfTwo[crc ^ payload[3]];
				crc = crctableProfTwo[crc ^ payload[4]];
				switch (CounterValForCRC_LDC_Rq_StWhl_Pr2)
				{
					case(0) :
						crc = crctableProfTwo[crc ^ 105];
						break;
					case(1) :
						crc = crctableProfTwo[crc ^ 167];
						break;
					case(2) :
						crc = crctableProfTwo[crc ^ 229];
						break;
					case(3) :
						crc = crctableProfTwo[crc ^ 40];
						break;
					case(4) :
						crc = crctableProfTwo[crc ^ 102];
						break;
					case(5) :
						crc = crctableProfTwo[crc ^ 164];
						break;
					case(6) :
						crc = crctableProfTwo[crc ^ 226];
						break;
					case(7) :
						crc = crctableProfTwo[crc ^ 37];
						break;
					case(8) :
						crc = crctableProfTwo[crc ^ 99];
						break;
					case(9) :
						crc = crctableProfTwo[crc ^ 161];
						break;
					case(10) :
						crc = crctableProfTwo[crc ^ 223];
						break;
					case(11) :
						crc = crctableProfTwo[crc ^ 34];
						break;
					case(12) :
						crc = crctableProfTwo[crc ^ 96];
						break;
					case(13) :
						crc = crctableProfTwo[crc ^ 158];
						break;
					case(14) :
						crc = crctableProfTwo[crc ^ 220];
						break;
					case(15) :
						crc = crctableProfTwo[crc ^ 31];
						break;
					default :
//						write("error: wrong parameter (%d)",CounterValForCRC_LDC_Rq_StWhl_Pr2); stop();
						break;
				}
				crc = (crc ^ 0xFF);
				payload[0] = crc;
			}
			else
			{
				//CRC manuel veränderbar
			}

			CH_SCCMSCCM_Sw_Stat_AR2();
			CH_SCCMLDC_SBW_Rq_SCCM_AR2();
			CH_SCCMLDC_Rq_StWhl_AR2();
		}
	}
	if (strncmp (pduName, "LDC_SBW_Rq_SCCM_AR2", strLen(pduName)+strLen("LDC_SBW_Rq_SCCM_AR2")) == 0)
	{
		if (TxAck == 1)
		{
			if (@sysvar::CH_Nodes::CH_SCCMSQC_LDC_Rq_SCCM_Pr2L_AUTO == 0)
			{
				//SQC automatisch ändern
				SQC_VAL_LDC_Rq_SCCM_Pr2 = (SQC_VAL_LDC_Rq_SCCM_Pr2 + 1) % 16;
			}
			else
			{
				//SQC manuel veränderbar
			}
			if (@sysvar::CH_Nodes::CH_SCCMSQC_SBW_Rq_SCCM_Pr2L_AUTO == 0)
			{
				//SQC automatisch ändern
				SQC_VAL_SBW_Rq_SCCM_Pr2 = (SQC_VAL_SBW_Rq_SCCM_Pr2 + 1) % 16;
			}
			else
			{
				//SQC manuel veränderbar
			}

		}
		else
		{
			if (@sysvar::CH_Nodes::CH_SCCMSQC_LDC_Rq_SCCM_Pr2L_AUTO == 0)
			{
				//SQC automatisch ändern
				//SQC für CRC speichern
				CounterValForCRC_LDC_Rq_SCCM_Pr2 = SQC_VAL_LDC_Rq_SCCM_Pr2;
				//SQC in Byte schreiben
				payload[1] = (payload[1] & ~0x0F) |  SQC_VAL_LDC_Rq_SCCM_Pr2;
			}
			else
			{
				//SQC manuel veränderbar
			}
			if (@sysvar::CH_Nodes::CH_SCCMSQC_SBW_Rq_SCCM_Pr2L_AUTO == 0)
			{
				//SQC automatisch ändern
				//SQC für CRC speichern
				CounterValForCRC_SBW_Rq_SCCM_Pr2 = SQC_VAL_SBW_Rq_SCCM_Pr2;
				//SQC in Byte schreiben
				payload[5] = (payload[5] & ~0x0F) |  SQC_VAL_SBW_Rq_SCCM_Pr2;
			}
			else
			{
				//SQC manuel veränderbar
			}

			if (@sysvar::CH_Nodes::CH_SCCMCRC_LDC_Rq_SCCM_Pr2L_AUTO == 0)
			{
				//CRC automatisch berechnen
				crc = 0xFF;
				crc = crctableProfTwo[crc ^ payload[1]];
				crc = crctableProfTwo[crc ^ payload[2]];
				crc = crctableProfTwo[crc ^ payload[3]];
				switch (CounterValForCRC_LDC_Rq_SCCM_Pr2)
				{
					case(0) :
						crc = crctableProfTwo[crc ^ 178];
						break;
					case(1) :
						crc = crctableProfTwo[crc ^ 38];
						break;
					case(2) :
						crc = crctableProfTwo[crc ^ 149];
						break;
					case(3) :
						crc = crctableProfTwo[crc ^ 9];
						break;
					case(4) :
						crc = crctableProfTwo[crc ^ 120];
						break;
					case(5) :
						crc = crctableProfTwo[crc ^ 231];
						break;
					case(6) :
						crc = crctableProfTwo[crc ^ 91];
						break;
					case(7) :
						crc = crctableProfTwo[crc ^ 202];
						break;
					case(8) :
						crc = crctableProfTwo[crc ^ 62];
						break;
					case(9) :
						crc = crctableProfTwo[crc ^ 173];
						break;
					case(10) :
						crc = crctableProfTwo[crc ^ 33];
						break;
					case(11) :
						crc = crctableProfTwo[crc ^ 144];
						break;
					case(12) :
						crc = crctableProfTwo[crc ^ 4];
						break;
					case(13) :
						crc = crctableProfTwo[crc ^ 115];
						break;
					case(14) :
						crc = crctableProfTwo[crc ^ 226];
						break;
					case(15) :
						crc = crctableProfTwo[crc ^ 86];
						break;
					default :
//						write("error: wrong parameter (%d)",CounterValForCRC_LDC_Rq_SCCM_Pr2); stop();
						break;
				}
				crc = (crc ^ 0xFF);
				payload[0] = crc;
			}
			else
			{
				//CRC manuel veränderbar
			}
			if (@sysvar::CH_Nodes::CH_SCCMCRC_SBW_Rq_SCCM_Pr2L_AUTO == 0)
			{
				//CRC automatisch berechnen
				crc = 0xFF;
				crc = crctableProfTwo[crc ^ payload[5]];
				crc = crctableProfTwo[crc ^ payload[6]];
				crc = crctableProfTwo[crc ^ payload[7]];
				switch (CounterValForCRC_SBW_Rq_SCCM_Pr2)
				{
					case(0) :
						crc = crctableProfTwo[crc ^ 124];
						break;
					case(1) :
						crc = crctableProfTwo[crc ^ 182];
						break;
					case(2) :
						crc = crctableProfTwo[crc ^ 240];
						break;
					case(3) :
						crc = crctableProfTwo[crc ^ 47];
						break;
					case(4) :
						crc = crctableProfTwo[crc ^ 105];
						break;
					case(5) :
						crc = crctableProfTwo[crc ^ 163];
						break;
					case(6) :
						crc = crctableProfTwo[crc ^ 221];
						break;
					case(7) :
						crc = crctableProfTwo[crc ^ 28];
						break;
					case(8) :
						crc = crctableProfTwo[crc ^ 86];
						break;
					case(9) :
						crc = crctableProfTwo[crc ^ 144];
						break;
					case(10) :
						crc = crctableProfTwo[crc ^ 202];
						break;
					case(11) :
						crc = crctableProfTwo[crc ^ 9];
						break;
					case(12) :
						crc = crctableProfTwo[crc ^ 67];
						break;
					case(13) :
						crc = crctableProfTwo[crc ^ 125];
						break;
					case(14) :
						crc = crctableProfTwo[crc ^ 183];
						break;
					case(15) :
						crc = crctableProfTwo[crc ^ 241];
						break;
					default :
//						write("error: wrong parameter (%d)",CounterValForCRC_SBW_Rq_SCCM_Pr2); stop();
						break;
				}
				crc = (crc ^ 0xFF);
				payload[4] = crc;
			}
			else
			{
				//CRC manuel veränderbar
			}

			CH_SCCMSCCM_Sw_Stat_AR2();
			CH_SCCMLDC_SBW_Rq_SCCM_AR2();
			CH_SCCMLDC_Rq_StWhl_AR2();
		}
	}
	if (strncmp (pduName, "ROE_SCCM", strLen(pduName)+strLen("ROE_SCCM")) == 0)
	{
		if (TxAck == 1)
		{
		}
		else
		{
		}
	}
	if (strncmp (pduName, "ROE_SWSP", strLen(pduName)+strLen("ROE_SWSP")) == 0)
	{
		if (TxAck == 1)
		{
		}
		else
		{
		}
	}
	if (strncmp (pduName, "SCCM_Sw_Stat_AR2", strLen(pduName)+strLen("SCCM_Sw_Stat_AR2")) == 0)
	{
		if (TxAck == 1)
		{
			if (@sysvar::CH_Nodes::CH_SCCMSQC_SCCM_Lvr_Stat_Pr_AUTO == 0)
			{
				//SQC automatisch ändern
				SQC_VAL_SCCM_Lvr_Stat_Pr2 = (SQC_VAL_SCCM_Lvr_Stat_Pr2 + 1) % 16;
			}
			else
			{
				//SQC manuel veränderbar
			}
			if (@sysvar::CH_Nodes::CH_SCCMSQC_WprWashSw_Stat_P_AUTO == 0)
			{
				//SQC automatisch ändern
				SQC_VAL_WprWashSw_Stat_Pr2 = (SQC_VAL_WprWashSw_Stat_Pr2 + 1) % 16;
			}
			else
			{
				//SQC manuel veränderbar
			}

		}
		else
		{
			if (@sysvar::CH_Nodes::CH_SCCMSQC_SCCM_Lvr_Stat_Pr_AUTO == 0)
			{
				//SQC automatisch ändern
				//SQC für CRC speichern
				CounterValForCRC_SCCM_Lvr_Stat_Pr2 = SQC_VAL_SCCM_Lvr_Stat_Pr2;
				//SQC in Byte schreiben
				payload[1] = (payload[1] & ~0x0F) |  SQC_VAL_SCCM_Lvr_Stat_Pr2;
			}
			else
			{
				//SQC manuel veränderbar
			}
			if (@sysvar::CH_Nodes::CH_SCCMSQC_WprWashSw_Stat_P_AUTO == 0)
			{
				//SQC automatisch ändern
				//SQC für CRC speichern
				CounterValForCRC_WprWashSw_Stat_Pr2 = SQC_VAL_WprWashSw_Stat_Pr2;
				//SQC in Byte schreiben
				payload[4] = (payload[4] & ~0x0F) |  SQC_VAL_WprWashSw_Stat_Pr2;
			}
			else
			{
				//SQC manuel veränderbar
			}

			if (@sysvar::CH_Nodes::CH_SCCMCRC_SCCM_Lvr_Stat_Pr_AUTO == 0)
			{
				//CRC automatisch berechnen
				crc = 0xFF;
				crc = crctableProfTwo[crc ^ payload[1]];
				crc = crctableProfTwo[crc ^ payload[2]];
				switch (CounterValForCRC_SCCM_Lvr_Stat_Pr2)
				{
					case(0) :
						crc = crctableProfTwo[crc ^ 157];
						break;
					case(1) :
						crc = crctableProfTwo[crc ^ 179];
						break;
					case(2) :
						crc = crctableProfTwo[crc ^ 201];
						break;
					case(3) :
						crc = crctableProfTwo[crc ^ 223];
						break;
					case(4) :
						crc = crctableProfTwo[crc ^ 245];
						break;
					case(5) :
						crc = crctableProfTwo[crc ^ 16];
						break;
					case(6) :
						crc = crctableProfTwo[crc ^ 38];
						break;
					case(7) :
						crc = crctableProfTwo[crc ^ 60];
						break;
					case(8) :
						crc = crctableProfTwo[crc ^ 82];
						break;
					case(9) :
						crc = crctableProfTwo[crc ^ 104];
						break;
					case(10) :
						crc = crctableProfTwo[crc ^ 126];
						break;
					case(11) :
						crc = crctableProfTwo[crc ^ 148];
						break;
					case(12) :
						crc = crctableProfTwo[crc ^ 170];
						break;
					case(13) :
						crc = crctableProfTwo[crc ^ 192];
						break;
					case(14) :
						crc = crctableProfTwo[crc ^ 214];
						break;
					case(15) :
						crc = crctableProfTwo[crc ^ 236];
						break;
					default :
//						write("error: wrong parameter (%d)",CounterValForCRC_SCCM_Lvr_Stat_Pr2); stop();
						break;
				}
				crc = (crc ^ 0xFF);
				payload[0] = crc;
			}
			else
			{
				//CRC manuel veränderbar
			}
			if (@sysvar::CH_Nodes::CH_SCCMCRC_WprWashSw_Stat_P_AUTO == 0)
			{
				//CRC automatisch berechnen
				crc = 0xFF;
				crc = crctableProfTwo[crc ^ payload[4]];
				crc = crctableProfTwo[crc ^ payload[5]];
				switch (CounterValForCRC_WprWashSw_Stat_Pr2)
				{
					case(0) :
						crc = crctableProfTwo[crc ^ 201];
						break;
					case(1) :
						crc = crctableProfTwo[crc ^ 168];
						break;
					case(2) :
						crc = crctableProfTwo[crc ^ 135];
						break;
					case(3) :
						crc = crctableProfTwo[crc ^ 102];
						break;
					case(4) :
						crc = crctableProfTwo[crc ^ 69];
						break;
					case(5) :
						crc = crctableProfTwo[crc ^ 36];
						break;
					case(6) :
						crc = crctableProfTwo[crc ^ 3];
						break;
					case(7) :
						crc = crctableProfTwo[crc ^ 221];
						break;
					case(8) :
						crc = crctableProfTwo[crc ^ 188];
						break;
					case(9) :
						crc = crctableProfTwo[crc ^ 155];
						break;
					case(10) :
						crc = crctableProfTwo[crc ^ 122];
						break;
					case(11) :
						crc = crctableProfTwo[crc ^ 89];
						break;
					case(12) :
						crc = crctableProfTwo[crc ^ 56];
						break;
					case(13) :
						crc = crctableProfTwo[crc ^ 23];
						break;
					case(14) :
						crc = crctableProfTwo[crc ^ 241];
						break;
					case(15) :
						crc = crctableProfTwo[crc ^ 208];
						break;
					default :
//						write("error: wrong parameter (%d)",CounterValForCRC_WprWashSw_Stat_Pr2); stop();
						break;
				}
				crc = (crc ^ 0xFF);
				payload[3] = crc;
			}
			else
			{
				//CRC manuel veränderbar
			}

			CH_SCCMSCCM_Sw_Stat_AR2();
			CH_SCCMLDC_SBW_Rq_SCCM_AR2();
			CH_SCCMLDC_Rq_StWhl_AR2();
		}
	}
	if (strncmp (pduName, "StWhl_Angl_Stat_AR2", strLen(pduName)+strLen("StWhl_Angl_Stat_AR2")) == 0)
	{
		if (TxAck == 1)
		{
			if (@sysvar::CH_Nodes::CH_SCCMSQC_StWhl_Angl_Stat__AUTO == 0)
			{
				//SQC automatisch ändern
				SQC_VAL_StWhl_Angl_Stat_Pr2 = (SQC_VAL_StWhl_Angl_Stat_Pr2 + 1) % 16;
			}
			else
			{
				//SQC manuel veränderbar
			}

		}
		else
		{
			if (@sysvar::CH_Nodes::CH_SCCMSQC_StWhl_Angl_Stat__AUTO == 0)
			{
				//SQC automatisch ändern
				//SQC für CRC speichern
				CounterValForCRC_StWhl_Angl_Stat_Pr2 = SQC_VAL_StWhl_Angl_Stat_Pr2;
				//SQC in Byte schreiben
				payload[1] = (payload[1] & ~0x0F) |  SQC_VAL_StWhl_Angl_Stat_Pr2;
			}
			else
			{
				//SQC manuel veränderbar
			}

			if (@sysvar::CH_Nodes::CH_SCCMCRC_StWhl_Angl_Stat__AUTO == 0)
			{
				//CRC automatisch berechnen
				crc = 0xFF;
				crc = crctableProfTwo[crc ^ payload[1]];
				crc = crctableProfTwo[crc ^ payload[2]];
				crc = crctableProfTwo[crc ^ payload[3]];
				crc = crctableProfTwo[crc ^ payload[4]];
				crc = crctableProfTwo[crc ^ payload[5]];
				crc = crctableProfTwo[crc ^ payload[6]];
				crc = crctableProfTwo[crc ^ payload[7]];
				switch (CounterValForCRC_StWhl_Angl_Stat_Pr2)
				{
					case(0) :
						crc = crctableProfTwo[crc ^ 39];
						break;
					case(1) :
						crc = crctableProfTwo[crc ^ 7];
						break;
					case(2) :
						crc = crctableProfTwo[crc ^ 226];
						break;
					case(3) :
						crc = crctableProfTwo[crc ^ 194];
						break;
					case(4) :
						crc = crctableProfTwo[crc ^ 162];
						break;
					case(5) :
						crc = crctableProfTwo[crc ^ 130];
						break;
					case(6) :
						crc = crctableProfTwo[crc ^ 98];
						break;
					case(7) :
						crc = crctableProfTwo[crc ^ 66];
						break;
					case(8) :
						crc = crctableProfTwo[crc ^ 34];
						break;
					case(9) :
						crc = crctableProfTwo[crc ^ 253];
						break;
					case(10) :
						crc = crctableProfTwo[crc ^ 221];
						break;
					case(11) :
						crc = crctableProfTwo[crc ^ 189];
						break;
					case(12) :
						crc = crctableProfTwo[crc ^ 157];
						break;
					case(13) :
						crc = crctableProfTwo[crc ^ 125];
						break;
					case(14) :
						crc = crctableProfTwo[crc ^ 93];
						break;
					case(15) :
						crc = crctableProfTwo[crc ^ 61];
						break;
					default :
//						write("error: wrong parameter (%d)",CounterValForCRC_StWhl_Angl_Stat_Pr2); stop();
						break;
				}
				crc = (crc ^ 0xFF);
				payload[0] = crc;
			}
			else
			{
				//CRC manuel veränderbar
			}

			CH_SCCMStWhl_Angl_Stat_AR2();
		}
	}
	if (strncmp (pduName, "StWhl_OFN_Stat_AR2", strLen(pduName)+strLen("StWhl_OFN_Stat_AR2")) == 0)
	{
		if (TxAck == 1)
		{
		}
		else
		{
			CH_SCCMStWhl_OFN_Stat_AR2();
			CH_SCCMStWhl_Sw_Stat_AR2();
		}
	}
	if (strncmp (pduName, "StWhl_Sw_Stat_AR2", strLen(pduName)+strLen("StWhl_Sw_Stat_AR2")) == 0)
	{
		if (TxAck == 1)
		{
			if (@sysvar::CH_Nodes::CH_SCCMSQC_StWhl_Sw_Ok1_Ok2_AUTO == 0)
			{
				//SQC automatisch ändern
				SQC_VAL_StWhl_Sw_Ok1_Ok2_Psd_Pr2 = (SQC_VAL_StWhl_Sw_Ok1_Ok2_Psd_Pr2 + 1) % 16;
			}
			else
			{
				//SQC manuel veränderbar
			}

		}
		else
		{
			if (@sysvar::CH_Nodes::CH_SCCMSQC_StWhl_Sw_Ok1_Ok2_AUTO == 0)
			{
				//SQC automatisch ändern
				//SQC für CRC speichern
				CounterValForCRC_StWhl_Sw_Ok1_Ok2_Psd_Pr2 = SQC_VAL_StWhl_Sw_Ok1_Ok2_Psd_Pr2;
				//SQC in Byte schreiben
				payload[2] = (payload[2] & ~0x0F) |  SQC_VAL_StWhl_Sw_Ok1_Ok2_Psd_Pr2;
			}
			else
			{
				//SQC manuel veränderbar
			}

			if (@sysvar::CH_Nodes::CH_SCCMCRC_StWhl_Sw_Ok1_Ok2_AUTO == 0)
			{
				//CRC automatisch berechnen
				crc = 0xFF;
				crc = crctableProfTwo[crc ^ payload[2]];
				switch (CounterValForCRC_StWhl_Sw_Ok1_Ok2_Psd_Pr2)
				{
					case(0) :
						crc = crctableProfTwo[crc ^ 189];
						break;
					case(1) :
						crc = crctableProfTwo[crc ^ 144];
						break;
					case(2) :
						crc = crctableProfTwo[crc ^ 99];
						break;
					case(3) :
						crc = crctableProfTwo[crc ^ 54];
						break;
					case(4) :
						crc = crctableProfTwo[crc ^ 9];
						break;
					case(5) :
						crc = crctableProfTwo[crc ^ 215];
						break;
					case(6) :
						crc = crctableProfTwo[crc ^ 170];
						break;
					case(7) :
						crc = crctableProfTwo[crc ^ 125];
						break;
					case(8) :
						crc = crctableProfTwo[crc ^ 80];
						break;
					case(9) :
						crc = crctableProfTwo[crc ^ 35];
						break;
					case(10) :
						crc = crctableProfTwo[crc ^ 241];
						break;
					case(11) :
						crc = crctableProfTwo[crc ^ 196];
						break;
					case(12) :
						crc = crctableProfTwo[crc ^ 151];
						break;
					case(13) :
						crc = crctableProfTwo[crc ^ 106];
						break;
					case(14) :
						crc = crctableProfTwo[crc ^ 61];
						break;
					case(15) :
						crc = crctableProfTwo[crc ^ 16];
						break;
					default :
//						write("error: wrong parameter (%d)",CounterValForCRC_StWhl_Sw_Ok1_Ok2_Psd_Pr2); stop();
						break;
				}
				crc = (crc ^ 0xFF);
				payload[1] = crc;
			}
			else
			{
				//CRC manuel veränderbar
			}

			CH_SCCMStWhl_OFN_Stat_AR2();
			CH_SCCMStWhl_Sw_Stat_AR2();
		}
	}
	if (strncmp (pduName, "WUDOP_SCCM_FR", strLen(pduName)+strLen("WUDOP_SCCM_FR")) == 0)
	{
		if (TxAck == 1)
		{
		}
		else
		{
		}
	}
}
/*@@end*/

/*@@caplFunc:StartSim(int):*/
StartSim(int BusAktiv)
{
	result = EnableCRC("", 0); // 1 = on, 0 = off
	result = EnableTGL("", 0); // 1 = on, 0 = off 
	result = EnableSQC("", 0); // 1 = on, 0 = off 
	result = EnableMC("", 0); // 1 = on, 0 = off 
	switch (@sysvar::CH_Nodes::CH_SCCMLDC_Rq_StWhl_AR2_UB_AUTO)
	{
		case (0):
			enableControl("LDC_Rq_StWhl_AR2", "CH_SCCMLDC_Rq_StWhl_AR2_UB_", 0); //1: enable; 0: disable
			@sysvar::CH_Nodes::CH_SCCMLDC_Rq_StWhl_AR2_UB_ = 1;
			break;
		case (1):
			enableControl("LDC_Rq_StWhl_AR2", "CH_SCCMLDC_Rq_StWhl_AR2_UB_", 1); //1: enable; 0: disable
			break;
		case (2):
			enableControl("LDC_Rq_StWhl_AR2", "CH_SCCMLDC_Rq_StWhl_AR2_UB_", 0); //1: enable; 0: disable
			@sysvar::CH_Nodes::CH_SCCMLDC_Rq_StWhl_AR2_UB_ = 1;
			break;
		case (3):
			enableControl("LDC_Rq_StWhl_AR2", "CH_SCCMLDC_Rq_StWhl_AR2_UB_", 0); //1: enable; 0: disable
			@sysvar::CH_Nodes::CH_SCCMLDC_Rq_StWhl_AR2_UB_ = 0;
			break;
	}

	CRC_LDC_Rq_StWhl_Pr2 = 0;
	SQC_VAL_LDC_Rq_StWhl_Pr2 = 0;
	SQC_LDC_Rq_StWhl_Pr2 = 0;
	switch (@sysvar::CH_Nodes::CH_SCCMLDC_SBW_Rq_SCCM_A_UB_AUTO)
	{
		case (0):
			enableControl("LDC_SBW_Rq_SCCM_AR2", "CH_SCCMLDC_SBW_Rq_SCCM_AR2_UB_", 0); //1: enable; 0: disable
			@sysvar::CH_Nodes::CH_SCCMLDC_SBW_Rq_SCCM_AR2_UB_ = 1;
			break;
		case (1):
			enableControl("LDC_SBW_Rq_SCCM_AR2", "CH_SCCMLDC_SBW_Rq_SCCM_AR2_UB_", 1); //1: enable; 0: disable
			break;
		case (2):
			enableControl("LDC_SBW_Rq_SCCM_AR2", "CH_SCCMLDC_SBW_Rq_SCCM_AR2_UB_", 0); //1: enable; 0: disable
			@sysvar::CH_Nodes::CH_SCCMLDC_SBW_Rq_SCCM_AR2_UB_ = 1;
			break;
		case (3):
			enableControl("LDC_SBW_Rq_SCCM_AR2", "CH_SCCMLDC_SBW_Rq_SCCM_AR2_UB_", 0); //1: enable; 0: disable
			@sysvar::CH_Nodes::CH_SCCMLDC_SBW_Rq_SCCM_AR2_UB_ = 0;
			break;
	}

	CRC_LDC_Rq_SCCM_Pr2 = 0;
	SQC_VAL_LDC_Rq_SCCM_Pr2 = 0;
	SQC_LDC_Rq_SCCM_Pr2 = 0;
	CRC_SBW_Rq_SCCM_Pr2 = 0;
	SQC_VAL_SBW_Rq_SCCM_Pr2 = 0;
	SQC_SBW_Rq_SCCM_Pr2 = 0;
	switch (@sysvar::CH_Nodes::CH_SCCMSCCM_Sw_Stat_AR2_UB_AUTO)
	{
		case (0):
			enableControl("SCCM_Sw_Stat_AR2", "CH_SCCMSCCM_Sw_Stat_AR2_UB_", 0); //1: enable; 0: disable
			@sysvar::CH_Nodes::CH_SCCMSCCM_Sw_Stat_AR2_UB_ = 1;
			break;
		case (1):
			enableControl("SCCM_Sw_Stat_AR2", "CH_SCCMSCCM_Sw_Stat_AR2_UB_", 1); //1: enable; 0: disable
			break;
		case (2):
			enableControl("SCCM_Sw_Stat_AR2", "CH_SCCMSCCM_Sw_Stat_AR2_UB_", 0); //1: enable; 0: disable
			@sysvar::CH_Nodes::CH_SCCMSCCM_Sw_Stat_AR2_UB_ = 1;
			break;
		case (3):
			enableControl("SCCM_Sw_Stat_AR2", "CH_SCCMSCCM_Sw_Stat_AR2_UB_", 0); //1: enable; 0: disable
			@sysvar::CH_Nodes::CH_SCCMSCCM_Sw_Stat_AR2_UB_ = 0;
			break;
	}

	CRC_SCCM_Lvr_Stat_Pr2 = 0;
	SQC_VAL_SCCM_Lvr_Stat_Pr2 = 0;
	SQC_SCCM_Lvr_Stat_Pr2 = 0;
	CRC_WprWashSw_Stat_Pr2 = 0;
	SQC_VAL_WprWashSw_Stat_Pr2 = 0;
	SQC_WprWashSw_Stat_Pr2 = 0;
	OldVal_StWhl_Cond_Disp_Rq = $StWhl_Cond_Disp_Rq;
	OldVal_HMSW_Act_Stat = $HMSW_Act_Stat;
	switch (@sysvar::CH_Nodes::CH_SCCMStWhl_Angl_Stat_A_UB_AUTO)
	{
		case (0):
			enableControl("StWhl_Angl_Stat_AR2", "CH_SCCMStWhl_Angl_Stat_AR2_UB_", 0); //1: enable; 0: disable
			@sysvar::CH_Nodes::CH_SCCMStWhl_Angl_Stat_AR2_UB_ = 1;
			break;
		case (1):
			enableControl("StWhl_Angl_Stat_AR2", "CH_SCCMStWhl_Angl_Stat_AR2_UB_", 1); //1: enable; 0: disable
			break;
		case (2):
			enableControl("StWhl_Angl_Stat_AR2", "CH_SCCMStWhl_Angl_Stat_AR2_UB_", 0); //1: enable; 0: disable
			@sysvar::CH_Nodes::CH_SCCMStWhl_Angl_Stat_AR2_UB_ = 1;
			break;
		case (3):
			enableControl("StWhl_Angl_Stat_AR2", "CH_SCCMStWhl_Angl_Stat_AR2_UB_", 0); //1: enable; 0: disable
			@sysvar::CH_Nodes::CH_SCCMStWhl_Angl_Stat_AR2_UB_ = 0;
			break;
	}

	CRC_StWhl_Angl_Stat_Pr2 = 0;
	SQC_VAL_StWhl_Angl_Stat_Pr2 = 0;
	SQC_StWhl_Angl_Stat_Pr2 = 0;
	switch (@sysvar::CH_Nodes::CH_SCCMStWhl_OFN_Stat_AR_UB_AUTO)
	{
		case (0):
			enableControl("StWhl_OFN_Stat_AR2", "CH_SCCMStWhl_OFN_Stat_AR2_UB_", 0); //1: enable; 0: disable
			@sysvar::CH_Nodes::CH_SCCMStWhl_OFN_Stat_AR2_UB_ = 1;
			break;
		case (1):
			enableControl("StWhl_OFN_Stat_AR2", "CH_SCCMStWhl_OFN_Stat_AR2_UB_", 1); //1: enable; 0: disable
			break;
		case (2):
			enableControl("StWhl_OFN_Stat_AR2", "CH_SCCMStWhl_OFN_Stat_AR2_UB_", 0); //1: enable; 0: disable
			@sysvar::CH_Nodes::CH_SCCMStWhl_OFN_Stat_AR2_UB_ = 1;
			break;
		case (3):
			enableControl("StWhl_OFN_Stat_AR2", "CH_SCCMStWhl_OFN_Stat_AR2_UB_", 0); //1: enable; 0: disable
			@sysvar::CH_Nodes::CH_SCCMStWhl_OFN_Stat_AR2_UB_ = 0;
			break;
	}

	switch (@sysvar::CH_Nodes::CH_SCCMStWhl_Sw_Stat_AR2_UB_AUTO)
	{
		case (0):
			enableControl("StWhl_Sw_Stat_AR2", "CH_SCCMStWhl_Sw_Stat_AR2_UB_", 0); //1: enable; 0: disable
			@sysvar::CH_Nodes::CH_SCCMStWhl_Sw_Stat_AR2_UB_ = 1;
			break;
		case (1):
			enableControl("StWhl_Sw_Stat_AR2", "CH_SCCMStWhl_Sw_Stat_AR2_UB_", 1); //1: enable; 0: disable
			break;
		case (2):
			enableControl("StWhl_Sw_Stat_AR2", "CH_SCCMStWhl_Sw_Stat_AR2_UB_", 0); //1: enable; 0: disable
			@sysvar::CH_Nodes::CH_SCCMStWhl_Sw_Stat_AR2_UB_ = 1;
			break;
		case (3):
			enableControl("StWhl_Sw_Stat_AR2", "CH_SCCMStWhl_Sw_Stat_AR2_UB_", 0); //1: enable; 0: disable
			@sysvar::CH_Nodes::CH_SCCMStWhl_Sw_Stat_AR2_UB_ = 0;
			break;
	}

	OldVal_ALDW_VibMot_Stat = $ALDW_VibMot_Stat;
	OldVal_ALDW_VibMot_Avl = $ALDW_VibMot_Avl;
	CRC_StWhl_Sw_Ok1_Ok2_Psd_Pr2 = 0;
	SQC_VAL_StWhl_Sw_Ok1_Ok2_Psd_Pr2 = 0;
	SQC_StWhl_Sw_Ok1_Ok2_Psd_Pr2 = 0;
}
/*@@end*/

/*@@caplFunc:StopSim():*/
StopSim()
{
}
/*@@end*/

/*@@frPDU:MsgChannel1.CHASSIS::LDC_Rq_StWhl_AR2:*/
on frPDU MsgChannel1.CHASSIS::LDC_Rq_StWhl_AR2
{
}
/*@@end*/

/*@@frPDU:MsgChannel1.CHASSIS::LDC_SBW_Rq_SCCM_AR2:*/
on frPDU MsgChannel1.CHASSIS::LDC_SBW_Rq_SCCM_AR2
{
}
/*@@end*/

/*@@frPDU:MsgChannel1.CHASSIS::ROE_SCCM:*/
on frPDU MsgChannel1.CHASSIS::ROE_SCCM
{
}
/*@@end*/

/*@@frPDU:MsgChannel1.CHASSIS::ROE_SWSP:*/
on frPDU MsgChannel1.CHASSIS::ROE_SWSP
{
}
/*@@end*/

/*@@frPDU:MsgChannel1.CHASSIS::SCCM_Sw_Stat_AR2:*/
on frPDU MsgChannel1.CHASSIS::SCCM_Sw_Stat_AR2
{
	if (@sysvar::CH_Nodes::CH_SCCMStWhl_Cond_Disp_R_UB_AUTO == 0)
	{
		if ($StWhl_Cond_Disp_Rq != OldVal_StWhl_Cond_Disp_Rq)
		{
			DisturbUB("SCCM_Sw_Stat_AR2", "StWhl_Cond_Disp_Rq_UB", 1, 1);
			OldVal_StWhl_Cond_Disp_Rq = $StWhl_Cond_Disp_Rq;
		}
		else
		{
			DisturbUB("SCCM_Sw_Stat_AR2", "StWhl_Cond_Disp_Rq_UB", -1, 0);
		}
	}	if (@sysvar::CH_Nodes::CH_SCCMHMSW_Act_StatSCCM_UB_AUTO == 0)
	{
		if ($HMSW_Act_Stat != OldVal_HMSW_Act_Stat)
		{
			DisturbUB("SCCM_Sw_Stat_AR2", "HMSW_Act_Stat_UB", 1, 1);
			OldVal_HMSW_Act_Stat = $HMSW_Act_Stat;
		}
		else
		{
			DisturbUB("SCCM_Sw_Stat_AR2", "HMSW_Act_Stat_UB", -1, 0);
		}
	}}
/*@@end*/

/*@@frPDU:MsgChannel1.CHASSIS::StWhl_Angl_Stat_AR2:*/
on frPDU MsgChannel1.CHASSIS::StWhl_Angl_Stat_AR2
{
}
/*@@end*/

/*@@frPDU:MsgChannel1.CHASSIS::StWhl_OFN_Stat_AR2:*/
on frPDU MsgChannel1.CHASSIS::StWhl_OFN_Stat_AR2
{
}
/*@@end*/

/*@@frPDU:MsgChannel1.CHASSIS::StWhl_Sw_Stat_AR2:*/
on frPDU MsgChannel1.CHASSIS::StWhl_Sw_Stat_AR2
{
	if (@sysvar::CH_Nodes::CH_SCCMALDW_VibMot_StatS_UB_AUTO == 0)
	{
		if ($ALDW_VibMot_Stat != OldVal_ALDW_VibMot_Stat)
		{
			DisturbUB("StWhl_Sw_Stat_AR2", "ALDW_VibMot_Stat_UB", 1, 1);
			OldVal_ALDW_VibMot_Stat = $ALDW_VibMot_Stat;
		}
		else
		{
			DisturbUB("StWhl_Sw_Stat_AR2", "ALDW_VibMot_Stat_UB", -1, 0);
		}
	}	if (@sysvar::CH_Nodes::CH_SCCMALDW_VibMot_AvlSt_UB_AUTO == 0)
	{
		if ($ALDW_VibMot_Avl != OldVal_ALDW_VibMot_Avl)
		{
			DisturbUB("StWhl_Sw_Stat_AR2", "ALDW_VibMot_Avl_UB", 1, 1);
			OldVal_ALDW_VibMot_Avl = $ALDW_VibMot_Avl;
		}
		else
		{
			DisturbUB("StWhl_Sw_Stat_AR2", "ALDW_VibMot_Avl_UB", -1, 0);
		}
	}}
/*@@end*/

/*@@frPDU:MsgChannel1.CHASSIS::WUDOP_SCCM_FR:*/
on frPDU MsgChannel1.CHASSIS::WUDOP_SCCM_FR
{
}
/*@@end*/

