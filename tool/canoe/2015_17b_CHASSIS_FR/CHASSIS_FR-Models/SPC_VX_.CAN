/*@@includes:*/
includes
{
	#include "ASR_FR_NM_IL.CIN"
}
/*@@end*/

/*@@var:*/
/*
|==========================================================================================|
|                                                                                          |
|                                                                                          |
|                                         COPYRIGHT                                        |
|                                                                                          |
|                   Copyright (c) by Daimler AG Abt. RD/EEV 2015                           |
|                                                                                          |
|                                                                                          |
|==========================================================================================|
|                                                                                          |
|                                   CAPL AUTHOR IDENTITY                                   |
|                                   --------------------                                   |
|                                                                                          |
| Initials   | Name                 | Company                                              |
| -----------+----------------------+----------------------------------------------------- |
| BH         | Björn Haßelkus       | Firma TZM (EXTERN im Auftrag der Daimler AG)         |
| RS         | Rainer Schulte       | Firma TZM (EXTERN im Auftrag der Daimler AG)         |
|            |                      |                                                      |
|                                                                                          |
|==========================================================================================|
|                                                                                          |
|                                     REVISION HISTORY                                     |
|                                     ----------------                                     |
|                                                                                          |
| Date       | Ver   | Author       | Description                                          |
| -----------+-------+--------------+----------------------------------------------------- |
| 27.04.15   | 1.0   | RS           | creation                                             |
|            |       |              |                                                      |
|                                                                                          |
|------------------------------------------------------------------------------------------|
*/

variables
{
	long ret_Register;
	// global variable for getting (showing) results auf dll-Functions
	long result;


	msTimer Timer_SPC_VX_ROE_SPC_VX;
	msTimer Timer_SPC_VX_SPC_VX_Stat1_AR;
	msTimer Timer_SPC_VX_SpringVlv_Stat_AR;

}
/*@@end*/

/*@@startStart:Start:*/
on start
{
	result = EnableCRC("", 0); // 1 = on, 0 = off
	result = EnableTGL("", 0); // 1 = on, 0 = off 
	result = EnableSQC("", 0); // 1 = on, 0 = off 
	result = EnableMC("", 0); // 1 = on, 0 = off 

	@sysvar::CH_Nodes::CH__PDURECEIPT_SIM_SPC_VX_ROE_SPC_VX = 1;
	@sysvar::CH_Nodes::CH__PDURECEIPT_SIM_SPC_VX_SPC_VX_Stat1_AR = 1;
	@sysvar::CH_Nodes::CH__PDURECEIPT_SIM_SPC_VX_SpringVlv_Stat_AR = 1;
	// netzwerk management

	enableControl("CHASSIS_FR Netzmanagement", "CH__NMActive_SPC_VX", 1);
}
/*@@end*/

/*@@preStart:PreStart:*/
on preStart
{


}
/*@@end*/

/*@@timer:Timer_SPC_VX_ROE_SPC_VX:*/
on timer Timer_SPC_VX_ROE_SPC_VX
{
	@sysvar::CH_Nodes::CH__STPDU_SPC_VX_ROE_SPC_VX = 0;
}
/*@@end*/

/*@@timer:Timer_SPC_VX_SPC_VX_Stat1_AR:*/
on timer Timer_SPC_VX_SPC_VX_Stat1_AR
{
	@sysvar::CH_Nodes::CH__STPDU_SPC_VX_SPC_VX_Stat1_AR = 0;
}
/*@@end*/

/*@@timer:Timer_SPC_VX_SpringVlv_Stat_AR:*/
on timer Timer_SPC_VX_SpringVlv_Stat_AR
{
	@sysvar::CH_Nodes::CH__STPDU_SPC_VX_SpringVlv_Stat_AR = 0;
}
/*@@end*/



/*@@sysvarChange:CH_Nodes::CH__STPDU_SPC_VX_ROE_SPC_VX:*/
on sysvar sysvar::CH_Nodes::CH__STPDU_SPC_VX_ROE_SPC_VX
{
	long res;
	long tDelay;
	switch (@this)
	{
		case (0):
			res = ResetTimingCyclic("ROE_SPC_VX");
			res = ResetTimingEvtTrg("ROE_SPC_VX");
			res = EnableTimingCyclic("ROE_SPC_VX", 1);
			res = EnableTimingEvtTrg("ROE_SPC_VX", 1);
			break;
		case (1):
			tDelay = @sysvar::CH_Nodes::CH__STPDU_T_SPC_VX_ROE_SPC_VX;
			if (tDelay > 0)
			{
				if (isTimerActive(Timer_SPC_VX_ROE_SPC_VX) == 0)
				{
					res = SetTimingCyclic("ROE_SPC_VX", 1, tDelay, 1);
					setTimer (Timer_SPC_VX_ROE_SPC_VX, tDelay);
					@sysvar::CH_Nodes::CH__STPDU_SPC_VX_ROE_SPC_VX = 2;
				}
			}
			else if (tDelay == 0)
			{
				if (isTimerActive(Timer_SPC_VX_ROE_SPC_VX) == 0)
				{
					res = EnableTimingCyclic("ROE_SPC_VX", 0);
					res = EnableTimingEvtTrg("ROE_SPC_VX", 0);
				}
			}
			break;
		case (2):
			break;
		default:
			Write("error: wrong parameter (%d)", @this);
			stop();
			break;
	}
}
/*@@end*/

/*@@sysvarChange:CH_Nodes::CH__STPDU_SPC_VX_SPC_VX_Stat1_AR:*/
on sysvar sysvar::CH_Nodes::CH__STPDU_SPC_VX_SPC_VX_Stat1_AR
{
	long res;
	long tDelay;
	switch (@this)
	{
		case (0):
			res = ResetTimingCyclic("SPC_VX_Stat1_AR");
			res = ResetTimingEvtTrg("SPC_VX_Stat1_AR");
			res = EnableTimingCyclic("SPC_VX_Stat1_AR", 1);
			res = EnableTimingEvtTrg("SPC_VX_Stat1_AR", 1);
			break;
		case (1):
			tDelay = @sysvar::CH_Nodes::CH__STPDU_T_SPC_VX_SPC_VX_Stat1_AR;
			if (tDelay > 0)
			{
				if (isTimerActive(Timer_SPC_VX_SPC_VX_Stat1_AR) == 0)
				{
					res = SetTimingCyclic("SPC_VX_Stat1_AR", 1, tDelay, 1);
					setTimer (Timer_SPC_VX_SPC_VX_Stat1_AR, tDelay);
					@sysvar::CH_Nodes::CH__STPDU_SPC_VX_SPC_VX_Stat1_AR = 2;
				}
			}
			else if (tDelay == 0)
			{
				if (isTimerActive(Timer_SPC_VX_SPC_VX_Stat1_AR) == 0)
				{
					res = EnableTimingCyclic("SPC_VX_Stat1_AR", 0);
					res = EnableTimingEvtTrg("SPC_VX_Stat1_AR", 0);
				}
			}
			break;
		case (2):
			break;
		default:
			Write("error: wrong parameter (%d)", @this);
			stop();
			break;
	}
}
/*@@end*/

/*@@sysvarChange:CH_Nodes::CH__STPDU_SPC_VX_SpringVlv_Stat_AR:*/
on sysvar sysvar::CH_Nodes::CH__STPDU_SPC_VX_SpringVlv_Stat_AR
{
	long res;
	long tDelay;
	switch (@this)
	{
		case (0):
			res = ResetTimingCyclic("SpringVlv_Stat_AR");
			res = ResetTimingEvtTrg("SpringVlv_Stat_AR");
			res = EnableTimingCyclic("SpringVlv_Stat_AR", 1);
			res = EnableTimingEvtTrg("SpringVlv_Stat_AR", 1);
			break;
		case (1):
			tDelay = @sysvar::CH_Nodes::CH__STPDU_T_SPC_VX_SpringVlv_Stat_AR;
			if (tDelay > 0)
			{
				if (isTimerActive(Timer_SPC_VX_SpringVlv_Stat_AR) == 0)
				{
					res = SetTimingCyclic("SpringVlv_Stat_AR", 1, tDelay, 1);
					setTimer (Timer_SPC_VX_SpringVlv_Stat_AR, tDelay);
					@sysvar::CH_Nodes::CH__STPDU_SPC_VX_SpringVlv_Stat_AR = 2;
				}
			}
			else if (tDelay == 0)
			{
				if (isTimerActive(Timer_SPC_VX_SpringVlv_Stat_AR) == 0)
				{
					res = EnableTimingCyclic("SpringVlv_Stat_AR", 0);
					res = EnableTimingEvtTrg("SpringVlv_Stat_AR", 0);
				}
			}
			break;
		case (2):
			break;
		default:
			Write("error: wrong parameter (%d)", @this);
			stop();
			break;
	}
}
/*@@end*/


/*@@caplFunc:FrILTxPending(char[],long,byte[],long):*///callback
void FrILTxPending(char pduName[], long len, byte payload[], long TxAck)
{
	byte crc;
	dword SQC;
	dword MC;
	dword Tgl;
	dword i;

	if (strncmp (pduName, "ROE_SPC_VX", strLen(pduName)+strLen("ROE_SPC_VX")) == 0)
	{
		if (TxAck == 1)
		{
		}
		else
		{
		}
	}
	if (strncmp (pduName, "SPC_VX_Stat1_AR", strLen(pduName)+strLen("SPC_VX_Stat1_AR")) == 0)
	{
		if (TxAck == 1)
		{
		}
		else
		{
		}
	}
	if (strncmp (pduName, "SpringVlv_Stat_AR", strLen(pduName)+strLen("SpringVlv_Stat_AR")) == 0)
	{
		if (TxAck == 1)
		{
		}
		else
		{
		}
	}
}
/*@@end*/

/*@@caplFunc:StartSim(int):*/
StartSim(int BusAktiv)
{
	result = EnableCRC("", 0); // 1 = on, 0 = off
	result = EnableTGL("", 0); // 1 = on, 0 = off 
	result = EnableSQC("", 0); // 1 = on, 0 = off 
	result = EnableMC("", 0); // 1 = on, 0 = off 
}
/*@@end*/

/*@@caplFunc:StopSim():*/
StopSim()
{
}
/*@@end*/

/*@@frPDU:MsgChannel1.CHASSIS::ROE_SPC_VX:*/
on frPDU MsgChannel1.CHASSIS::ROE_SPC_VX
{
}
/*@@end*/

/*@@frPDU:MsgChannel1.CHASSIS::SPC_VX_Stat1_AR:*/
on frPDU MsgChannel1.CHASSIS::SPC_VX_Stat1_AR
{
}
/*@@end*/

/*@@frPDU:MsgChannel1.CHASSIS::SpringVlv_Stat_AR:*/
on frPDU MsgChannel1.CHASSIS::SpringVlv_Stat_AR
{
}
/*@@end*/

