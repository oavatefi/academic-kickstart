/*@@includes:*/
includes
{
	#include "FR_KL15_IL.CIN"
}
/*@@end*/

/*@@var:*/
/*
|==========================================================================================|
|                                                                                          |
|                                                                                          |
|                                         COPYRIGHT                                        |
|                                                                                          |
|                   Copyright (c) by Daimler AG Abt. RD/EEV 2015                           |
|                                                                                          |
|                                                                                          |
|==========================================================================================|
|                                                                                          |
|                                   CAPL AUTHOR IDENTITY                                   |
|                                   --------------------                                   |
|                                                                                          |
| Initials   | Name                 | Company                                              |
| -----------+----------------------+----------------------------------------------------- |
| BH         | Björn Haßelkus       | Firma TZM (EXTERN im Auftrag der Daimler AG)         |
| RS         | Rainer Schulte       | Firma TZM (EXTERN im Auftrag der Daimler AG)         |
|            |                      |                                                      |
|                                                                                          |
|==========================================================================================|
|                                                                                          |
|                                     REVISION HISTORY                                     |
|                                     ----------------                                     |
|                                                                                          |
| Date       | Ver   | Author       | Description                                          |
| -----------+-------+--------------+----------------------------------------------------- |
| 27.04.15   | 1.0   | RS           | creation                                             |
|            |       |              |                                                      |
|                                                                                          |
|------------------------------------------------------------------------------------------|
*/

variables
{
	long ret_Register;
	// global variable for getting (showing) results auf dll-Functions
	long result;

	int CRC_DTR_Obj_A_Pr2;
	dword CounterValForCRC_DTR_Obj_A_Pr2;
	int SQC_VAL_DTR_Obj_A_Pr2;
	int SQC_DTR_Obj_A_Pr2;
	int CRC_DTR_Obj_B_Pr2;
	dword CounterValForCRC_DTR_Obj_B_Pr2;
	int SQC_VAL_DTR_Obj_B_Pr2;
	int SQC_DTR_Obj_B_Pr2;
	int CRC_DTR_Obj_C_Pr2;
	dword CounterValForCRC_DTR_Obj_C_Pr2;
	int SQC_VAL_DTR_Obj_C_Pr2;
	int SQC_DTR_Obj_C_Pr2;
	int CRC_DTR_Obj_D_Pr2;
	dword CounterValForCRC_DTR_Obj_D_Pr2;
	int SQC_VAL_DTR_Obj_D_Pr2;
	int SQC_DTR_Obj_D_Pr2;
	int CRC_DTR_Obj_E_Pr2;
	dword CounterValForCRC_DTR_Obj_E_Pr2;
	int SQC_VAL_DTR_Obj_E_Pr2;
	int SQC_DTR_Obj_E_Pr2;
	int CRC_DTR_Obj_F_Pr2;
	dword CounterValForCRC_DTR_Obj_F_Pr2;
	int SQC_VAL_DTR_Obj_F_Pr2;
	int SQC_DTR_Obj_F_Pr2;
	int CRC_DTR_Obj_G_Pr2;
	dword CounterValForCRC_DTR_Obj_G_Pr2;
	int SQC_VAL_DTR_Obj_G_Pr2;
	int SQC_DTR_Obj_G_Pr2;
	int CRC_DTR_ObjStat_Pr2;
	dword CounterValForCRC_DTR_ObjStat_Pr2;
	int SQC_VAL_DTR_ObjStat_Pr2;
	int SQC_DTR_ObjStat_Pr2;
	int CRC_DTR_Polyg_Lt_Pr2;
	dword CounterValForCRC_DTR_Polyg_Lt_Pr2;
	int SQC_VAL_DTR_Polyg_Lt_Pr2;
	int SQC_DTR_Polyg_Lt_Pr2;
	int CRC_DTR_Polyg_Rt_Pr2;
	dword CounterValForCRC_DTR_Polyg_Rt_Pr2;
	int SQC_VAL_DTR_Polyg_Rt_Pr2;
	int SQC_DTR_Polyg_Rt_Pr2;
	int CRC_DTR_Stat_Pr2;
	dword CounterValForCRC_DTR_Stat_Pr2;
	int SQC_VAL_DTR_Stat_Pr2;
	int SQC_DTR_Stat_Pr2;

	msTimer Timer_LRR_DTR_Obj_A_FR2;
	msTimer Timer_LRR_DTR_Obj_B_FR2;
	msTimer Timer_LRR_DTR_Obj_C_FR2;
	msTimer Timer_LRR_DTR_Obj_D_FR2;
	msTimer Timer_LRR_DTR_Obj_E_FR2;
	msTimer Timer_LRR_DTR_Obj_F_FR2;
	msTimer Timer_LRR_DTR_Obj_G_FR2;
	msTimer Timer_LRR_DTR_ObjStat_FR2;
	msTimer Timer_LRR_DTR_Polyg_Lt_FR2;
	msTimer Timer_LRR_DTR_Polyg_Rt_FR2;
	msTimer Timer_LRR_DTR_Stat_FR2;
	msTimer Timer_LRR_ROE_LRR;

   byte  crctable[256] = {
      0x00, 0x1D, 0x3A, 0x27, 0x74, 0x69, 0x4E, 0x53,
      0xE8, 0xF5, 0xD2, 0xCF, 0x9C, 0x81, 0xA6, 0xBB,
      0xCD, 0xD0, 0xF7, 0xEA, 0xB9, 0xA4, 0x83, 0x9E,
      0x25, 0x38, 0x1F, 0x02, 0x51, 0x4C, 0x6B, 0x76,
      0x87, 0x9A, 0xBD, 0xA0, 0xF3, 0xEE, 0xC9, 0xD4,
      0x6F, 0x72, 0x55, 0x48, 0x1B, 0x06, 0x21, 0x3C,
      0x4A, 0x57, 0x70, 0x6D, 0x3E, 0x23, 0x04, 0x19,
      0xA2, 0xBF, 0x98, 0x85, 0xD6, 0xCB, 0xEC, 0xF1,
      0x13, 0x0E, 0x29, 0x34, 0x67, 0x7A, 0x5D, 0x40,
      0xFB, 0xE6, 0xC1, 0xDC, 0x8F, 0x92, 0xB5, 0xA8,
      0xDE, 0xC3, 0xE4, 0xF9, 0xAA, 0xB7, 0x90, 0x8D,
      0x36, 0x2B, 0x0C, 0x11, 0x42, 0x5F, 0x78, 0x65,
      0x94, 0x89, 0xAE, 0xB3, 0xE0, 0xFD, 0xDA, 0xC7,
      0x7C, 0x61, 0x46, 0x5B, 0x08, 0x15, 0x32, 0x2F,
      0x59, 0x44, 0x63, 0x7E, 0x2D, 0x30, 0x17, 0x0A,
      0xB1, 0xAC, 0x8B, 0x96, 0xC5, 0xD8, 0xFF, 0xE2,
      0x26, 0x3B, 0x1C, 0x01, 0x52, 0x4F, 0x68, 0x75,
      0xCE, 0xD3, 0xF4, 0xE9, 0xBA, 0xA7, 0x80, 0x9D,
      0xEB, 0xF6, 0xD1, 0xCC, 0x9F, 0x82, 0xA5, 0xB8,
      0x03, 0x1E, 0x39, 0x24, 0x77, 0x6A, 0x4D, 0x50,
      0xA1, 0xBC, 0x9B, 0x86, 0xD5, 0xC8, 0xEF, 0xF2,
      0x49, 0x54, 0x73, 0x6E, 0x3D, 0x20, 0x07, 0x1A,
      0x6C, 0x71, 0x56, 0x4B, 0x18, 0x05, 0x22, 0x3F,
      0x84, 0x99, 0xBE, 0xA3, 0xF0, 0xED, 0xCA, 0xD7,
      0x35, 0x28, 0x0F, 0x12, 0x41, 0x5C, 0x7B, 0x66,
      0xDD, 0xC0, 0xE7, 0xFA, 0xA9, 0xB4, 0x93, 0x8E,
      0xF8, 0xE5, 0xC2, 0xDF, 0x8C, 0x91, 0xB6, 0xAB,
      0x10, 0x0D, 0x2A, 0x37, 0x64, 0x79, 0x5E, 0x43,
      0xB2, 0xAF, 0x88, 0x95, 0xC6, 0xDB, 0xFC, 0xE1,
      0x5A, 0x47, 0x60, 0x7D, 0x2E, 0x33, 0x14, 0x09,
      0x7F, 0x62, 0x45, 0x58, 0x0B, 0x16, 0x31, 0x2C,
      0x97, 0x8A, 0xAD, 0xB0, 0xE3, 0xFE, 0xD9, 0xC4
   };

   byte  crctableProfTwo[256] = {
			0x00, 0x2F, 0x5E, 0x71, 0xBC, 0x93, 0xE2, 0xCD,
			0x57, 0x78, 0x09, 0x26, 0xEB, 0xC4, 0xB5, 0x9A,
			0xAE, 0x81, 0xF0, 0xDF, 0x12, 0x3D, 0x4C, 0x63,
			0xF9, 0xD6, 0xA7, 0x88, 0x45, 0x6A, 0x1B, 0x34,
			0x73, 0x5C, 0x2D, 0x02, 0xCF, 0xE0, 0x91, 0xBE,
			0x24, 0x0B, 0x7A, 0x55, 0x98, 0xB7, 0xC6, 0xE9,
			0xDD, 0xF2, 0x83, 0xAC, 0x61, 0x4E, 0x3F, 0x10,
			0x8A, 0xA5, 0xD4, 0xFB, 0x36, 0x19, 0x68, 0x47,
			0xE6, 0xC9, 0xB8, 0x97, 0x5A, 0x75, 0x04, 0x2B,
			0xB1, 0x9E, 0xEF, 0xC0, 0x0D, 0x22, 0x53, 0x7C,
			0x48, 0x67, 0x16, 0x39, 0xF4, 0xDB, 0xAA, 0x85,
			0x1F, 0x30, 0x41, 0x6E, 0xA3, 0x8C, 0xFD, 0xD2,
			0x95, 0xBA, 0xCB, 0xE4, 0x29, 0x06, 0x77, 0x58,
			0xC2, 0xED, 0x9C, 0xB3, 0x7E, 0x51, 0x20, 0x0F,
			0x3B, 0x14, 0x65, 0x4A, 0x87, 0xA8, 0xD9, 0xF6,
			0x6C, 0x43, 0x32, 0x1D, 0xD0, 0xFF, 0x8E, 0xA1,
			0xE3, 0xCC, 0xBD, 0x92, 0x5F, 0x70, 0x01, 0x2E,
			0xB4, 0x9B, 0xEA, 0xC5, 0x08, 0x27, 0x56, 0x79,
			0x4D, 0x62, 0x13, 0x3C, 0xF1, 0xDE, 0xAF, 0x80,
			0x1A, 0x35, 0x44, 0x6B, 0xA6, 0x89, 0xF8, 0xD7,
			0x90, 0xBF, 0xCE, 0xE1, 0x2C, 0x03, 0x72, 0x5D,
			0xC7, 0xE8, 0x99, 0xB6, 0x7B, 0x54, 0x25, 0x0A,
			0x3E, 0x11, 0x60, 0x4F, 0x82, 0xAD, 0xDC, 0xF3,
			0x69, 0x46, 0x37, 0x18, 0xD5, 0xFA, 0x8B, 0xA4,
			0x05, 0x2A, 0x5B, 0x74, 0xB9, 0x96, 0xE7, 0xC8,
			0x52, 0x7D, 0x0C, 0x23, 0xEE, 0xC1, 0xB0, 0x9F,
			0xAB, 0x84, 0xF5, 0xDA, 0x17, 0x38, 0x49, 0x66,
			0xFC, 0xD3, 0xA2, 0x8D, 0x40, 0x6F, 0x1E, 0x31,
			0x76, 0x59, 0x28, 0x07, 0xCA, 0xE5, 0x94, 0xBB,
			0x21, 0x0E, 0x7F, 0x50, 0x9D, 0xB2, 0xC3, 0xEC,
			0xD8, 0xF7, 0x86, 0xA9, 0x64, 0x4B, 0x3A, 0x15,
			0x8F, 0xA0, 0xD1, 0xFE, 0x33, 0x1C, 0x6D, 0x42
   };
}
/*@@end*/

/*@@startStart:Start:*/
on start
{
	result = EnableCRC("", 0); // 1 = on, 0 = off
	result = EnableTGL("", 0); // 1 = on, 0 = off 
	result = EnableSQC("", 0); // 1 = on, 0 = off 
	result = EnableMC("", 0); // 1 = on, 0 = off 

	if (@sysvar::CH_Nodes::CH_LRRCRC_DTR_Obj_A_Pr2DTR__AUTO == 0)
	{
		//Automatisch
		enableControl("DTR_Obj_A_FR2", "CH_LRRCRC_DTR_Obj_A_Pr2DTR_Obj__", 0); //1: enable; 0: disable
	}
	else
	{
		//Manuel
		enableControl("DTR_Obj_A_FR2", "CH_LRRCRC_DTR_Obj_A_Pr2DTR_Obj__", 1); //1: enable; 0: disable
	}
	if (@sysvar::CH_Nodes::CH_LRRSQC_DTR_Obj_A_Pr2DTR__AUTO == 0)
	{
		//Automatisch
		enableControl("DTR_Obj_A_FR2", "CH_LRRSQC_DTR_Obj_A_Pr2DTR_Obj__", 0); //1: enable; 0: disable
	}
	else
	{
		//Manuel
		enableControl("DTR_Obj_A_FR2", "CH_LRRSQC_DTR_Obj_A_Pr2DTR_Obj__", 1); //1: enable; 0: disable
	}
	@sysvar::CH_Nodes::CH__PDURECEIPT_SIM_LRR_DTR_Obj_A_FR2 = 1;
	if (@sysvar::CH_Nodes::CH_LRRCRC_DTR_Obj_B_Pr2DTR__AUTO == 0)
	{
		//Automatisch
		enableControl("DTR_Obj_B_FR2", "CH_LRRCRC_DTR_Obj_B_Pr2DTR_Obj__", 0); //1: enable; 0: disable
	}
	else
	{
		//Manuel
		enableControl("DTR_Obj_B_FR2", "CH_LRRCRC_DTR_Obj_B_Pr2DTR_Obj__", 1); //1: enable; 0: disable
	}
	if (@sysvar::CH_Nodes::CH_LRRSQC_DTR_Obj_B_Pr2DTR__AUTO == 0)
	{
		//Automatisch
		enableControl("DTR_Obj_B_FR2", "CH_LRRSQC_DTR_Obj_B_Pr2DTR_Obj__", 0); //1: enable; 0: disable
	}
	else
	{
		//Manuel
		enableControl("DTR_Obj_B_FR2", "CH_LRRSQC_DTR_Obj_B_Pr2DTR_Obj__", 1); //1: enable; 0: disable
	}
	@sysvar::CH_Nodes::CH__PDURECEIPT_SIM_LRR_DTR_Obj_B_FR2 = 1;
	if (@sysvar::CH_Nodes::CH_LRRCRC_DTR_Obj_C_Pr2DTR__AUTO == 0)
	{
		//Automatisch
		enableControl("DTR_Obj_C_FR2", "CH_LRRCRC_DTR_Obj_C_Pr2DTR_Obj__", 0); //1: enable; 0: disable
	}
	else
	{
		//Manuel
		enableControl("DTR_Obj_C_FR2", "CH_LRRCRC_DTR_Obj_C_Pr2DTR_Obj__", 1); //1: enable; 0: disable
	}
	if (@sysvar::CH_Nodes::CH_LRRSQC_DTR_Obj_C_Pr2DTR__AUTO == 0)
	{
		//Automatisch
		enableControl("DTR_Obj_C_FR2", "CH_LRRSQC_DTR_Obj_C_Pr2DTR_Obj__", 0); //1: enable; 0: disable
	}
	else
	{
		//Manuel
		enableControl("DTR_Obj_C_FR2", "CH_LRRSQC_DTR_Obj_C_Pr2DTR_Obj__", 1); //1: enable; 0: disable
	}
	@sysvar::CH_Nodes::CH__PDURECEIPT_SIM_LRR_DTR_Obj_C_FR2 = 1;
	if (@sysvar::CH_Nodes::CH_LRRCRC_DTR_Obj_D_Pr2DTR__AUTO == 0)
	{
		//Automatisch
		enableControl("DTR_Obj_D_FR2", "CH_LRRCRC_DTR_Obj_D_Pr2DTR_Obj__", 0); //1: enable; 0: disable
	}
	else
	{
		//Manuel
		enableControl("DTR_Obj_D_FR2", "CH_LRRCRC_DTR_Obj_D_Pr2DTR_Obj__", 1); //1: enable; 0: disable
	}
	if (@sysvar::CH_Nodes::CH_LRRSQC_DTR_Obj_D_Pr2DTR__AUTO == 0)
	{
		//Automatisch
		enableControl("DTR_Obj_D_FR2", "CH_LRRSQC_DTR_Obj_D_Pr2DTR_Obj__", 0); //1: enable; 0: disable
	}
	else
	{
		//Manuel
		enableControl("DTR_Obj_D_FR2", "CH_LRRSQC_DTR_Obj_D_Pr2DTR_Obj__", 1); //1: enable; 0: disable
	}
	@sysvar::CH_Nodes::CH__PDURECEIPT_SIM_LRR_DTR_Obj_D_FR2 = 1;
	if (@sysvar::CH_Nodes::CH_LRRCRC_DTR_Obj_E_Pr2DTR__AUTO == 0)
	{
		//Automatisch
		enableControl("DTR_Obj_E_FR2", "CH_LRRCRC_DTR_Obj_E_Pr2DTR_Obj__", 0); //1: enable; 0: disable
	}
	else
	{
		//Manuel
		enableControl("DTR_Obj_E_FR2", "CH_LRRCRC_DTR_Obj_E_Pr2DTR_Obj__", 1); //1: enable; 0: disable
	}
	if (@sysvar::CH_Nodes::CH_LRRSQC_DTR_Obj_E_Pr2DTR__AUTO == 0)
	{
		//Automatisch
		enableControl("DTR_Obj_E_FR2", "CH_LRRSQC_DTR_Obj_E_Pr2DTR_Obj__", 0); //1: enable; 0: disable
	}
	else
	{
		//Manuel
		enableControl("DTR_Obj_E_FR2", "CH_LRRSQC_DTR_Obj_E_Pr2DTR_Obj__", 1); //1: enable; 0: disable
	}
	@sysvar::CH_Nodes::CH__PDURECEIPT_SIM_LRR_DTR_Obj_E_FR2 = 1;
	if (@sysvar::CH_Nodes::CH_LRRCRC_DTR_Obj_F_Pr2DTR__AUTO == 0)
	{
		//Automatisch
		enableControl("DTR_Obj_F_FR2", "CH_LRRCRC_DTR_Obj_F_Pr2DTR_Obj__", 0); //1: enable; 0: disable
	}
	else
	{
		//Manuel
		enableControl("DTR_Obj_F_FR2", "CH_LRRCRC_DTR_Obj_F_Pr2DTR_Obj__", 1); //1: enable; 0: disable
	}
	if (@sysvar::CH_Nodes::CH_LRRSQC_DTR_Obj_F_Pr2DTR__AUTO == 0)
	{
		//Automatisch
		enableControl("DTR_Obj_F_FR2", "CH_LRRSQC_DTR_Obj_F_Pr2DTR_Obj__", 0); //1: enable; 0: disable
	}
	else
	{
		//Manuel
		enableControl("DTR_Obj_F_FR2", "CH_LRRSQC_DTR_Obj_F_Pr2DTR_Obj__", 1); //1: enable; 0: disable
	}
	@sysvar::CH_Nodes::CH__PDURECEIPT_SIM_LRR_DTR_Obj_F_FR2 = 1;
	if (@sysvar::CH_Nodes::CH_LRRCRC_DTR_Obj_G_Pr2DTR__AUTO == 0)
	{
		//Automatisch
		enableControl("DTR_Obj_G_FR2", "CH_LRRCRC_DTR_Obj_G_Pr2DTR_Obj__", 0); //1: enable; 0: disable
	}
	else
	{
		//Manuel
		enableControl("DTR_Obj_G_FR2", "CH_LRRCRC_DTR_Obj_G_Pr2DTR_Obj__", 1); //1: enable; 0: disable
	}
	if (@sysvar::CH_Nodes::CH_LRRSQC_DTR_Obj_G_Pr2DTR__AUTO == 0)
	{
		//Automatisch
		enableControl("DTR_Obj_G_FR2", "CH_LRRSQC_DTR_Obj_G_Pr2DTR_Obj__", 0); //1: enable; 0: disable
	}
	else
	{
		//Manuel
		enableControl("DTR_Obj_G_FR2", "CH_LRRSQC_DTR_Obj_G_Pr2DTR_Obj__", 1); //1: enable; 0: disable
	}
	@sysvar::CH_Nodes::CH__PDURECEIPT_SIM_LRR_DTR_Obj_G_FR2 = 1;
	if (@sysvar::CH_Nodes::CH_LRRCRC_DTR_ObjStat_Pr2DT_AUTO == 0)
	{
		//Automatisch
		enableControl("DTR_ObjStat_FR2", "CH_LRRCRC_DTR_ObjStat_Pr2DTR_Ob_", 0); //1: enable; 0: disable
	}
	else
	{
		//Manuel
		enableControl("DTR_ObjStat_FR2", "CH_LRRCRC_DTR_ObjStat_Pr2DTR_Ob_", 1); //1: enable; 0: disable
	}
	if (@sysvar::CH_Nodes::CH_LRRSQC_DTR_ObjStat_Pr2DT_AUTO == 0)
	{
		//Automatisch
		enableControl("DTR_ObjStat_FR2", "CH_LRRSQC_DTR_ObjStat_Pr2DTR_Ob_", 0); //1: enable; 0: disable
	}
	else
	{
		//Manuel
		enableControl("DTR_ObjStat_FR2", "CH_LRRSQC_DTR_ObjStat_Pr2DTR_Ob_", 1); //1: enable; 0: disable
	}
	@sysvar::CH_Nodes::CH__PDURECEIPT_SIM_LRR_DTR_ObjStat_FR2 = 1;
	if (@sysvar::CH_Nodes::CH_LRRCRC_DTR_Polyg_Lt_Pr2D_AUTO == 0)
	{
		//Automatisch
		enableControl("DTR_Polyg_Lt_FR2", "CH_LRRCRC_DTR_Polyg_Lt_Pr2DTR_P_", 0); //1: enable; 0: disable
	}
	else
	{
		//Manuel
		enableControl("DTR_Polyg_Lt_FR2", "CH_LRRCRC_DTR_Polyg_Lt_Pr2DTR_P_", 1); //1: enable; 0: disable
	}
	if (@sysvar::CH_Nodes::CH_LRRSQC_DTR_Polyg_Lt_Pr2D_AUTO == 0)
	{
		//Automatisch
		enableControl("DTR_Polyg_Lt_FR2", "CH_LRRSQC_DTR_Polyg_Lt_Pr2DTR_P_", 0); //1: enable; 0: disable
	}
	else
	{
		//Manuel
		enableControl("DTR_Polyg_Lt_FR2", "CH_LRRSQC_DTR_Polyg_Lt_Pr2DTR_P_", 1); //1: enable; 0: disable
	}
	@sysvar::CH_Nodes::CH__PDURECEIPT_SIM_LRR_DTR_Polyg_Lt_FR2 = 1;
	if (@sysvar::CH_Nodes::CH_LRRCRC_DTR_Polyg_Rt_Pr2D_AUTO == 0)
	{
		//Automatisch
		enableControl("DTR_Polyg_Rt_FR2", "CH_LRRCRC_DTR_Polyg_Rt_Pr2DTR_P_", 0); //1: enable; 0: disable
	}
	else
	{
		//Manuel
		enableControl("DTR_Polyg_Rt_FR2", "CH_LRRCRC_DTR_Polyg_Rt_Pr2DTR_P_", 1); //1: enable; 0: disable
	}
	if (@sysvar::CH_Nodes::CH_LRRSQC_DTR_Polyg_Rt_Pr2D_AUTO == 0)
	{
		//Automatisch
		enableControl("DTR_Polyg_Rt_FR2", "CH_LRRSQC_DTR_Polyg_Rt_Pr2DTR_P_", 0); //1: enable; 0: disable
	}
	else
	{
		//Manuel
		enableControl("DTR_Polyg_Rt_FR2", "CH_LRRSQC_DTR_Polyg_Rt_Pr2DTR_P_", 1); //1: enable; 0: disable
	}
	@sysvar::CH_Nodes::CH__PDURECEIPT_SIM_LRR_DTR_Polyg_Rt_FR2 = 1;
	if (@sysvar::CH_Nodes::CH_LRRCRC_DTR_Stat_Pr2DTR_S_AUTO == 0)
	{
		//Automatisch
		enableControl("DTR_Stat_FR2", "CH_LRRCRC_DTR_Stat_Pr2DTR_Stat__", 0); //1: enable; 0: disable
	}
	else
	{
		//Manuel
		enableControl("DTR_Stat_FR2", "CH_LRRCRC_DTR_Stat_Pr2DTR_Stat__", 1); //1: enable; 0: disable
	}
	if (@sysvar::CH_Nodes::CH_LRRSQC_DTR_Stat_Pr2DTR_S_AUTO == 0)
	{
		//Automatisch
		enableControl("DTR_Stat_FR2", "CH_LRRSQC_DTR_Stat_Pr2DTR_Stat__", 0); //1: enable; 0: disable
	}
	else
	{
		//Manuel
		enableControl("DTR_Stat_FR2", "CH_LRRSQC_DTR_Stat_Pr2DTR_Stat__", 1); //1: enable; 0: disable
	}
	@sysvar::CH_Nodes::CH__PDURECEIPT_SIM_LRR_DTR_Stat_FR2 = 1;
	@sysvar::CH_Nodes::CH__PDURECEIPT_SIM_LRR_ROE_LRR = 1;
	enableControl("DTR_Obj_A_FR2", "ECU LRR awake", 0);
	enableControl("CHASSIS_FR Netzmanagement", "CH__NMActive_LRR", 0);
	enableControl("CHASSIS_FR Netzmanagement", "CH__NMAwake_LRR", 0);
}
/*@@end*/

/*@@preStart:PreStart:*/
on preStart
{



}
/*@@end*/

/*@@timer:Timer_LRR_DTR_Obj_A_FR2:*/
on timer Timer_LRR_DTR_Obj_A_FR2
{
	@sysvar::CH_Nodes::CH__STPDU_LRR_DTR_Obj_A_FR2 = 0;
}
/*@@end*/

/*@@timer:Timer_LRR_DTR_Obj_B_FR2:*/
on timer Timer_LRR_DTR_Obj_B_FR2
{
	@sysvar::CH_Nodes::CH__STPDU_LRR_DTR_Obj_B_FR2 = 0;
}
/*@@end*/

/*@@timer:Timer_LRR_DTR_Obj_C_FR2:*/
on timer Timer_LRR_DTR_Obj_C_FR2
{
	@sysvar::CH_Nodes::CH__STPDU_LRR_DTR_Obj_C_FR2 = 0;
}
/*@@end*/

/*@@timer:Timer_LRR_DTR_Obj_D_FR2:*/
on timer Timer_LRR_DTR_Obj_D_FR2
{
	@sysvar::CH_Nodes::CH__STPDU_LRR_DTR_Obj_D_FR2 = 0;
}
/*@@end*/

/*@@timer:Timer_LRR_DTR_Obj_E_FR2:*/
on timer Timer_LRR_DTR_Obj_E_FR2
{
	@sysvar::CH_Nodes::CH__STPDU_LRR_DTR_Obj_E_FR2 = 0;
}
/*@@end*/

/*@@timer:Timer_LRR_DTR_Obj_F_FR2:*/
on timer Timer_LRR_DTR_Obj_F_FR2
{
	@sysvar::CH_Nodes::CH__STPDU_LRR_DTR_Obj_F_FR2 = 0;
}
/*@@end*/

/*@@timer:Timer_LRR_DTR_Obj_G_FR2:*/
on timer Timer_LRR_DTR_Obj_G_FR2
{
	@sysvar::CH_Nodes::CH__STPDU_LRR_DTR_Obj_G_FR2 = 0;
}
/*@@end*/

/*@@timer:Timer_LRR_DTR_ObjStat_FR2:*/
on timer Timer_LRR_DTR_ObjStat_FR2
{
	@sysvar::CH_Nodes::CH__STPDU_LRR_DTR_ObjStat_FR2 = 0;
}
/*@@end*/

/*@@timer:Timer_LRR_DTR_Polyg_Lt_FR2:*/
on timer Timer_LRR_DTR_Polyg_Lt_FR2
{
	@sysvar::CH_Nodes::CH__STPDU_LRR_DTR_Polyg_Lt_FR2 = 0;
}
/*@@end*/

/*@@timer:Timer_LRR_DTR_Polyg_Rt_FR2:*/
on timer Timer_LRR_DTR_Polyg_Rt_FR2
{
	@sysvar::CH_Nodes::CH__STPDU_LRR_DTR_Polyg_Rt_FR2 = 0;
}
/*@@end*/

/*@@timer:Timer_LRR_DTR_Stat_FR2:*/
on timer Timer_LRR_DTR_Stat_FR2
{
	@sysvar::CH_Nodes::CH__STPDU_LRR_DTR_Stat_FR2 = 0;
}
/*@@end*/

/*@@timer:Timer_LRR_ROE_LRR:*/
on timer Timer_LRR_ROE_LRR
{
	@sysvar::CH_Nodes::CH__STPDU_LRR_ROE_LRR = 0;
}
/*@@end*/



/*@@sysvarChange:CH_Nodes::CH__STPDU_LRR_DTR_Obj_A_FR2:*/
on sysvar sysvar::CH_Nodes::CH__STPDU_LRR_DTR_Obj_A_FR2
{
	long res;
	long tDelay;
	switch (@this)
	{
		case (0):
			res = ResetTimingCyclic("DTR_Obj_A_FR2");
			res = ResetTimingEvtTrg("DTR_Obj_A_FR2");
			res = EnableTimingCyclic("DTR_Obj_A_FR2", 1);
			res = EnableTimingEvtTrg("DTR_Obj_A_FR2", 1);
			break;
		case (1):
			tDelay = @sysvar::CH_Nodes::CH__STPDU_T_LRR_DTR_Obj_A_FR2;
			if (tDelay > 0)
			{
				if (isTimerActive(Timer_LRR_DTR_Obj_A_FR2) == 0)
				{
					res = SetTimingCyclic("DTR_Obj_A_FR2", 1, tDelay, 1);
					setTimer (Timer_LRR_DTR_Obj_A_FR2, tDelay);
					@sysvar::CH_Nodes::CH__STPDU_LRR_DTR_Obj_A_FR2 = 2;
				}
			}
			else if (tDelay == 0)
			{
				if (isTimerActive(Timer_LRR_DTR_Obj_A_FR2) == 0)
				{
					res = EnableTimingCyclic("DTR_Obj_A_FR2", 0);
					res = EnableTimingEvtTrg("DTR_Obj_A_FR2", 0);
				}
			}
			break;
		case (2):
			break;
		default:
			Write("error: wrong parameter (%d)", @this);
			stop();
			break;
	}
}
/*@@end*/

/*@@sysvarChange:CH_Nodes::CH__STPDU_LRR_DTR_Obj_B_FR2:*/
on sysvar sysvar::CH_Nodes::CH__STPDU_LRR_DTR_Obj_B_FR2
{
	long res;
	long tDelay;
	switch (@this)
	{
		case (0):
			res = ResetTimingCyclic("DTR_Obj_B_FR2");
			res = ResetTimingEvtTrg("DTR_Obj_B_FR2");
			res = EnableTimingCyclic("DTR_Obj_B_FR2", 1);
			res = EnableTimingEvtTrg("DTR_Obj_B_FR2", 1);
			break;
		case (1):
			tDelay = @sysvar::CH_Nodes::CH__STPDU_T_LRR_DTR_Obj_B_FR2;
			if (tDelay > 0)
			{
				if (isTimerActive(Timer_LRR_DTR_Obj_B_FR2) == 0)
				{
					res = SetTimingCyclic("DTR_Obj_B_FR2", 1, tDelay, 1);
					setTimer (Timer_LRR_DTR_Obj_B_FR2, tDelay);
					@sysvar::CH_Nodes::CH__STPDU_LRR_DTR_Obj_B_FR2 = 2;
				}
			}
			else if (tDelay == 0)
			{
				if (isTimerActive(Timer_LRR_DTR_Obj_B_FR2) == 0)
				{
					res = EnableTimingCyclic("DTR_Obj_B_FR2", 0);
					res = EnableTimingEvtTrg("DTR_Obj_B_FR2", 0);
				}
			}
			break;
		case (2):
			break;
		default:
			Write("error: wrong parameter (%d)", @this);
			stop();
			break;
	}
}
/*@@end*/

/*@@sysvarChange:CH_Nodes::CH__STPDU_LRR_DTR_Obj_C_FR2:*/
on sysvar sysvar::CH_Nodes::CH__STPDU_LRR_DTR_Obj_C_FR2
{
	long res;
	long tDelay;
	switch (@this)
	{
		case (0):
			res = ResetTimingCyclic("DTR_Obj_C_FR2");
			res = ResetTimingEvtTrg("DTR_Obj_C_FR2");
			res = EnableTimingCyclic("DTR_Obj_C_FR2", 1);
			res = EnableTimingEvtTrg("DTR_Obj_C_FR2", 1);
			break;
		case (1):
			tDelay = @sysvar::CH_Nodes::CH__STPDU_T_LRR_DTR_Obj_C_FR2;
			if (tDelay > 0)
			{
				if (isTimerActive(Timer_LRR_DTR_Obj_C_FR2) == 0)
				{
					res = SetTimingCyclic("DTR_Obj_C_FR2", 1, tDelay, 1);
					setTimer (Timer_LRR_DTR_Obj_C_FR2, tDelay);
					@sysvar::CH_Nodes::CH__STPDU_LRR_DTR_Obj_C_FR2 = 2;
				}
			}
			else if (tDelay == 0)
			{
				if (isTimerActive(Timer_LRR_DTR_Obj_C_FR2) == 0)
				{
					res = EnableTimingCyclic("DTR_Obj_C_FR2", 0);
					res = EnableTimingEvtTrg("DTR_Obj_C_FR2", 0);
				}
			}
			break;
		case (2):
			break;
		default:
			Write("error: wrong parameter (%d)", @this);
			stop();
			break;
	}
}
/*@@end*/

/*@@sysvarChange:CH_Nodes::CH__STPDU_LRR_DTR_Obj_D_FR2:*/
on sysvar sysvar::CH_Nodes::CH__STPDU_LRR_DTR_Obj_D_FR2
{
	long res;
	long tDelay;
	switch (@this)
	{
		case (0):
			res = ResetTimingCyclic("DTR_Obj_D_FR2");
			res = ResetTimingEvtTrg("DTR_Obj_D_FR2");
			res = EnableTimingCyclic("DTR_Obj_D_FR2", 1);
			res = EnableTimingEvtTrg("DTR_Obj_D_FR2", 1);
			break;
		case (1):
			tDelay = @sysvar::CH_Nodes::CH__STPDU_T_LRR_DTR_Obj_D_FR2;
			if (tDelay > 0)
			{
				if (isTimerActive(Timer_LRR_DTR_Obj_D_FR2) == 0)
				{
					res = SetTimingCyclic("DTR_Obj_D_FR2", 1, tDelay, 1);
					setTimer (Timer_LRR_DTR_Obj_D_FR2, tDelay);
					@sysvar::CH_Nodes::CH__STPDU_LRR_DTR_Obj_D_FR2 = 2;
				}
			}
			else if (tDelay == 0)
			{
				if (isTimerActive(Timer_LRR_DTR_Obj_D_FR2) == 0)
				{
					res = EnableTimingCyclic("DTR_Obj_D_FR2", 0);
					res = EnableTimingEvtTrg("DTR_Obj_D_FR2", 0);
				}
			}
			break;
		case (2):
			break;
		default:
			Write("error: wrong parameter (%d)", @this);
			stop();
			break;
	}
}
/*@@end*/

/*@@sysvarChange:CH_Nodes::CH__STPDU_LRR_DTR_Obj_E_FR2:*/
on sysvar sysvar::CH_Nodes::CH__STPDU_LRR_DTR_Obj_E_FR2
{
	long res;
	long tDelay;
	switch (@this)
	{
		case (0):
			res = ResetTimingCyclic("DTR_Obj_E_FR2");
			res = ResetTimingEvtTrg("DTR_Obj_E_FR2");
			res = EnableTimingCyclic("DTR_Obj_E_FR2", 1);
			res = EnableTimingEvtTrg("DTR_Obj_E_FR2", 1);
			break;
		case (1):
			tDelay = @sysvar::CH_Nodes::CH__STPDU_T_LRR_DTR_Obj_E_FR2;
			if (tDelay > 0)
			{
				if (isTimerActive(Timer_LRR_DTR_Obj_E_FR2) == 0)
				{
					res = SetTimingCyclic("DTR_Obj_E_FR2", 1, tDelay, 1);
					setTimer (Timer_LRR_DTR_Obj_E_FR2, tDelay);
					@sysvar::CH_Nodes::CH__STPDU_LRR_DTR_Obj_E_FR2 = 2;
				}
			}
			else if (tDelay == 0)
			{
				if (isTimerActive(Timer_LRR_DTR_Obj_E_FR2) == 0)
				{
					res = EnableTimingCyclic("DTR_Obj_E_FR2", 0);
					res = EnableTimingEvtTrg("DTR_Obj_E_FR2", 0);
				}
			}
			break;
		case (2):
			break;
		default:
			Write("error: wrong parameter (%d)", @this);
			stop();
			break;
	}
}
/*@@end*/

/*@@sysvarChange:CH_Nodes::CH__STPDU_LRR_DTR_Obj_F_FR2:*/
on sysvar sysvar::CH_Nodes::CH__STPDU_LRR_DTR_Obj_F_FR2
{
	long res;
	long tDelay;
	switch (@this)
	{
		case (0):
			res = ResetTimingCyclic("DTR_Obj_F_FR2");
			res = ResetTimingEvtTrg("DTR_Obj_F_FR2");
			res = EnableTimingCyclic("DTR_Obj_F_FR2", 1);
			res = EnableTimingEvtTrg("DTR_Obj_F_FR2", 1);
			break;
		case (1):
			tDelay = @sysvar::CH_Nodes::CH__STPDU_T_LRR_DTR_Obj_F_FR2;
			if (tDelay > 0)
			{
				if (isTimerActive(Timer_LRR_DTR_Obj_F_FR2) == 0)
				{
					res = SetTimingCyclic("DTR_Obj_F_FR2", 1, tDelay, 1);
					setTimer (Timer_LRR_DTR_Obj_F_FR2, tDelay);
					@sysvar::CH_Nodes::CH__STPDU_LRR_DTR_Obj_F_FR2 = 2;
				}
			}
			else if (tDelay == 0)
			{
				if (isTimerActive(Timer_LRR_DTR_Obj_F_FR2) == 0)
				{
					res = EnableTimingCyclic("DTR_Obj_F_FR2", 0);
					res = EnableTimingEvtTrg("DTR_Obj_F_FR2", 0);
				}
			}
			break;
		case (2):
			break;
		default:
			Write("error: wrong parameter (%d)", @this);
			stop();
			break;
	}
}
/*@@end*/

/*@@sysvarChange:CH_Nodes::CH__STPDU_LRR_DTR_Obj_G_FR2:*/
on sysvar sysvar::CH_Nodes::CH__STPDU_LRR_DTR_Obj_G_FR2
{
	long res;
	long tDelay;
	switch (@this)
	{
		case (0):
			res = ResetTimingCyclic("DTR_Obj_G_FR2");
			res = ResetTimingEvtTrg("DTR_Obj_G_FR2");
			res = EnableTimingCyclic("DTR_Obj_G_FR2", 1);
			res = EnableTimingEvtTrg("DTR_Obj_G_FR2", 1);
			break;
		case (1):
			tDelay = @sysvar::CH_Nodes::CH__STPDU_T_LRR_DTR_Obj_G_FR2;
			if (tDelay > 0)
			{
				if (isTimerActive(Timer_LRR_DTR_Obj_G_FR2) == 0)
				{
					res = SetTimingCyclic("DTR_Obj_G_FR2", 1, tDelay, 1);
					setTimer (Timer_LRR_DTR_Obj_G_FR2, tDelay);
					@sysvar::CH_Nodes::CH__STPDU_LRR_DTR_Obj_G_FR2 = 2;
				}
			}
			else if (tDelay == 0)
			{
				if (isTimerActive(Timer_LRR_DTR_Obj_G_FR2) == 0)
				{
					res = EnableTimingCyclic("DTR_Obj_G_FR2", 0);
					res = EnableTimingEvtTrg("DTR_Obj_G_FR2", 0);
				}
			}
			break;
		case (2):
			break;
		default:
			Write("error: wrong parameter (%d)", @this);
			stop();
			break;
	}
}
/*@@end*/

/*@@sysvarChange:CH_Nodes::CH__STPDU_LRR_DTR_ObjStat_FR2:*/
on sysvar sysvar::CH_Nodes::CH__STPDU_LRR_DTR_ObjStat_FR2
{
	long res;
	long tDelay;
	switch (@this)
	{
		case (0):
			res = ResetTimingCyclic("DTR_ObjStat_FR2");
			res = ResetTimingEvtTrg("DTR_ObjStat_FR2");
			res = EnableTimingCyclic("DTR_ObjStat_FR2", 1);
			res = EnableTimingEvtTrg("DTR_ObjStat_FR2", 1);
			break;
		case (1):
			tDelay = @sysvar::CH_Nodes::CH__STPDU_T_LRR_DTR_ObjStat_FR2;
			if (tDelay > 0)
			{
				if (isTimerActive(Timer_LRR_DTR_ObjStat_FR2) == 0)
				{
					res = SetTimingCyclic("DTR_ObjStat_FR2", 1, tDelay, 1);
					setTimer (Timer_LRR_DTR_ObjStat_FR2, tDelay);
					@sysvar::CH_Nodes::CH__STPDU_LRR_DTR_ObjStat_FR2 = 2;
				}
			}
			else if (tDelay == 0)
			{
				if (isTimerActive(Timer_LRR_DTR_ObjStat_FR2) == 0)
				{
					res = EnableTimingCyclic("DTR_ObjStat_FR2", 0);
					res = EnableTimingEvtTrg("DTR_ObjStat_FR2", 0);
				}
			}
			break;
		case (2):
			break;
		default:
			Write("error: wrong parameter (%d)", @this);
			stop();
			break;
	}
}
/*@@end*/

/*@@sysvarChange:CH_Nodes::CH__STPDU_LRR_DTR_Polyg_Lt_FR2:*/
on sysvar sysvar::CH_Nodes::CH__STPDU_LRR_DTR_Polyg_Lt_FR2
{
	long res;
	long tDelay;
	switch (@this)
	{
		case (0):
			res = ResetTimingCyclic("DTR_Polyg_Lt_FR2");
			res = ResetTimingEvtTrg("DTR_Polyg_Lt_FR2");
			res = EnableTimingCyclic("DTR_Polyg_Lt_FR2", 1);
			res = EnableTimingEvtTrg("DTR_Polyg_Lt_FR2", 1);
			break;
		case (1):
			tDelay = @sysvar::CH_Nodes::CH__STPDU_T_LRR_DTR_Polyg_Lt_FR2;
			if (tDelay > 0)
			{
				if (isTimerActive(Timer_LRR_DTR_Polyg_Lt_FR2) == 0)
				{
					res = SetTimingCyclic("DTR_Polyg_Lt_FR2", 1, tDelay, 1);
					setTimer (Timer_LRR_DTR_Polyg_Lt_FR2, tDelay);
					@sysvar::CH_Nodes::CH__STPDU_LRR_DTR_Polyg_Lt_FR2 = 2;
				}
			}
			else if (tDelay == 0)
			{
				if (isTimerActive(Timer_LRR_DTR_Polyg_Lt_FR2) == 0)
				{
					res = EnableTimingCyclic("DTR_Polyg_Lt_FR2", 0);
					res = EnableTimingEvtTrg("DTR_Polyg_Lt_FR2", 0);
				}
			}
			break;
		case (2):
			break;
		default:
			Write("error: wrong parameter (%d)", @this);
			stop();
			break;
	}
}
/*@@end*/

/*@@sysvarChange:CH_Nodes::CH__STPDU_LRR_DTR_Polyg_Rt_FR2:*/
on sysvar sysvar::CH_Nodes::CH__STPDU_LRR_DTR_Polyg_Rt_FR2
{
	long res;
	long tDelay;
	switch (@this)
	{
		case (0):
			res = ResetTimingCyclic("DTR_Polyg_Rt_FR2");
			res = ResetTimingEvtTrg("DTR_Polyg_Rt_FR2");
			res = EnableTimingCyclic("DTR_Polyg_Rt_FR2", 1);
			res = EnableTimingEvtTrg("DTR_Polyg_Rt_FR2", 1);
			break;
		case (1):
			tDelay = @sysvar::CH_Nodes::CH__STPDU_T_LRR_DTR_Polyg_Rt_FR2;
			if (tDelay > 0)
			{
				if (isTimerActive(Timer_LRR_DTR_Polyg_Rt_FR2) == 0)
				{
					res = SetTimingCyclic("DTR_Polyg_Rt_FR2", 1, tDelay, 1);
					setTimer (Timer_LRR_DTR_Polyg_Rt_FR2, tDelay);
					@sysvar::CH_Nodes::CH__STPDU_LRR_DTR_Polyg_Rt_FR2 = 2;
				}
			}
			else if (tDelay == 0)
			{
				if (isTimerActive(Timer_LRR_DTR_Polyg_Rt_FR2) == 0)
				{
					res = EnableTimingCyclic("DTR_Polyg_Rt_FR2", 0);
					res = EnableTimingEvtTrg("DTR_Polyg_Rt_FR2", 0);
				}
			}
			break;
		case (2):
			break;
		default:
			Write("error: wrong parameter (%d)", @this);
			stop();
			break;
	}
}
/*@@end*/

/*@@sysvarChange:CH_Nodes::CH__STPDU_LRR_DTR_Stat_FR2:*/
on sysvar sysvar::CH_Nodes::CH__STPDU_LRR_DTR_Stat_FR2
{
	long res;
	long tDelay;
	switch (@this)
	{
		case (0):
			res = ResetTimingCyclic("DTR_Stat_FR2");
			res = ResetTimingEvtTrg("DTR_Stat_FR2");
			res = EnableTimingCyclic("DTR_Stat_FR2", 1);
			res = EnableTimingEvtTrg("DTR_Stat_FR2", 1);
			break;
		case (1):
			tDelay = @sysvar::CH_Nodes::CH__STPDU_T_LRR_DTR_Stat_FR2;
			if (tDelay > 0)
			{
				if (isTimerActive(Timer_LRR_DTR_Stat_FR2) == 0)
				{
					res = SetTimingCyclic("DTR_Stat_FR2", 1, tDelay, 1);
					setTimer (Timer_LRR_DTR_Stat_FR2, tDelay);
					@sysvar::CH_Nodes::CH__STPDU_LRR_DTR_Stat_FR2 = 2;
				}
			}
			else if (tDelay == 0)
			{
				if (isTimerActive(Timer_LRR_DTR_Stat_FR2) == 0)
				{
					res = EnableTimingCyclic("DTR_Stat_FR2", 0);
					res = EnableTimingEvtTrg("DTR_Stat_FR2", 0);
				}
			}
			break;
		case (2):
			break;
		default:
			Write("error: wrong parameter (%d)", @this);
			stop();
			break;
	}
}
/*@@end*/

/*@@sysvarChange:CH_Nodes::CH__STPDU_LRR_ROE_LRR:*/
on sysvar sysvar::CH_Nodes::CH__STPDU_LRR_ROE_LRR
{
	long res;
	long tDelay;
	switch (@this)
	{
		case (0):
			res = ResetTimingCyclic("ROE_LRR");
			res = ResetTimingEvtTrg("ROE_LRR");
			res = EnableTimingCyclic("ROE_LRR", 1);
			res = EnableTimingEvtTrg("ROE_LRR", 1);
			break;
		case (1):
			tDelay = @sysvar::CH_Nodes::CH__STPDU_T_LRR_ROE_LRR;
			if (tDelay > 0)
			{
				if (isTimerActive(Timer_LRR_ROE_LRR) == 0)
				{
					res = SetTimingCyclic("ROE_LRR", 1, tDelay, 1);
					setTimer (Timer_LRR_ROE_LRR, tDelay);
					@sysvar::CH_Nodes::CH__STPDU_LRR_ROE_LRR = 2;
				}
			}
			else if (tDelay == 0)
			{
				if (isTimerActive(Timer_LRR_ROE_LRR) == 0)
				{
					res = EnableTimingCyclic("ROE_LRR", 0);
					res = EnableTimingEvtTrg("ROE_LRR", 0);
				}
			}
			break;
		case (2):
			break;
		default:
			Write("error: wrong parameter (%d)", @this);
			stop();
			break;
	}
}
/*@@end*/


/*@@sysvarChange:CH_Nodes::CH_LRRCRC_DTR_Obj_A_Pr2DTR__AUTO:*/
on sysvar sysvar::CH_Nodes::CH_LRRCRC_DTR_Obj_A_Pr2DTR__AUTO
{
//	EnableCRC("DTR_Obj_A_FR2",  "DTR_Obj_A_Pr2", !@this); // 1 = on, 0 = off 
	enableControl("DTR_Obj_A_FR2", "CH_LRRCRC_DTR_Obj_A_Pr2DTR_Obj__", @this); //1: enable; 0: disable
	CRC_DTR_Obj_A_Pr2 = @sysvar::CH_Nodes::CH_LRRCRC_DTR_Obj_A_Pr2DTR__AUTO;
}
/*@@end*/

/*@@sysvarChange:CH_Nodes::CH_LRRSQC_DTR_Obj_A_Pr2DTR__AUTO:*/
on sysvar sysvar::CH_Nodes::CH_LRRSQC_DTR_Obj_A_Pr2DTR__AUTO
{
//	EnableSQC("DTR_Obj_A_FR2",  "DTR_Obj_A_Pr2", !@this); // 1 = on, 0 = off 
	enableControl("DTR_Obj_A_FR2", "CH_LRRSQC_DTR_Obj_A_Pr2DTR_Obj__", @this); //1: enable; 0: disable
	SQC_DTR_Obj_A_Pr2 = @sysvar::CH_Nodes::CH_LRRSQC_DTR_Obj_A_Pr2DTR__AUTO;
}
/*@@end*/

/*@@sysvarChange:CH_Nodes::CH_LRRCRC_DTR_Obj_B_Pr2DTR__AUTO:*/
on sysvar sysvar::CH_Nodes::CH_LRRCRC_DTR_Obj_B_Pr2DTR__AUTO
{
//	EnableCRC("DTR_Obj_B_FR2",  "DTR_Obj_B_Pr2", !@this); // 1 = on, 0 = off 
	enableControl("DTR_Obj_B_FR2", "CH_LRRCRC_DTR_Obj_B_Pr2DTR_Obj__", @this); //1: enable; 0: disable
	CRC_DTR_Obj_B_Pr2 = @sysvar::CH_Nodes::CH_LRRCRC_DTR_Obj_B_Pr2DTR__AUTO;
}
/*@@end*/

/*@@sysvarChange:CH_Nodes::CH_LRRSQC_DTR_Obj_B_Pr2DTR__AUTO:*/
on sysvar sysvar::CH_Nodes::CH_LRRSQC_DTR_Obj_B_Pr2DTR__AUTO
{
//	EnableSQC("DTR_Obj_B_FR2",  "DTR_Obj_B_Pr2", !@this); // 1 = on, 0 = off 
	enableControl("DTR_Obj_B_FR2", "CH_LRRSQC_DTR_Obj_B_Pr2DTR_Obj__", @this); //1: enable; 0: disable
	SQC_DTR_Obj_B_Pr2 = @sysvar::CH_Nodes::CH_LRRSQC_DTR_Obj_B_Pr2DTR__AUTO;
}
/*@@end*/

/*@@sysvarChange:CH_Nodes::CH_LRRCRC_DTR_Obj_C_Pr2DTR__AUTO:*/
on sysvar sysvar::CH_Nodes::CH_LRRCRC_DTR_Obj_C_Pr2DTR__AUTO
{
//	EnableCRC("DTR_Obj_C_FR2",  "DTR_Obj_C_Pr2", !@this); // 1 = on, 0 = off 
	enableControl("DTR_Obj_C_FR2", "CH_LRRCRC_DTR_Obj_C_Pr2DTR_Obj__", @this); //1: enable; 0: disable
	CRC_DTR_Obj_C_Pr2 = @sysvar::CH_Nodes::CH_LRRCRC_DTR_Obj_C_Pr2DTR__AUTO;
}
/*@@end*/

/*@@sysvarChange:CH_Nodes::CH_LRRSQC_DTR_Obj_C_Pr2DTR__AUTO:*/
on sysvar sysvar::CH_Nodes::CH_LRRSQC_DTR_Obj_C_Pr2DTR__AUTO
{
//	EnableSQC("DTR_Obj_C_FR2",  "DTR_Obj_C_Pr2", !@this); // 1 = on, 0 = off 
	enableControl("DTR_Obj_C_FR2", "CH_LRRSQC_DTR_Obj_C_Pr2DTR_Obj__", @this); //1: enable; 0: disable
	SQC_DTR_Obj_C_Pr2 = @sysvar::CH_Nodes::CH_LRRSQC_DTR_Obj_C_Pr2DTR__AUTO;
}
/*@@end*/

/*@@sysvarChange:CH_Nodes::CH_LRRCRC_DTR_Obj_D_Pr2DTR__AUTO:*/
on sysvar sysvar::CH_Nodes::CH_LRRCRC_DTR_Obj_D_Pr2DTR__AUTO
{
//	EnableCRC("DTR_Obj_D_FR2",  "DTR_Obj_D_Pr2", !@this); // 1 = on, 0 = off 
	enableControl("DTR_Obj_D_FR2", "CH_LRRCRC_DTR_Obj_D_Pr2DTR_Obj__", @this); //1: enable; 0: disable
	CRC_DTR_Obj_D_Pr2 = @sysvar::CH_Nodes::CH_LRRCRC_DTR_Obj_D_Pr2DTR__AUTO;
}
/*@@end*/

/*@@sysvarChange:CH_Nodes::CH_LRRSQC_DTR_Obj_D_Pr2DTR__AUTO:*/
on sysvar sysvar::CH_Nodes::CH_LRRSQC_DTR_Obj_D_Pr2DTR__AUTO
{
//	EnableSQC("DTR_Obj_D_FR2",  "DTR_Obj_D_Pr2", !@this); // 1 = on, 0 = off 
	enableControl("DTR_Obj_D_FR2", "CH_LRRSQC_DTR_Obj_D_Pr2DTR_Obj__", @this); //1: enable; 0: disable
	SQC_DTR_Obj_D_Pr2 = @sysvar::CH_Nodes::CH_LRRSQC_DTR_Obj_D_Pr2DTR__AUTO;
}
/*@@end*/

/*@@sysvarChange:CH_Nodes::CH_LRRCRC_DTR_Obj_E_Pr2DTR__AUTO:*/
on sysvar sysvar::CH_Nodes::CH_LRRCRC_DTR_Obj_E_Pr2DTR__AUTO
{
//	EnableCRC("DTR_Obj_E_FR2",  "DTR_Obj_E_Pr2", !@this); // 1 = on, 0 = off 
	enableControl("DTR_Obj_E_FR2", "CH_LRRCRC_DTR_Obj_E_Pr2DTR_Obj__", @this); //1: enable; 0: disable
	CRC_DTR_Obj_E_Pr2 = @sysvar::CH_Nodes::CH_LRRCRC_DTR_Obj_E_Pr2DTR__AUTO;
}
/*@@end*/

/*@@sysvarChange:CH_Nodes::CH_LRRSQC_DTR_Obj_E_Pr2DTR__AUTO:*/
on sysvar sysvar::CH_Nodes::CH_LRRSQC_DTR_Obj_E_Pr2DTR__AUTO
{
//	EnableSQC("DTR_Obj_E_FR2",  "DTR_Obj_E_Pr2", !@this); // 1 = on, 0 = off 
	enableControl("DTR_Obj_E_FR2", "CH_LRRSQC_DTR_Obj_E_Pr2DTR_Obj__", @this); //1: enable; 0: disable
	SQC_DTR_Obj_E_Pr2 = @sysvar::CH_Nodes::CH_LRRSQC_DTR_Obj_E_Pr2DTR__AUTO;
}
/*@@end*/

/*@@sysvarChange:CH_Nodes::CH_LRRCRC_DTR_Obj_F_Pr2DTR__AUTO:*/
on sysvar sysvar::CH_Nodes::CH_LRRCRC_DTR_Obj_F_Pr2DTR__AUTO
{
//	EnableCRC("DTR_Obj_F_FR2",  "DTR_Obj_F_Pr2", !@this); // 1 = on, 0 = off 
	enableControl("DTR_Obj_F_FR2", "CH_LRRCRC_DTR_Obj_F_Pr2DTR_Obj__", @this); //1: enable; 0: disable
	CRC_DTR_Obj_F_Pr2 = @sysvar::CH_Nodes::CH_LRRCRC_DTR_Obj_F_Pr2DTR__AUTO;
}
/*@@end*/

/*@@sysvarChange:CH_Nodes::CH_LRRSQC_DTR_Obj_F_Pr2DTR__AUTO:*/
on sysvar sysvar::CH_Nodes::CH_LRRSQC_DTR_Obj_F_Pr2DTR__AUTO
{
//	EnableSQC("DTR_Obj_F_FR2",  "DTR_Obj_F_Pr2", !@this); // 1 = on, 0 = off 
	enableControl("DTR_Obj_F_FR2", "CH_LRRSQC_DTR_Obj_F_Pr2DTR_Obj__", @this); //1: enable; 0: disable
	SQC_DTR_Obj_F_Pr2 = @sysvar::CH_Nodes::CH_LRRSQC_DTR_Obj_F_Pr2DTR__AUTO;
}
/*@@end*/

/*@@sysvarChange:CH_Nodes::CH_LRRCRC_DTR_Obj_G_Pr2DTR__AUTO:*/
on sysvar sysvar::CH_Nodes::CH_LRRCRC_DTR_Obj_G_Pr2DTR__AUTO
{
//	EnableCRC("DTR_Obj_G_FR2",  "DTR_Obj_G_Pr2", !@this); // 1 = on, 0 = off 
	enableControl("DTR_Obj_G_FR2", "CH_LRRCRC_DTR_Obj_G_Pr2DTR_Obj__", @this); //1: enable; 0: disable
	CRC_DTR_Obj_G_Pr2 = @sysvar::CH_Nodes::CH_LRRCRC_DTR_Obj_G_Pr2DTR__AUTO;
}
/*@@end*/

/*@@sysvarChange:CH_Nodes::CH_LRRSQC_DTR_Obj_G_Pr2DTR__AUTO:*/
on sysvar sysvar::CH_Nodes::CH_LRRSQC_DTR_Obj_G_Pr2DTR__AUTO
{
//	EnableSQC("DTR_Obj_G_FR2",  "DTR_Obj_G_Pr2", !@this); // 1 = on, 0 = off 
	enableControl("DTR_Obj_G_FR2", "CH_LRRSQC_DTR_Obj_G_Pr2DTR_Obj__", @this); //1: enable; 0: disable
	SQC_DTR_Obj_G_Pr2 = @sysvar::CH_Nodes::CH_LRRSQC_DTR_Obj_G_Pr2DTR__AUTO;
}
/*@@end*/

/*@@sysvarChange:CH_Nodes::CH_LRRCRC_DTR_ObjStat_Pr2DT_AUTO:*/
on sysvar sysvar::CH_Nodes::CH_LRRCRC_DTR_ObjStat_Pr2DT_AUTO
{
//	EnableCRC("DTR_ObjStat_FR2",  "DTR_ObjStat_Pr2", !@this); // 1 = on, 0 = off 
	enableControl("DTR_ObjStat_FR2", "CH_LRRCRC_DTR_ObjStat_Pr2DTR_Ob_", @this); //1: enable; 0: disable
	CRC_DTR_ObjStat_Pr2 = @sysvar::CH_Nodes::CH_LRRCRC_DTR_ObjStat_Pr2DT_AUTO;
}
/*@@end*/

/*@@sysvarChange:CH_Nodes::CH_LRRSQC_DTR_ObjStat_Pr2DT_AUTO:*/
on sysvar sysvar::CH_Nodes::CH_LRRSQC_DTR_ObjStat_Pr2DT_AUTO
{
//	EnableSQC("DTR_ObjStat_FR2",  "DTR_ObjStat_Pr2", !@this); // 1 = on, 0 = off 
	enableControl("DTR_ObjStat_FR2", "CH_LRRSQC_DTR_ObjStat_Pr2DTR_Ob_", @this); //1: enable; 0: disable
	SQC_DTR_ObjStat_Pr2 = @sysvar::CH_Nodes::CH_LRRSQC_DTR_ObjStat_Pr2DT_AUTO;
}
/*@@end*/

/*@@sysvarChange:CH_Nodes::CH_LRRCRC_DTR_Polyg_Lt_Pr2D_AUTO:*/
on sysvar sysvar::CH_Nodes::CH_LRRCRC_DTR_Polyg_Lt_Pr2D_AUTO
{
//	EnableCRC("DTR_Polyg_Lt_FR2",  "DTR_Polyg_Lt_Pr2", !@this); // 1 = on, 0 = off 
	enableControl("DTR_Polyg_Lt_FR2", "CH_LRRCRC_DTR_Polyg_Lt_Pr2DTR_P_", @this); //1: enable; 0: disable
	CRC_DTR_Polyg_Lt_Pr2 = @sysvar::CH_Nodes::CH_LRRCRC_DTR_Polyg_Lt_Pr2D_AUTO;
}
/*@@end*/

/*@@sysvarChange:CH_Nodes::CH_LRRSQC_DTR_Polyg_Lt_Pr2D_AUTO:*/
on sysvar sysvar::CH_Nodes::CH_LRRSQC_DTR_Polyg_Lt_Pr2D_AUTO
{
//	EnableSQC("DTR_Polyg_Lt_FR2",  "DTR_Polyg_Lt_Pr2", !@this); // 1 = on, 0 = off 
	enableControl("DTR_Polyg_Lt_FR2", "CH_LRRSQC_DTR_Polyg_Lt_Pr2DTR_P_", @this); //1: enable; 0: disable
	SQC_DTR_Polyg_Lt_Pr2 = @sysvar::CH_Nodes::CH_LRRSQC_DTR_Polyg_Lt_Pr2D_AUTO;
}
/*@@end*/

/*@@sysvarChange:CH_Nodes::CH_LRRCRC_DTR_Polyg_Rt_Pr2D_AUTO:*/
on sysvar sysvar::CH_Nodes::CH_LRRCRC_DTR_Polyg_Rt_Pr2D_AUTO
{
//	EnableCRC("DTR_Polyg_Rt_FR2",  "DTR_Polyg_Rt_Pr2", !@this); // 1 = on, 0 = off 
	enableControl("DTR_Polyg_Rt_FR2", "CH_LRRCRC_DTR_Polyg_Rt_Pr2DTR_P_", @this); //1: enable; 0: disable
	CRC_DTR_Polyg_Rt_Pr2 = @sysvar::CH_Nodes::CH_LRRCRC_DTR_Polyg_Rt_Pr2D_AUTO;
}
/*@@end*/

/*@@sysvarChange:CH_Nodes::CH_LRRSQC_DTR_Polyg_Rt_Pr2D_AUTO:*/
on sysvar sysvar::CH_Nodes::CH_LRRSQC_DTR_Polyg_Rt_Pr2D_AUTO
{
//	EnableSQC("DTR_Polyg_Rt_FR2",  "DTR_Polyg_Rt_Pr2", !@this); // 1 = on, 0 = off 
	enableControl("DTR_Polyg_Rt_FR2", "CH_LRRSQC_DTR_Polyg_Rt_Pr2DTR_P_", @this); //1: enable; 0: disable
	SQC_DTR_Polyg_Rt_Pr2 = @sysvar::CH_Nodes::CH_LRRSQC_DTR_Polyg_Rt_Pr2D_AUTO;
}
/*@@end*/

/*@@sysvarChange:CH_Nodes::CH_LRRCRC_DTR_Stat_Pr2DTR_S_AUTO:*/
on sysvar sysvar::CH_Nodes::CH_LRRCRC_DTR_Stat_Pr2DTR_S_AUTO
{
//	EnableCRC("DTR_Stat_FR2",  "DTR_Stat_Pr2", !@this); // 1 = on, 0 = off 
	enableControl("DTR_Stat_FR2", "CH_LRRCRC_DTR_Stat_Pr2DTR_Stat__", @this); //1: enable; 0: disable
	CRC_DTR_Stat_Pr2 = @sysvar::CH_Nodes::CH_LRRCRC_DTR_Stat_Pr2DTR_S_AUTO;
}
/*@@end*/

/*@@sysvarChange:CH_Nodes::CH_LRRSQC_DTR_Stat_Pr2DTR_S_AUTO:*/
on sysvar sysvar::CH_Nodes::CH_LRRSQC_DTR_Stat_Pr2DTR_S_AUTO
{
//	EnableSQC("DTR_Stat_FR2",  "DTR_Stat_Pr2", !@this); // 1 = on, 0 = off 
	enableControl("DTR_Stat_FR2", "CH_LRRSQC_DTR_Stat_Pr2DTR_Stat__", @this); //1: enable; 0: disable
	SQC_DTR_Stat_Pr2 = @sysvar::CH_Nodes::CH_LRRSQC_DTR_Stat_Pr2DTR_S_AUTO;
}
/*@@end*/

/*@@caplFunc:FrILTxPending(char[],long,byte[],long):*///callback
void FrILTxPending(char pduName[], long len, byte payload[], long TxAck)
{
	byte crc;
	dword SQC;
	dword MC;
	dword Tgl;
	dword i;

	if (strncmp (pduName, "DTR_Obj_A_FR2", strLen(pduName)+strLen("DTR_Obj_A_FR2")) == 0)
	{
		if (TxAck == 1)
		{
			if (@sysvar::CH_Nodes::CH_LRRSQC_DTR_Obj_A_Pr2DTR__AUTO == 0)
			{
				//SQC automatisch ändern
				SQC_VAL_DTR_Obj_A_Pr2 = (SQC_VAL_DTR_Obj_A_Pr2 + 1) % 16;
			}
			else
			{
				//SQC manuel veränderbar
			}

		}
		else
		{
			if (@sysvar::CH_Nodes::CH_LRRSQC_DTR_Obj_A_Pr2DTR__AUTO == 0)
			{
				//SQC automatisch ändern
				//SQC für CRC speichern
				CounterValForCRC_DTR_Obj_A_Pr2 = SQC_VAL_DTR_Obj_A_Pr2;
				//SQC in Byte schreiben
				payload[1] = (payload[1] & ~0x0F) |  SQC_VAL_DTR_Obj_A_Pr2;
			}
			else
			{
				//SQC manuel veränderbar
			}

			if (@sysvar::CH_Nodes::CH_LRRCRC_DTR_Obj_A_Pr2DTR__AUTO == 0)
			{
				//CRC automatisch berechnen
				crc = 0xFF;
				crc = crctableProfTwo[crc ^ payload[1]];
				crc = crctableProfTwo[crc ^ payload[2]];
				crc = crctableProfTwo[crc ^ payload[3]];
				crc = crctableProfTwo[crc ^ payload[4]];
				crc = crctableProfTwo[crc ^ payload[5]];
				crc = crctableProfTwo[crc ^ payload[6]];
				crc = crctableProfTwo[crc ^ payload[7]];
				crc = crctableProfTwo[crc ^ payload[8]];
				crc = crctableProfTwo[crc ^ payload[9]];
				crc = crctableProfTwo[crc ^ payload[10]];
				crc = crctableProfTwo[crc ^ payload[11]];
				crc = crctableProfTwo[crc ^ payload[12]];
				crc = crctableProfTwo[crc ^ payload[13]];
				crc = crctableProfTwo[crc ^ payload[14]];
				crc = crctableProfTwo[crc ^ payload[15]];
				crc = crctableProfTwo[crc ^ payload[16]];
				crc = crctableProfTwo[crc ^ payload[17]];
				switch (CounterValForCRC_DTR_Obj_A_Pr2)
				{
					case(0) :
						crc = crctableProfTwo[crc ^ 34];
						break;
					case(1) :
						crc = crctableProfTwo[crc ^ 6];
						break;
					case(2) :
						crc = crctableProfTwo[crc ^ 229];
						break;
					case(3) :
						crc = crctableProfTwo[crc ^ 201];
						break;
					case(4) :
						crc = crctableProfTwo[crc ^ 173];
						break;
					case(5) :
						crc = crctableProfTwo[crc ^ 145];
						break;
					case(6) :
						crc = crctableProfTwo[crc ^ 117];
						break;
					case(7) :
						crc = crctableProfTwo[crc ^ 89];
						break;
					case(8) :
						crc = crctableProfTwo[crc ^ 61];
						break;
					case(9) :
						crc = crctableProfTwo[crc ^ 33];
						break;
					case(10) :
						crc = crctableProfTwo[crc ^ 5];
						break;
					case(11) :
						crc = crctableProfTwo[crc ^ 228];
						break;
					case(12) :
						crc = crctableProfTwo[crc ^ 200];
						break;
					case(13) :
						crc = crctableProfTwo[crc ^ 172];
						break;
					case(14) :
						crc = crctableProfTwo[crc ^ 144];
						break;
					case(15) :
						crc = crctableProfTwo[crc ^ 116];
						break;
					default :
//						write("error: wrong parameter (%d)",CounterValForCRC_DTR_Obj_A_Pr2); stop();
						break;
				}
				crc = (crc ^ 0xFF);
				payload[0] = crc;
			}
			else
			{
				//CRC manuel veränderbar
			}

		}
	}
	if (strncmp (pduName, "DTR_Obj_B_FR2", strLen(pduName)+strLen("DTR_Obj_B_FR2")) == 0)
	{
		if (TxAck == 1)
		{
			if (@sysvar::CH_Nodes::CH_LRRSQC_DTR_Obj_B_Pr2DTR__AUTO == 0)
			{
				//SQC automatisch ändern
				SQC_VAL_DTR_Obj_B_Pr2 = (SQC_VAL_DTR_Obj_B_Pr2 + 1) % 16;
			}
			else
			{
				//SQC manuel veränderbar
			}

		}
		else
		{
			if (@sysvar::CH_Nodes::CH_LRRSQC_DTR_Obj_B_Pr2DTR__AUTO == 0)
			{
				//SQC automatisch ändern
				//SQC für CRC speichern
				CounterValForCRC_DTR_Obj_B_Pr2 = SQC_VAL_DTR_Obj_B_Pr2;
				//SQC in Byte schreiben
				payload[1] = (payload[1] & ~0x0F) |  SQC_VAL_DTR_Obj_B_Pr2;
			}
			else
			{
				//SQC manuel veränderbar
			}

			if (@sysvar::CH_Nodes::CH_LRRCRC_DTR_Obj_B_Pr2DTR__AUTO == 0)
			{
				//CRC automatisch berechnen
				crc = 0xFF;
				crc = crctableProfTwo[crc ^ payload[1]];
				crc = crctableProfTwo[crc ^ payload[2]];
				crc = crctableProfTwo[crc ^ payload[3]];
				crc = crctableProfTwo[crc ^ payload[4]];
				crc = crctableProfTwo[crc ^ payload[5]];
				crc = crctableProfTwo[crc ^ payload[6]];
				crc = crctableProfTwo[crc ^ payload[7]];
				crc = crctableProfTwo[crc ^ payload[8]];
				crc = crctableProfTwo[crc ^ payload[9]];
				crc = crctableProfTwo[crc ^ payload[10]];
				crc = crctableProfTwo[crc ^ payload[11]];
				crc = crctableProfTwo[crc ^ payload[12]];
				crc = crctableProfTwo[crc ^ payload[13]];
				crc = crctableProfTwo[crc ^ payload[14]];
				crc = crctableProfTwo[crc ^ payload[15]];
				crc = crctableProfTwo[crc ^ payload[16]];
				crc = crctableProfTwo[crc ^ payload[17]];
				switch (CounterValForCRC_DTR_Obj_B_Pr2)
				{
					case(0) :
						crc = crctableProfTwo[crc ^ 240];
						break;
					case(1) :
						crc = crctableProfTwo[crc ^ 245];
						break;
					case(2) :
						crc = crctableProfTwo[crc ^ 250];
						break;
					case(3) :
						crc = crctableProfTwo[crc ^ 4];
						break;
					case(4) :
						crc = crctableProfTwo[crc ^ 9];
						break;
					case(5) :
						crc = crctableProfTwo[crc ^ 14];
						break;
					case(6) :
						crc = crctableProfTwo[crc ^ 19];
						break;
					case(7) :
						crc = crctableProfTwo[crc ^ 24];
						break;
					case(8) :
						crc = crctableProfTwo[crc ^ 29];
						break;
					case(9) :
						crc = crctableProfTwo[crc ^ 34];
						break;
					case(10) :
						crc = crctableProfTwo[crc ^ 39];
						break;
					case(11) :
						crc = crctableProfTwo[crc ^ 44];
						break;
					case(12) :
						crc = crctableProfTwo[crc ^ 49];
						break;
					case(13) :
						crc = crctableProfTwo[crc ^ 54];
						break;
					case(14) :
						crc = crctableProfTwo[crc ^ 59];
						break;
					case(15) :
						crc = crctableProfTwo[crc ^ 64];
						break;
					default :
//						write("error: wrong parameter (%d)",CounterValForCRC_DTR_Obj_B_Pr2); stop();
						break;
				}
				crc = (crc ^ 0xFF);
				payload[0] = crc;
			}
			else
			{
				//CRC manuel veränderbar
			}

		}
	}
	if (strncmp (pduName, "DTR_Obj_C_FR2", strLen(pduName)+strLen("DTR_Obj_C_FR2")) == 0)
	{
		if (TxAck == 1)
		{
			if (@sysvar::CH_Nodes::CH_LRRSQC_DTR_Obj_C_Pr2DTR__AUTO == 0)
			{
				//SQC automatisch ändern
				SQC_VAL_DTR_Obj_C_Pr2 = (SQC_VAL_DTR_Obj_C_Pr2 + 1) % 16;
			}
			else
			{
				//SQC manuel veränderbar
			}

		}
		else
		{
			if (@sysvar::CH_Nodes::CH_LRRSQC_DTR_Obj_C_Pr2DTR__AUTO == 0)
			{
				//SQC automatisch ändern
				//SQC für CRC speichern
				CounterValForCRC_DTR_Obj_C_Pr2 = SQC_VAL_DTR_Obj_C_Pr2;
				//SQC in Byte schreiben
				payload[1] = (payload[1] & ~0x0F) |  SQC_VAL_DTR_Obj_C_Pr2;
			}
			else
			{
				//SQC manuel veränderbar
			}

			if (@sysvar::CH_Nodes::CH_LRRCRC_DTR_Obj_C_Pr2DTR__AUTO == 0)
			{
				//CRC automatisch berechnen
				crc = 0xFF;
				crc = crctableProfTwo[crc ^ payload[1]];
				crc = crctableProfTwo[crc ^ payload[2]];
				crc = crctableProfTwo[crc ^ payload[3]];
				crc = crctableProfTwo[crc ^ payload[4]];
				crc = crctableProfTwo[crc ^ payload[5]];
				crc = crctableProfTwo[crc ^ payload[6]];
				crc = crctableProfTwo[crc ^ payload[7]];
				crc = crctableProfTwo[crc ^ payload[8]];
				crc = crctableProfTwo[crc ^ payload[9]];
				crc = crctableProfTwo[crc ^ payload[10]];
				crc = crctableProfTwo[crc ^ payload[11]];
				crc = crctableProfTwo[crc ^ payload[12]];
				crc = crctableProfTwo[crc ^ payload[13]];
				crc = crctableProfTwo[crc ^ payload[14]];
				crc = crctableProfTwo[crc ^ payload[15]];
				crc = crctableProfTwo[crc ^ payload[16]];
				crc = crctableProfTwo[crc ^ payload[17]];
				switch (CounterValForCRC_DTR_Obj_C_Pr2)
				{
					case(0) :
						crc = crctableProfTwo[crc ^ 217];
						break;
					case(1) :
						crc = crctableProfTwo[crc ^ 250];
						break;
					case(2) :
						crc = crctableProfTwo[crc ^ 32];
						break;
					case(3) :
						crc = crctableProfTwo[crc ^ 65];
						break;
					case(4) :
						crc = crctableProfTwo[crc ^ 98];
						break;
					case(5) :
						crc = crctableProfTwo[crc ^ 131];
						break;
					case(6) :
						crc = crctableProfTwo[crc ^ 164];
						break;
					case(7) :
						crc = crctableProfTwo[crc ^ 197];
						break;
					case(8) :
						crc = crctableProfTwo[crc ^ 230];
						break;
					case(9) :
						crc = crctableProfTwo[crc ^ 12];
						break;
					case(10) :
						crc = crctableProfTwo[crc ^ 45];
						break;
					case(11) :
						crc = crctableProfTwo[crc ^ 78];
						break;
					case(12) :
						crc = crctableProfTwo[crc ^ 111];
						break;
					case(13) :
						crc = crctableProfTwo[crc ^ 144];
						break;
					case(14) :
						crc = crctableProfTwo[crc ^ 177];
						break;
					case(15) :
						crc = crctableProfTwo[crc ^ 210];
						break;
					default :
//						write("error: wrong parameter (%d)",CounterValForCRC_DTR_Obj_C_Pr2); stop();
						break;
				}
				crc = (crc ^ 0xFF);
				payload[0] = crc;
			}
			else
			{
				//CRC manuel veränderbar
			}

		}
	}
	if (strncmp (pduName, "DTR_Obj_D_FR2", strLen(pduName)+strLen("DTR_Obj_D_FR2")) == 0)
	{
		if (TxAck == 1)
		{
			if (@sysvar::CH_Nodes::CH_LRRSQC_DTR_Obj_D_Pr2DTR__AUTO == 0)
			{
				//SQC automatisch ändern
				SQC_VAL_DTR_Obj_D_Pr2 = (SQC_VAL_DTR_Obj_D_Pr2 + 1) % 16;
			}
			else
			{
				//SQC manuel veränderbar
			}

		}
		else
		{
			if (@sysvar::CH_Nodes::CH_LRRSQC_DTR_Obj_D_Pr2DTR__AUTO == 0)
			{
				//SQC automatisch ändern
				//SQC für CRC speichern
				CounterValForCRC_DTR_Obj_D_Pr2 = SQC_VAL_DTR_Obj_D_Pr2;
				//SQC in Byte schreiben
				payload[1] = (payload[1] & ~0x0F) |  SQC_VAL_DTR_Obj_D_Pr2;
			}
			else
			{
				//SQC manuel veränderbar
			}

			if (@sysvar::CH_Nodes::CH_LRRCRC_DTR_Obj_D_Pr2DTR__AUTO == 0)
			{
				//CRC automatisch berechnen
				crc = 0xFF;
				crc = crctableProfTwo[crc ^ payload[1]];
				crc = crctableProfTwo[crc ^ payload[2]];
				crc = crctableProfTwo[crc ^ payload[3]];
				crc = crctableProfTwo[crc ^ payload[4]];
				crc = crctableProfTwo[crc ^ payload[5]];
				crc = crctableProfTwo[crc ^ payload[6]];
				crc = crctableProfTwo[crc ^ payload[7]];
				crc = crctableProfTwo[crc ^ payload[8]];
				crc = crctableProfTwo[crc ^ payload[9]];
				crc = crctableProfTwo[crc ^ payload[10]];
				crc = crctableProfTwo[crc ^ payload[11]];
				crc = crctableProfTwo[crc ^ payload[12]];
				crc = crctableProfTwo[crc ^ payload[13]];
				crc = crctableProfTwo[crc ^ payload[14]];
				crc = crctableProfTwo[crc ^ payload[15]];
				crc = crctableProfTwo[crc ^ payload[16]];
				crc = crctableProfTwo[crc ^ payload[17]];
				switch (CounterValForCRC_DTR_Obj_D_Pr2)
				{
					case(0) :
						crc = crctableProfTwo[crc ^ 204];
						break;
					case(1) :
						crc = crctableProfTwo[crc ^ 84];
						break;
					case(2) :
						crc = crctableProfTwo[crc ^ 215];
						break;
					case(3) :
						crc = crctableProfTwo[crc ^ 95];
						break;
					case(4) :
						crc = crctableProfTwo[crc ^ 226];
						break;
					case(5) :
						crc = crctableProfTwo[crc ^ 106];
						break;
					case(6) :
						crc = crctableProfTwo[crc ^ 237];
						break;
					case(7) :
						crc = crctableProfTwo[crc ^ 117];
						break;
					case(8) :
						crc = crctableProfTwo[crc ^ 248];
						break;
					case(9) :
						crc = crctableProfTwo[crc ^ 128];
						break;
					case(10) :
						crc = crctableProfTwo[crc ^ 8];
						break;
					case(11) :
						crc = crctableProfTwo[crc ^ 139];
						break;
					case(12) :
						crc = crctableProfTwo[crc ^ 19];
						break;
					case(13) :
						crc = crctableProfTwo[crc ^ 150];
						break;
					case(14) :
						crc = crctableProfTwo[crc ^ 30];
						break;
					case(15) :
						crc = crctableProfTwo[crc ^ 161];
						break;
					default :
//						write("error: wrong parameter (%d)",CounterValForCRC_DTR_Obj_D_Pr2); stop();
						break;
				}
				crc = (crc ^ 0xFF);
				payload[0] = crc;
			}
			else
			{
				//CRC manuel veränderbar
			}

		}
	}
	if (strncmp (pduName, "DTR_Obj_E_FR2", strLen(pduName)+strLen("DTR_Obj_E_FR2")) == 0)
	{
		if (TxAck == 1)
		{
			if (@sysvar::CH_Nodes::CH_LRRSQC_DTR_Obj_E_Pr2DTR__AUTO == 0)
			{
				//SQC automatisch ändern
				SQC_VAL_DTR_Obj_E_Pr2 = (SQC_VAL_DTR_Obj_E_Pr2 + 1) % 16;
			}
			else
			{
				//SQC manuel veränderbar
			}

		}
		else
		{
			if (@sysvar::CH_Nodes::CH_LRRSQC_DTR_Obj_E_Pr2DTR__AUTO == 0)
			{
				//SQC automatisch ändern
				//SQC für CRC speichern
				CounterValForCRC_DTR_Obj_E_Pr2 = SQC_VAL_DTR_Obj_E_Pr2;
				//SQC in Byte schreiben
				payload[1] = (payload[1] & ~0x0F) |  SQC_VAL_DTR_Obj_E_Pr2;
			}
			else
			{
				//SQC manuel veränderbar
			}

			if (@sysvar::CH_Nodes::CH_LRRCRC_DTR_Obj_E_Pr2DTR__AUTO == 0)
			{
				//CRC automatisch berechnen
				crc = 0xFF;
				crc = crctableProfTwo[crc ^ payload[1]];
				crc = crctableProfTwo[crc ^ payload[2]];
				crc = crctableProfTwo[crc ^ payload[3]];
				crc = crctableProfTwo[crc ^ payload[4]];
				crc = crctableProfTwo[crc ^ payload[5]];
				crc = crctableProfTwo[crc ^ payload[6]];
				crc = crctableProfTwo[crc ^ payload[7]];
				crc = crctableProfTwo[crc ^ payload[8]];
				crc = crctableProfTwo[crc ^ payload[9]];
				crc = crctableProfTwo[crc ^ payload[10]];
				crc = crctableProfTwo[crc ^ payload[11]];
				crc = crctableProfTwo[crc ^ payload[12]];
				crc = crctableProfTwo[crc ^ payload[13]];
				crc = crctableProfTwo[crc ^ payload[14]];
				crc = crctableProfTwo[crc ^ payload[15]];
				crc = crctableProfTwo[crc ^ payload[16]];
				crc = crctableProfTwo[crc ^ payload[17]];
				switch (CounterValForCRC_DTR_Obj_E_Pr2)
				{
					case(0) :
						crc = crctableProfTwo[crc ^ 132];
						break;
					case(1) :
						crc = crctableProfTwo[crc ^ 48];
						break;
					case(2) :
						crc = crctableProfTwo[crc ^ 215];
						break;
					case(3) :
						crc = crctableProfTwo[crc ^ 131];
						break;
					case(4) :
						crc = crctableProfTwo[crc ^ 47];
						break;
					case(5) :
						crc = crctableProfTwo[crc ^ 214];
						break;
					case(6) :
						crc = crctableProfTwo[crc ^ 130];
						break;
					case(7) :
						crc = crctableProfTwo[crc ^ 46];
						break;
					case(8) :
						crc = crctableProfTwo[crc ^ 213];
						break;
					case(9) :
						crc = crctableProfTwo[crc ^ 129];
						break;
					case(10) :
						crc = crctableProfTwo[crc ^ 45];
						break;
					case(11) :
						crc = crctableProfTwo[crc ^ 212];
						break;
					case(12) :
						crc = crctableProfTwo[crc ^ 128];
						break;
					case(13) :
						crc = crctableProfTwo[crc ^ 44];
						break;
					case(14) :
						crc = crctableProfTwo[crc ^ 211];
						break;
					case(15) :
						crc = crctableProfTwo[crc ^ 127];
						break;
					default :
//						write("error: wrong parameter (%d)",CounterValForCRC_DTR_Obj_E_Pr2); stop();
						break;
				}
				crc = (crc ^ 0xFF);
				payload[0] = crc;
			}
			else
			{
				//CRC manuel veränderbar
			}

		}
	}
	if (strncmp (pduName, "DTR_Obj_F_FR2", strLen(pduName)+strLen("DTR_Obj_F_FR2")) == 0)
	{
		if (TxAck == 1)
		{
			if (@sysvar::CH_Nodes::CH_LRRSQC_DTR_Obj_F_Pr2DTR__AUTO == 0)
			{
				//SQC automatisch ändern
				SQC_VAL_DTR_Obj_F_Pr2 = (SQC_VAL_DTR_Obj_F_Pr2 + 1) % 16;
			}
			else
			{
				//SQC manuel veränderbar
			}

		}
		else
		{
			if (@sysvar::CH_Nodes::CH_LRRSQC_DTR_Obj_F_Pr2DTR__AUTO == 0)
			{
				//SQC automatisch ändern
				//SQC für CRC speichern
				CounterValForCRC_DTR_Obj_F_Pr2 = SQC_VAL_DTR_Obj_F_Pr2;
				//SQC in Byte schreiben
				payload[1] = (payload[1] & ~0x0F) |  SQC_VAL_DTR_Obj_F_Pr2;
			}
			else
			{
				//SQC manuel veränderbar
			}

			if (@sysvar::CH_Nodes::CH_LRRCRC_DTR_Obj_F_Pr2DTR__AUTO == 0)
			{
				//CRC automatisch berechnen
				crc = 0xFF;
				crc = crctableProfTwo[crc ^ payload[1]];
				crc = crctableProfTwo[crc ^ payload[2]];
				crc = crctableProfTwo[crc ^ payload[3]];
				crc = crctableProfTwo[crc ^ payload[4]];
				crc = crctableProfTwo[crc ^ payload[5]];
				crc = crctableProfTwo[crc ^ payload[6]];
				crc = crctableProfTwo[crc ^ payload[7]];
				crc = crctableProfTwo[crc ^ payload[8]];
				crc = crctableProfTwo[crc ^ payload[9]];
				crc = crctableProfTwo[crc ^ payload[10]];
				crc = crctableProfTwo[crc ^ payload[11]];
				crc = crctableProfTwo[crc ^ payload[12]];
				crc = crctableProfTwo[crc ^ payload[13]];
				crc = crctableProfTwo[crc ^ payload[14]];
				crc = crctableProfTwo[crc ^ payload[15]];
				crc = crctableProfTwo[crc ^ payload[16]];
				crc = crctableProfTwo[crc ^ payload[17]];
				switch (CounterValForCRC_DTR_Obj_F_Pr2)
				{
					case(0) :
						crc = crctableProfTwo[crc ^ 56];
						break;
					case(1) :
						crc = crctableProfTwo[crc ^ 119];
						break;
					case(2) :
						crc = crctableProfTwo[crc ^ 182];
						break;
					case(3) :
						crc = crctableProfTwo[crc ^ 245];
						break;
					case(4) :
						crc = crctableProfTwo[crc ^ 57];
						break;
					case(5) :
						crc = crctableProfTwo[crc ^ 120];
						break;
					case(6) :
						crc = crctableProfTwo[crc ^ 183];
						break;
					case(7) :
						crc = crctableProfTwo[crc ^ 246];
						break;
					case(8) :
						crc = crctableProfTwo[crc ^ 58];
						break;
					case(9) :
						crc = crctableProfTwo[crc ^ 121];
						break;
					case(10) :
						crc = crctableProfTwo[crc ^ 184];
						break;
					case(11) :
						crc = crctableProfTwo[crc ^ 247];
						break;
					case(12) :
						crc = crctableProfTwo[crc ^ 59];
						break;
					case(13) :
						crc = crctableProfTwo[crc ^ 122];
						break;
					case(14) :
						crc = crctableProfTwo[crc ^ 185];
						break;
					case(15) :
						crc = crctableProfTwo[crc ^ 248];
						break;
					default :
//						write("error: wrong parameter (%d)",CounterValForCRC_DTR_Obj_F_Pr2); stop();
						break;
				}
				crc = (crc ^ 0xFF);
				payload[0] = crc;
			}
			else
			{
				//CRC manuel veränderbar
			}

		}
	}
	if (strncmp (pduName, "DTR_Obj_G_FR2", strLen(pduName)+strLen("DTR_Obj_G_FR2")) == 0)
	{
		if (TxAck == 1)
		{
			if (@sysvar::CH_Nodes::CH_LRRSQC_DTR_Obj_G_Pr2DTR__AUTO == 0)
			{
				//SQC automatisch ändern
				SQC_VAL_DTR_Obj_G_Pr2 = (SQC_VAL_DTR_Obj_G_Pr2 + 1) % 16;
			}
			else
			{
				//SQC manuel veränderbar
			}

		}
		else
		{
			if (@sysvar::CH_Nodes::CH_LRRSQC_DTR_Obj_G_Pr2DTR__AUTO == 0)
			{
				//SQC automatisch ändern
				//SQC für CRC speichern
				CounterValForCRC_DTR_Obj_G_Pr2 = SQC_VAL_DTR_Obj_G_Pr2;
				//SQC in Byte schreiben
				payload[1] = (payload[1] & ~0x0F) |  SQC_VAL_DTR_Obj_G_Pr2;
			}
			else
			{
				//SQC manuel veränderbar
			}

			if (@sysvar::CH_Nodes::CH_LRRCRC_DTR_Obj_G_Pr2DTR__AUTO == 0)
			{
				//CRC automatisch berechnen
				crc = 0xFF;
				crc = crctableProfTwo[crc ^ payload[1]];
				crc = crctableProfTwo[crc ^ payload[2]];
				crc = crctableProfTwo[crc ^ payload[3]];
				crc = crctableProfTwo[crc ^ payload[4]];
				crc = crctableProfTwo[crc ^ payload[5]];
				crc = crctableProfTwo[crc ^ payload[6]];
				crc = crctableProfTwo[crc ^ payload[7]];
				crc = crctableProfTwo[crc ^ payload[8]];
				crc = crctableProfTwo[crc ^ payload[9]];
				crc = crctableProfTwo[crc ^ payload[10]];
				crc = crctableProfTwo[crc ^ payload[11]];
				crc = crctableProfTwo[crc ^ payload[12]];
				crc = crctableProfTwo[crc ^ payload[13]];
				crc = crctableProfTwo[crc ^ payload[14]];
				crc = crctableProfTwo[crc ^ payload[15]];
				crc = crctableProfTwo[crc ^ payload[16]];
				crc = crctableProfTwo[crc ^ payload[17]];
				switch (CounterValForCRC_DTR_Obj_G_Pr2)
				{
					case(0) :
						crc = crctableProfTwo[crc ^ 159];
						break;
					case(1) :
						crc = crctableProfTwo[crc ^ 171];
						break;
					case(2) :
						crc = crctableProfTwo[crc ^ 183];
						break;
					case(3) :
						crc = crctableProfTwo[crc ^ 195];
						break;
					case(4) :
						crc = crctableProfTwo[crc ^ 207];
						break;
					case(5) :
						crc = crctableProfTwo[crc ^ 219];
						break;
					case(6) :
						crc = crctableProfTwo[crc ^ 231];
						break;
					case(7) :
						crc = crctableProfTwo[crc ^ 243];
						break;
					case(8) :
						crc = crctableProfTwo[crc ^ 4];
						break;
					case(9) :
						crc = crctableProfTwo[crc ^ 16];
						break;
					case(10) :
						crc = crctableProfTwo[crc ^ 28];
						break;
					case(11) :
						crc = crctableProfTwo[crc ^ 40];
						break;
					case(12) :
						crc = crctableProfTwo[crc ^ 52];
						break;
					case(13) :
						crc = crctableProfTwo[crc ^ 64];
						break;
					case(14) :
						crc = crctableProfTwo[crc ^ 76];
						break;
					case(15) :
						crc = crctableProfTwo[crc ^ 88];
						break;
					default :
//						write("error: wrong parameter (%d)",CounterValForCRC_DTR_Obj_G_Pr2); stop();
						break;
				}
				crc = (crc ^ 0xFF);
				payload[0] = crc;
			}
			else
			{
				//CRC manuel veränderbar
			}

		}
	}
	if (strncmp (pduName, "DTR_ObjStat_FR2", strLen(pduName)+strLen("DTR_ObjStat_FR2")) == 0)
	{
		if (TxAck == 1)
		{
			if (@sysvar::CH_Nodes::CH_LRRSQC_DTR_ObjStat_Pr2DT_AUTO == 0)
			{
				//SQC automatisch ändern
				SQC_VAL_DTR_ObjStat_Pr2 = (SQC_VAL_DTR_ObjStat_Pr2 + 1) % 16;
			}
			else
			{
				//SQC manuel veränderbar
			}

		}
		else
		{
			if (@sysvar::CH_Nodes::CH_LRRSQC_DTR_ObjStat_Pr2DT_AUTO == 0)
			{
				//SQC automatisch ändern
				//SQC für CRC speichern
				CounterValForCRC_DTR_ObjStat_Pr2 = SQC_VAL_DTR_ObjStat_Pr2;
				//SQC in Byte schreiben
				payload[1] = (payload[1] & ~0x0F) |  SQC_VAL_DTR_ObjStat_Pr2;
			}
			else
			{
				//SQC manuel veränderbar
			}

			if (@sysvar::CH_Nodes::CH_LRRCRC_DTR_ObjStat_Pr2DT_AUTO == 0)
			{
				//CRC automatisch berechnen
				crc = 0xFF;
				crc = crctableProfTwo[crc ^ payload[1]];
				crc = crctableProfTwo[crc ^ payload[2]];
				crc = crctableProfTwo[crc ^ payload[3]];
				crc = crctableProfTwo[crc ^ payload[4]];
				crc = crctableProfTwo[crc ^ payload[5]];
				crc = crctableProfTwo[crc ^ payload[6]];
				crc = crctableProfTwo[crc ^ payload[7]];
				crc = crctableProfTwo[crc ^ payload[8]];
				crc = crctableProfTwo[crc ^ payload[9]];
				crc = crctableProfTwo[crc ^ payload[10]];
				crc = crctableProfTwo[crc ^ payload[11]];
				crc = crctableProfTwo[crc ^ payload[12]];
				crc = crctableProfTwo[crc ^ payload[13]];
				crc = crctableProfTwo[crc ^ payload[14]];
				crc = crctableProfTwo[crc ^ payload[15]];
				crc = crctableProfTwo[crc ^ payload[16]];
				crc = crctableProfTwo[crc ^ payload[17]];
				switch (CounterValForCRC_DTR_ObjStat_Pr2)
				{
					case(0) :
						crc = crctableProfTwo[crc ^ 214];
						break;
					case(1) :
						crc = crctableProfTwo[crc ^ 182];
						break;
					case(2) :
						crc = crctableProfTwo[crc ^ 150];
						break;
					case(3) :
						crc = crctableProfTwo[crc ^ 118];
						break;
					case(4) :
						crc = crctableProfTwo[crc ^ 86];
						break;
					case(5) :
						crc = crctableProfTwo[crc ^ 54];
						break;
					case(6) :
						crc = crctableProfTwo[crc ^ 22];
						break;
					case(7) :
						crc = crctableProfTwo[crc ^ 241];
						break;
					case(8) :
						crc = crctableProfTwo[crc ^ 209];
						break;
					case(9) :
						crc = crctableProfTwo[crc ^ 177];
						break;
					case(10) :
						crc = crctableProfTwo[crc ^ 145];
						break;
					case(11) :
						crc = crctableProfTwo[crc ^ 113];
						break;
					case(12) :
						crc = crctableProfTwo[crc ^ 81];
						break;
					case(13) :
						crc = crctableProfTwo[crc ^ 49];
						break;
					case(14) :
						crc = crctableProfTwo[crc ^ 17];
						break;
					case(15) :
						crc = crctableProfTwo[crc ^ 236];
						break;
					default :
//						write("error: wrong parameter (%d)",CounterValForCRC_DTR_ObjStat_Pr2); stop();
						break;
				}
				crc = (crc ^ 0xFF);
				payload[0] = crc;
			}
			else
			{
				//CRC manuel veränderbar
			}

		}
	}
	if (strncmp (pduName, "DTR_Polyg_Lt_FR2", strLen(pduName)+strLen("DTR_Polyg_Lt_FR2")) == 0)
	{
		if (TxAck == 1)
		{
			if (@sysvar::CH_Nodes::CH_LRRSQC_DTR_Polyg_Lt_Pr2D_AUTO == 0)
			{
				//SQC automatisch ändern
				SQC_VAL_DTR_Polyg_Lt_Pr2 = (SQC_VAL_DTR_Polyg_Lt_Pr2 + 1) % 16;
			}
			else
			{
				//SQC manuel veränderbar
			}

		}
		else
		{
			if (@sysvar::CH_Nodes::CH_LRRSQC_DTR_Polyg_Lt_Pr2D_AUTO == 0)
			{
				//SQC automatisch ändern
				//SQC für CRC speichern
				CounterValForCRC_DTR_Polyg_Lt_Pr2 = SQC_VAL_DTR_Polyg_Lt_Pr2;
				//SQC in Byte schreiben
				payload[1] = (payload[1] & ~0x0F) |  SQC_VAL_DTR_Polyg_Lt_Pr2;
			}
			else
			{
				//SQC manuel veränderbar
			}

			if (@sysvar::CH_Nodes::CH_LRRCRC_DTR_Polyg_Lt_Pr2D_AUTO == 0)
			{
				//CRC automatisch berechnen
				crc = 0xFF;
				crc = crctableProfTwo[crc ^ payload[1]];
				crc = crctableProfTwo[crc ^ payload[2]];
				crc = crctableProfTwo[crc ^ payload[3]];
				crc = crctableProfTwo[crc ^ payload[4]];
				crc = crctableProfTwo[crc ^ payload[5]];
				crc = crctableProfTwo[crc ^ payload[6]];
				crc = crctableProfTwo[crc ^ payload[7]];
				crc = crctableProfTwo[crc ^ payload[8]];
				crc = crctableProfTwo[crc ^ payload[9]];
				crc = crctableProfTwo[crc ^ payload[10]];
				crc = crctableProfTwo[crc ^ payload[11]];
				crc = crctableProfTwo[crc ^ payload[12]];
				crc = crctableProfTwo[crc ^ payload[13]];
				crc = crctableProfTwo[crc ^ payload[14]];
				crc = crctableProfTwo[crc ^ payload[15]];
				crc = crctableProfTwo[crc ^ payload[16]];
				crc = crctableProfTwo[crc ^ payload[17]];
				switch (CounterValForCRC_DTR_Polyg_Lt_Pr2)
				{
					case(0) :
						crc = crctableProfTwo[crc ^ 242];
						break;
					case(1) :
						crc = crctableProfTwo[crc ^ 6];
						break;
					case(2) :
						crc = crctableProfTwo[crc ^ 21];
						break;
					case(3) :
						crc = crctableProfTwo[crc ^ 36];
						break;
					case(4) :
						crc = crctableProfTwo[crc ^ 51];
						break;
					case(5) :
						crc = crctableProfTwo[crc ^ 66];
						break;
					case(6) :
						crc = crctableProfTwo[crc ^ 81];
						break;
					case(7) :
						crc = crctableProfTwo[crc ^ 96];
						break;
					case(8) :
						crc = crctableProfTwo[crc ^ 111];
						break;
					case(9) :
						crc = crctableProfTwo[crc ^ 126];
						break;
					case(10) :
						crc = crctableProfTwo[crc ^ 141];
						break;
					case(11) :
						crc = crctableProfTwo[crc ^ 156];
						break;
					case(12) :
						crc = crctableProfTwo[crc ^ 171];
						break;
					case(13) :
						crc = crctableProfTwo[crc ^ 186];
						break;
					case(14) :
						crc = crctableProfTwo[crc ^ 201];
						break;
					case(15) :
						crc = crctableProfTwo[crc ^ 216];
						break;
					default :
//						write("error: wrong parameter (%d)",CounterValForCRC_DTR_Polyg_Lt_Pr2); stop();
						break;
				}
				crc = (crc ^ 0xFF);
				payload[0] = crc;
			}
			else
			{
				//CRC manuel veränderbar
			}

		}
	}
	if (strncmp (pduName, "DTR_Polyg_Rt_FR2", strLen(pduName)+strLen("DTR_Polyg_Rt_FR2")) == 0)
	{
		if (TxAck == 1)
		{
			if (@sysvar::CH_Nodes::CH_LRRSQC_DTR_Polyg_Rt_Pr2D_AUTO == 0)
			{
				//SQC automatisch ändern
				SQC_VAL_DTR_Polyg_Rt_Pr2 = (SQC_VAL_DTR_Polyg_Rt_Pr2 + 1) % 16;
			}
			else
			{
				//SQC manuel veränderbar
			}

		}
		else
		{
			if (@sysvar::CH_Nodes::CH_LRRSQC_DTR_Polyg_Rt_Pr2D_AUTO == 0)
			{
				//SQC automatisch ändern
				//SQC für CRC speichern
				CounterValForCRC_DTR_Polyg_Rt_Pr2 = SQC_VAL_DTR_Polyg_Rt_Pr2;
				//SQC in Byte schreiben
				payload[1] = (payload[1] & ~0x0F) |  SQC_VAL_DTR_Polyg_Rt_Pr2;
			}
			else
			{
				//SQC manuel veränderbar
			}

			if (@sysvar::CH_Nodes::CH_LRRCRC_DTR_Polyg_Rt_Pr2D_AUTO == 0)
			{
				//CRC automatisch berechnen
				crc = 0xFF;
				crc = crctableProfTwo[crc ^ payload[1]];
				crc = crctableProfTwo[crc ^ payload[2]];
				crc = crctableProfTwo[crc ^ payload[3]];
				crc = crctableProfTwo[crc ^ payload[4]];
				crc = crctableProfTwo[crc ^ payload[5]];
				crc = crctableProfTwo[crc ^ payload[6]];
				crc = crctableProfTwo[crc ^ payload[7]];
				crc = crctableProfTwo[crc ^ payload[8]];
				crc = crctableProfTwo[crc ^ payload[9]];
				crc = crctableProfTwo[crc ^ payload[10]];
				crc = crctableProfTwo[crc ^ payload[11]];
				crc = crctableProfTwo[crc ^ payload[12]];
				crc = crctableProfTwo[crc ^ payload[13]];
				crc = crctableProfTwo[crc ^ payload[14]];
				crc = crctableProfTwo[crc ^ payload[15]];
				crc = crctableProfTwo[crc ^ payload[16]];
				crc = crctableProfTwo[crc ^ payload[17]];
				switch (CounterValForCRC_DTR_Polyg_Rt_Pr2)
				{
					case(0) :
						crc = crctableProfTwo[crc ^ 45];
						break;
					case(1) :
						crc = crctableProfTwo[crc ^ 5];
						break;
					case(2) :
						crc = crctableProfTwo[crc ^ 216];
						break;
					case(3) :
						crc = crctableProfTwo[crc ^ 176];
						break;
					case(4) :
						crc = crctableProfTwo[crc ^ 136];
						break;
					case(5) :
						crc = crctableProfTwo[crc ^ 96];
						break;
					case(6) :
						crc = crctableProfTwo[crc ^ 56];
						break;
					case(7) :
						crc = crctableProfTwo[crc ^ 16];
						break;
					case(8) :
						crc = crctableProfTwo[crc ^ 227];
						break;
					case(9) :
						crc = crctableProfTwo[crc ^ 187];
						break;
					case(10) :
						crc = crctableProfTwo[crc ^ 147];
						break;
					case(11) :
						crc = crctableProfTwo[crc ^ 107];
						break;
					case(12) :
						crc = crctableProfTwo[crc ^ 67];
						break;
					case(13) :
						crc = crctableProfTwo[crc ^ 27];
						break;
					case(14) :
						crc = crctableProfTwo[crc ^ 238];
						break;
					case(15) :
						crc = crctableProfTwo[crc ^ 198];
						break;
					default :
//						write("error: wrong parameter (%d)",CounterValForCRC_DTR_Polyg_Rt_Pr2); stop();
						break;
				}
				crc = (crc ^ 0xFF);
				payload[0] = crc;
			}
			else
			{
				//CRC manuel veränderbar
			}

		}
	}
	if (strncmp (pduName, "DTR_Stat_FR2", strLen(pduName)+strLen("DTR_Stat_FR2")) == 0)
	{
		if (TxAck == 1)
		{
			if (@sysvar::CH_Nodes::CH_LRRSQC_DTR_Stat_Pr2DTR_S_AUTO == 0)
			{
				//SQC automatisch ändern
				SQC_VAL_DTR_Stat_Pr2 = (SQC_VAL_DTR_Stat_Pr2 + 1) % 16;
			}
			else
			{
				//SQC manuel veränderbar
			}

		}
		else
		{
			if (@sysvar::CH_Nodes::CH_LRRSQC_DTR_Stat_Pr2DTR_S_AUTO == 0)
			{
				//SQC automatisch ändern
				//SQC für CRC speichern
				CounterValForCRC_DTR_Stat_Pr2 = SQC_VAL_DTR_Stat_Pr2;
				//SQC in Byte schreiben
				payload[1] = (payload[1] & ~0x0F) |  SQC_VAL_DTR_Stat_Pr2;
			}
			else
			{
				//SQC manuel veränderbar
			}

			if (@sysvar::CH_Nodes::CH_LRRCRC_DTR_Stat_Pr2DTR_S_AUTO == 0)
			{
				//CRC automatisch berechnen
				crc = 0xFF;
				crc = crctableProfTwo[crc ^ payload[1]];
				crc = crctableProfTwo[crc ^ payload[2]];
				crc = crctableProfTwo[crc ^ payload[3]];
				crc = crctableProfTwo[crc ^ payload[4]];
				crc = crctableProfTwo[crc ^ payload[5]];
				crc = crctableProfTwo[crc ^ payload[6]];
				crc = crctableProfTwo[crc ^ payload[7]];
				crc = crctableProfTwo[crc ^ payload[8]];
				crc = crctableProfTwo[crc ^ payload[9]];
				crc = crctableProfTwo[crc ^ payload[10]];
				crc = crctableProfTwo[crc ^ payload[11]];
				crc = crctableProfTwo[crc ^ payload[12]];
				crc = crctableProfTwo[crc ^ payload[13]];
				crc = crctableProfTwo[crc ^ payload[14]];
				crc = crctableProfTwo[crc ^ payload[15]];
				crc = crctableProfTwo[crc ^ payload[16]];
				crc = crctableProfTwo[crc ^ payload[17]];
				switch (CounterValForCRC_DTR_Stat_Pr2)
				{
					case(0) :
						crc = crctableProfTwo[crc ^ 4];
						break;
					case(1) :
						crc = crctableProfTwo[crc ^ 12];
						break;
					case(2) :
						crc = crctableProfTwo[crc ^ 20];
						break;
					case(3) :
						crc = crctableProfTwo[crc ^ 28];
						break;
					case(4) :
						crc = crctableProfTwo[crc ^ 36];
						break;
					case(5) :
						crc = crctableProfTwo[crc ^ 44];
						break;
					case(6) :
						crc = crctableProfTwo[crc ^ 52];
						break;
					case(7) :
						crc = crctableProfTwo[crc ^ 60];
						break;
					case(8) :
						crc = crctableProfTwo[crc ^ 68];
						break;
					case(9) :
						crc = crctableProfTwo[crc ^ 76];
						break;
					case(10) :
						crc = crctableProfTwo[crc ^ 84];
						break;
					case(11) :
						crc = crctableProfTwo[crc ^ 92];
						break;
					case(12) :
						crc = crctableProfTwo[crc ^ 100];
						break;
					case(13) :
						crc = crctableProfTwo[crc ^ 108];
						break;
					case(14) :
						crc = crctableProfTwo[crc ^ 116];
						break;
					case(15) :
						crc = crctableProfTwo[crc ^ 124];
						break;
					default :
//						write("error: wrong parameter (%d)",CounterValForCRC_DTR_Stat_Pr2); stop();
						break;
				}
				crc = (crc ^ 0xFF);
				payload[0] = crc;
			}
			else
			{
				//CRC manuel veränderbar
			}

		}
	}
	if (strncmp (pduName, "ROE_LRR", strLen(pduName)+strLen("ROE_LRR")) == 0)
	{
		if (TxAck == 1)
		{
		}
		else
		{
		}
	}
}
/*@@end*/

/*@@caplFunc:StartSim(int):*/
StartSim(int BusAktiv)
{
	result = EnableCRC("", 0); // 1 = on, 0 = off
	result = EnableTGL("", 0); // 1 = on, 0 = off 
	result = EnableSQC("", 0); // 1 = on, 0 = off 
	result = EnableMC("", 0); // 1 = on, 0 = off 
	CRC_DTR_Obj_A_Pr2 = 0;
	SQC_VAL_DTR_Obj_A_Pr2 = 0;
	SQC_DTR_Obj_A_Pr2 = 0;
	CRC_DTR_Obj_B_Pr2 = 0;
	SQC_VAL_DTR_Obj_B_Pr2 = 0;
	SQC_DTR_Obj_B_Pr2 = 0;
	CRC_DTR_Obj_C_Pr2 = 0;
	SQC_VAL_DTR_Obj_C_Pr2 = 0;
	SQC_DTR_Obj_C_Pr2 = 0;
	CRC_DTR_Obj_D_Pr2 = 0;
	SQC_VAL_DTR_Obj_D_Pr2 = 0;
	SQC_DTR_Obj_D_Pr2 = 0;
	CRC_DTR_Obj_E_Pr2 = 0;
	SQC_VAL_DTR_Obj_E_Pr2 = 0;
	SQC_DTR_Obj_E_Pr2 = 0;
	CRC_DTR_Obj_F_Pr2 = 0;
	SQC_VAL_DTR_Obj_F_Pr2 = 0;
	SQC_DTR_Obj_F_Pr2 = 0;
	CRC_DTR_Obj_G_Pr2 = 0;
	SQC_VAL_DTR_Obj_G_Pr2 = 0;
	SQC_DTR_Obj_G_Pr2 = 0;
	CRC_DTR_ObjStat_Pr2 = 0;
	SQC_VAL_DTR_ObjStat_Pr2 = 0;
	SQC_DTR_ObjStat_Pr2 = 0;
	CRC_DTR_Polyg_Lt_Pr2 = 0;
	SQC_VAL_DTR_Polyg_Lt_Pr2 = 0;
	SQC_DTR_Polyg_Lt_Pr2 = 0;
	CRC_DTR_Polyg_Rt_Pr2 = 0;
	SQC_VAL_DTR_Polyg_Rt_Pr2 = 0;
	SQC_DTR_Polyg_Rt_Pr2 = 0;
	CRC_DTR_Stat_Pr2 = 0;
	SQC_VAL_DTR_Stat_Pr2 = 0;
	SQC_DTR_Stat_Pr2 = 0;
}
/*@@end*/

/*@@caplFunc:StopSim():*/
StopSim()
{
}
/*@@end*/

/*@@frPDU:MsgChannel1.CHASSIS::DTR_Obj_A_FR2:*/
on frPDU MsgChannel1.CHASSIS::DTR_Obj_A_FR2
{
}
/*@@end*/

/*@@frPDU:MsgChannel1.CHASSIS::DTR_Obj_B_FR2:*/
on frPDU MsgChannel1.CHASSIS::DTR_Obj_B_FR2
{
}
/*@@end*/

/*@@frPDU:MsgChannel1.CHASSIS::DTR_Obj_C_FR2:*/
on frPDU MsgChannel1.CHASSIS::DTR_Obj_C_FR2
{
}
/*@@end*/

/*@@frPDU:MsgChannel1.CHASSIS::DTR_Obj_D_FR2:*/
on frPDU MsgChannel1.CHASSIS::DTR_Obj_D_FR2
{
}
/*@@end*/

/*@@frPDU:MsgChannel1.CHASSIS::DTR_Obj_E_FR2:*/
on frPDU MsgChannel1.CHASSIS::DTR_Obj_E_FR2
{
}
/*@@end*/

/*@@frPDU:MsgChannel1.CHASSIS::DTR_Obj_F_FR2:*/
on frPDU MsgChannel1.CHASSIS::DTR_Obj_F_FR2
{
}
/*@@end*/

/*@@frPDU:MsgChannel1.CHASSIS::DTR_Obj_G_FR2:*/
on frPDU MsgChannel1.CHASSIS::DTR_Obj_G_FR2
{
}
/*@@end*/

/*@@frPDU:MsgChannel1.CHASSIS::DTR_ObjStat_FR2:*/
on frPDU MsgChannel1.CHASSIS::DTR_ObjStat_FR2
{
}
/*@@end*/

/*@@frPDU:MsgChannel1.CHASSIS::DTR_Polyg_Lt_FR2:*/
on frPDU MsgChannel1.CHASSIS::DTR_Polyg_Lt_FR2
{
}
/*@@end*/

/*@@frPDU:MsgChannel1.CHASSIS::DTR_Polyg_Rt_FR2:*/
on frPDU MsgChannel1.CHASSIS::DTR_Polyg_Rt_FR2
{
}
/*@@end*/

/*@@frPDU:MsgChannel1.CHASSIS::DTR_Stat_FR2:*/
on frPDU MsgChannel1.CHASSIS::DTR_Stat_FR2
{
}
/*@@end*/

/*@@frPDU:MsgChannel1.CHASSIS::ROE_LRR:*/
on frPDU MsgChannel1.CHASSIS::ROE_LRR
{
}
/*@@end*/

