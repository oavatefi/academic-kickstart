/*@@var:*/
/*
|==========================================================================================|
|                                                                                          |
|                                                                                          |
|                                         COPYRIGHT                                        |
|                                                                                          |
|                   Copyright (c) by Daimler AG Abt. RD/EEV 2015                           |
|                                                                                          |
|                                                                                          |
|==========================================================================================|
|                                                                                          |
|                                   CAPL AUTHOR IDENTITY                                   |
|                                   --------------------                                   |
|                                                                                          |
| Initials   | Name                 | Company                                              |
| -----------+----------------------+----------------------------------------------------- |
| BH         | Björn Haßelkus       | Firma TZM (EXTERN im Auftrag der Daimler AG)         |
| RS         | Rainer Schulte       | Firma TZM (EXTERN im Auftrag der Daimler AG)         |
|            |                      |                                                      |
|                                                                                          |
|==========================================================================================|
|                                                                                          |
|                                     REVISION HISTORY                                     |
|                                     ----------------                                     |
|                                                                                          |
| Date       | Ver   | Author       | Description                                          |
| -----------+-------+--------------+----------------------------------------------------- |
| 27.04.15   | 1.0   | RS           | creation                                             |
|            |       |              |                                                      |
|                                                                                          |
|------------------------------------------------------------------------------------------|
*/



variables
{
// Timer definieren von nicht im xml enthaltenen ECUs
	mstimer Timer_CH__NMNm_00;
// Timer definieren von nicht im xml enthaltenen ECUs
	mstimer Timer_CH__NMNm_01;
// Timer definieren von nicht im xml enthaltenen ECUs
	mstimer Timer_CH__NMNm_02;
// Timer definieren von nicht im xml enthaltenen ECUs
	mstimer Timer_CH__NMNm_03;
// Timer definieren von nicht im xml enthaltenen ECUs
	mstimer Timer_CH__NMNm_04;
// Timer definieren von nicht im xml enthaltenen ECUs
	mstimer Timer_CH__NMNm_05;
// Timer definieren von nicht im xml enthaltenen ECUs
	mstimer Timer_CH__NMNm_06;
// EIS
	mstimer Timer_CH__NMAppl_EIS;
	mstimer Timer_CH__NMNm_EIS;
// Timer definieren von nicht im xml enthaltenen ECUs
	mstimer Timer_CH__NMNm_08;
// Timer definieren von nicht im xml enthaltenen ECUs
	mstimer Timer_CH__NMNm_09;
// Timer definieren von nicht im xml enthaltenen ECUs
	mstimer Timer_CH__NMNm_0A;
// Timer definieren von nicht im xml enthaltenen ECUs
	mstimer Timer_CH__NMNm_0B;
// Timer definieren von nicht im xml enthaltenen ECUs
	mstimer Timer_CH__NMNm_0C;
// Timer definieren von nicht im xml enthaltenen ECUs
	mstimer Timer_CH__NMNm_0D;
// Timer definieren von nicht im xml enthaltenen ECUs
	mstimer Timer_CH__NMNm_0E;
// Timer definieren von nicht im xml enthaltenen ECUs
	mstimer Timer_CH__NMNm_0F;
// Timer definieren von nicht im xml enthaltenen ECUs
	mstimer Timer_CH__NMNm_10;
// Timer definieren von nicht im xml enthaltenen ECUs
	mstimer Timer_CH__NMNm_11;
// Timer definieren von nicht im xml enthaltenen ECUs
	mstimer Timer_CH__NMNm_12;
// Timer definieren von nicht im xml enthaltenen ECUs
	mstimer Timer_CH__NMNm_13;
// Timer definieren von nicht im xml enthaltenen ECUs
	mstimer Timer_CH__NMNm_14;
// Timer definieren von nicht im xml enthaltenen ECUs
	mstimer Timer_CH__NMNm_15;
// Timer definieren von nicht im xml enthaltenen ECUs
	mstimer Timer_CH__NMNm_16;
// Timer definieren von nicht im xml enthaltenen ECUs
	mstimer Timer_CH__NMNm_17;
// Timer definieren von nicht im xml enthaltenen ECUs
	mstimer Timer_CH__NMNm_18;
// Timer definieren von nicht im xml enthaltenen ECUs
	mstimer Timer_CH__NMNm_19;
// Timer definieren von nicht im xml enthaltenen ECUs
	mstimer Timer_CH__NMNm_1A;
// Timer definieren von nicht im xml enthaltenen ECUs
	mstimer Timer_CH__NMNm_1B;
// Timer definieren von nicht im xml enthaltenen ECUs
	mstimer Timer_CH__NMNm_1C;
// Timer definieren von nicht im xml enthaltenen ECUs
	mstimer Timer_CH__NMNm_1D;
// Timer definieren von nicht im xml enthaltenen ECUs
	mstimer Timer_CH__NMNm_1E;
// Timer definieren von nicht im xml enthaltenen ECUs
	mstimer Timer_CH__NMNm_1F;
// Timer definieren von nicht im xml enthaltenen ECUs
	mstimer Timer_CH__NMNm_20;
// Timer definieren von nicht im xml enthaltenen ECUs
	mstimer Timer_CH__NMNm_21;
// Timer definieren von nicht im xml enthaltenen ECUs
	mstimer Timer_CH__NMNm_22;
// Timer definieren von nicht im xml enthaltenen ECUs
	mstimer Timer_CH__NMNm_23;
// Timer definieren von nicht im xml enthaltenen ECUs
	mstimer Timer_CH__NMNm_24;
// Timer definieren von nicht im xml enthaltenen ECUs
	mstimer Timer_CH__NMNm_25;
// Timer definieren von nicht im xml enthaltenen ECUs
	mstimer Timer_CH__NMNm_26;
// Timer definieren von nicht im xml enthaltenen ECUs
	mstimer Timer_CH__NMNm_27;
// Timer definieren von nicht im xml enthaltenen ECUs
	mstimer Timer_CH__NMNm_28;
// Timer definieren von nicht im xml enthaltenen ECUs
	mstimer Timer_CH__NMNm_29;
// Timer definieren von nicht im xml enthaltenen ECUs
	mstimer Timer_CH__NMNm_2A;
// Timer definieren von nicht im xml enthaltenen ECUs
	mstimer Timer_CH__NMNm_2B;
// Timer definieren von nicht im xml enthaltenen ECUs
	mstimer Timer_CH__NMNm_2C;
// Timer definieren von nicht im xml enthaltenen ECUs
	mstimer Timer_CH__NMNm_2D;
// Timer definieren von nicht im xml enthaltenen ECUs
	mstimer Timer_CH__NMNm_2E;
// Timer definieren von nicht im xml enthaltenen ECUs
	mstimer Timer_CH__NMNm_2F;
// Timer definieren von nicht im xml enthaltenen ECUs
	mstimer Timer_CH__NMNm_30;
// Timer definieren von nicht im xml enthaltenen ECUs
	mstimer Timer_CH__NMNm_31;
// Timer definieren von nicht im xml enthaltenen ECUs
	mstimer Timer_CH__NMNm_32;
// Timer definieren von nicht im xml enthaltenen ECUs
	mstimer Timer_CH__NMNm_33;
// Timer definieren von nicht im xml enthaltenen ECUs
	mstimer Timer_CH__NMNm_34;
// Timer definieren von nicht im xml enthaltenen ECUs
	mstimer Timer_CH__NMNm_35;
// Timer definieren von nicht im xml enthaltenen ECUs
	mstimer Timer_CH__NMNm_36;
// Timer definieren von nicht im xml enthaltenen ECUs
	mstimer Timer_CH__NMNm_37;
// Timer definieren von nicht im xml enthaltenen ECUs
	mstimer Timer_CH__NMNm_38;
// Timer definieren von nicht im xml enthaltenen ECUs
	mstimer Timer_CH__NMNm_39;
// Timer definieren von nicht im xml enthaltenen ECUs
	mstimer Timer_CH__NMNm_3A;
// Timer definieren von nicht im xml enthaltenen ECUs
	mstimer Timer_CH__NMNm_3B;
// Timer definieren von nicht im xml enthaltenen ECUs
	mstimer Timer_CH__NMNm_3C;
// Timer definieren von nicht im xml enthaltenen ECUs
	mstimer Timer_CH__NMNm_3D;
// Timer definieren von nicht im xml enthaltenen ECUs
	mstimer Timer_CH__NMNm_3E;
// Timer definieren von nicht im xml enthaltenen ECUs
	mstimer Timer_CH__NMNm_3F;
// Timer definieren von nicht im xml enthaltenen ECUs
	mstimer Timer_CH__NMNm_40;
// Timer definieren von nicht im xml enthaltenen ECUs
	mstimer Timer_CH__NMNm_41;
// Timer definieren von nicht im xml enthaltenen ECUs
	mstimer Timer_CH__NMNm_42;
// Timer definieren von nicht im xml enthaltenen ECUs
	mstimer Timer_CH__NMNm_43;
// Timer definieren von nicht im xml enthaltenen ECUs
	mstimer Timer_CH__NMNm_44;
// Timer definieren von nicht im xml enthaltenen ECUs
	mstimer Timer_CH__NMNm_45;
// Timer definieren von nicht im xml enthaltenen ECUs
	mstimer Timer_CH__NMNm_46;
// Timer definieren von nicht im xml enthaltenen ECUs
	mstimer Timer_CH__NMNm_47;
// Timer definieren von nicht im xml enthaltenen ECUs
	mstimer Timer_CH__NMNm_48;
// Timer definieren von nicht im xml enthaltenen ECUs
	mstimer Timer_CH__NMNm_49;
// Timer definieren von nicht im xml enthaltenen ECUs
	mstimer Timer_CH__NMNm_4A;
// Timer definieren von nicht im xml enthaltenen ECUs
	mstimer Timer_CH__NMNm_4B;
// Timer definieren von nicht im xml enthaltenen ECUs
	mstimer Timer_CH__NMNm_4C;
// DRVU
	mstimer Timer_CH__NMAppl_DRVU;
	mstimer Timer_CH__NMNm_DRVU;
// Timer definieren von nicht im xml enthaltenen ECUs
	mstimer Timer_CH__NMNm_4E;
// Timer definieren von nicht im xml enthaltenen ECUs
	mstimer Timer_CH__NMNm_4F;
// Timer definieren von nicht im xml enthaltenen ECUs
	mstimer Timer_CH__NMNm_50;
// Timer definieren von nicht im xml enthaltenen ECUs
	mstimer Timer_CH__NMNm_51;
// Timer definieren von nicht im xml enthaltenen ECUs
	mstimer Timer_CH__NMNm_52;
// Timer definieren von nicht im xml enthaltenen ECUs
	mstimer Timer_CH__NMNm_53;
// Timer definieren von nicht im xml enthaltenen ECUs
	mstimer Timer_CH__NMNm_54;
// Timer definieren von nicht im xml enthaltenen ECUs
	mstimer Timer_CH__NMNm_55;
// Timer definieren von nicht im xml enthaltenen ECUs
	mstimer Timer_CH__NMNm_56;
// Timer definieren von nicht im xml enthaltenen ECUs
	mstimer Timer_CH__NMNm_57;
// Timer definieren von nicht im xml enthaltenen ECUs
	mstimer Timer_CH__NMNm_58;
// CPC
	mstimer Timer_CH__NMAppl_CPC;
	mstimer Timer_CH__NMNm_CPC;
// Timer definieren von nicht im xml enthaltenen ECUs
	mstimer Timer_CH__NMNm_5A;
// Timer definieren von nicht im xml enthaltenen ECUs
	mstimer Timer_CH__NMNm_5B;
// Timer definieren von nicht im xml enthaltenen ECUs
	mstimer Timer_CH__NMNm_5C;
// Timer definieren von nicht im xml enthaltenen ECUs
	mstimer Timer_CH__NMNm_5D;
// Timer definieren von nicht im xml enthaltenen ECUs
	mstimer Timer_CH__NMNm_5E;
// Timer definieren von nicht im xml enthaltenen ECUs
	mstimer Timer_CH__NMNm_5F;
// Timer definieren von nicht im xml enthaltenen ECUs
	mstimer Timer_CH__NMNm_60;
// Timer definieren von nicht im xml enthaltenen ECUs
	mstimer Timer_CH__NMNm_61;
// Timer definieren von nicht im xml enthaltenen ECUs
	mstimer Timer_CH__NMNm_62;
// Timer definieren von nicht im xml enthaltenen ECUs
	mstimer Timer_CH__NMNm_63;
// Timer definieren von nicht im xml enthaltenen ECUs
	mstimer Timer_CH__NMNm_64;
// Timer definieren von nicht im xml enthaltenen ECUs
	mstimer Timer_CH__NMNm_65;
// Timer definieren von nicht im xml enthaltenen ECUs
	mstimer Timer_CH__NMNm_66;
// Timer definieren von nicht im xml enthaltenen ECUs
	mstimer Timer_CH__NMNm_67;
// Timer definieren von nicht im xml enthaltenen ECUs
	mstimer Timer_CH__NMNm_68;
// Timer definieren von nicht im xml enthaltenen ECUs
	mstimer Timer_CH__NMNm_69;
// Timer definieren von nicht im xml enthaltenen ECUs
	mstimer Timer_CH__NMNm_6A;
// Timer definieren von nicht im xml enthaltenen ECUs
	mstimer Timer_CH__NMNm_6B;
// Timer definieren von nicht im xml enthaltenen ECUs
	mstimer Timer_CH__NMNm_6C;
// Timer definieren von nicht im xml enthaltenen ECUs
	mstimer Timer_CH__NMNm_6D;
// Timer definieren von nicht im xml enthaltenen ECUs
	mstimer Timer_CH__NMNm_6E;
// Timer definieren von nicht im xml enthaltenen ECUs
	mstimer Timer_CH__NMNm_6F;
// Timer definieren von nicht im xml enthaltenen ECUs
	mstimer Timer_CH__NMNm_70;
// Timer definieren von nicht im xml enthaltenen ECUs
	mstimer Timer_CH__NMNm_71;
// Timer definieren von nicht im xml enthaltenen ECUs
	mstimer Timer_CH__NMNm_72;
// Timer definieren von nicht im xml enthaltenen ECUs
	mstimer Timer_CH__NMNm_73;
// Timer definieren von nicht im xml enthaltenen ECUs
	mstimer Timer_CH__NMNm_74;
// Timer definieren von nicht im xml enthaltenen ECUs
	mstimer Timer_CH__NMNm_75;
// Timer definieren von nicht im xml enthaltenen ECUs
	mstimer Timer_CH__NMNm_76;
// Timer definieren von nicht im xml enthaltenen ECUs
	mstimer Timer_CH__NMNm_77;
// Timer definieren von nicht im xml enthaltenen ECUs
	mstimer Timer_CH__NMNm_78;
// Timer definieren von nicht im xml enthaltenen ECUs
	mstimer Timer_CH__NMNm_79;
// Timer definieren von nicht im xml enthaltenen ECUs
	mstimer Timer_CH__NMNm_7A;
// Timer definieren von nicht im xml enthaltenen ECUs
	mstimer Timer_CH__NMNm_7B;
// Timer definieren von nicht im xml enthaltenen ECUs
	mstimer Timer_CH__NMNm_7C;
// Timer definieren von nicht im xml enthaltenen ECUs
	mstimer Timer_CH__NMNm_7D;
// Timer definieren von nicht im xml enthaltenen ECUs
	mstimer Timer_CH__NMNm_7E;
// MPC
	mstimer Timer_CH__NMAppl_MPC;
	mstimer Timer_CH__NMNm_MPC;
// LRR
	mstimer Timer_CH__NMAppl_LRR;
	mstimer Timer_CH__NMNm_LRR;
// FCWRDUSDTR
	mstimer Timer_CH__NMAppl_FCWRDUSDTR;
	mstimer Timer_CH__NMNm_FCWRDUSDTR;
// PARK
	mstimer Timer_CH__NMAppl_PARK;
	mstimer Timer_CH__NMNm_PARK;
// SPC
	mstimer Timer_CH__NMAppl_SPC;
	mstimer Timer_CH__NMNm_SPC;
// EPS
	mstimer Timer_CH__NMAppl_EPS;
	mstimer Timer_CH__NMNm_EPS;
// SCCM
	mstimer Timer_CH__NMAppl_SCCM;
	mstimer Timer_CH__NMNm_SCCM;
// ESP
	mstimer Timer_CH__NMAppl_ESP;
	mstimer Timer_CH__NMNm_ESP;
// SPC_VX
	mstimer Timer_CH__NMAppl_SPC_VX;
	mstimer Timer_CH__NMNm_SPC_VX;
// AWD_TCASE
	mstimer Timer_CH__NMAppl_AWD_TCASE;
	mstimer Timer_CH__NMNm_AWD_TCASE;
// NM
	mstimer Timer_CH__NMAppl_NM;
	mstimer Timer_CH__NMNm_NM;
}
/*@@end*/

/*@@startStart:Start:*/
on start
{
// Startwerte setzen für den Empfang von nicht im xml enthaltenen ECUs
	@sysvar::CH_NM::CH__NMNm_00 = 0;
// Startwerte setzen für den Empfang von nicht im xml enthaltenen ECUs
	@sysvar::CH_NM::CH__NMNm_01 = 0;
// Startwerte setzen für den Empfang von nicht im xml enthaltenen ECUs
	@sysvar::CH_NM::CH__NMNm_02 = 0;
// Startwerte setzen für den Empfang von nicht im xml enthaltenen ECUs
	@sysvar::CH_NM::CH__NMNm_03 = 0;
// Startwerte setzen für den Empfang von nicht im xml enthaltenen ECUs
	@sysvar::CH_NM::CH__NMNm_04 = 0;
// Startwerte setzen für den Empfang von nicht im xml enthaltenen ECUs
	@sysvar::CH_NM::CH__NMNm_05 = 0;
// Startwerte setzen für den Empfang von nicht im xml enthaltenen ECUs
	@sysvar::CH_NM::CH__NMNm_06 = 0;
// EIS
	@sysvar::CH_Nodes::CH__NMAwake_EIS = 0;
	@sysvar::CH_NM::CH__NMAppl_EIS = 0;
	@sysvar::CH_NM::CH__NMNm_EIS = 0;
	@sysvar::CH_NM::CH__NMStat_EIS = 0;
	@sysvar::CH_NM::CH__NMSimStat_EIS = 0;
	@sysvar::CH_Nodes::CH__NMActive_EIS = 1;
// Startwerte setzen für den Empfang von nicht im xml enthaltenen ECUs
	@sysvar::CH_NM::CH__NMNm_08 = 0;
// Startwerte setzen für den Empfang von nicht im xml enthaltenen ECUs
	@sysvar::CH_NM::CH__NMNm_09 = 0;
// Startwerte setzen für den Empfang von nicht im xml enthaltenen ECUs
	@sysvar::CH_NM::CH__NMNm_0A = 0;
// Startwerte setzen für den Empfang von nicht im xml enthaltenen ECUs
	@sysvar::CH_NM::CH__NMNm_0B = 0;
// Startwerte setzen für den Empfang von nicht im xml enthaltenen ECUs
	@sysvar::CH_NM::CH__NMNm_0C = 0;
// Startwerte setzen für den Empfang von nicht im xml enthaltenen ECUs
	@sysvar::CH_NM::CH__NMNm_0D = 0;
// Startwerte setzen für den Empfang von nicht im xml enthaltenen ECUs
	@sysvar::CH_NM::CH__NMNm_0E = 0;
// Startwerte setzen für den Empfang von nicht im xml enthaltenen ECUs
	@sysvar::CH_NM::CH__NMNm_0F = 0;
// Startwerte setzen für den Empfang von nicht im xml enthaltenen ECUs
	@sysvar::CH_NM::CH__NMNm_10 = 0;
// Startwerte setzen für den Empfang von nicht im xml enthaltenen ECUs
	@sysvar::CH_NM::CH__NMNm_11 = 0;
// Startwerte setzen für den Empfang von nicht im xml enthaltenen ECUs
	@sysvar::CH_NM::CH__NMNm_12 = 0;
// Startwerte setzen für den Empfang von nicht im xml enthaltenen ECUs
	@sysvar::CH_NM::CH__NMNm_13 = 0;
// Startwerte setzen für den Empfang von nicht im xml enthaltenen ECUs
	@sysvar::CH_NM::CH__NMNm_14 = 0;
// Startwerte setzen für den Empfang von nicht im xml enthaltenen ECUs
	@sysvar::CH_NM::CH__NMNm_15 = 0;
// Startwerte setzen für den Empfang von nicht im xml enthaltenen ECUs
	@sysvar::CH_NM::CH__NMNm_16 = 0;
// Startwerte setzen für den Empfang von nicht im xml enthaltenen ECUs
	@sysvar::CH_NM::CH__NMNm_17 = 0;
// Startwerte setzen für den Empfang von nicht im xml enthaltenen ECUs
	@sysvar::CH_NM::CH__NMNm_18 = 0;
// Startwerte setzen für den Empfang von nicht im xml enthaltenen ECUs
	@sysvar::CH_NM::CH__NMNm_19 = 0;
// Startwerte setzen für den Empfang von nicht im xml enthaltenen ECUs
	@sysvar::CH_NM::CH__NMNm_1A = 0;
// Startwerte setzen für den Empfang von nicht im xml enthaltenen ECUs
	@sysvar::CH_NM::CH__NMNm_1B = 0;
// Startwerte setzen für den Empfang von nicht im xml enthaltenen ECUs
	@sysvar::CH_NM::CH__NMNm_1C = 0;
// Startwerte setzen für den Empfang von nicht im xml enthaltenen ECUs
	@sysvar::CH_NM::CH__NMNm_1D = 0;
// Startwerte setzen für den Empfang von nicht im xml enthaltenen ECUs
	@sysvar::CH_NM::CH__NMNm_1E = 0;
// Startwerte setzen für den Empfang von nicht im xml enthaltenen ECUs
	@sysvar::CH_NM::CH__NMNm_1F = 0;
// Startwerte setzen für den Empfang von nicht im xml enthaltenen ECUs
	@sysvar::CH_NM::CH__NMNm_20 = 0;
// Startwerte setzen für den Empfang von nicht im xml enthaltenen ECUs
	@sysvar::CH_NM::CH__NMNm_21 = 0;
// Startwerte setzen für den Empfang von nicht im xml enthaltenen ECUs
	@sysvar::CH_NM::CH__NMNm_22 = 0;
// Startwerte setzen für den Empfang von nicht im xml enthaltenen ECUs
	@sysvar::CH_NM::CH__NMNm_23 = 0;
// Startwerte setzen für den Empfang von nicht im xml enthaltenen ECUs
	@sysvar::CH_NM::CH__NMNm_24 = 0;
// Startwerte setzen für den Empfang von nicht im xml enthaltenen ECUs
	@sysvar::CH_NM::CH__NMNm_25 = 0;
// Startwerte setzen für den Empfang von nicht im xml enthaltenen ECUs
	@sysvar::CH_NM::CH__NMNm_26 = 0;
// Startwerte setzen für den Empfang von nicht im xml enthaltenen ECUs
	@sysvar::CH_NM::CH__NMNm_27 = 0;
// Startwerte setzen für den Empfang von nicht im xml enthaltenen ECUs
	@sysvar::CH_NM::CH__NMNm_28 = 0;
// Startwerte setzen für den Empfang von nicht im xml enthaltenen ECUs
	@sysvar::CH_NM::CH__NMNm_29 = 0;
// Startwerte setzen für den Empfang von nicht im xml enthaltenen ECUs
	@sysvar::CH_NM::CH__NMNm_2A = 0;
// Startwerte setzen für den Empfang von nicht im xml enthaltenen ECUs
	@sysvar::CH_NM::CH__NMNm_2B = 0;
// Startwerte setzen für den Empfang von nicht im xml enthaltenen ECUs
	@sysvar::CH_NM::CH__NMNm_2C = 0;
// Startwerte setzen für den Empfang von nicht im xml enthaltenen ECUs
	@sysvar::CH_NM::CH__NMNm_2D = 0;
// Startwerte setzen für den Empfang von nicht im xml enthaltenen ECUs
	@sysvar::CH_NM::CH__NMNm_2E = 0;
// Startwerte setzen für den Empfang von nicht im xml enthaltenen ECUs
	@sysvar::CH_NM::CH__NMNm_2F = 0;
// Startwerte setzen für den Empfang von nicht im xml enthaltenen ECUs
	@sysvar::CH_NM::CH__NMNm_30 = 0;
// Startwerte setzen für den Empfang von nicht im xml enthaltenen ECUs
	@sysvar::CH_NM::CH__NMNm_31 = 0;
// Startwerte setzen für den Empfang von nicht im xml enthaltenen ECUs
	@sysvar::CH_NM::CH__NMNm_32 = 0;
// Startwerte setzen für den Empfang von nicht im xml enthaltenen ECUs
	@sysvar::CH_NM::CH__NMNm_33 = 0;
// Startwerte setzen für den Empfang von nicht im xml enthaltenen ECUs
	@sysvar::CH_NM::CH__NMNm_34 = 0;
// Startwerte setzen für den Empfang von nicht im xml enthaltenen ECUs
	@sysvar::CH_NM::CH__NMNm_35 = 0;
// Startwerte setzen für den Empfang von nicht im xml enthaltenen ECUs
	@sysvar::CH_NM::CH__NMNm_36 = 0;
// Startwerte setzen für den Empfang von nicht im xml enthaltenen ECUs
	@sysvar::CH_NM::CH__NMNm_37 = 0;
// Startwerte setzen für den Empfang von nicht im xml enthaltenen ECUs
	@sysvar::CH_NM::CH__NMNm_38 = 0;
// Startwerte setzen für den Empfang von nicht im xml enthaltenen ECUs
	@sysvar::CH_NM::CH__NMNm_39 = 0;
// Startwerte setzen für den Empfang von nicht im xml enthaltenen ECUs
	@sysvar::CH_NM::CH__NMNm_3A = 0;
// Startwerte setzen für den Empfang von nicht im xml enthaltenen ECUs
	@sysvar::CH_NM::CH__NMNm_3B = 0;
// Startwerte setzen für den Empfang von nicht im xml enthaltenen ECUs
	@sysvar::CH_NM::CH__NMNm_3C = 0;
// Startwerte setzen für den Empfang von nicht im xml enthaltenen ECUs
	@sysvar::CH_NM::CH__NMNm_3D = 0;
// Startwerte setzen für den Empfang von nicht im xml enthaltenen ECUs
	@sysvar::CH_NM::CH__NMNm_3E = 0;
// Startwerte setzen für den Empfang von nicht im xml enthaltenen ECUs
	@sysvar::CH_NM::CH__NMNm_3F = 0;
// Startwerte setzen für den Empfang von nicht im xml enthaltenen ECUs
	@sysvar::CH_NM::CH__NMNm_40 = 0;
// Startwerte setzen für den Empfang von nicht im xml enthaltenen ECUs
	@sysvar::CH_NM::CH__NMNm_41 = 0;
// Startwerte setzen für den Empfang von nicht im xml enthaltenen ECUs
	@sysvar::CH_NM::CH__NMNm_42 = 0;
// Startwerte setzen für den Empfang von nicht im xml enthaltenen ECUs
	@sysvar::CH_NM::CH__NMNm_43 = 0;
// Startwerte setzen für den Empfang von nicht im xml enthaltenen ECUs
	@sysvar::CH_NM::CH__NMNm_44 = 0;
// Startwerte setzen für den Empfang von nicht im xml enthaltenen ECUs
	@sysvar::CH_NM::CH__NMNm_45 = 0;
// Startwerte setzen für den Empfang von nicht im xml enthaltenen ECUs
	@sysvar::CH_NM::CH__NMNm_46 = 0;
// Startwerte setzen für den Empfang von nicht im xml enthaltenen ECUs
	@sysvar::CH_NM::CH__NMNm_47 = 0;
// Startwerte setzen für den Empfang von nicht im xml enthaltenen ECUs
	@sysvar::CH_NM::CH__NMNm_48 = 0;
// Startwerte setzen für den Empfang von nicht im xml enthaltenen ECUs
	@sysvar::CH_NM::CH__NMNm_49 = 0;
// Startwerte setzen für den Empfang von nicht im xml enthaltenen ECUs
	@sysvar::CH_NM::CH__NMNm_4A = 0;
// Startwerte setzen für den Empfang von nicht im xml enthaltenen ECUs
	@sysvar::CH_NM::CH__NMNm_4B = 0;
// Startwerte setzen für den Empfang von nicht im xml enthaltenen ECUs
	@sysvar::CH_NM::CH__NMNm_4C = 0;
// DRVU
	@sysvar::CH_Nodes::CH__NMAwake_DRVU = 0;
	@sysvar::CH_NM::CH__NMAppl_DRVU = 0;
	@sysvar::CH_NM::CH__NMNm_DRVU = 0;
	@sysvar::CH_NM::CH__NMStat_DRVU = 0;
	@sysvar::CH_NM::CH__NMSimStat_DRVU = 0;
	@sysvar::CH_Nodes::CH__NMActive_DRVU = 1;
// Startwerte setzen für den Empfang von nicht im xml enthaltenen ECUs
	@sysvar::CH_NM::CH__NMNm_4E = 0;
// Startwerte setzen für den Empfang von nicht im xml enthaltenen ECUs
	@sysvar::CH_NM::CH__NMNm_4F = 0;
// Startwerte setzen für den Empfang von nicht im xml enthaltenen ECUs
	@sysvar::CH_NM::CH__NMNm_50 = 0;
// Startwerte setzen für den Empfang von nicht im xml enthaltenen ECUs
	@sysvar::CH_NM::CH__NMNm_51 = 0;
// Startwerte setzen für den Empfang von nicht im xml enthaltenen ECUs
	@sysvar::CH_NM::CH__NMNm_52 = 0;
// Startwerte setzen für den Empfang von nicht im xml enthaltenen ECUs
	@sysvar::CH_NM::CH__NMNm_53 = 0;
// Startwerte setzen für den Empfang von nicht im xml enthaltenen ECUs
	@sysvar::CH_NM::CH__NMNm_54 = 0;
// Startwerte setzen für den Empfang von nicht im xml enthaltenen ECUs
	@sysvar::CH_NM::CH__NMNm_55 = 0;
// Startwerte setzen für den Empfang von nicht im xml enthaltenen ECUs
	@sysvar::CH_NM::CH__NMNm_56 = 0;
// Startwerte setzen für den Empfang von nicht im xml enthaltenen ECUs
	@sysvar::CH_NM::CH__NMNm_57 = 0;
// Startwerte setzen für den Empfang von nicht im xml enthaltenen ECUs
	@sysvar::CH_NM::CH__NMNm_58 = 0;
// CPC
	@sysvar::CH_Nodes::CH__NMAwake_CPC = 0;
	@sysvar::CH_NM::CH__NMAppl_CPC = 0;
	@sysvar::CH_NM::CH__NMNm_CPC = 0;
	@sysvar::CH_NM::CH__NMStat_CPC = 0;
	@sysvar::CH_NM::CH__NMSimStat_CPC = 0;
	@sysvar::CH_Nodes::CH__NMActive_CPC = 1;
// Startwerte setzen für den Empfang von nicht im xml enthaltenen ECUs
	@sysvar::CH_NM::CH__NMNm_5A = 0;
// Startwerte setzen für den Empfang von nicht im xml enthaltenen ECUs
	@sysvar::CH_NM::CH__NMNm_5B = 0;
// Startwerte setzen für den Empfang von nicht im xml enthaltenen ECUs
	@sysvar::CH_NM::CH__NMNm_5C = 0;
// Startwerte setzen für den Empfang von nicht im xml enthaltenen ECUs
	@sysvar::CH_NM::CH__NMNm_5D = 0;
// Startwerte setzen für den Empfang von nicht im xml enthaltenen ECUs
	@sysvar::CH_NM::CH__NMNm_5E = 0;
// Startwerte setzen für den Empfang von nicht im xml enthaltenen ECUs
	@sysvar::CH_NM::CH__NMNm_5F = 0;
// Startwerte setzen für den Empfang von nicht im xml enthaltenen ECUs
	@sysvar::CH_NM::CH__NMNm_60 = 0;
// Startwerte setzen für den Empfang von nicht im xml enthaltenen ECUs
	@sysvar::CH_NM::CH__NMNm_61 = 0;
// Startwerte setzen für den Empfang von nicht im xml enthaltenen ECUs
	@sysvar::CH_NM::CH__NMNm_62 = 0;
// Startwerte setzen für den Empfang von nicht im xml enthaltenen ECUs
	@sysvar::CH_NM::CH__NMNm_63 = 0;
// Startwerte setzen für den Empfang von nicht im xml enthaltenen ECUs
	@sysvar::CH_NM::CH__NMNm_64 = 0;
// Startwerte setzen für den Empfang von nicht im xml enthaltenen ECUs
	@sysvar::CH_NM::CH__NMNm_65 = 0;
// Startwerte setzen für den Empfang von nicht im xml enthaltenen ECUs
	@sysvar::CH_NM::CH__NMNm_66 = 0;
// Startwerte setzen für den Empfang von nicht im xml enthaltenen ECUs
	@sysvar::CH_NM::CH__NMNm_67 = 0;
// Startwerte setzen für den Empfang von nicht im xml enthaltenen ECUs
	@sysvar::CH_NM::CH__NMNm_68 = 0;
// Startwerte setzen für den Empfang von nicht im xml enthaltenen ECUs
	@sysvar::CH_NM::CH__NMNm_69 = 0;
// Startwerte setzen für den Empfang von nicht im xml enthaltenen ECUs
	@sysvar::CH_NM::CH__NMNm_6A = 0;
// Startwerte setzen für den Empfang von nicht im xml enthaltenen ECUs
	@sysvar::CH_NM::CH__NMNm_6B = 0;
// Startwerte setzen für den Empfang von nicht im xml enthaltenen ECUs
	@sysvar::CH_NM::CH__NMNm_6C = 0;
// Startwerte setzen für den Empfang von nicht im xml enthaltenen ECUs
	@sysvar::CH_NM::CH__NMNm_6D = 0;
// Startwerte setzen für den Empfang von nicht im xml enthaltenen ECUs
	@sysvar::CH_NM::CH__NMNm_6E = 0;
// Startwerte setzen für den Empfang von nicht im xml enthaltenen ECUs
	@sysvar::CH_NM::CH__NMNm_6F = 0;
// Startwerte setzen für den Empfang von nicht im xml enthaltenen ECUs
	@sysvar::CH_NM::CH__NMNm_70 = 0;
// Startwerte setzen für den Empfang von nicht im xml enthaltenen ECUs
	@sysvar::CH_NM::CH__NMNm_71 = 0;
// Startwerte setzen für den Empfang von nicht im xml enthaltenen ECUs
	@sysvar::CH_NM::CH__NMNm_72 = 0;
// Startwerte setzen für den Empfang von nicht im xml enthaltenen ECUs
	@sysvar::CH_NM::CH__NMNm_73 = 0;
// Startwerte setzen für den Empfang von nicht im xml enthaltenen ECUs
	@sysvar::CH_NM::CH__NMNm_74 = 0;
// Startwerte setzen für den Empfang von nicht im xml enthaltenen ECUs
	@sysvar::CH_NM::CH__NMNm_75 = 0;
// Startwerte setzen für den Empfang von nicht im xml enthaltenen ECUs
	@sysvar::CH_NM::CH__NMNm_76 = 0;
// Startwerte setzen für den Empfang von nicht im xml enthaltenen ECUs
	@sysvar::CH_NM::CH__NMNm_77 = 0;
// Startwerte setzen für den Empfang von nicht im xml enthaltenen ECUs
	@sysvar::CH_NM::CH__NMNm_78 = 0;
// Startwerte setzen für den Empfang von nicht im xml enthaltenen ECUs
	@sysvar::CH_NM::CH__NMNm_79 = 0;
// Startwerte setzen für den Empfang von nicht im xml enthaltenen ECUs
	@sysvar::CH_NM::CH__NMNm_7A = 0;
// Startwerte setzen für den Empfang von nicht im xml enthaltenen ECUs
	@sysvar::CH_NM::CH__NMNm_7B = 0;
// Startwerte setzen für den Empfang von nicht im xml enthaltenen ECUs
	@sysvar::CH_NM::CH__NMNm_7C = 0;
// Startwerte setzen für den Empfang von nicht im xml enthaltenen ECUs
	@sysvar::CH_NM::CH__NMNm_7D = 0;
// Startwerte setzen für den Empfang von nicht im xml enthaltenen ECUs
	@sysvar::CH_NM::CH__NMNm_7E = 0;
// MPC
	@sysvar::CH_Nodes::CH__NMAwake_MPC = 0;
	@sysvar::CH_NM::CH__NMAppl_MPC = 0;
	@sysvar::CH_NM::CH__NMNm_MPC = 0;
	@sysvar::CH_NM::CH__NMStat_MPC = 0;
	@sysvar::CH_NM::CH__NMSimStat_MPC = 0;
	@sysvar::CH_Nodes::CH__NMActive_MPC = 1;
// LRR
	@sysvar::CH_Nodes::CH__NMAwake_LRR = 0;
	@sysvar::CH_NM::CH__NMAppl_LRR = 0;
	@sysvar::CH_NM::CH__NMNm_LRR = 0;
	@sysvar::CH_NM::CH__NMStat_LRR = 0;
	@sysvar::CH_NM::CH__NMSimStat_LRR = 0;
	@sysvar::CH_Nodes::CH__NMActive_LRR = 1;
// FCWRDUSDTR
	@sysvar::CH_Nodes::CH__NMAwake_FCWRDUSDTR = 0;
	@sysvar::CH_NM::CH__NMAppl_FCWRDUSDTR = 0;
	@sysvar::CH_NM::CH__NMNm_FCWRDUSDTR = 0;
	@sysvar::CH_NM::CH__NMStat_FCWRDUSDTR = 0;
	@sysvar::CH_NM::CH__NMSimStat_FCWRDUSDTR = 0;
	@sysvar::CH_Nodes::CH__NMActive_FCWRDUSDTR = 1;
// PARK
	@sysvar::CH_Nodes::CH__NMAwake_PARK = 0;
	@sysvar::CH_NM::CH__NMAppl_PARK = 0;
	@sysvar::CH_NM::CH__NMNm_PARK = 0;
	@sysvar::CH_NM::CH__NMStat_PARK = 0;
	@sysvar::CH_NM::CH__NMSimStat_PARK = 0;
	@sysvar::CH_Nodes::CH__NMActive_PARK = 1;
// SPC
	@sysvar::CH_Nodes::CH__NMAwake_SPC = 0;
	@sysvar::CH_NM::CH__NMAppl_SPC = 0;
	@sysvar::CH_NM::CH__NMNm_SPC = 0;
	@sysvar::CH_NM::CH__NMStat_SPC = 0;
	@sysvar::CH_NM::CH__NMSimStat_SPC = 0;
	@sysvar::CH_Nodes::CH__NMActive_SPC = 1;
// EPS
	@sysvar::CH_Nodes::CH__NMAwake_EPS = 0;
	@sysvar::CH_NM::CH__NMAppl_EPS = 0;
	@sysvar::CH_NM::CH__NMNm_EPS = 0;
	@sysvar::CH_NM::CH__NMStat_EPS = 0;
	@sysvar::CH_NM::CH__NMSimStat_EPS = 0;
	@sysvar::CH_Nodes::CH__NMActive_EPS = 1;
// SCCM
	@sysvar::CH_Nodes::CH__NMAwake_SCCM = 0;
	@sysvar::CH_NM::CH__NMAppl_SCCM = 0;
	@sysvar::CH_NM::CH__NMNm_SCCM = 0;
	@sysvar::CH_NM::CH__NMStat_SCCM = 0;
	@sysvar::CH_NM::CH__NMSimStat_SCCM = 0;
	@sysvar::CH_Nodes::CH__NMActive_SCCM = 1;
// ESP
	@sysvar::CH_Nodes::CH__NMAwake_ESP = 0;
	@sysvar::CH_NM::CH__NMAppl_ESP = 0;
	@sysvar::CH_NM::CH__NMNm_ESP = 0;
	@sysvar::CH_NM::CH__NMStat_ESP = 0;
	@sysvar::CH_NM::CH__NMSimStat_ESP = 0;
	@sysvar::CH_Nodes::CH__NMActive_ESP = 1;
// SPC_VX
	@sysvar::CH_Nodes::CH__NMAwake_SPC_VX = 0;
	@sysvar::CH_NM::CH__NMAppl_SPC_VX = 0;
	@sysvar::CH_NM::CH__NMNm_SPC_VX = 0;
	@sysvar::CH_NM::CH__NMStat_SPC_VX = 0;
	@sysvar::CH_NM::CH__NMSimStat_SPC_VX = 0;
	@sysvar::CH_Nodes::CH__NMActive_SPC_VX = 1;
// AWD_TCASE
	@sysvar::CH_Nodes::CH__NMAwake_AWD_TCASE = 0;
	@sysvar::CH_NM::CH__NMAppl_AWD_TCASE = 0;
	@sysvar::CH_NM::CH__NMNm_AWD_TCASE = 0;
	@sysvar::CH_NM::CH__NMStat_AWD_TCASE = 0;
	@sysvar::CH_NM::CH__NMSimStat_AWD_TCASE = 0;
	@sysvar::CH_Nodes::CH__NMActive_AWD_TCASE = 1;
// NM
	@sysvar::CH_NM::CH__NMAwake_NM = 0;
	@sysvar::CH_NM::CH__NMAppl_NM = 0;
	@sysvar::CH_NM::CH__NMNm_NM = 0;
	@sysvar::CH_NM::CH__NMStat_NM = 0;
	@sysvar::CH_NM::CH__NMSimStat_NM = 0;
	@sysvar::CH_NM::CH__NMActive_NM = 1;
}
/*@@end*/

/*@@frPDU:MsgChannel1.CHASSIS::AWD_TCASE_Disp_Rq_AR2:*/
on frPDU MsgChannel1.CHASSIS::AWD_TCASE_Disp_Rq_AR2
{
	if (@sysvar::CH_NM::CH__NMAppl_AWD_TCASE != 2) @sysvar::CH_NM::CH__NMAppl_AWD_TCASE = 2;
	settimer(Timer_CH__NMAppl_AWD_TCASE, 1100);
	if (@sysvar::CH_NM::CH__NMNm_AWD_TCASE == 2)
	{
		if (@sysvar::CH_NM::CH__NMStat_AWD_TCASE != 3) @sysvar::CH_NM::CH__NMStat_AWD_TCASE = 3;
	}
	else
	{
		if (@sysvar::CH_NM::CH__NMStat_AWD_TCASE != 4) @sysvar::CH_NM::CH__NMStat_AWD_TCASE = 4;
	}
	output(this);
}
/*@@end*/

/*@@frPDU:MsgChannel1.CHASSIS::AWD_TCASE_Stat1_AR2:*/
on frPDU MsgChannel1.CHASSIS::AWD_TCASE_Stat1_AR2
{
	if (@sysvar::CH_NM::CH__NMAppl_AWD_TCASE != 2) @sysvar::CH_NM::CH__NMAppl_AWD_TCASE = 2;
	settimer(Timer_CH__NMAppl_AWD_TCASE, 1100);
	if (@sysvar::CH_NM::CH__NMNm_AWD_TCASE == 2)
	{
		if (@sysvar::CH_NM::CH__NMStat_AWD_TCASE != 3) @sysvar::CH_NM::CH__NMStat_AWD_TCASE = 3;
	}
	else
	{
		if (@sysvar::CH_NM::CH__NMStat_AWD_TCASE != 4) @sysvar::CH_NM::CH__NMStat_AWD_TCASE = 4;
	}
	output(this);
}
/*@@end*/

/*@@frPDU:MsgChannel1.CHASSIS::AWD_TCASE_Stat2_AR2:*/
on frPDU MsgChannel1.CHASSIS::AWD_TCASE_Stat2_AR2
{
	if (@sysvar::CH_NM::CH__NMAppl_AWD_TCASE != 2) @sysvar::CH_NM::CH__NMAppl_AWD_TCASE = 2;
	settimer(Timer_CH__NMAppl_AWD_TCASE, 1100);
	if (@sysvar::CH_NM::CH__NMNm_AWD_TCASE == 2)
	{
		if (@sysvar::CH_NM::CH__NMStat_AWD_TCASE != 3) @sysvar::CH_NM::CH__NMStat_AWD_TCASE = 3;
	}
	else
	{
		if (@sysvar::CH_NM::CH__NMStat_AWD_TCASE != 4) @sysvar::CH_NM::CH__NMStat_AWD_TCASE = 4;
	}
	output(this);
}
/*@@end*/

/*@@frPDU:MsgChannel1.CHASSIS::ROE_AWD_TCASE:*/
on frPDU MsgChannel1.CHASSIS::ROE_AWD_TCASE
{
	if (@sysvar::CH_NM::CH__NMAppl_AWD_TCASE != 2) @sysvar::CH_NM::CH__NMAppl_AWD_TCASE = 2;
	settimer(Timer_CH__NMAppl_AWD_TCASE, 1100);
	if (@sysvar::CH_NM::CH__NMNm_AWD_TCASE == 2)
	{
		if (@sysvar::CH_NM::CH__NMStat_AWD_TCASE != 3) @sysvar::CH_NM::CH__NMStat_AWD_TCASE = 3;
	}
	else
	{
		if (@sysvar::CH_NM::CH__NMStat_AWD_TCASE != 4) @sysvar::CH_NM::CH__NMStat_AWD_TCASE = 4;
	}
	output(this);
}
/*@@end*/

/*@@frPDU:MsgChannel1.CHASSIS::Adblue_Disp_Rq_AR:*/
on frPDU MsgChannel1.CHASSIS::Adblue_Disp_Rq_AR
{
	if (@sysvar::CH_NM::CH__NMAppl_CPC != 2) @sysvar::CH_NM::CH__NMAppl_CPC = 2;
	settimer(Timer_CH__NMAppl_CPC, 1100);
	if (@sysvar::CH_NM::CH__NMNm_CPC == 2)
	{
		if (@sysvar::CH_NM::CH__NMStat_CPC != 3) @sysvar::CH_NM::CH__NMStat_CPC = 3;
	}
	else
	{
		if (@sysvar::CH_NM::CH__NMStat_CPC != 4) @sysvar::CH_NM::CH__NMStat_CPC = 4;
	}
	output(this);
}
/*@@end*/

/*@@frPDU:MsgChannel1.CHASSIS::Adblue_Disp_Warn_Rq_AR:*/
on frPDU MsgChannel1.CHASSIS::Adblue_Disp_Warn_Rq_AR
{
	if (@sysvar::CH_NM::CH__NMAppl_CPC != 2) @sysvar::CH_NM::CH__NMAppl_CPC = 2;
	settimer(Timer_CH__NMAppl_CPC, 1100);
	if (@sysvar::CH_NM::CH__NMNm_CPC == 2)
	{
		if (@sysvar::CH_NM::CH__NMStat_CPC != 3) @sysvar::CH_NM::CH__NMStat_CPC = 3;
	}
	else
	{
		if (@sysvar::CH_NM::CH__NMStat_CPC != 4) @sysvar::CH_NM::CH__NMStat_CPC = 4;
	}
	output(this);
}
/*@@end*/

/*@@frPDU:MsgChannel1.CHASSIS::Assyst_Stat2_AR:*/
on frPDU MsgChannel1.CHASSIS::Assyst_Stat2_AR
{
	if (@sysvar::CH_NM::CH__NMAppl_CPC != 2) @sysvar::CH_NM::CH__NMAppl_CPC = 2;
	settimer(Timer_CH__NMAppl_CPC, 1100);
	if (@sysvar::CH_NM::CH__NMNm_CPC == 2)
	{
		if (@sysvar::CH_NM::CH__NMStat_CPC != 3) @sysvar::CH_NM::CH__NMStat_CPC = 3;
	}
	else
	{
		if (@sysvar::CH_NM::CH__NMStat_CPC != 4) @sysvar::CH_NM::CH__NMStat_CPC = 4;
	}
	output(this);
}
/*@@end*/

/*@@frPDU:MsgChannel1.CHASSIS::Assyst_Stat3_AR2:*/
on frPDU MsgChannel1.CHASSIS::Assyst_Stat3_AR2
{
	if (@sysvar::CH_NM::CH__NMAppl_CPC != 2) @sysvar::CH_NM::CH__NMAppl_CPC = 2;
	settimer(Timer_CH__NMAppl_CPC, 1100);
	if (@sysvar::CH_NM::CH__NMNm_CPC == 2)
	{
		if (@sysvar::CH_NM::CH__NMStat_CPC != 3) @sysvar::CH_NM::CH__NMStat_CPC = 3;
	}
	else
	{
		if (@sysvar::CH_NM::CH__NMStat_CPC != 4) @sysvar::CH_NM::CH__NMStat_CPC = 4;
	}
	output(this);
}
/*@@end*/

/*@@frPDU:MsgChannel1.CHASSIS::Assyst_Stat_AR:*/
on frPDU MsgChannel1.CHASSIS::Assyst_Stat_AR
{
	if (@sysvar::CH_NM::CH__NMAppl_CPC != 2) @sysvar::CH_NM::CH__NMAppl_CPC = 2;
	settimer(Timer_CH__NMAppl_CPC, 1100);
	if (@sysvar::CH_NM::CH__NMNm_CPC == 2)
	{
		if (@sysvar::CH_NM::CH__NMStat_CPC != 3) @sysvar::CH_NM::CH__NMStat_CPC = 3;
	}
	else
	{
		if (@sysvar::CH_NM::CH__NMStat_CPC != 4) @sysvar::CH_NM::CH__NMStat_CPC = 4;
	}
	output(this);
}
/*@@end*/

/*@@frPDU:MsgChannel1.CHASSIS::CNG_Disp_Rq_AR2:*/
on frPDU MsgChannel1.CHASSIS::CNG_Disp_Rq_AR2
{
	if (@sysvar::CH_NM::CH__NMAppl_CPC != 2) @sysvar::CH_NM::CH__NMAppl_CPC = 2;
	settimer(Timer_CH__NMAppl_CPC, 1100);
	if (@sysvar::CH_NM::CH__NMNm_CPC == 2)
	{
		if (@sysvar::CH_NM::CH__NMStat_CPC != 3) @sysvar::CH_NM::CH__NMStat_CPC = 3;
	}
	else
	{
		if (@sysvar::CH_NM::CH__NMStat_CPC != 4) @sysvar::CH_NM::CH__NMStat_CPC = 4;
	}
	output(this);
}
/*@@end*/

/*@@frPDU:MsgChannel1.CHASSIS::CPC_CHASSIS_R1_AR2:*/
on frPDU MsgChannel1.CHASSIS::CPC_CHASSIS_R1_AR2
{
	if (@sysvar::CH_NM::CH__NMAppl_CPC != 2) @sysvar::CH_NM::CH__NMAppl_CPC = 2;
	settimer(Timer_CH__NMAppl_CPC, 1100);
	if (@sysvar::CH_NM::CH__NMNm_CPC == 2)
	{
		if (@sysvar::CH_NM::CH__NMStat_CPC != 3) @sysvar::CH_NM::CH__NMStat_CPC = 3;
	}
	else
	{
		if (@sysvar::CH_NM::CH__NMStat_CPC != 4) @sysvar::CH_NM::CH__NMStat_CPC = 4;
	}
	output(this);
}
/*@@end*/

/*@@frPDU:MsgChannel1.CHASSIS::CPC_CHASSIS_R2_AR2:*/
on frPDU MsgChannel1.CHASSIS::CPC_CHASSIS_R2_AR2
{
	if (@sysvar::CH_NM::CH__NMAppl_CPC != 2) @sysvar::CH_NM::CH__NMAppl_CPC = 2;
	settimer(Timer_CH__NMAppl_CPC, 1100);
	if (@sysvar::CH_NM::CH__NMNm_CPC == 2)
	{
		if (@sysvar::CH_NM::CH__NMStat_CPC != 3) @sysvar::CH_NM::CH__NMStat_CPC = 3;
	}
	else
	{
		if (@sysvar::CH_NM::CH__NMStat_CPC != 4) @sysvar::CH_NM::CH__NMStat_CPC = 4;
	}
	output(this);
}
/*@@end*/

/*@@frPDU:MsgChannel1.CHASSIS::DCDC1_Rs1_AR2:*/
on frPDU MsgChannel1.CHASSIS::DCDC1_Rs1_AR2
{
	if (@sysvar::CH_NM::CH__NMAppl_CPC != 2) @sysvar::CH_NM::CH__NMAppl_CPC = 2;
	settimer(Timer_CH__NMAppl_CPC, 1100);
	if (@sysvar::CH_NM::CH__NMNm_CPC == 2)
	{
		if (@sysvar::CH_NM::CH__NMStat_CPC != 3) @sysvar::CH_NM::CH__NMStat_CPC = 3;
	}
	else
	{
		if (@sysvar::CH_NM::CH__NMStat_CPC != 4) @sysvar::CH_NM::CH__NMStat_CPC = 4;
	}
	output(this);
}
/*@@end*/

/*@@frPDU:MsgChannel1.CHASSIS::DPC_PT_Rs_AR:*/
on frPDU MsgChannel1.CHASSIS::DPC_PT_Rs_AR
{
	if (@sysvar::CH_NM::CH__NMAppl_CPC != 2) @sysvar::CH_NM::CH__NMAppl_CPC = 2;
	settimer(Timer_CH__NMAppl_CPC, 1100);
	if (@sysvar::CH_NM::CH__NMNm_CPC == 2)
	{
		if (@sysvar::CH_NM::CH__NMStat_CPC != 3) @sysvar::CH_NM::CH__NMStat_CPC = 3;
	}
	else
	{
		if (@sysvar::CH_NM::CH__NMStat_CPC != 4) @sysvar::CH_NM::CH__NMStat_CPC = 4;
	}
	output(this);
}
/*@@end*/

/*@@frPDU:MsgChannel1.CHASSIS::ECM_DAC4_AR:*/
on frPDU MsgChannel1.CHASSIS::ECM_DAC4_AR
{
	if (@sysvar::CH_NM::CH__NMAppl_CPC != 2) @sysvar::CH_NM::CH__NMAppl_CPC = 2;
	settimer(Timer_CH__NMAppl_CPC, 1100);
	if (@sysvar::CH_NM::CH__NMNm_CPC == 2)
	{
		if (@sysvar::CH_NM::CH__NMStat_CPC != 3) @sysvar::CH_NM::CH__NMStat_CPC = 3;
	}
	else
	{
		if (@sysvar::CH_NM::CH__NMStat_CPC != 4) @sysvar::CH_NM::CH__NMStat_CPC = 4;
	}
	output(this);
}
/*@@end*/

/*@@frPDU:MsgChannel1.CHASSIS::ECO_Homepage_Data:*/
on frPDU MsgChannel1.CHASSIS::ECO_Homepage_Data
{
	if (@sysvar::CH_NM::CH__NMAppl_CPC != 2) @sysvar::CH_NM::CH__NMAppl_CPC = 2;
	settimer(Timer_CH__NMAppl_CPC, 1100);
	if (@sysvar::CH_NM::CH__NMNm_CPC == 2)
	{
		if (@sysvar::CH_NM::CH__NMStat_CPC != 3) @sysvar::CH_NM::CH__NMStat_CPC = 3;
	}
	else
	{
		if (@sysvar::CH_NM::CH__NMStat_CPC != 4) @sysvar::CH_NM::CH__NMStat_CPC = 4;
	}
	output(this);
}
/*@@end*/

/*@@frPDU:MsgChannel1.CHASSIS::ECO_Score_Disp_Rq_AR:*/
on frPDU MsgChannel1.CHASSIS::ECO_Score_Disp_Rq_AR
{
	if (@sysvar::CH_NM::CH__NMAppl_CPC != 2) @sysvar::CH_NM::CH__NMAppl_CPC = 2;
	settimer(Timer_CH__NMAppl_CPC, 1100);
	if (@sysvar::CH_NM::CH__NMNm_CPC == 2)
	{
		if (@sysvar::CH_NM::CH__NMStat_CPC != 3) @sysvar::CH_NM::CH__NMStat_CPC = 3;
	}
	else
	{
		if (@sysvar::CH_NM::CH__NMStat_CPC != 4) @sysvar::CH_NM::CH__NMStat_CPC = 4;
	}
	output(this);
}
/*@@end*/

/*@@frPDU:MsgChannel1.CHASSIS::EM01_Stat1_AR2:*/
on frPDU MsgChannel1.CHASSIS::EM01_Stat1_AR2
{
	if (@sysvar::CH_NM::CH__NMAppl_CPC != 2) @sysvar::CH_NM::CH__NMAppl_CPC = 2;
	settimer(Timer_CH__NMAppl_CPC, 1100);
	if (@sysvar::CH_NM::CH__NMNm_CPC == 2)
	{
		if (@sysvar::CH_NM::CH__NMStat_CPC != 3) @sysvar::CH_NM::CH__NMStat_CPC = 3;
	}
	else
	{
		if (@sysvar::CH_NM::CH__NMStat_CPC != 4) @sysvar::CH_NM::CH__NMStat_CPC = 4;
	}
	output(this);
}
/*@@end*/

/*@@frPDU:MsgChannel1.CHASSIS::EM01_Stat2_AR2:*/
on frPDU MsgChannel1.CHASSIS::EM01_Stat2_AR2
{
	if (@sysvar::CH_NM::CH__NMAppl_CPC != 2) @sysvar::CH_NM::CH__NMAppl_CPC = 2;
	settimer(Timer_CH__NMAppl_CPC, 1100);
	if (@sysvar::CH_NM::CH__NMNm_CPC == 2)
	{
		if (@sysvar::CH_NM::CH__NMStat_CPC != 3) @sysvar::CH_NM::CH__NMStat_CPC = 3;
	}
	else
	{
		if (@sysvar::CH_NM::CH__NMStat_CPC != 4) @sysvar::CH_NM::CH__NMStat_CPC = 4;
	}
	output(this);
}
/*@@end*/

/*@@frPDU:MsgChannel1.CHASSIS::EM01_Trq_Rs_AR2:*/
on frPDU MsgChannel1.CHASSIS::EM01_Trq_Rs_AR2
{
	if (@sysvar::CH_NM::CH__NMAppl_CPC != 2) @sysvar::CH_NM::CH__NMAppl_CPC = 2;
	settimer(Timer_CH__NMAppl_CPC, 1100);
	if (@sysvar::CH_NM::CH__NMNm_CPC == 2)
	{
		if (@sysvar::CH_NM::CH__NMStat_CPC != 3) @sysvar::CH_NM::CH__NMStat_CPC = 3;
	}
	else
	{
		if (@sysvar::CH_NM::CH__NMStat_CPC != 4) @sysvar::CH_NM::CH__NMStat_CPC = 4;
	}
	output(this);
}
/*@@end*/

/*@@frPDU:MsgChannel1.CHASSIS::EM_DAC4_AR:*/
on frPDU MsgChannel1.CHASSIS::EM_DAC4_AR
{
	if (@sysvar::CH_NM::CH__NMAppl_CPC != 2) @sysvar::CH_NM::CH__NMAppl_CPC = 2;
	settimer(Timer_CH__NMAppl_CPC, 1100);
	if (@sysvar::CH_NM::CH__NMNm_CPC == 2)
	{
		if (@sysvar::CH_NM::CH__NMStat_CPC != 3) @sysvar::CH_NM::CH__NMStat_CPC = 3;
	}
	else
	{
		if (@sysvar::CH_NM::CH__NMStat_CPC != 4) @sysvar::CH_NM::CH__NMStat_CPC = 4;
	}
	output(this);
}
/*@@end*/

/*@@frPDU:MsgChannel1.CHASSIS::EMM_Data1_AR2:*/
on frPDU MsgChannel1.CHASSIS::EMM_Data1_AR2
{
	if (@sysvar::CH_NM::CH__NMAppl_CPC != 2) @sysvar::CH_NM::CH__NMAppl_CPC = 2;
	settimer(Timer_CH__NMAppl_CPC, 1100);
	if (@sysvar::CH_NM::CH__NMNm_CPC == 2)
	{
		if (@sysvar::CH_NM::CH__NMStat_CPC != 3) @sysvar::CH_NM::CH__NMStat_CPC = 3;
	}
	else
	{
		if (@sysvar::CH_NM::CH__NMStat_CPC != 4) @sysvar::CH_NM::CH__NMStat_CPC = 4;
	}
	output(this);
}
/*@@end*/

/*@@frPDU:MsgChannel1.CHASSIS::EnergyMngmnt_PreCond_Stat_AR2:*/
on frPDU MsgChannel1.CHASSIS::EnergyMngmnt_PreCond_Stat_AR2
{
	if (@sysvar::CH_NM::CH__NMAppl_CPC != 2) @sysvar::CH_NM::CH__NMAppl_CPC = 2;
	settimer(Timer_CH__NMAppl_CPC, 1100);
	if (@sysvar::CH_NM::CH__NMNm_CPC == 2)
	{
		if (@sysvar::CH_NM::CH__NMStat_CPC != 3) @sysvar::CH_NM::CH__NMStat_CPC = 3;
	}
	else
	{
		if (@sysvar::CH_NM::CH__NMStat_CPC != 4) @sysvar::CH_NM::CH__NMStat_CPC = 4;
	}
	output(this);
}
/*@@end*/

/*@@frPDU:MsgChannel1.CHASSIS::Eng_Rs_1_AR2:*/
on frPDU MsgChannel1.CHASSIS::Eng_Rs_1_AR2
{
	if (@sysvar::CH_NM::CH__NMAppl_CPC != 2) @sysvar::CH_NM::CH__NMAppl_CPC = 2;
	settimer(Timer_CH__NMAppl_CPC, 1100);
	if (@sysvar::CH_NM::CH__NMNm_CPC == 2)
	{
		if (@sysvar::CH_NM::CH__NMStat_CPC != 3) @sysvar::CH_NM::CH__NMStat_CPC = 3;
	}
	else
	{
		if (@sysvar::CH_NM::CH__NMStat_CPC != 4) @sysvar::CH_NM::CH__NMStat_CPC = 4;
	}
	output(this);
}
/*@@end*/

/*@@frPDU:MsgChannel1.CHASSIS::Eng_Rs_2_AR2:*/
on frPDU MsgChannel1.CHASSIS::Eng_Rs_2_AR2
{
	if (@sysvar::CH_NM::CH__NMAppl_CPC != 2) @sysvar::CH_NM::CH__NMAppl_CPC = 2;
	settimer(Timer_CH__NMAppl_CPC, 1100);
	if (@sysvar::CH_NM::CH__NMNm_CPC == 2)
	{
		if (@sysvar::CH_NM::CH__NMStat_CPC != 3) @sysvar::CH_NM::CH__NMStat_CPC = 3;
	}
	else
	{
		if (@sysvar::CH_NM::CH__NMStat_CPC != 4) @sysvar::CH_NM::CH__NMStat_CPC = 4;
	}
	output(this);
}
/*@@end*/

/*@@frPDU:MsgChannel1.CHASSIS::Eng_Rs_3_AR2:*/
on frPDU MsgChannel1.CHASSIS::Eng_Rs_3_AR2
{
	if (@sysvar::CH_NM::CH__NMAppl_CPC != 2) @sysvar::CH_NM::CH__NMAppl_CPC = 2;
	settimer(Timer_CH__NMAppl_CPC, 1100);
	if (@sysvar::CH_NM::CH__NMNm_CPC == 2)
	{
		if (@sysvar::CH_NM::CH__NMStat_CPC != 3) @sysvar::CH_NM::CH__NMStat_CPC = 3;
	}
	else
	{
		if (@sysvar::CH_NM::CH__NMStat_CPC != 4) @sysvar::CH_NM::CH__NMStat_CPC = 4;
	}
	output(this);
}
/*@@end*/

/*@@frPDU:MsgChannel1.CHASSIS::Eng_Rs_EM_AR2:*/
on frPDU MsgChannel1.CHASSIS::Eng_Rs_EM_AR2
{
	if (@sysvar::CH_NM::CH__NMAppl_CPC != 2) @sysvar::CH_NM::CH__NMAppl_CPC = 2;
	settimer(Timer_CH__NMAppl_CPC, 1100);
	if (@sysvar::CH_NM::CH__NMNm_CPC == 2)
	{
		if (@sysvar::CH_NM::CH__NMStat_CPC != 3) @sysvar::CH_NM::CH__NMStat_CPC = 3;
	}
	else
	{
		if (@sysvar::CH_NM::CH__NMStat_CPC != 4) @sysvar::CH_NM::CH__NMStat_CPC = 4;
	}
	output(this);
}
/*@@end*/

/*@@frPDU:MsgChannel1.CHASSIS::Eng_Rs_EngCtrl_AR2:*/
on frPDU MsgChannel1.CHASSIS::Eng_Rs_EngCtrl_AR2
{
	if (@sysvar::CH_NM::CH__NMAppl_CPC != 2) @sysvar::CH_NM::CH__NMAppl_CPC = 2;
	settimer(Timer_CH__NMAppl_CPC, 1100);
	if (@sysvar::CH_NM::CH__NMNm_CPC == 2)
	{
		if (@sysvar::CH_NM::CH__NMStat_CPC != 3) @sysvar::CH_NM::CH__NMStat_CPC = 3;
	}
	else
	{
		if (@sysvar::CH_NM::CH__NMStat_CPC != 4) @sysvar::CH_NM::CH__NMStat_CPC = 4;
	}
	output(this);
}
/*@@end*/

/*@@frPDU:MsgChannel1.CHASSIS::EngCtrl_Disp_Rq_AR2:*/
on frPDU MsgChannel1.CHASSIS::EngCtrl_Disp_Rq_AR2
{
	if (@sysvar::CH_NM::CH__NMAppl_CPC != 2) @sysvar::CH_NM::CH__NMAppl_CPC = 2;
	settimer(Timer_CH__NMAppl_CPC, 1100);
	if (@sysvar::CH_NM::CH__NMNm_CPC == 2)
	{
		if (@sysvar::CH_NM::CH__NMStat_CPC != 3) @sysvar::CH_NM::CH__NMStat_CPC = 3;
	}
	else
	{
		if (@sysvar::CH_NM::CH__NMStat_CPC != 4) @sysvar::CH_NM::CH__NMStat_CPC = 4;
	}
	output(this);
}
/*@@end*/

/*@@frPDU:MsgChannel1.CHASSIS::EngCtrl_OBD1_AR:*/
on frPDU MsgChannel1.CHASSIS::EngCtrl_OBD1_AR
{
	if (@sysvar::CH_NM::CH__NMAppl_CPC != 2) @sysvar::CH_NM::CH__NMAppl_CPC = 2;
	settimer(Timer_CH__NMAppl_CPC, 1100);
	if (@sysvar::CH_NM::CH__NMNm_CPC == 2)
	{
		if (@sysvar::CH_NM::CH__NMStat_CPC != 3) @sysvar::CH_NM::CH__NMStat_CPC = 3;
	}
	else
	{
		if (@sysvar::CH_NM::CH__NMStat_CPC != 4) @sysvar::CH_NM::CH__NMStat_CPC = 4;
	}
	output(this);
}
/*@@end*/

/*@@frPDU:MsgChannel1.CHASSIS::EngCtrl_Stat_AR2:*/
on frPDU MsgChannel1.CHASSIS::EngCtrl_Stat_AR2
{
	if (@sysvar::CH_NM::CH__NMAppl_CPC != 2) @sysvar::CH_NM::CH__NMAppl_CPC = 2;
	settimer(Timer_CH__NMAppl_CPC, 1100);
	if (@sysvar::CH_NM::CH__NMNm_CPC == 2)
	{
		if (@sysvar::CH_NM::CH__NMStat_CPC != 3) @sysvar::CH_NM::CH__NMStat_CPC = 3;
	}
	else
	{
		if (@sysvar::CH_NM::CH__NMStat_CPC != 4) @sysvar::CH_NM::CH__NMStat_CPC = 4;
	}
	output(this);
}
/*@@end*/

/*@@frPDU:MsgChannel1.CHASSIS::ESP_OBD_Data_AR:*/
on frPDU MsgChannel1.CHASSIS::ESP_OBD_Data_AR
{
	if (@sysvar::CH_NM::CH__NMAppl_CPC != 2) @sysvar::CH_NM::CH__NMAppl_CPC = 2;
	settimer(Timer_CH__NMAppl_CPC, 1100);
	if (@sysvar::CH_NM::CH__NMNm_CPC == 2)
	{
		if (@sysvar::CH_NM::CH__NMStat_CPC != 3) @sysvar::CH_NM::CH__NMStat_CPC = 3;
	}
	else
	{
		if (@sysvar::CH_NM::CH__NMStat_CPC != 4) @sysvar::CH_NM::CH__NMStat_CPC = 4;
	}
	output(this);
}
/*@@end*/

/*@@frPDU:MsgChannel1.CHASSIS::Fuel_Stat2_AR2:*/
on frPDU MsgChannel1.CHASSIS::Fuel_Stat2_AR2
{
	if (@sysvar::CH_NM::CH__NMAppl_CPC != 2) @sysvar::CH_NM::CH__NMAppl_CPC = 2;
	settimer(Timer_CH__NMAppl_CPC, 1100);
	if (@sysvar::CH_NM::CH__NMNm_CPC == 2)
	{
		if (@sysvar::CH_NM::CH__NMStat_CPC != 3) @sysvar::CH_NM::CH__NMStat_CPC = 3;
	}
	else
	{
		if (@sysvar::CH_NM::CH__NMStat_CPC != 4) @sysvar::CH_NM::CH__NMStat_CPC = 4;
	}
	output(this);
}
/*@@end*/

/*@@frPDU:MsgChannel1.CHASSIS::FuelLvl_Stat_AR2:*/
on frPDU MsgChannel1.CHASSIS::FuelLvl_Stat_AR2
{
	if (@sysvar::CH_NM::CH__NMAppl_CPC != 2) @sysvar::CH_NM::CH__NMAppl_CPC = 2;
	settimer(Timer_CH__NMAppl_CPC, 1100);
	if (@sysvar::CH_NM::CH__NMNm_CPC == 2)
	{
		if (@sysvar::CH_NM::CH__NMStat_CPC != 3) @sysvar::CH_NM::CH__NMStat_CPC = 3;
	}
	else
	{
		if (@sysvar::CH_NM::CH__NMStat_CPC != 4) @sysvar::CH_NM::CH__NMStat_CPC = 4;
	}
	output(this);
}
/*@@end*/

/*@@frPDU:MsgChannel1.CHASSIS::HumanMachineIfc_AR2:*/
on frPDU MsgChannel1.CHASSIS::HumanMachineIfc_AR2
{
	if (@sysvar::CH_NM::CH__NMAppl_CPC != 2) @sysvar::CH_NM::CH__NMAppl_CPC = 2;
	settimer(Timer_CH__NMAppl_CPC, 1100);
	if (@sysvar::CH_NM::CH__NMNm_CPC == 2)
	{
		if (@sysvar::CH_NM::CH__NMStat_CPC != 3) @sysvar::CH_NM::CH__NMStat_CPC = 3;
	}
	else
	{
		if (@sysvar::CH_NM::CH__NMStat_CPC != 4) @sysvar::CH_NM::CH__NMStat_CPC = 4;
	}
	output(this);
}
/*@@end*/

/*@@frPDU:MsgChannel1.CHASSIS::HumanMachineIfc_Rq_AR:*/
on frPDU MsgChannel1.CHASSIS::HumanMachineIfc_Rq_AR
{
	if (@sysvar::CH_NM::CH__NMAppl_CPC != 2) @sysvar::CH_NM::CH__NMAppl_CPC = 2;
	settimer(Timer_CH__NMAppl_CPC, 1100);
	if (@sysvar::CH_NM::CH__NMNm_CPC == 2)
	{
		if (@sysvar::CH_NM::CH__NMStat_CPC != 3) @sysvar::CH_NM::CH__NMStat_CPC = 3;
	}
	else
	{
		if (@sysvar::CH_NM::CH__NMStat_CPC != 4) @sysvar::CH_NM::CH__NMStat_CPC = 4;
	}
	output(this);
}
/*@@end*/

/*@@frPDU:MsgChannel1.CHASSIS::ISM_DAC4_AR:*/
on frPDU MsgChannel1.CHASSIS::ISM_DAC4_AR
{
	if (@sysvar::CH_NM::CH__NMAppl_CPC != 2) @sysvar::CH_NM::CH__NMAppl_CPC = 2;
	settimer(Timer_CH__NMAppl_CPC, 1100);
	if (@sysvar::CH_NM::CH__NMNm_CPC == 2)
	{
		if (@sysvar::CH_NM::CH__NMStat_CPC != 3) @sysvar::CH_NM::CH__NMStat_CPC = 3;
	}
	else
	{
		if (@sysvar::CH_NM::CH__NMStat_CPC != 4) @sysvar::CH_NM::CH__NMStat_CPC = 4;
	}
	output(this);
}
/*@@end*/

/*@@frPDU:MsgChannel1.CHASSIS::OBL_DC_Output_AR:*/
on frPDU MsgChannel1.CHASSIS::OBL_DC_Output_AR
{
	if (@sysvar::CH_NM::CH__NMAppl_CPC != 2) @sysvar::CH_NM::CH__NMAppl_CPC = 2;
	settimer(Timer_CH__NMAppl_CPC, 1100);
	if (@sysvar::CH_NM::CH__NMNm_CPC == 2)
	{
		if (@sysvar::CH_NM::CH__NMStat_CPC != 3) @sysvar::CH_NM::CH__NMStat_CPC = 3;
	}
	else
	{
		if (@sysvar::CH_NM::CH__NMStat_CPC != 4) @sysvar::CH_NM::CH__NMStat_CPC = 4;
	}
	output(this);
}
/*@@end*/

/*@@frPDU:MsgChannel1.CHASSIS::PARK_Drv_Rs_TCM_AR2:*/
on frPDU MsgChannel1.CHASSIS::PARK_Drv_Rs_TCM_AR2
{
	if (@sysvar::CH_NM::CH__NMAppl_CPC != 2) @sysvar::CH_NM::CH__NMAppl_CPC = 2;
	settimer(Timer_CH__NMAppl_CPC, 1100);
	if (@sysvar::CH_NM::CH__NMNm_CPC == 2)
	{
		if (@sysvar::CH_NM::CH__NMStat_CPC != 3) @sysvar::CH_NM::CH__NMStat_CPC = 3;
	}
	else
	{
		if (@sysvar::CH_NM::CH__NMStat_CPC != 4) @sysvar::CH_NM::CH__NMStat_CPC = 4;
	}
	output(this);
}
/*@@end*/

/*@@frPDU:MsgChannel1.CHASSIS::PN14_Gen_Rs_AR:*/
on frPDU MsgChannel1.CHASSIS::PN14_Gen_Rs_AR
{
	if (@sysvar::CH_NM::CH__NMAppl_CPC != 2) @sysvar::CH_NM::CH__NMAppl_CPC = 2;
	settimer(Timer_CH__NMAppl_CPC, 1100);
	if (@sysvar::CH_NM::CH__NMNm_CPC == 2)
	{
		if (@sysvar::CH_NM::CH__NMStat_CPC != 3) @sysvar::CH_NM::CH__NMStat_CPC = 3;
	}
	else
	{
		if (@sysvar::CH_NM::CH__NMStat_CPC != 4) @sysvar::CH_NM::CH__NMStat_CPC = 4;
	}
	output(this);
}
/*@@end*/

/*@@frPDU:MsgChannel1.CHASSIS::PNHV_BMS_Stat_AR2:*/
on frPDU MsgChannel1.CHASSIS::PNHV_BMS_Stat_AR2
{
	if (@sysvar::CH_NM::CH__NMAppl_CPC != 2) @sysvar::CH_NM::CH__NMAppl_CPC = 2;
	settimer(Timer_CH__NMAppl_CPC, 1100);
	if (@sysvar::CH_NM::CH__NMNm_CPC == 2)
	{
		if (@sysvar::CH_NM::CH__NMStat_CPC != 3) @sysvar::CH_NM::CH__NMStat_CPC = 3;
	}
	else
	{
		if (@sysvar::CH_NM::CH__NMStat_CPC != 4) @sysvar::CH_NM::CH__NMStat_CPC = 4;
	}
	output(this);
}
/*@@end*/

/*@@frPDU:MsgChannel1.CHASSIS::PNHV_EnergyMngmnt_Disp_Rq_AR:*/
on frPDU MsgChannel1.CHASSIS::PNHV_EnergyMngmnt_Disp_Rq_AR
{
	if (@sysvar::CH_NM::CH__NMAppl_CPC != 2) @sysvar::CH_NM::CH__NMAppl_CPC = 2;
	settimer(Timer_CH__NMAppl_CPC, 1100);
	if (@sysvar::CH_NM::CH__NMNm_CPC == 2)
	{
		if (@sysvar::CH_NM::CH__NMStat_CPC != 3) @sysvar::CH_NM::CH__NMStat_CPC = 3;
	}
	else
	{
		if (@sysvar::CH_NM::CH__NMStat_CPC != 4) @sysvar::CH_NM::CH__NMStat_CPC = 4;
	}
	output(this);
}
/*@@end*/

/*@@frPDU:MsgChannel1.CHASSIS::PNHV_EnergyMngmnt_Stat2_AR2:*/
on frPDU MsgChannel1.CHASSIS::PNHV_EnergyMngmnt_Stat2_AR2
{
	if (@sysvar::CH_NM::CH__NMAppl_CPC != 2) @sysvar::CH_NM::CH__NMAppl_CPC = 2;
	settimer(Timer_CH__NMAppl_CPC, 1100);
	if (@sysvar::CH_NM::CH__NMNm_CPC == 2)
	{
		if (@sysvar::CH_NM::CH__NMStat_CPC != 3) @sysvar::CH_NM::CH__NMStat_CPC = 3;
	}
	else
	{
		if (@sysvar::CH_NM::CH__NMStat_CPC != 4) @sysvar::CH_NM::CH__NMStat_CPC = 4;
	}
	output(this);
}
/*@@end*/

/*@@frPDU:MsgChannel1.CHASSIS::PNHV_EnergyMngmnt_Stat3_AR2:*/
on frPDU MsgChannel1.CHASSIS::PNHV_EnergyMngmnt_Stat3_AR2
{
	if (@sysvar::CH_NM::CH__NMAppl_CPC != 2) @sysvar::CH_NM::CH__NMAppl_CPC = 2;
	settimer(Timer_CH__NMAppl_CPC, 1100);
	if (@sysvar::CH_NM::CH__NMNm_CPC == 2)
	{
		if (@sysvar::CH_NM::CH__NMStat_CPC != 3) @sysvar::CH_NM::CH__NMStat_CPC = 3;
	}
	else
	{
		if (@sysvar::CH_NM::CH__NMStat_CPC != 4) @sysvar::CH_NM::CH__NMStat_CPC = 4;
	}
	output(this);
}
/*@@end*/

/*@@frPDU:MsgChannel1.CHASSIS::PNHV_EnergyMngmntSet_Rs1_AR2:*/
on frPDU MsgChannel1.CHASSIS::PNHV_EnergyMngmntSet_Rs1_AR2
{
	if (@sysvar::CH_NM::CH__NMAppl_CPC != 2) @sysvar::CH_NM::CH__NMAppl_CPC = 2;
	settimer(Timer_CH__NMAppl_CPC, 1100);
	if (@sysvar::CH_NM::CH__NMNm_CPC == 2)
	{
		if (@sysvar::CH_NM::CH__NMStat_CPC != 3) @sysvar::CH_NM::CH__NMStat_CPC = 3;
	}
	else
	{
		if (@sysvar::CH_NM::CH__NMStat_CPC != 4) @sysvar::CH_NM::CH__NMStat_CPC = 4;
	}
	output(this);
}
/*@@end*/

/*@@frPDU:MsgChannel1.CHASSIS::PNHV_EnergyMngmntSet_Rs2_AR:*/
on frPDU MsgChannel1.CHASSIS::PNHV_EnergyMngmntSet_Rs2_AR
{
	if (@sysvar::CH_NM::CH__NMAppl_CPC != 2) @sysvar::CH_NM::CH__NMAppl_CPC = 2;
	settimer(Timer_CH__NMAppl_CPC, 1100);
	if (@sysvar::CH_NM::CH__NMNm_CPC == 2)
	{
		if (@sysvar::CH_NM::CH__NMStat_CPC != 3) @sysvar::CH_NM::CH__NMStat_CPC = 3;
	}
	else
	{
		if (@sysvar::CH_NM::CH__NMStat_CPC != 4) @sysvar::CH_NM::CH__NMStat_CPC = 4;
	}
	output(this);
}
/*@@end*/

/*@@frPDU:MsgChannel1.CHASSIS::PNHV_Stat_AR2:*/
on frPDU MsgChannel1.CHASSIS::PNHV_Stat_AR2
{
	if (@sysvar::CH_NM::CH__NMAppl_CPC != 2) @sysvar::CH_NM::CH__NMAppl_CPC = 2;
	settimer(Timer_CH__NMAppl_CPC, 1100);
	if (@sysvar::CH_NM::CH__NMNm_CPC == 2)
	{
		if (@sysvar::CH_NM::CH__NMStat_CPC != 3) @sysvar::CH_NM::CH__NMStat_CPC = 3;
	}
	else
	{
		if (@sysvar::CH_NM::CH__NMStat_CPC != 4) @sysvar::CH_NM::CH__NMStat_CPC = 4;
	}
	output(this);
}
/*@@end*/

/*@@frPDU:MsgChannel1.CHASSIS::PNHV_WeekDepTmTbl_Stat_AR2:*/
on frPDU MsgChannel1.CHASSIS::PNHV_WeekDepTmTbl_Stat_AR2
{
	if (@sysvar::CH_NM::CH__NMAppl_CPC != 2) @sysvar::CH_NM::CH__NMAppl_CPC = 2;
	settimer(Timer_CH__NMAppl_CPC, 1100);
	if (@sysvar::CH_NM::CH__NMNm_CPC == 2)
	{
		if (@sysvar::CH_NM::CH__NMStat_CPC != 3) @sysvar::CH_NM::CH__NMStat_CPC = 3;
	}
	else
	{
		if (@sysvar::CH_NM::CH__NMStat_CPC != 4) @sysvar::CH_NM::CH__NMStat_CPC = 4;
	}
	output(this);
}
/*@@end*/

/*@@frPDU:MsgChannel1.CHASSIS::PT_DataContain_Rq_AR2:*/
on frPDU MsgChannel1.CHASSIS::PT_DataContain_Rq_AR2
{
	if (@sysvar::CH_NM::CH__NMAppl_CPC != 2) @sysvar::CH_NM::CH__NMAppl_CPC = 2;
	settimer(Timer_CH__NMAppl_CPC, 1100);
	if (@sysvar::CH_NM::CH__NMNm_CPC == 2)
	{
		if (@sysvar::CH_NM::CH__NMStat_CPC != 3) @sysvar::CH_NM::CH__NMStat_CPC = 3;
	}
	else
	{
		if (@sysvar::CH_NM::CH__NMStat_CPC != 4) @sysvar::CH_NM::CH__NMStat_CPC = 4;
	}
	output(this);
}
/*@@end*/

/*@@frPDU:MsgChannel1.CHASSIS::PT_Disp_Rq2_AR:*/
on frPDU MsgChannel1.CHASSIS::PT_Disp_Rq2_AR
{
	if (@sysvar::CH_NM::CH__NMAppl_CPC != 2) @sysvar::CH_NM::CH__NMAppl_CPC = 2;
	settimer(Timer_CH__NMAppl_CPC, 1100);
	if (@sysvar::CH_NM::CH__NMNm_CPC == 2)
	{
		if (@sysvar::CH_NM::CH__NMStat_CPC != 3) @sysvar::CH_NM::CH__NMStat_CPC = 3;
	}
	else
	{
		if (@sysvar::CH_NM::CH__NMStat_CPC != 4) @sysvar::CH_NM::CH__NMStat_CPC = 4;
	}
	output(this);
}
/*@@end*/

/*@@frPDU:MsgChannel1.CHASSIS::PT_ThermM_AR2:*/
on frPDU MsgChannel1.CHASSIS::PT_ThermM_AR2
{
	if (@sysvar::CH_NM::CH__NMAppl_CPC != 2) @sysvar::CH_NM::CH__NMAppl_CPC = 2;
	settimer(Timer_CH__NMAppl_CPC, 1100);
	if (@sysvar::CH_NM::CH__NMNm_CPC == 2)
	{
		if (@sysvar::CH_NM::CH__NMStat_CPC != 3) @sysvar::CH_NM::CH__NMStat_CPC = 3;
	}
	else
	{
		if (@sysvar::CH_NM::CH__NMStat_CPC != 4) @sysvar::CH_NM::CH__NMStat_CPC = 4;
	}
	output(this);
}
/*@@end*/

/*@@frPDU:MsgChannel1.CHASSIS::PT_ThermM_Rq_AR2:*/
on frPDU MsgChannel1.CHASSIS::PT_ThermM_Rq_AR2
{
	if (@sysvar::CH_NM::CH__NMAppl_CPC != 2) @sysvar::CH_NM::CH__NMAppl_CPC = 2;
	settimer(Timer_CH__NMAppl_CPC, 1100);
	if (@sysvar::CH_NM::CH__NMNm_CPC == 2)
	{
		if (@sysvar::CH_NM::CH__NMStat_CPC != 3) @sysvar::CH_NM::CH__NMStat_CPC = 3;
	}
	else
	{
		if (@sysvar::CH_NM::CH__NMStat_CPC != 4) @sysvar::CH_NM::CH__NMStat_CPC = 4;
	}
	output(this);
}
/*@@end*/

/*@@frPDU:MsgChannel1.CHASSIS::PtHyb_Mngmnt_Rq1_AR:*/
on frPDU MsgChannel1.CHASSIS::PtHyb_Mngmnt_Rq1_AR
{
	if (@sysvar::CH_NM::CH__NMAppl_CPC != 2) @sysvar::CH_NM::CH__NMAppl_CPC = 2;
	settimer(Timer_CH__NMAppl_CPC, 1100);
	if (@sysvar::CH_NM::CH__NMNm_CPC == 2)
	{
		if (@sysvar::CH_NM::CH__NMStat_CPC != 3) @sysvar::CH_NM::CH__NMStat_CPC = 3;
	}
	else
	{
		if (@sysvar::CH_NM::CH__NMStat_CPC != 4) @sysvar::CH_NM::CH__NMStat_CPC = 4;
	}
	output(this);
}
/*@@end*/

/*@@frPDU:MsgChannel1.CHASSIS::PtMngmnt_Disp_Rq_AR2:*/
on frPDU MsgChannel1.CHASSIS::PtMngmnt_Disp_Rq_AR2
{
	if (@sysvar::CH_NM::CH__NMAppl_CPC != 2) @sysvar::CH_NM::CH__NMAppl_CPC = 2;
	settimer(Timer_CH__NMAppl_CPC, 1100);
	if (@sysvar::CH_NM::CH__NMNm_CPC == 2)
	{
		if (@sysvar::CH_NM::CH__NMStat_CPC != 3) @sysvar::CH_NM::CH__NMStat_CPC = 3;
	}
	else
	{
		if (@sysvar::CH_NM::CH__NMStat_CPC != 4) @sysvar::CH_NM::CH__NMStat_CPC = 4;
	}
	output(this);
}
/*@@end*/

/*@@frPDU:MsgChannel1.CHASSIS::PtMngmnt_Rq_AR2:*/
on frPDU MsgChannel1.CHASSIS::PtMngmnt_Rq_AR2
{
	if (@sysvar::CH_NM::CH__NMAppl_CPC != 2) @sysvar::CH_NM::CH__NMAppl_CPC = 2;
	settimer(Timer_CH__NMAppl_CPC, 1100);
	if (@sysvar::CH_NM::CH__NMNm_CPC == 2)
	{
		if (@sysvar::CH_NM::CH__NMStat_CPC != 3) @sysvar::CH_NM::CH__NMStat_CPC = 3;
	}
	else
	{
		if (@sysvar::CH_NM::CH__NMStat_CPC != 4) @sysvar::CH_NM::CH__NMStat_CPC = 4;
	}
	output(this);
}
/*@@end*/

/*@@frPDU:MsgChannel1.CHASSIS::PtMngmnt_Stat2_AR2:*/
on frPDU MsgChannel1.CHASSIS::PtMngmnt_Stat2_AR2
{
	if (@sysvar::CH_NM::CH__NMAppl_CPC != 2) @sysvar::CH_NM::CH__NMAppl_CPC = 2;
	settimer(Timer_CH__NMAppl_CPC, 1100);
	if (@sysvar::CH_NM::CH__NMNm_CPC == 2)
	{
		if (@sysvar::CH_NM::CH__NMStat_CPC != 3) @sysvar::CH_NM::CH__NMStat_CPC = 3;
	}
	else
	{
		if (@sysvar::CH_NM::CH__NMStat_CPC != 4) @sysvar::CH_NM::CH__NMStat_CPC = 4;
	}
	output(this);
}
/*@@end*/

/*@@frPDU:MsgChannel1.CHASSIS::PtMngmnt_Stat_AR2:*/
on frPDU MsgChannel1.CHASSIS::PtMngmnt_Stat_AR2
{
	if (@sysvar::CH_NM::CH__NMAppl_CPC != 2) @sysvar::CH_NM::CH__NMAppl_CPC = 2;
	settimer(Timer_CH__NMAppl_CPC, 1100);
	if (@sysvar::CH_NM::CH__NMNm_CPC == 2)
	{
		if (@sysvar::CH_NM::CH__NMStat_CPC != 3) @sysvar::CH_NM::CH__NMStat_CPC = 3;
	}
	else
	{
		if (@sysvar::CH_NM::CH__NMStat_CPC != 4) @sysvar::CH_NM::CH__NMStat_CPC = 4;
	}
	output(this);
}
/*@@end*/

/*@@frPDU:MsgChannel1.CHASSIS::SBW_DrvPosn_Disp_Rq_ISM_AR2:*/
on frPDU MsgChannel1.CHASSIS::SBW_DrvPosn_Disp_Rq_ISM_AR2
{
	if (@sysvar::CH_NM::CH__NMAppl_CPC != 2) @sysvar::CH_NM::CH__NMAppl_CPC = 2;
	settimer(Timer_CH__NMAppl_CPC, 1100);
	if (@sysvar::CH_NM::CH__NMNm_CPC == 2)
	{
		if (@sysvar::CH_NM::CH__NMStat_CPC != 3) @sysvar::CH_NM::CH__NMStat_CPC = 3;
	}
	else
	{
		if (@sysvar::CH_NM::CH__NMStat_CPC != 4) @sysvar::CH_NM::CH__NMStat_CPC = 4;
	}
	output(this);
}
/*@@end*/

/*@@frPDU:MsgChannel1.CHASSIS::SBW_DrvPosn_Disp_Rq_TCM_AR2:*/
on frPDU MsgChannel1.CHASSIS::SBW_DrvPosn_Disp_Rq_TCM_AR2
{
	if (@sysvar::CH_NM::CH__NMAppl_CPC != 2) @sysvar::CH_NM::CH__NMAppl_CPC = 2;
	settimer(Timer_CH__NMAppl_CPC, 1100);
	if (@sysvar::CH_NM::CH__NMNm_CPC == 2)
	{
		if (@sysvar::CH_NM::CH__NMStat_CPC != 3) @sysvar::CH_NM::CH__NMStat_CPC = 3;
	}
	else
	{
		if (@sysvar::CH_NM::CH__NMStat_CPC != 4) @sysvar::CH_NM::CH__NMStat_CPC = 4;
	}
	output(this);
}
/*@@end*/

/*@@frPDU:MsgChannel1.CHASSIS::SBW_Stat_AR2:*/
on frPDU MsgChannel1.CHASSIS::SBW_Stat_AR2
{
	if (@sysvar::CH_NM::CH__NMAppl_CPC != 2) @sysvar::CH_NM::CH__NMAppl_CPC = 2;
	settimer(Timer_CH__NMAppl_CPC, 1100);
	if (@sysvar::CH_NM::CH__NMNm_CPC == 2)
	{
		if (@sysvar::CH_NM::CH__NMStat_CPC != 3) @sysvar::CH_NM::CH__NMStat_CPC = 3;
	}
	else
	{
		if (@sysvar::CH_NM::CH__NMStat_CPC != 4) @sysvar::CH_NM::CH__NMStat_CPC = 4;
	}
	output(this);
}
/*@@end*/

/*@@frPDU:MsgChannel1.CHASSIS::SND_GEN_Stat_AR:*/
on frPDU MsgChannel1.CHASSIS::SND_GEN_Stat_AR
{
	if (@sysvar::CH_NM::CH__NMAppl_CPC != 2) @sysvar::CH_NM::CH__NMAppl_CPC = 2;
	settimer(Timer_CH__NMAppl_CPC, 1100);
	if (@sysvar::CH_NM::CH__NMNm_CPC == 2)
	{
		if (@sysvar::CH_NM::CH__NMStat_CPC != 3) @sysvar::CH_NM::CH__NMStat_CPC = 3;
	}
	else
	{
		if (@sysvar::CH_NM::CH__NMStat_CPC != 4) @sysvar::CH_NM::CH__NMStat_CPC = 4;
	}
	output(this);
}
/*@@end*/

/*@@frPDU:MsgChannel1.CHASSIS::TC_Disp_Rq_ECM_AR:*/
on frPDU MsgChannel1.CHASSIS::TC_Disp_Rq_ECM_AR
{
	if (@sysvar::CH_NM::CH__NMAppl_CPC != 2) @sysvar::CH_NM::CH__NMAppl_CPC = 2;
	settimer(Timer_CH__NMAppl_CPC, 1100);
	if (@sysvar::CH_NM::CH__NMNm_CPC == 2)
	{
		if (@sysvar::CH_NM::CH__NMStat_CPC != 3) @sysvar::CH_NM::CH__NMStat_CPC = 3;
	}
	else
	{
		if (@sysvar::CH_NM::CH__NMStat_CPC != 4) @sysvar::CH_NM::CH__NMStat_CPC = 4;
	}
	output(this);
}
/*@@end*/

/*@@frPDU:MsgChannel1.CHASSIS::TC_EBBC_Disp_Rq_ECM_AR:*/
on frPDU MsgChannel1.CHASSIS::TC_EBBC_Disp_Rq_ECM_AR
{
	if (@sysvar::CH_NM::CH__NMAppl_CPC != 2) @sysvar::CH_NM::CH__NMAppl_CPC = 2;
	settimer(Timer_CH__NMAppl_CPC, 1100);
	if (@sysvar::CH_NM::CH__NMNm_CPC == 2)
	{
		if (@sysvar::CH_NM::CH__NMStat_CPC != 3) @sysvar::CH_NM::CH__NMStat_CPC = 3;
	}
	else
	{
		if (@sysvar::CH_NM::CH__NMStat_CPC != 4) @sysvar::CH_NM::CH__NMStat_CPC = 4;
	}
	output(this);
}
/*@@end*/

/*@@frPDU:MsgChannel1.CHASSIS::TC_EEBBC_Disp_Rq_AR:*/
on frPDU MsgChannel1.CHASSIS::TC_EEBBC_Disp_Rq_AR
{
	if (@sysvar::CH_NM::CH__NMAppl_CPC != 2) @sysvar::CH_NM::CH__NMAppl_CPC = 2;
	settimer(Timer_CH__NMAppl_CPC, 1100);
	if (@sysvar::CH_NM::CH__NMNm_CPC == 2)
	{
		if (@sysvar::CH_NM::CH__NMStat_CPC != 3) @sysvar::CH_NM::CH__NMStat_CPC = 3;
	}
	else
	{
		if (@sysvar::CH_NM::CH__NMStat_CPC != 4) @sysvar::CH_NM::CH__NMStat_CPC = 4;
	}
	output(this);
}
/*@@end*/

/*@@frPDU:MsgChannel1.CHASSIS::TCM_DAC4_AR:*/
on frPDU MsgChannel1.CHASSIS::TCM_DAC4_AR
{
	if (@sysvar::CH_NM::CH__NMAppl_CPC != 2) @sysvar::CH_NM::CH__NMAppl_CPC = 2;
	settimer(Timer_CH__NMAppl_CPC, 1100);
	if (@sysvar::CH_NM::CH__NMNm_CPC == 2)
	{
		if (@sysvar::CH_NM::CH__NMStat_CPC != 3) @sysvar::CH_NM::CH__NMStat_CPC = 3;
	}
	else
	{
		if (@sysvar::CH_NM::CH__NMStat_CPC != 4) @sysvar::CH_NM::CH__NMStat_CPC = 4;
	}
	output(this);
}
/*@@end*/

/*@@frPDU:MsgChannel1.CHASSIS::TCM_Data2_AR2:*/
on frPDU MsgChannel1.CHASSIS::TCM_Data2_AR2
{
	if (@sysvar::CH_NM::CH__NMAppl_CPC != 2) @sysvar::CH_NM::CH__NMAppl_CPC = 2;
	settimer(Timer_CH__NMAppl_CPC, 1100);
	if (@sysvar::CH_NM::CH__NMNm_CPC == 2)
	{
		if (@sysvar::CH_NM::CH__NMStat_CPC != 3) @sysvar::CH_NM::CH__NMStat_CPC = 3;
	}
	else
	{
		if (@sysvar::CH_NM::CH__NMStat_CPC != 4) @sysvar::CH_NM::CH__NMStat_CPC = 4;
	}
	output(this);
}
/*@@end*/

/*@@frPDU:MsgChannel1.CHASSIS::TCM_Data3_AR2:*/
on frPDU MsgChannel1.CHASSIS::TCM_Data3_AR2
{
	if (@sysvar::CH_NM::CH__NMAppl_CPC != 2) @sysvar::CH_NM::CH__NMAppl_CPC = 2;
	settimer(Timer_CH__NMAppl_CPC, 1100);
	if (@sysvar::CH_NM::CH__NMNm_CPC == 2)
	{
		if (@sysvar::CH_NM::CH__NMStat_CPC != 3) @sysvar::CH_NM::CH__NMStat_CPC = 3;
	}
	else
	{
		if (@sysvar::CH_NM::CH__NMStat_CPC != 4) @sysvar::CH_NM::CH__NMStat_CPC = 4;
	}
	output(this);
}
/*@@end*/

/*@@frPDU:MsgChannel1.CHASSIS::TCM_Disp_Rq_AMG_AR:*/
on frPDU MsgChannel1.CHASSIS::TCM_Disp_Rq_AMG_AR
{
	if (@sysvar::CH_NM::CH__NMAppl_CPC != 2) @sysvar::CH_NM::CH__NMAppl_CPC = 2;
	settimer(Timer_CH__NMAppl_CPC, 1100);
	if (@sysvar::CH_NM::CH__NMNm_CPC == 2)
	{
		if (@sysvar::CH_NM::CH__NMStat_CPC != 3) @sysvar::CH_NM::CH__NMStat_CPC = 3;
	}
	else
	{
		if (@sysvar::CH_NM::CH__NMStat_CPC != 4) @sysvar::CH_NM::CH__NMStat_CPC = 4;
	}
	output(this);
}
/*@@end*/

/*@@frPDU:MsgChannel1.CHASSIS::TCM_State3_AR2:*/
on frPDU MsgChannel1.CHASSIS::TCM_State3_AR2
{
	if (@sysvar::CH_NM::CH__NMAppl_CPC != 2) @sysvar::CH_NM::CH__NMAppl_CPC = 2;
	settimer(Timer_CH__NMAppl_CPC, 1100);
	if (@sysvar::CH_NM::CH__NMNm_CPC == 2)
	{
		if (@sysvar::CH_NM::CH__NMStat_CPC != 3) @sysvar::CH_NM::CH__NMStat_CPC = 3;
	}
	else
	{
		if (@sysvar::CH_NM::CH__NMStat_CPC != 4) @sysvar::CH_NM::CH__NMStat_CPC = 4;
	}
	output(this);
}
/*@@end*/

/*@@frPDU:MsgChannel1.CHASSIS::TCU_Disp_Rq_AR2:*/
on frPDU MsgChannel1.CHASSIS::TCU_Disp_Rq_AR2
{
	if (@sysvar::CH_NM::CH__NMAppl_CPC != 2) @sysvar::CH_NM::CH__NMAppl_CPC = 2;
	settimer(Timer_CH__NMAppl_CPC, 1100);
	if (@sysvar::CH_NM::CH__NMNm_CPC == 2)
	{
		if (@sysvar::CH_NM::CH__NMStat_CPC != 3) @sysvar::CH_NM::CH__NMStat_CPC = 3;
	}
	else
	{
		if (@sysvar::CH_NM::CH__NMStat_CPC != 4) @sysvar::CH_NM::CH__NMStat_CPC = 4;
	}
	output(this);
}
/*@@end*/

/*@@frPDU:MsgChannel1.CHASSIS::ThermMngmnt_1_AR2:*/
on frPDU MsgChannel1.CHASSIS::ThermMngmnt_1_AR2
{
	if (@sysvar::CH_NM::CH__NMAppl_CPC != 2) @sysvar::CH_NM::CH__NMAppl_CPC = 2;
	settimer(Timer_CH__NMAppl_CPC, 1100);
	if (@sysvar::CH_NM::CH__NMNm_CPC == 2)
	{
		if (@sysvar::CH_NM::CH__NMStat_CPC != 3) @sysvar::CH_NM::CH__NMStat_CPC = 3;
	}
	else
	{
		if (@sysvar::CH_NM::CH__NMStat_CPC != 4) @sysvar::CH_NM::CH__NMStat_CPC = 4;
	}
	output(this);
}
/*@@end*/

/*@@frPDU:MsgChannel1.CHASSIS::ThermMngmnt_4_AR:*/
on frPDU MsgChannel1.CHASSIS::ThermMngmnt_4_AR
{
	if (@sysvar::CH_NM::CH__NMAppl_CPC != 2) @sysvar::CH_NM::CH__NMAppl_CPC = 2;
	settimer(Timer_CH__NMAppl_CPC, 1100);
	if (@sysvar::CH_NM::CH__NMNm_CPC == 2)
	{
		if (@sysvar::CH_NM::CH__NMStat_CPC != 3) @sysvar::CH_NM::CH__NMStat_CPC = 3;
	}
	else
	{
		if (@sysvar::CH_NM::CH__NMStat_CPC != 4) @sysvar::CH_NM::CH__NMStat_CPC = 4;
	}
	output(this);
}
/*@@end*/

/*@@frPDU:MsgChannel1.CHASSIS::ThermMngmnt_EV_1_AR2:*/
on frPDU MsgChannel1.CHASSIS::ThermMngmnt_EV_1_AR2
{
	if (@sysvar::CH_NM::CH__NMAppl_CPC != 2) @sysvar::CH_NM::CH__NMAppl_CPC = 2;
	settimer(Timer_CH__NMAppl_CPC, 1100);
	if (@sysvar::CH_NM::CH__NMNm_CPC == 2)
	{
		if (@sysvar::CH_NM::CH__NMStat_CPC != 3) @sysvar::CH_NM::CH__NMStat_CPC = 3;
	}
	else
	{
		if (@sysvar::CH_NM::CH__NMStat_CPC != 4) @sysvar::CH_NM::CH__NMStat_CPC = 4;
	}
	output(this);
}
/*@@end*/

/*@@frPDU:MsgChannel1.CHASSIS::VehPwrMngmnt_EMM_Stat2_AR2:*/
on frPDU MsgChannel1.CHASSIS::VehPwrMngmnt_EMM_Stat2_AR2
{
	if (@sysvar::CH_NM::CH__NMAppl_CPC != 2) @sysvar::CH_NM::CH__NMAppl_CPC = 2;
	settimer(Timer_CH__NMAppl_CPC, 1100);
	if (@sysvar::CH_NM::CH__NMNm_CPC == 2)
	{
		if (@sysvar::CH_NM::CH__NMStat_CPC != 3) @sysvar::CH_NM::CH__NMStat_CPC = 3;
	}
	else
	{
		if (@sysvar::CH_NM::CH__NMStat_CPC != 4) @sysvar::CH_NM::CH__NMStat_CPC = 4;
	}
	output(this);
}
/*@@end*/

/*@@frPDU:MsgChannel1.CHASSIS::VehPwrMngmnt_Rq_AR:*/
on frPDU MsgChannel1.CHASSIS::VehPwrMngmnt_Rq_AR
{
	if (@sysvar::CH_NM::CH__NMAppl_CPC != 2) @sysvar::CH_NM::CH__NMAppl_CPC = 2;
	settimer(Timer_CH__NMAppl_CPC, 1100);
	if (@sysvar::CH_NM::CH__NMNm_CPC == 2)
	{
		if (@sysvar::CH_NM::CH__NMStat_CPC != 3) @sysvar::CH_NM::CH__NMStat_CPC = 3;
	}
	else
	{
		if (@sysvar::CH_NM::CH__NMStat_CPC != 4) @sysvar::CH_NM::CH__NMStat_CPC = 4;
	}
	output(this);
}
/*@@end*/

/*@@frPDU:MsgChannel1.CHASSIS::WIA_EngTrq_AR:*/
on frPDU MsgChannel1.CHASSIS::WIA_EngTrq_AR
{
	if (@sysvar::CH_NM::CH__NMAppl_CPC != 2) @sysvar::CH_NM::CH__NMAppl_CPC = 2;
	settimer(Timer_CH__NMAppl_CPC, 1100);
	if (@sysvar::CH_NM::CH__NMNm_CPC == 2)
	{
		if (@sysvar::CH_NM::CH__NMStat_CPC != 3) @sysvar::CH_NM::CH__NMStat_CPC = 3;
	}
	else
	{
		if (@sysvar::CH_NM::CH__NMStat_CPC != 4) @sysvar::CH_NM::CH__NMStat_CPC = 4;
	}
	output(this);
}
/*@@end*/

/*@@frPDU:MsgChannel1.CHASSIS::WPT_Stat2_AR2:*/
on frPDU MsgChannel1.CHASSIS::WPT_Stat2_AR2
{
	if (@sysvar::CH_NM::CH__NMAppl_CPC != 2) @sysvar::CH_NM::CH__NMAppl_CPC = 2;
	settimer(Timer_CH__NMAppl_CPC, 1100);
	if (@sysvar::CH_NM::CH__NMNm_CPC == 2)
	{
		if (@sysvar::CH_NM::CH__NMStat_CPC != 3) @sysvar::CH_NM::CH__NMStat_CPC = 3;
	}
	else
	{
		if (@sysvar::CH_NM::CH__NMStat_CPC != 4) @sysvar::CH_NM::CH__NMStat_CPC = 4;
	}
	output(this);
}
/*@@end*/

/*@@frPDU:MsgChannel1.CHASSIS::DPC_Disp_Rq_AMG_AR2:*/
on frPDU MsgChannel1.CHASSIS::DPC_Disp_Rq_AMG_AR2
{
	if (@sysvar::CH_NM::CH__NMAppl_DRVU != 2) @sysvar::CH_NM::CH__NMAppl_DRVU = 2;
	settimer(Timer_CH__NMAppl_DRVU, 1100);
	if (@sysvar::CH_NM::CH__NMNm_DRVU == 2)
	{
		if (@sysvar::CH_NM::CH__NMStat_DRVU != 3) @sysvar::CH_NM::CH__NMStat_DRVU = 3;
	}
	else
	{
		if (@sysvar::CH_NM::CH__NMStat_DRVU != 4) @sysvar::CH_NM::CH__NMStat_DRVU = 4;
	}
	output(this);
}
/*@@end*/

/*@@frPDU:MsgChannel1.CHASSIS::DPC_IndMd_Stat_AMG_AR2:*/
on frPDU MsgChannel1.CHASSIS::DPC_IndMd_Stat_AMG_AR2
{
	if (@sysvar::CH_NM::CH__NMAppl_DRVU != 2) @sysvar::CH_NM::CH__NMAppl_DRVU = 2;
	settimer(Timer_CH__NMAppl_DRVU, 1100);
	if (@sysvar::CH_NM::CH__NMNm_DRVU == 2)
	{
		if (@sysvar::CH_NM::CH__NMStat_DRVU != 3) @sysvar::CH_NM::CH__NMStat_DRVU = 3;
	}
	else
	{
		if (@sysvar::CH_NM::CH__NMStat_DRVU != 4) @sysvar::CH_NM::CH__NMStat_DRVU = 4;
	}
	output(this);
}
/*@@end*/

/*@@frPDU:MsgChannel1.CHASSIS::DPC_IndMd_Style2_AMG_AR2:*/
on frPDU MsgChannel1.CHASSIS::DPC_IndMd_Style2_AMG_AR2
{
	if (@sysvar::CH_NM::CH__NMAppl_DRVU != 2) @sysvar::CH_NM::CH__NMAppl_DRVU = 2;
	settimer(Timer_CH__NMAppl_DRVU, 1100);
	if (@sysvar::CH_NM::CH__NMNm_DRVU == 2)
	{
		if (@sysvar::CH_NM::CH__NMStat_DRVU != 3) @sysvar::CH_NM::CH__NMStat_DRVU = 3;
	}
	else
	{
		if (@sysvar::CH_NM::CH__NMStat_DRVU != 4) @sysvar::CH_NM::CH__NMStat_DRVU = 4;
	}
	output(this);
}
/*@@end*/

/*@@frPDU:MsgChannel1.CHASSIS::DPC_IndMd_Style_AMG_AR2:*/
on frPDU MsgChannel1.CHASSIS::DPC_IndMd_Style_AMG_AR2
{
	if (@sysvar::CH_NM::CH__NMAppl_DRVU != 2) @sysvar::CH_NM::CH__NMAppl_DRVU = 2;
	settimer(Timer_CH__NMAppl_DRVU, 1100);
	if (@sysvar::CH_NM::CH__NMNm_DRVU == 2)
	{
		if (@sysvar::CH_NM::CH__NMStat_DRVU != 3) @sysvar::CH_NM::CH__NMStat_DRVU = 3;
	}
	else
	{
		if (@sysvar::CH_NM::CH__NMStat_DRVU != 4) @sysvar::CH_NM::CH__NMStat_DRVU = 4;
	}
	output(this);
}
/*@@end*/

/*@@frPDU:MsgChannel1.CHASSIS::DPC_Master_Rq_AMG_AR2:*/
on frPDU MsgChannel1.CHASSIS::DPC_Master_Rq_AMG_AR2
{
	if (@sysvar::CH_NM::CH__NMAppl_DRVU != 2) @sysvar::CH_NM::CH__NMAppl_DRVU = 2;
	settimer(Timer_CH__NMAppl_DRVU, 1100);
	if (@sysvar::CH_NM::CH__NMNm_DRVU == 2)
	{
		if (@sysvar::CH_NM::CH__NMStat_DRVU != 3) @sysvar::CH_NM::CH__NMStat_DRVU = 3;
	}
	else
	{
		if (@sysvar::CH_NM::CH__NMStat_DRVU != 4) @sysvar::CH_NM::CH__NMStat_DRVU = 4;
	}
	output(this);
}
/*@@end*/

/*@@frPDU:MsgChannel1.CHASSIS::DRVU_Stat_AR:*/
on frPDU MsgChannel1.CHASSIS::DRVU_Stat_AR
{
	if (@sysvar::CH_NM::CH__NMAppl_DRVU != 2) @sysvar::CH_NM::CH__NMAppl_DRVU = 2;
	settimer(Timer_CH__NMAppl_DRVU, 1100);
	if (@sysvar::CH_NM::CH__NMNm_DRVU == 2)
	{
		if (@sysvar::CH_NM::CH__NMStat_DRVU != 3) @sysvar::CH_NM::CH__NMStat_DRVU = 3;
	}
	else
	{
		if (@sysvar::CH_NM::CH__NMStat_DRVU != 4) @sysvar::CH_NM::CH__NMStat_DRVU = 4;
	}
	output(this);
}
/*@@end*/

/*@@frPDU:MsgChannel1.CHASSIS::ESP_EDIFF_Rs_AR:*/
on frPDU MsgChannel1.CHASSIS::ESP_EDIFF_Rs_AR
{
	if (@sysvar::CH_NM::CH__NMAppl_DRVU != 2) @sysvar::CH_NM::CH__NMAppl_DRVU = 2;
	settimer(Timer_CH__NMAppl_DRVU, 1100);
	if (@sysvar::CH_NM::CH__NMNm_DRVU == 2)
	{
		if (@sysvar::CH_NM::CH__NMStat_DRVU != 3) @sysvar::CH_NM::CH__NMStat_DRVU = 3;
	}
	else
	{
		if (@sysvar::CH_NM::CH__NMStat_DRVU != 4) @sysvar::CH_NM::CH__NMStat_DRVU = 4;
	}
	output(this);
}
/*@@end*/

/*@@frPDU:MsgChannel1.CHASSIS::ActvComf_Rq_AR2:*/
on frPDU MsgChannel1.CHASSIS::ActvComf_Rq_AR2
{
	if (@sysvar::CH_NM::CH__NMAppl_EIS != 2) @sysvar::CH_NM::CH__NMAppl_EIS = 2;
	settimer(Timer_CH__NMAppl_EIS, 1100);
	if (@sysvar::CH_NM::CH__NMNm_EIS == 2)
	{
		if (@sysvar::CH_NM::CH__NMStat_EIS != 3) @sysvar::CH_NM::CH__NMStat_EIS = 3;
	}
	else
	{
		if (@sysvar::CH_NM::CH__NMStat_EIS != 4) @sysvar::CH_NM::CH__NMStat_EIS = 4;
	}
	output(this);
}
/*@@end*/

/*@@frPDU:MsgChannel1.CHASSIS::ADAS_CURRENT_ATTRIBUTES_AR:*/
on frPDU MsgChannel1.CHASSIS::ADAS_CURRENT_ATTRIBUTES_AR
{
	if (@sysvar::CH_NM::CH__NMAppl_EIS != 2) @sysvar::CH_NM::CH__NMAppl_EIS = 2;
	settimer(Timer_CH__NMAppl_EIS, 1100);
	if (@sysvar::CH_NM::CH__NMNm_EIS == 2)
	{
		if (@sysvar::CH_NM::CH__NMStat_EIS != 3) @sysvar::CH_NM::CH__NMStat_EIS = 3;
	}
	else
	{
		if (@sysvar::CH_NM::CH__NMStat_EIS != 4) @sysvar::CH_NM::CH__NMStat_EIS = 4;
	}
	output(this);
}
/*@@end*/

/*@@frPDU:MsgChannel1.CHASSIS::ADAS_POSITION_AR:*/
on frPDU MsgChannel1.CHASSIS::ADAS_POSITION_AR
{
	if (@sysvar::CH_NM::CH__NMAppl_EIS != 2) @sysvar::CH_NM::CH__NMAppl_EIS = 2;
	settimer(Timer_CH__NMAppl_EIS, 1100);
	if (@sysvar::CH_NM::CH__NMNm_EIS == 2)
	{
		if (@sysvar::CH_NM::CH__NMStat_EIS != 3) @sysvar::CH_NM::CH__NMStat_EIS = 3;
	}
	else
	{
		if (@sysvar::CH_NM::CH__NMStat_EIS != 4) @sysvar::CH_NM::CH__NMStat_EIS = 4;
	}
	output(this);
}
/*@@end*/

/*@@frPDU:MsgChannel1.CHASSIS::ADAS_PREDICTION_AR:*/
on frPDU MsgChannel1.CHASSIS::ADAS_PREDICTION_AR
{
	if (@sysvar::CH_NM::CH__NMAppl_EIS != 2) @sysvar::CH_NM::CH__NMAppl_EIS = 2;
	settimer(Timer_CH__NMAppl_EIS, 1100);
	if (@sysvar::CH_NM::CH__NMNm_EIS == 2)
	{
		if (@sysvar::CH_NM::CH__NMStat_EIS != 3) @sysvar::CH_NM::CH__NMStat_EIS = 3;
	}
	else
	{
		if (@sysvar::CH_NM::CH__NMStat_EIS != 4) @sysvar::CH_NM::CH__NMStat_EIS = 4;
	}
	output(this);
}
/*@@end*/

/*@@frPDU:MsgChannel1.CHASSIS::ADAS_PROFILE_LONG_AR:*/
on frPDU MsgChannel1.CHASSIS::ADAS_PROFILE_LONG_AR
{
	if (@sysvar::CH_NM::CH__NMAppl_EIS != 2) @sysvar::CH_NM::CH__NMAppl_EIS = 2;
	settimer(Timer_CH__NMAppl_EIS, 1100);
	if (@sysvar::CH_NM::CH__NMNm_EIS == 2)
	{
		if (@sysvar::CH_NM::CH__NMStat_EIS != 3) @sysvar::CH_NM::CH__NMStat_EIS = 3;
	}
	else
	{
		if (@sysvar::CH_NM::CH__NMStat_EIS != 4) @sysvar::CH_NM::CH__NMStat_EIS = 4;
	}
	output(this);
}
/*@@end*/

/*@@frPDU:MsgChannel1.CHASSIS::ADAS_PROFILE_SHORT_AR:*/
on frPDU MsgChannel1.CHASSIS::ADAS_PROFILE_SHORT_AR
{
	if (@sysvar::CH_NM::CH__NMAppl_EIS != 2) @sysvar::CH_NM::CH__NMAppl_EIS = 2;
	settimer(Timer_CH__NMAppl_EIS, 1100);
	if (@sysvar::CH_NM::CH__NMNm_EIS == 2)
	{
		if (@sysvar::CH_NM::CH__NMStat_EIS != 3) @sysvar::CH_NM::CH__NMStat_EIS = 3;
	}
	else
	{
		if (@sysvar::CH_NM::CH__NMStat_EIS != 4) @sysvar::CH_NM::CH__NMStat_EIS = 4;
	}
	output(this);
}
/*@@end*/

/*@@frPDU:MsgChannel1.CHASSIS::ADASLR_POSITION_AR:*/
on frPDU MsgChannel1.CHASSIS::ADASLR_POSITION_AR
{
	if (@sysvar::CH_NM::CH__NMAppl_EIS != 2) @sysvar::CH_NM::CH__NMAppl_EIS = 2;
	settimer(Timer_CH__NMAppl_EIS, 1100);
	if (@sysvar::CH_NM::CH__NMNm_EIS == 2)
	{
		if (@sysvar::CH_NM::CH__NMStat_EIS != 3) @sysvar::CH_NM::CH__NMStat_EIS = 3;
	}
	else
	{
		if (@sysvar::CH_NM::CH__NMStat_EIS != 4) @sysvar::CH_NM::CH__NMStat_EIS = 4;
	}
	output(this);
}
/*@@end*/

/*@@frPDU:MsgChannel1.CHASSIS::ADASLR_PROFILE_LONG_AR:*/
on frPDU MsgChannel1.CHASSIS::ADASLR_PROFILE_LONG_AR
{
	if (@sysvar::CH_NM::CH__NMAppl_EIS != 2) @sysvar::CH_NM::CH__NMAppl_EIS = 2;
	settimer(Timer_CH__NMAppl_EIS, 1100);
	if (@sysvar::CH_NM::CH__NMNm_EIS == 2)
	{
		if (@sysvar::CH_NM::CH__NMStat_EIS != 3) @sysvar::CH_NM::CH__NMStat_EIS = 3;
	}
	else
	{
		if (@sysvar::CH_NM::CH__NMStat_EIS != 4) @sysvar::CH_NM::CH__NMStat_EIS = 4;
	}
	output(this);
}
/*@@end*/

/*@@frPDU:MsgChannel1.CHASSIS::Assyst_Rq_AR2:*/
on frPDU MsgChannel1.CHASSIS::Assyst_Rq_AR2
{
	if (@sysvar::CH_NM::CH__NMAppl_EIS != 2) @sysvar::CH_NM::CH__NMAppl_EIS = 2;
	settimer(Timer_CH__NMAppl_EIS, 1100);
	if (@sysvar::CH_NM::CH__NMNm_EIS == 2)
	{
		if (@sysvar::CH_NM::CH__NMStat_EIS != 3) @sysvar::CH_NM::CH__NMStat_EIS = 3;
	}
	else
	{
		if (@sysvar::CH_NM::CH__NMStat_EIS != 4) @sysvar::CH_NM::CH__NMStat_EIS = 4;
	}
	output(this);
}
/*@@end*/

/*@@frPDU:MsgChannel1.CHASSIS::BC_F_Disp_Rq_AR:*/
on frPDU MsgChannel1.CHASSIS::BC_F_Disp_Rq_AR
{
	if (@sysvar::CH_NM::CH__NMAppl_EIS != 2) @sysvar::CH_NM::CH__NMAppl_EIS = 2;
	settimer(Timer_CH__NMAppl_EIS, 1100);
	if (@sysvar::CH_NM::CH__NMNm_EIS == 2)
	{
		if (@sysvar::CH_NM::CH__NMStat_EIS != 3) @sysvar::CH_NM::CH__NMStat_EIS = 3;
	}
	else
	{
		if (@sysvar::CH_NM::CH__NMStat_EIS != 4) @sysvar::CH_NM::CH__NMStat_EIS = 4;
	}
	output(this);
}
/*@@end*/

/*@@frPDU:MsgChannel1.CHASSIS::BC_F_Stat1_AR:*/
on frPDU MsgChannel1.CHASSIS::BC_F_Stat1_AR
{
	if (@sysvar::CH_NM::CH__NMAppl_EIS != 2) @sysvar::CH_NM::CH__NMAppl_EIS = 2;
	settimer(Timer_CH__NMAppl_EIS, 1100);
	if (@sysvar::CH_NM::CH__NMNm_EIS == 2)
	{
		if (@sysvar::CH_NM::CH__NMStat_EIS != 3) @sysvar::CH_NM::CH__NMStat_EIS = 3;
	}
	else
	{
		if (@sysvar::CH_NM::CH__NMStat_EIS != 4) @sysvar::CH_NM::CH__NMStat_EIS = 4;
	}
	output(this);
}
/*@@end*/

/*@@frPDU:MsgChannel1.CHASSIS::BC_F_Stat2_AR2:*/
on frPDU MsgChannel1.CHASSIS::BC_F_Stat2_AR2
{
	if (@sysvar::CH_NM::CH__NMAppl_EIS != 2) @sysvar::CH_NM::CH__NMAppl_EIS = 2;
	settimer(Timer_CH__NMAppl_EIS, 1100);
	if (@sysvar::CH_NM::CH__NMNm_EIS == 2)
	{
		if (@sysvar::CH_NM::CH__NMStat_EIS != 3) @sysvar::CH_NM::CH__NMStat_EIS = 3;
	}
	else
	{
		if (@sysvar::CH_NM::CH__NMStat_EIS != 4) @sysvar::CH_NM::CH__NMStat_EIS = 4;
	}
	output(this);
}
/*@@end*/

/*@@frPDU:MsgChannel1.CHASSIS::BC_R_Stat1_AR:*/
on frPDU MsgChannel1.CHASSIS::BC_R_Stat1_AR
{
	if (@sysvar::CH_NM::CH__NMAppl_EIS != 2) @sysvar::CH_NM::CH__NMAppl_EIS = 2;
	settimer(Timer_CH__NMAppl_EIS, 1100);
	if (@sysvar::CH_NM::CH__NMNm_EIS == 2)
	{
		if (@sysvar::CH_NM::CH__NMStat_EIS != 3) @sysvar::CH_NM::CH__NMStat_EIS = 3;
	}
	else
	{
		if (@sysvar::CH_NM::CH__NMStat_EIS != 4) @sysvar::CH_NM::CH__NMStat_EIS = 4;
	}
	output(this);
}
/*@@end*/

/*@@frPDU:MsgChannel1.CHASSIS::BLSM_Disp_Stat_AR:*/
on frPDU MsgChannel1.CHASSIS::BLSM_Disp_Stat_AR
{
	if (@sysvar::CH_NM::CH__NMAppl_EIS != 2) @sysvar::CH_NM::CH__NMAppl_EIS = 2;
	settimer(Timer_CH__NMAppl_EIS, 1100);
	if (@sysvar::CH_NM::CH__NMNm_EIS == 2)
	{
		if (@sysvar::CH_NM::CH__NMStat_EIS != 3) @sysvar::CH_NM::CH__NMStat_EIS = 3;
	}
	else
	{
		if (@sysvar::CH_NM::CH__NMStat_EIS != 4) @sysvar::CH_NM::CH__NMStat_EIS = 4;
	}
	output(this);
}
/*@@end*/

/*@@frPDU:MsgChannel1.CHASSIS::BODY_CHASSIS_R1_AR:*/
on frPDU MsgChannel1.CHASSIS::BODY_CHASSIS_R1_AR
{
	if (@sysvar::CH_NM::CH__NMAppl_EIS != 2) @sysvar::CH_NM::CH__NMAppl_EIS = 2;
	settimer(Timer_CH__NMAppl_EIS, 1100);
	if (@sysvar::CH_NM::CH__NMNm_EIS == 2)
	{
		if (@sysvar::CH_NM::CH__NMStat_EIS != 3) @sysvar::CH_NM::CH__NMStat_EIS = 3;
	}
	else
	{
		if (@sysvar::CH_NM::CH__NMStat_EIS != 4) @sysvar::CH_NM::CH__NMStat_EIS = 4;
	}
	output(this);
}
/*@@end*/

/*@@frPDU:MsgChannel1.CHASSIS::BSM_Disp_Warn_Rq_AR2:*/
on frPDU MsgChannel1.CHASSIS::BSM_Disp_Warn_Rq_AR2
{
	if (@sysvar::CH_NM::CH__NMAppl_EIS != 2) @sysvar::CH_NM::CH__NMAppl_EIS = 2;
	settimer(Timer_CH__NMAppl_EIS, 1100);
	if (@sysvar::CH_NM::CH__NMNm_EIS == 2)
	{
		if (@sysvar::CH_NM::CH__NMStat_EIS != 3) @sysvar::CH_NM::CH__NMStat_EIS = 3;
	}
	else
	{
		if (@sysvar::CH_NM::CH__NMStat_EIS != 4) @sysvar::CH_NM::CH__NMStat_EIS = 4;
	}
	output(this);
}
/*@@end*/

/*@@frPDU:MsgChannel1.CHASSIS::CamLane_Disp_Warn_Rq_AR2:*/
on frPDU MsgChannel1.CHASSIS::CamLane_Disp_Warn_Rq_AR2
{
	if (@sysvar::CH_NM::CH__NMAppl_EIS != 2) @sysvar::CH_NM::CH__NMAppl_EIS = 2;
	settimer(Timer_CH__NMAppl_EIS, 1100);
	if (@sysvar::CH_NM::CH__NMNm_EIS == 2)
	{
		if (@sysvar::CH_NM::CH__NMStat_EIS != 3) @sysvar::CH_NM::CH__NMStat_EIS = 3;
	}
	else
	{
		if (@sysvar::CH_NM::CH__NMStat_EIS != 4) @sysvar::CH_NM::CH__NMStat_EIS = 4;
	}
	output(this);
}
/*@@end*/

/*@@frPDU:MsgChannel1.CHASSIS::CamLane_LaneAttr1_AR2:*/
on frPDU MsgChannel1.CHASSIS::CamLane_LaneAttr1_AR2
{
	if (@sysvar::CH_NM::CH__NMAppl_EIS != 2) @sysvar::CH_NM::CH__NMAppl_EIS = 2;
	settimer(Timer_CH__NMAppl_EIS, 1100);
	if (@sysvar::CH_NM::CH__NMNm_EIS == 2)
	{
		if (@sysvar::CH_NM::CH__NMStat_EIS != 3) @sysvar::CH_NM::CH__NMStat_EIS = 3;
	}
	else
	{
		if (@sysvar::CH_NM::CH__NMStat_EIS != 4) @sysvar::CH_NM::CH__NMStat_EIS = 4;
	}
	output(this);
}
/*@@end*/

/*@@frPDU:MsgChannel1.CHASSIS::CamLane_LaneAttr2_AR2:*/
on frPDU MsgChannel1.CHASSIS::CamLane_LaneAttr2_AR2
{
	if (@sysvar::CH_NM::CH__NMAppl_EIS != 2) @sysvar::CH_NM::CH__NMAppl_EIS = 2;
	settimer(Timer_CH__NMAppl_EIS, 1100);
	if (@sysvar::CH_NM::CH__NMNm_EIS == 2)
	{
		if (@sysvar::CH_NM::CH__NMStat_EIS != 3) @sysvar::CH_NM::CH__NMStat_EIS = 3;
	}
	else
	{
		if (@sysvar::CH_NM::CH__NMStat_EIS != 4) @sysvar::CH_NM::CH__NMStat_EIS = 4;
	}
	output(this);
}
/*@@end*/

/*@@frPDU:MsgChannel1.CHASSIS::CamLane_LaneAttr3_AR2:*/
on frPDU MsgChannel1.CHASSIS::CamLane_LaneAttr3_AR2
{
	if (@sysvar::CH_NM::CH__NMAppl_EIS != 2) @sysvar::CH_NM::CH__NMAppl_EIS = 2;
	settimer(Timer_CH__NMAppl_EIS, 1100);
	if (@sysvar::CH_NM::CH__NMNm_EIS == 2)
	{
		if (@sysvar::CH_NM::CH__NMStat_EIS != 3) @sysvar::CH_NM::CH__NMStat_EIS = 3;
	}
	else
	{
		if (@sysvar::CH_NM::CH__NMStat_EIS != 4) @sysvar::CH_NM::CH__NMStat_EIS = 4;
	}
	output(this);
}
/*@@end*/

/*@@frPDU:MsgChannel1.CHASSIS::CamLane_LaneAttr6_AR2:*/
on frPDU MsgChannel1.CHASSIS::CamLane_LaneAttr6_AR2
{
	if (@sysvar::CH_NM::CH__NMAppl_EIS != 2) @sysvar::CH_NM::CH__NMAppl_EIS = 2;
	settimer(Timer_CH__NMAppl_EIS, 1100);
	if (@sysvar::CH_NM::CH__NMNm_EIS == 2)
	{
		if (@sysvar::CH_NM::CH__NMStat_EIS != 3) @sysvar::CH_NM::CH__NMStat_EIS = 3;
	}
	else
	{
		if (@sysvar::CH_NM::CH__NMStat_EIS != 4) @sysvar::CH_NM::CH__NMStat_EIS = 4;
	}
	output(this);
}
/*@@end*/

/*@@frPDU:MsgChannel1.CHASSIS::CamLane_LaneAttr7_AR2:*/
on frPDU MsgChannel1.CHASSIS::CamLane_LaneAttr7_AR2
{
	if (@sysvar::CH_NM::CH__NMAppl_EIS != 2) @sysvar::CH_NM::CH__NMAppl_EIS = 2;
	settimer(Timer_CH__NMAppl_EIS, 1100);
	if (@sysvar::CH_NM::CH__NMNm_EIS == 2)
	{
		if (@sysvar::CH_NM::CH__NMStat_EIS != 3) @sysvar::CH_NM::CH__NMStat_EIS = 3;
	}
	else
	{
		if (@sysvar::CH_NM::CH__NMStat_EIS != 4) @sysvar::CH_NM::CH__NMStat_EIS = 4;
	}
	output(this);
}
/*@@end*/

/*@@frPDU:MsgChannel1.CHASSIS::CLkS_Rq_AR:*/
on frPDU MsgChannel1.CHASSIS::CLkS_Rq_AR
{
	if (@sysvar::CH_NM::CH__NMAppl_EIS != 2) @sysvar::CH_NM::CH__NMAppl_EIS = 2;
	settimer(Timer_CH__NMAppl_EIS, 1100);
	if (@sysvar::CH_NM::CH__NMNm_EIS == 2)
	{
		if (@sysvar::CH_NM::CH__NMStat_EIS != 3) @sysvar::CH_NM::CH__NMStat_EIS = 3;
	}
	else
	{
		if (@sysvar::CH_NM::CH__NMStat_EIS != 4) @sysvar::CH_NM::CH__NMStat_EIS = 4;
	}
	output(this);
}
/*@@end*/

/*@@frPDU:MsgChannel1.CHASSIS::CLkS_State_AR:*/
on frPDU MsgChannel1.CHASSIS::CLkS_State_AR
{
	if (@sysvar::CH_NM::CH__NMAppl_EIS != 2) @sysvar::CH_NM::CH__NMAppl_EIS = 2;
	settimer(Timer_CH__NMAppl_EIS, 1100);
	if (@sysvar::CH_NM::CH__NMNm_EIS == 2)
	{
		if (@sysvar::CH_NM::CH__NMStat_EIS != 3) @sysvar::CH_NM::CH__NMStat_EIS = 3;
	}
	else
	{
		if (@sysvar::CH_NM::CH__NMStat_EIS != 4) @sysvar::CH_NM::CH__NMStat_EIS = 4;
	}
	output(this);
}
/*@@end*/

/*@@frPDU:MsgChannel1.CHASSIS::ClockSync_Stat_FR2:*/
on frPDU MsgChannel1.CHASSIS::ClockSync_Stat_FR2
{
	if (@sysvar::CH_NM::CH__NMAppl_EIS != 2) @sysvar::CH_NM::CH__NMAppl_EIS = 2;
	settimer(Timer_CH__NMAppl_EIS, 1100);
	if (@sysvar::CH_NM::CH__NMNm_EIS == 2)
	{
		if (@sysvar::CH_NM::CH__NMStat_EIS != 3) @sysvar::CH_NM::CH__NMStat_EIS = 3;
	}
	else
	{
		if (@sysvar::CH_NM::CH__NMStat_EIS != 4) @sysvar::CH_NM::CH__NMStat_EIS = 4;
	}
	output(this);
}
/*@@end*/

/*@@frPDU:MsgChannel1.CHASSIS::CMS_PI_State_Gw_AR2:*/
on frPDU MsgChannel1.CHASSIS::CMS_PI_State_Gw_AR2
{
	if (@sysvar::CH_NM::CH__NMAppl_EIS != 2) @sysvar::CH_NM::CH__NMAppl_EIS = 2;
	settimer(Timer_CH__NMAppl_EIS, 1100);
	if (@sysvar::CH_NM::CH__NMNm_EIS == 2)
	{
		if (@sysvar::CH_NM::CH__NMStat_EIS != 3) @sysvar::CH_NM::CH__NMStat_EIS = 3;
	}
	else
	{
		if (@sysvar::CH_NM::CH__NMStat_EIS != 4) @sysvar::CH_NM::CH__NMStat_EIS = 4;
	}
	output(this);
}
/*@@end*/

/*@@frPDU:MsgChannel1.CHASSIS::Config_HU4_AR2:*/
on frPDU MsgChannel1.CHASSIS::Config_HU4_AR2
{
	if (@sysvar::CH_NM::CH__NMAppl_EIS != 2) @sysvar::CH_NM::CH__NMAppl_EIS = 2;
	settimer(Timer_CH__NMAppl_EIS, 1100);
	if (@sysvar::CH_NM::CH__NMNm_EIS == 2)
	{
		if (@sysvar::CH_NM::CH__NMStat_EIS != 3) @sysvar::CH_NM::CH__NMStat_EIS = 3;
	}
	else
	{
		if (@sysvar::CH_NM::CH__NMStat_EIS != 4) @sysvar::CH_NM::CH__NMStat_EIS = 4;
	}
	output(this);
}
/*@@end*/

/*@@frPDU:MsgChannel1.CHASSIS::Config_HU5_AR2:*/
on frPDU MsgChannel1.CHASSIS::Config_HU5_AR2
{
	if (@sysvar::CH_NM::CH__NMAppl_EIS != 2) @sysvar::CH_NM::CH__NMAppl_EIS = 2;
	settimer(Timer_CH__NMAppl_EIS, 1100);
	if (@sysvar::CH_NM::CH__NMNm_EIS == 2)
	{
		if (@sysvar::CH_NM::CH__NMStat_EIS != 3) @sysvar::CH_NM::CH__NMStat_EIS = 3;
	}
	else
	{
		if (@sysvar::CH_NM::CH__NMStat_EIS != 4) @sysvar::CH_NM::CH__NMStat_EIS = 4;
	}
	output(this);
}
/*@@end*/

/*@@frPDU:MsgChannel1.CHASSIS::CRCM_Stat_AR:*/
on frPDU MsgChannel1.CHASSIS::CRCM_Stat_AR
{
	if (@sysvar::CH_NM::CH__NMAppl_EIS != 2) @sysvar::CH_NM::CH__NMAppl_EIS = 2;
	settimer(Timer_CH__NMAppl_EIS, 1100);
	if (@sysvar::CH_NM::CH__NMNm_EIS == 2)
	{
		if (@sysvar::CH_NM::CH__NMStat_EIS != 3) @sysvar::CH_NM::CH__NMStat_EIS = 3;
	}
	else
	{
		if (@sysvar::CH_NM::CH__NMStat_EIS != 4) @sysvar::CH_NM::CH__NMStat_EIS = 4;
	}
	output(this);
}
/*@@end*/

/*@@frPDU:MsgChannel1.CHASSIS::CTRL_C_Stat1_AR:*/
on frPDU MsgChannel1.CHASSIS::CTRL_C_Stat1_AR
{
	if (@sysvar::CH_NM::CH__NMAppl_EIS != 2) @sysvar::CH_NM::CH__NMAppl_EIS = 2;
	settimer(Timer_CH__NMAppl_EIS, 1100);
	if (@sysvar::CH_NM::CH__NMNm_EIS == 2)
	{
		if (@sysvar::CH_NM::CH__NMStat_EIS != 3) @sysvar::CH_NM::CH__NMStat_EIS = 3;
	}
	else
	{
		if (@sysvar::CH_NM::CH__NMStat_EIS != 4) @sysvar::CH_NM::CH__NMStat_EIS = 4;
	}
	output(this);
}
/*@@end*/

/*@@frPDU:MsgChannel1.CHASSIS::DAC4_ECM_AR:*/
on frPDU MsgChannel1.CHASSIS::DAC4_ECM_AR
{
	if (@sysvar::CH_NM::CH__NMAppl_EIS != 2) @sysvar::CH_NM::CH__NMAppl_EIS = 2;
	settimer(Timer_CH__NMAppl_EIS, 1100);
	if (@sysvar::CH_NM::CH__NMNm_EIS == 2)
	{
		if (@sysvar::CH_NM::CH__NMStat_EIS != 3) @sysvar::CH_NM::CH__NMStat_EIS = 3;
	}
	else
	{
		if (@sysvar::CH_NM::CH__NMStat_EIS != 4) @sysvar::CH_NM::CH__NMStat_EIS = 4;
	}
	output(this);
}
/*@@end*/

/*@@frPDU:MsgChannel1.CHASSIS::DAC4_EM2_AR:*/
on frPDU MsgChannel1.CHASSIS::DAC4_EM2_AR
{
	if (@sysvar::CH_NM::CH__NMAppl_EIS != 2) @sysvar::CH_NM::CH__NMAppl_EIS = 2;
	settimer(Timer_CH__NMAppl_EIS, 1100);
	if (@sysvar::CH_NM::CH__NMNm_EIS == 2)
	{
		if (@sysvar::CH_NM::CH__NMStat_EIS != 3) @sysvar::CH_NM::CH__NMStat_EIS = 3;
	}
	else
	{
		if (@sysvar::CH_NM::CH__NMStat_EIS != 4) @sysvar::CH_NM::CH__NMStat_EIS = 4;
	}
	output(this);
}
/*@@end*/

/*@@frPDU:MsgChannel1.CHASSIS::DAC4_ISM_AR:*/
on frPDU MsgChannel1.CHASSIS::DAC4_ISM_AR
{
	if (@sysvar::CH_NM::CH__NMAppl_EIS != 2) @sysvar::CH_NM::CH__NMAppl_EIS = 2;
	settimer(Timer_CH__NMAppl_EIS, 1100);
	if (@sysvar::CH_NM::CH__NMNm_EIS == 2)
	{
		if (@sysvar::CH_NM::CH__NMStat_EIS != 3) @sysvar::CH_NM::CH__NMStat_EIS = 3;
	}
	else
	{
		if (@sysvar::CH_NM::CH__NMStat_EIS != 4) @sysvar::CH_NM::CH__NMStat_EIS = 4;
	}
	output(this);
}
/*@@end*/

/*@@frPDU:MsgChannel1.CHASSIS::DAC4_TCM_AR:*/
on frPDU MsgChannel1.CHASSIS::DAC4_TCM_AR
{
	if (@sysvar::CH_NM::CH__NMAppl_EIS != 2) @sysvar::CH_NM::CH__NMAppl_EIS = 2;
	settimer(Timer_CH__NMAppl_EIS, 1100);
	if (@sysvar::CH_NM::CH__NMNm_EIS == 2)
	{
		if (@sysvar::CH_NM::CH__NMStat_EIS != 3) @sysvar::CH_NM::CH__NMStat_EIS = 3;
	}
	else
	{
		if (@sysvar::CH_NM::CH__NMStat_EIS != 4) @sysvar::CH_NM::CH__NMStat_EIS = 4;
	}
	output(this);
}
/*@@end*/

/*@@frPDU:MsgChannel1.CHASSIS::Dimming_Stat_AR2:*/
on frPDU MsgChannel1.CHASSIS::Dimming_Stat_AR2
{
	if (@sysvar::CH_NM::CH__NMAppl_EIS != 2) @sysvar::CH_NM::CH__NMAppl_EIS = 2;
	settimer(Timer_CH__NMAppl_EIS, 1100);
	if (@sysvar::CH_NM::CH__NMNm_EIS == 2)
	{
		if (@sysvar::CH_NM::CH__NMStat_EIS != 3) @sysvar::CH_NM::CH__NMStat_EIS = 3;
	}
	else
	{
		if (@sysvar::CH_NM::CH__NMStat_EIS != 4) @sysvar::CH_NM::CH__NMStat_EIS = 4;
	}
	output(this);
}
/*@@end*/

/*@@frPDU:MsgChannel1.CHASSIS::Door_FL_Stat_AR2:*/
on frPDU MsgChannel1.CHASSIS::Door_FL_Stat_AR2
{
	if (@sysvar::CH_NM::CH__NMAppl_EIS != 2) @sysvar::CH_NM::CH__NMAppl_EIS = 2;
	settimer(Timer_CH__NMAppl_EIS, 1100);
	if (@sysvar::CH_NM::CH__NMNm_EIS == 2)
	{
		if (@sysvar::CH_NM::CH__NMStat_EIS != 3) @sysvar::CH_NM::CH__NMStat_EIS = 3;
	}
	else
	{
		if (@sysvar::CH_NM::CH__NMStat_EIS != 4) @sysvar::CH_NM::CH__NMStat_EIS = 4;
	}
	output(this);
}
/*@@end*/

/*@@frPDU:MsgChannel1.CHASSIS::Door_FR_Stat_AR2:*/
on frPDU MsgChannel1.CHASSIS::Door_FR_Stat_AR2
{
	if (@sysvar::CH_NM::CH__NMAppl_EIS != 2) @sysvar::CH_NM::CH__NMAppl_EIS = 2;
	settimer(Timer_CH__NMAppl_EIS, 1100);
	if (@sysvar::CH_NM::CH__NMNm_EIS == 2)
	{
		if (@sysvar::CH_NM::CH__NMStat_EIS != 3) @sysvar::CH_NM::CH__NMStat_EIS = 3;
	}
	else
	{
		if (@sysvar::CH_NM::CH__NMStat_EIS != 4) @sysvar::CH_NM::CH__NMStat_EIS = 4;
	}
	output(this);
}
/*@@end*/

/*@@frPDU:MsgChannel1.CHASSIS::Door_RL_Stat_AR2:*/
on frPDU MsgChannel1.CHASSIS::Door_RL_Stat_AR2
{
	if (@sysvar::CH_NM::CH__NMAppl_EIS != 2) @sysvar::CH_NM::CH__NMAppl_EIS = 2;
	settimer(Timer_CH__NMAppl_EIS, 1100);
	if (@sysvar::CH_NM::CH__NMNm_EIS == 2)
	{
		if (@sysvar::CH_NM::CH__NMStat_EIS != 3) @sysvar::CH_NM::CH__NMStat_EIS = 3;
	}
	else
	{
		if (@sysvar::CH_NM::CH__NMStat_EIS != 4) @sysvar::CH_NM::CH__NMStat_EIS = 4;
	}
	output(this);
}
/*@@end*/

/*@@frPDU:MsgChannel1.CHASSIS::Door_RR_Stat_AR2:*/
on frPDU MsgChannel1.CHASSIS::Door_RR_Stat_AR2
{
	if (@sysvar::CH_NM::CH__NMAppl_EIS != 2) @sysvar::CH_NM::CH__NMAppl_EIS = 2;
	settimer(Timer_CH__NMAppl_EIS, 1100);
	if (@sysvar::CH_NM::CH__NMNm_EIS == 2)
	{
		if (@sysvar::CH_NM::CH__NMStat_EIS != 3) @sysvar::CH_NM::CH__NMStat_EIS = 3;
	}
	else
	{
		if (@sysvar::CH_NM::CH__NMStat_EIS != 4) @sysvar::CH_NM::CH__NMStat_EIS = 4;
	}
	output(this);
}
/*@@end*/

/*@@frPDU:MsgChannel1.CHASSIS::DPC_IndMd_Rq_AR:*/
on frPDU MsgChannel1.CHASSIS::DPC_IndMd_Rq_AR
{
	if (@sysvar::CH_NM::CH__NMAppl_EIS != 2) @sysvar::CH_NM::CH__NMAppl_EIS = 2;
	settimer(Timer_CH__NMAppl_EIS, 1100);
	if (@sysvar::CH_NM::CH__NMNm_EIS == 2)
	{
		if (@sysvar::CH_NM::CH__NMStat_EIS != 3) @sysvar::CH_NM::CH__NMStat_EIS = 3;
	}
	else
	{
		if (@sysvar::CH_NM::CH__NMStat_EIS != 4) @sysvar::CH_NM::CH__NMStat_EIS = 4;
	}
	output(this);
}
/*@@end*/

/*@@frPDU:MsgChannel1.CHASSIS::EAC_Stat_AR:*/
on frPDU MsgChannel1.CHASSIS::EAC_Stat_AR
{
	if (@sysvar::CH_NM::CH__NMAppl_EIS != 2) @sysvar::CH_NM::CH__NMAppl_EIS = 2;
	settimer(Timer_CH__NMAppl_EIS, 1100);
	if (@sysvar::CH_NM::CH__NMNm_EIS == 2)
	{
		if (@sysvar::CH_NM::CH__NMStat_EIS != 3) @sysvar::CH_NM::CH__NMStat_EIS = 3;
	}
	else
	{
		if (@sysvar::CH_NM::CH__NMStat_EIS != 4) @sysvar::CH_NM::CH__NMStat_EIS = 4;
	}
	output(this);
}
/*@@end*/

/*@@frPDU:MsgChannel1.CHASSIS::EL_Stat_AR2:*/
on frPDU MsgChannel1.CHASSIS::EL_Stat_AR2
{
	if (@sysvar::CH_NM::CH__NMAppl_EIS != 2) @sysvar::CH_NM::CH__NMAppl_EIS = 2;
	settimer(Timer_CH__NMAppl_EIS, 1100);
	if (@sysvar::CH_NM::CH__NMNm_EIS == 2)
	{
		if (@sysvar::CH_NM::CH__NMStat_EIS != 3) @sysvar::CH_NM::CH__NMStat_EIS = 3;
	}
	else
	{
		if (@sysvar::CH_NM::CH__NMStat_EIS != 4) @sysvar::CH_NM::CH__NMStat_EIS = 4;
	}
	output(this);
}
/*@@end*/

/*@@frPDU:MsgChannel1.CHASSIS::EL_TurnInd_Rq_AR2:*/
on frPDU MsgChannel1.CHASSIS::EL_TurnInd_Rq_AR2
{
	if (@sysvar::CH_NM::CH__NMAppl_EIS != 2) @sysvar::CH_NM::CH__NMAppl_EIS = 2;
	settimer(Timer_CH__NMAppl_EIS, 1100);
	if (@sysvar::CH_NM::CH__NMNm_EIS == 2)
	{
		if (@sysvar::CH_NM::CH__NMStat_EIS != 3) @sysvar::CH_NM::CH__NMStat_EIS = 3;
	}
	else
	{
		if (@sysvar::CH_NM::CH__NMStat_EIS != 4) @sysvar::CH_NM::CH__NMStat_EIS = 4;
	}
	output(this);
}
/*@@end*/

/*@@frPDU:MsgChannel1.CHASSIS::EPKB_Stat_AR2:*/
on frPDU MsgChannel1.CHASSIS::EPKB_Stat_AR2
{
	if (@sysvar::CH_NM::CH__NMAppl_EIS != 2) @sysvar::CH_NM::CH__NMAppl_EIS = 2;
	settimer(Timer_CH__NMAppl_EIS, 1100);
	if (@sysvar::CH_NM::CH__NMNm_EIS == 2)
	{
		if (@sysvar::CH_NM::CH__NMStat_EIS != 3) @sysvar::CH_NM::CH__NMStat_EIS = 3;
	}
	else
	{
		if (@sysvar::CH_NM::CH__NMStat_EIS != 4) @sysvar::CH_NM::CH__NMStat_EIS = 4;
	}
	output(this);
}
/*@@end*/

/*@@frPDU:MsgChannel1.CHASSIS::EVC_CfgBit_01_32_AR2:*/
on frPDU MsgChannel1.CHASSIS::EVC_CfgBit_01_32_AR2
{
	if (@sysvar::CH_NM::CH__NMAppl_EIS != 2) @sysvar::CH_NM::CH__NMAppl_EIS = 2;
	settimer(Timer_CH__NMAppl_EIS, 1100);
	if (@sysvar::CH_NM::CH__NMNm_EIS == 2)
	{
		if (@sysvar::CH_NM::CH__NMStat_EIS != 3) @sysvar::CH_NM::CH__NMStat_EIS = 3;
	}
	else
	{
		if (@sysvar::CH_NM::CH__NMStat_EIS != 4) @sysvar::CH_NM::CH__NMStat_EIS = 4;
	}
	output(this);
}
/*@@end*/

/*@@frPDU:MsgChannel1.CHASSIS::EVC_CfgBit_33_64_AR2:*/
on frPDU MsgChannel1.CHASSIS::EVC_CfgBit_33_64_AR2
{
	if (@sysvar::CH_NM::CH__NMAppl_EIS != 2) @sysvar::CH_NM::CH__NMAppl_EIS = 2;
	settimer(Timer_CH__NMAppl_EIS, 1100);
	if (@sysvar::CH_NM::CH__NMNm_EIS == 2)
	{
		if (@sysvar::CH_NM::CH__NMStat_EIS != 3) @sysvar::CH_NM::CH__NMStat_EIS = 3;
	}
	else
	{
		if (@sysvar::CH_NM::CH__NMStat_EIS != 4) @sysvar::CH_NM::CH__NMStat_EIS = 4;
	}
	output(this);
}
/*@@end*/

/*@@frPDU:MsgChannel1.CHASSIS::EVC_CfgBit_65_96_AR2:*/
on frPDU MsgChannel1.CHASSIS::EVC_CfgBit_65_96_AR2
{
	if (@sysvar::CH_NM::CH__NMAppl_EIS != 2) @sysvar::CH_NM::CH__NMAppl_EIS = 2;
	settimer(Timer_CH__NMAppl_EIS, 1100);
	if (@sysvar::CH_NM::CH__NMNm_EIS == 2)
	{
		if (@sysvar::CH_NM::CH__NMStat_EIS != 3) @sysvar::CH_NM::CH__NMStat_EIS = 3;
	}
	else
	{
		if (@sysvar::CH_NM::CH__NMStat_EIS != 4) @sysvar::CH_NM::CH__NMStat_EIS = 4;
	}
	output(this);
}
/*@@end*/

/*@@frPDU:MsgChannel1.CHASSIS::EVC_CfgBit_97_C8_AR2:*/
on frPDU MsgChannel1.CHASSIS::EVC_CfgBit_97_C8_AR2
{
	if (@sysvar::CH_NM::CH__NMAppl_EIS != 2) @sysvar::CH_NM::CH__NMAppl_EIS = 2;
	settimer(Timer_CH__NMAppl_EIS, 1100);
	if (@sysvar::CH_NM::CH__NMNm_EIS == 2)
	{
		if (@sysvar::CH_NM::CH__NMStat_EIS != 3) @sysvar::CH_NM::CH__NMStat_EIS = 3;
	}
	else
	{
		if (@sysvar::CH_NM::CH__NMStat_EIS != 4) @sysvar::CH_NM::CH__NMStat_EIS = 4;
	}
	output(this);
}
/*@@end*/

/*@@frPDU:MsgChannel1.CHASSIS::EVC_CfgList_01_0C_AR2:*/
on frPDU MsgChannel1.CHASSIS::EVC_CfgList_01_0C_AR2
{
	if (@sysvar::CH_NM::CH__NMAppl_EIS != 2) @sysvar::CH_NM::CH__NMAppl_EIS = 2;
	settimer(Timer_CH__NMAppl_EIS, 1100);
	if (@sysvar::CH_NM::CH__NMNm_EIS == 2)
	{
		if (@sysvar::CH_NM::CH__NMStat_EIS != 3) @sysvar::CH_NM::CH__NMStat_EIS = 3;
	}
	else
	{
		if (@sysvar::CH_NM::CH__NMStat_EIS != 4) @sysvar::CH_NM::CH__NMStat_EIS = 4;
	}
	output(this);
}
/*@@end*/

/*@@frPDU:MsgChannel1.CHASSIS::FCW_Disp_Rq_AR:*/
on frPDU MsgChannel1.CHASSIS::FCW_Disp_Rq_AR
{
	if (@sysvar::CH_NM::CH__NMAppl_EIS != 2) @sysvar::CH_NM::CH__NMAppl_EIS = 2;
	settimer(Timer_CH__NMAppl_EIS, 1100);
	if (@sysvar::CH_NM::CH__NMNm_EIS == 2)
	{
		if (@sysvar::CH_NM::CH__NMStat_EIS != 3) @sysvar::CH_NM::CH__NMStat_EIS = 3;
	}
	else
	{
		if (@sysvar::CH_NM::CH__NMStat_EIS != 4) @sysvar::CH_NM::CH__NMStat_EIS = 4;
	}
	output(this);
}
/*@@end*/

/*@@frPDU:MsgChannel1.CHASSIS::HMI_CHASSIS_R1_AR2:*/
on frPDU MsgChannel1.CHASSIS::HMI_CHASSIS_R1_AR2
{
	if (@sysvar::CH_NM::CH__NMAppl_EIS != 2) @sysvar::CH_NM::CH__NMAppl_EIS = 2;
	settimer(Timer_CH__NMAppl_EIS, 1100);
	if (@sysvar::CH_NM::CH__NMNm_EIS == 2)
	{
		if (@sysvar::CH_NM::CH__NMStat_EIS != 3) @sysvar::CH_NM::CH__NMStat_EIS = 3;
	}
	else
	{
		if (@sysvar::CH_NM::CH__NMStat_EIS != 4) @sysvar::CH_NM::CH__NMStat_EIS = 4;
	}
	output(this);
}
/*@@end*/

/*@@frPDU:MsgChannel1.CHASSIS::HU_Comf_Rq_AR2:*/
on frPDU MsgChannel1.CHASSIS::HU_Comf_Rq_AR2
{
	if (@sysvar::CH_NM::CH__NMAppl_EIS != 2) @sysvar::CH_NM::CH__NMAppl_EIS = 2;
	settimer(Timer_CH__NMAppl_EIS, 1100);
	if (@sysvar::CH_NM::CH__NMNm_EIS == 2)
	{
		if (@sysvar::CH_NM::CH__NMStat_EIS != 3) @sysvar::CH_NM::CH__NMStat_EIS = 3;
	}
	else
	{
		if (@sysvar::CH_NM::CH__NMStat_EIS != 4) @sysvar::CH_NM::CH__NMStat_EIS = 4;
	}
	output(this);
}
/*@@end*/

/*@@frPDU:MsgChannel1.CHASSIS::HU_State_AR:*/
on frPDU MsgChannel1.CHASSIS::HU_State_AR
{
	if (@sysvar::CH_NM::CH__NMAppl_EIS != 2) @sysvar::CH_NM::CH__NMAppl_EIS = 2;
	settimer(Timer_CH__NMAppl_EIS, 1100);
	if (@sysvar::CH_NM::CH__NMNm_EIS == 2)
	{
		if (@sysvar::CH_NM::CH__NMStat_EIS != 3) @sysvar::CH_NM::CH__NMStat_EIS = 3;
	}
	else
	{
		if (@sysvar::CH_NM::CH__NMStat_EIS != 4) @sysvar::CH_NM::CH__NMStat_EIS = 4;
	}
	output(this);
}
/*@@end*/

/*@@frPDU:MsgChannel1.CHASSIS::HVAC_Disp_Stat1_AR:*/
on frPDU MsgChannel1.CHASSIS::HVAC_Disp_Stat1_AR
{
	if (@sysvar::CH_NM::CH__NMAppl_EIS != 2) @sysvar::CH_NM::CH__NMAppl_EIS = 2;
	settimer(Timer_CH__NMAppl_EIS, 1100);
	if (@sysvar::CH_NM::CH__NMNm_EIS == 2)
	{
		if (@sysvar::CH_NM::CH__NMStat_EIS != 3) @sysvar::CH_NM::CH__NMStat_EIS = 3;
	}
	else
	{
		if (@sysvar::CH_NM::CH__NMStat_EIS != 4) @sysvar::CH_NM::CH__NMStat_EIS = 4;
	}
	output(this);
}
/*@@end*/

/*@@frPDU:MsgChannel1.CHASSIS::HVAC_OBD_DTC_AR:*/
on frPDU MsgChannel1.CHASSIS::HVAC_OBD_DTC_AR
{
	if (@sysvar::CH_NM::CH__NMAppl_EIS != 2) @sysvar::CH_NM::CH__NMAppl_EIS = 2;
	settimer(Timer_CH__NMAppl_EIS, 1100);
	if (@sysvar::CH_NM::CH__NMNm_EIS == 2)
	{
		if (@sysvar::CH_NM::CH__NMStat_EIS != 3) @sysvar::CH_NM::CH__NMStat_EIS = 3;
	}
	else
	{
		if (@sysvar::CH_NM::CH__NMStat_EIS != 4) @sysvar::CH_NM::CH__NMStat_EIS = 4;
	}
	output(this);
}
/*@@end*/

/*@@frPDU:MsgChannel1.CHASSIS::HVAC_Rs2_AR:*/
on frPDU MsgChannel1.CHASSIS::HVAC_Rs2_AR
{
	if (@sysvar::CH_NM::CH__NMAppl_EIS != 2) @sysvar::CH_NM::CH__NMAppl_EIS = 2;
	settimer(Timer_CH__NMAppl_EIS, 1100);
	if (@sysvar::CH_NM::CH__NMNm_EIS == 2)
	{
		if (@sysvar::CH_NM::CH__NMStat_EIS != 3) @sysvar::CH_NM::CH__NMStat_EIS = 3;
	}
	else
	{
		if (@sysvar::CH_NM::CH__NMStat_EIS != 4) @sysvar::CH_NM::CH__NMStat_EIS = 4;
	}
	output(this);
}
/*@@end*/

/*@@frPDU:MsgChannel1.CHASSIS::HVAC_Rs3_AR2:*/
on frPDU MsgChannel1.CHASSIS::HVAC_Rs3_AR2
{
	if (@sysvar::CH_NM::CH__NMAppl_EIS != 2) @sysvar::CH_NM::CH__NMAppl_EIS = 2;
	settimer(Timer_CH__NMAppl_EIS, 1100);
	if (@sysvar::CH_NM::CH__NMNm_EIS == 2)
	{
		if (@sysvar::CH_NM::CH__NMStat_EIS != 3) @sysvar::CH_NM::CH__NMStat_EIS = 3;
	}
	else
	{
		if (@sysvar::CH_NM::CH__NMStat_EIS != 4) @sysvar::CH_NM::CH__NMStat_EIS = 4;
	}
	output(this);
}
/*@@end*/

/*@@frPDU:MsgChannel1.CHASSIS::HVAC_Rs_AR2:*/
on frPDU MsgChannel1.CHASSIS::HVAC_Rs_AR2
{
	if (@sysvar::CH_NM::CH__NMAppl_EIS != 2) @sysvar::CH_NM::CH__NMAppl_EIS = 2;
	settimer(Timer_CH__NMAppl_EIS, 1100);
	if (@sysvar::CH_NM::CH__NMNm_EIS == 2)
	{
		if (@sysvar::CH_NM::CH__NMStat_EIS != 3) @sysvar::CH_NM::CH__NMStat_EIS = 3;
	}
	else
	{
		if (@sysvar::CH_NM::CH__NMStat_EIS != 4) @sysvar::CH_NM::CH__NMStat_EIS = 4;
	}
	output(this);
}
/*@@end*/

/*@@frPDU:MsgChannel1.CHASSIS::HVAC_State1_AR:*/
on frPDU MsgChannel1.CHASSIS::HVAC_State1_AR
{
	if (@sysvar::CH_NM::CH__NMAppl_EIS != 2) @sysvar::CH_NM::CH__NMAppl_EIS = 2;
	settimer(Timer_CH__NMAppl_EIS, 1100);
	if (@sysvar::CH_NM::CH__NMNm_EIS == 2)
	{
		if (@sysvar::CH_NM::CH__NMStat_EIS != 3) @sysvar::CH_NM::CH__NMStat_EIS = 3;
	}
	else
	{
		if (@sysvar::CH_NM::CH__NMStat_EIS != 4) @sysvar::CH_NM::CH__NMStat_EIS = 4;
	}
	output(this);
}
/*@@end*/

/*@@frPDU:MsgChannel1.CHASSIS::IC_BasicInfo_AR2:*/
on frPDU MsgChannel1.CHASSIS::IC_BasicInfo_AR2
{
	if (@sysvar::CH_NM::CH__NMAppl_EIS != 2) @sysvar::CH_NM::CH__NMAppl_EIS = 2;
	settimer(Timer_CH__NMAppl_EIS, 1100);
	if (@sysvar::CH_NM::CH__NMNm_EIS == 2)
	{
		if (@sysvar::CH_NM::CH__NMStat_EIS != 3) @sysvar::CH_NM::CH__NMStat_EIS = 3;
	}
	else
	{
		if (@sysvar::CH_NM::CH__NMStat_EIS != 4) @sysvar::CH_NM::CH__NMStat_EIS = 4;
	}
	output(this);
}
/*@@end*/

/*@@frPDU:MsgChannel1.CHASSIS::IC_DriveAssistSys_AR2:*/
on frPDU MsgChannel1.CHASSIS::IC_DriveAssistSys_AR2
{
	if (@sysvar::CH_NM::CH__NMAppl_EIS != 2) @sysvar::CH_NM::CH__NMAppl_EIS = 2;
	settimer(Timer_CH__NMAppl_EIS, 1100);
	if (@sysvar::CH_NM::CH__NMNm_EIS == 2)
	{
		if (@sysvar::CH_NM::CH__NMStat_EIS != 3) @sysvar::CH_NM::CH__NMStat_EIS = 3;
	}
	else
	{
		if (@sysvar::CH_NM::CH__NMStat_EIS != 4) @sysvar::CH_NM::CH__NMStat_EIS = 4;
	}
	output(this);
}
/*@@end*/

/*@@frPDU:MsgChannel1.CHASSIS::IC_Settings_AR2:*/
on frPDU MsgChannel1.CHASSIS::IC_Settings_AR2
{
	if (@sysvar::CH_NM::CH__NMAppl_EIS != 2) @sysvar::CH_NM::CH__NMAppl_EIS = 2;
	settimer(Timer_CH__NMAppl_EIS, 1100);
	if (@sysvar::CH_NM::CH__NMNm_EIS == 2)
	{
		if (@sysvar::CH_NM::CH__NMStat_EIS != 3) @sysvar::CH_NM::CH__NMStat_EIS = 3;
	}
	else
	{
		if (@sysvar::CH_NM::CH__NMStat_EIS != 4) @sysvar::CH_NM::CH__NMStat_EIS = 4;
	}
	output(this);
}
/*@@end*/

/*@@frPDU:MsgChannel1.CHASSIS::ICH_Stat_AR:*/
on frPDU MsgChannel1.CHASSIS::ICH_Stat_AR
{
	if (@sysvar::CH_NM::CH__NMAppl_EIS != 2) @sysvar::CH_NM::CH__NMAppl_EIS = 2;
	settimer(Timer_CH__NMAppl_EIS, 1100);
	if (@sysvar::CH_NM::CH__NMNm_EIS == 2)
	{
		if (@sysvar::CH_NM::CH__NMStat_EIS != 3) @sysvar::CH_NM::CH__NMStat_EIS = 3;
	}
	else
	{
		if (@sysvar::CH_NM::CH__NMStat_EIS != 4) @sysvar::CH_NM::CH__NMStat_EIS = 4;
	}
	output(this);
}
/*@@end*/

/*@@frPDU:MsgChannel1.CHASSIS::Ign_Veh_Stat_AR2:*/
on frPDU MsgChannel1.CHASSIS::Ign_Veh_Stat_AR2
{
	if (@sysvar::CH_NM::CH__NMAppl_EIS != 2) @sysvar::CH_NM::CH__NMAppl_EIS = 2;
	settimer(Timer_CH__NMAppl_EIS, 1100);
	if (@sysvar::CH_NM::CH__NMNm_EIS == 2)
	{
		if (@sysvar::CH_NM::CH__NMStat_EIS != 3) @sysvar::CH_NM::CH__NMStat_EIS = 3;
	}
	else
	{
		if (@sysvar::CH_NM::CH__NMStat_EIS != 4) @sysvar::CH_NM::CH__NMStat_EIS = 4;
	}
	output(this);
}
/*@@end*/

/*@@frPDU:MsgChannel1.CHASSIS::IHC_Lgt_Stat_HLI_2_AR2:*/
on frPDU MsgChannel1.CHASSIS::IHC_Lgt_Stat_HLI_2_AR2
{
	if (@sysvar::CH_NM::CH__NMAppl_EIS != 2) @sysvar::CH_NM::CH__NMAppl_EIS = 2;
	settimer(Timer_CH__NMAppl_EIS, 1100);
	if (@sysvar::CH_NM::CH__NMNm_EIS == 2)
	{
		if (@sysvar::CH_NM::CH__NMStat_EIS != 3) @sysvar::CH_NM::CH__NMStat_EIS = 3;
	}
	else
	{
		if (@sysvar::CH_NM::CH__NMStat_EIS != 4) @sysvar::CH_NM::CH__NMStat_EIS = 4;
	}
	output(this);
}
/*@@end*/

/*@@frPDU:MsgChannel1.CHASSIS::IHC_Lgt_Stat_HLI_AR2:*/
on frPDU MsgChannel1.CHASSIS::IHC_Lgt_Stat_HLI_AR2
{
	if (@sysvar::CH_NM::CH__NMAppl_EIS != 2) @sysvar::CH_NM::CH__NMAppl_EIS = 2;
	settimer(Timer_CH__NMAppl_EIS, 1100);
	if (@sysvar::CH_NM::CH__NMNm_EIS == 2)
	{
		if (@sysvar::CH_NM::CH__NMStat_EIS != 3) @sysvar::CH_NM::CH__NMStat_EIS = 3;
	}
	else
	{
		if (@sysvar::CH_NM::CH__NMStat_EIS != 4) @sysvar::CH_NM::CH__NMStat_EIS = 4;
	}
	output(this);
}
/*@@end*/

/*@@frPDU:MsgChannel1.CHASSIS::KG_State_AR2:*/
on frPDU MsgChannel1.CHASSIS::KG_State_AR2
{
	if (@sysvar::CH_NM::CH__NMAppl_EIS != 2) @sysvar::CH_NM::CH__NMAppl_EIS = 2;
	settimer(Timer_CH__NMAppl_EIS, 1100);
	if (@sysvar::CH_NM::CH__NMNm_EIS == 2)
	{
		if (@sysvar::CH_NM::CH__NMStat_EIS != 3) @sysvar::CH_NM::CH__NMStat_EIS = 3;
	}
	else
	{
		if (@sysvar::CH_NM::CH__NMStat_EIS != 4) @sysvar::CH_NM::CH__NMStat_EIS = 4;
	}
	output(this);
}
/*@@end*/

/*@@frPDU:MsgChannel1.CHASSIS::LDC_Disp_Stat_IC_AR2:*/
on frPDU MsgChannel1.CHASSIS::LDC_Disp_Stat_IC_AR2
{
	if (@sysvar::CH_NM::CH__NMAppl_EIS != 2) @sysvar::CH_NM::CH__NMAppl_EIS = 2;
	settimer(Timer_CH__NMAppl_EIS, 1100);
	if (@sysvar::CH_NM::CH__NMNm_EIS == 2)
	{
		if (@sysvar::CH_NM::CH__NMStat_EIS != 3) @sysvar::CH_NM::CH__NMStat_EIS = 3;
	}
	else
	{
		if (@sysvar::CH_NM::CH__NMStat_EIS != 4) @sysvar::CH_NM::CH__NMStat_EIS = 4;
	}
	output(this);
}
/*@@end*/

/*@@frPDU:MsgChannel1.CHASSIS::LgtSens_State_AR:*/
on frPDU MsgChannel1.CHASSIS::LgtSens_State_AR
{
	if (@sysvar::CH_NM::CH__NMAppl_EIS != 2) @sysvar::CH_NM::CH__NMAppl_EIS = 2;
	settimer(Timer_CH__NMAppl_EIS, 1100);
	if (@sysvar::CH_NM::CH__NMNm_EIS == 2)
	{
		if (@sysvar::CH_NM::CH__NMStat_EIS != 3) @sysvar::CH_NM::CH__NMStat_EIS = 3;
	}
	else
	{
		if (@sysvar::CH_NM::CH__NMStat_EIS != 4) @sysvar::CH_NM::CH__NMStat_EIS = 4;
	}
	output(this);
}
/*@@end*/

/*@@frPDU:MsgChannel1.CHASSIS::Mirr_Adj_Lt_Rq_AR:*/
on frPDU MsgChannel1.CHASSIS::Mirr_Adj_Lt_Rq_AR
{
	if (@sysvar::CH_NM::CH__NMAppl_EIS != 2) @sysvar::CH_NM::CH__NMAppl_EIS = 2;
	settimer(Timer_CH__NMAppl_EIS, 1100);
	if (@sysvar::CH_NM::CH__NMNm_EIS == 2)
	{
		if (@sysvar::CH_NM::CH__NMStat_EIS != 3) @sysvar::CH_NM::CH__NMStat_EIS = 3;
	}
	else
	{
		if (@sysvar::CH_NM::CH__NMStat_EIS != 4) @sysvar::CH_NM::CH__NMStat_EIS = 4;
	}
	output(this);
}
/*@@end*/

/*@@frPDU:MsgChannel1.CHASSIS::Mirr_Adj_Rt_Rq_AR:*/
on frPDU MsgChannel1.CHASSIS::Mirr_Adj_Rt_Rq_AR
{
	if (@sysvar::CH_NM::CH__NMAppl_EIS != 2) @sysvar::CH_NM::CH__NMAppl_EIS = 2;
	settimer(Timer_CH__NMAppl_EIS, 1100);
	if (@sysvar::CH_NM::CH__NMNm_EIS == 2)
	{
		if (@sysvar::CH_NM::CH__NMStat_EIS != 3) @sysvar::CH_NM::CH__NMStat_EIS = 3;
	}
	else
	{
		if (@sysvar::CH_NM::CH__NMStat_EIS != 4) @sysvar::CH_NM::CH__NMStat_EIS = 4;
	}
	output(this);
}
/*@@end*/

/*@@frPDU:MsgChannel1.CHASSIS::NAVI_Pos1_AR:*/
on frPDU MsgChannel1.CHASSIS::NAVI_Pos1_AR
{
	if (@sysvar::CH_NM::CH__NMAppl_EIS != 2) @sysvar::CH_NM::CH__NMAppl_EIS = 2;
	settimer(Timer_CH__NMAppl_EIS, 1100);
	if (@sysvar::CH_NM::CH__NMNm_EIS == 2)
	{
		if (@sysvar::CH_NM::CH__NMStat_EIS != 3) @sysvar::CH_NM::CH__NMStat_EIS = 3;
	}
	else
	{
		if (@sysvar::CH_NM::CH__NMStat_EIS != 4) @sysvar::CH_NM::CH__NMStat_EIS = 4;
	}
	output(this);
}
/*@@end*/

/*@@frPDU:MsgChannel1.CHASSIS::NAVI_Pos2_AR:*/
on frPDU MsgChannel1.CHASSIS::NAVI_Pos2_AR
{
	if (@sysvar::CH_NM::CH__NMAppl_EIS != 2) @sysvar::CH_NM::CH__NMAppl_EIS = 2;
	settimer(Timer_CH__NMAppl_EIS, 1100);
	if (@sysvar::CH_NM::CH__NMNm_EIS == 2)
	{
		if (@sysvar::CH_NM::CH__NMStat_EIS != 3) @sysvar::CH_NM::CH__NMStat_EIS = 3;
	}
	else
	{
		if (@sysvar::CH_NM::CH__NMStat_EIS != 4) @sysvar::CH_NM::CH__NMStat_EIS = 4;
	}
	output(this);
}
/*@@end*/

/*@@frPDU:MsgChannel1.CHASSIS::NAVI_Pos3_AR:*/
on frPDU MsgChannel1.CHASSIS::NAVI_Pos3_AR
{
	if (@sysvar::CH_NM::CH__NMAppl_EIS != 2) @sysvar::CH_NM::CH__NMAppl_EIS = 2;
	settimer(Timer_CH__NMAppl_EIS, 1100);
	if (@sysvar::CH_NM::CH__NMNm_EIS == 2)
	{
		if (@sysvar::CH_NM::CH__NMStat_EIS != 3) @sysvar::CH_NM::CH__NMStat_EIS = 3;
	}
	else
	{
		if (@sysvar::CH_NM::CH__NMStat_EIS != 4) @sysvar::CH_NM::CH__NMStat_EIS = 4;
	}
	output(this);
}
/*@@end*/

/*@@frPDU:MsgChannel1.CHASSIS::NAVI_Pos4_AR:*/
on frPDU MsgChannel1.CHASSIS::NAVI_Pos4_AR
{
	if (@sysvar::CH_NM::CH__NMAppl_EIS != 2) @sysvar::CH_NM::CH__NMAppl_EIS = 2;
	settimer(Timer_CH__NMAppl_EIS, 1100);
	if (@sysvar::CH_NM::CH__NMNm_EIS == 2)
	{
		if (@sysvar::CH_NM::CH__NMStat_EIS != 3) @sysvar::CH_NM::CH__NMStat_EIS = 3;
	}
	else
	{
		if (@sysvar::CH_NM::CH__NMStat_EIS != 4) @sysvar::CH_NM::CH__NMStat_EIS = 4;
	}
	output(this);
}
/*@@end*/

/*@@frPDU:MsgChannel1.CHASSIS::NAVI_Pos5_AR:*/
on frPDU MsgChannel1.CHASSIS::NAVI_Pos5_AR
{
	if (@sysvar::CH_NM::CH__NMAppl_EIS != 2) @sysvar::CH_NM::CH__NMAppl_EIS = 2;
	settimer(Timer_CH__NMAppl_EIS, 1100);
	if (@sysvar::CH_NM::CH__NMNm_EIS == 2)
	{
		if (@sysvar::CH_NM::CH__NMStat_EIS != 3) @sysvar::CH_NM::CH__NMStat_EIS = 3;
	}
	else
	{
		if (@sysvar::CH_NM::CH__NMStat_EIS != 4) @sysvar::CH_NM::CH__NMStat_EIS = 4;
	}
	output(this);
}
/*@@end*/

/*@@frPDU:MsgChannel1.CHASSIS::NVP_Stat1_AR2:*/
on frPDU MsgChannel1.CHASSIS::NVP_Stat1_AR2
{
	if (@sysvar::CH_NM::CH__NMAppl_EIS != 2) @sysvar::CH_NM::CH__NMAppl_EIS = 2;
	settimer(Timer_CH__NMAppl_EIS, 1100);
	if (@sysvar::CH_NM::CH__NMNm_EIS == 2)
	{
		if (@sysvar::CH_NM::CH__NMStat_EIS != 3) @sysvar::CH_NM::CH__NMStat_EIS = 3;
	}
	else
	{
		if (@sysvar::CH_NM::CH__NMStat_EIS != 4) @sysvar::CH_NM::CH__NMStat_EIS = 4;
	}
	output(this);
}
/*@@end*/

/*@@frPDU:MsgChannel1.CHASSIS::OHCM_Stat_AR2:*/
on frPDU MsgChannel1.CHASSIS::OHCM_Stat_AR2
{
	if (@sysvar::CH_NM::CH__NMAppl_EIS != 2) @sysvar::CH_NM::CH__NMAppl_EIS = 2;
	settimer(Timer_CH__NMAppl_EIS, 1100);
	if (@sysvar::CH_NM::CH__NMNm_EIS == 2)
	{
		if (@sysvar::CH_NM::CH__NMStat_EIS != 3) @sysvar::CH_NM::CH__NMStat_EIS = 3;
	}
	else
	{
		if (@sysvar::CH_NM::CH__NMStat_EIS != 4) @sysvar::CH_NM::CH__NMStat_EIS = 4;
	}
	output(this);
}
/*@@end*/

/*@@frPDU:MsgChannel1.CHASSIS::ORC_Disp_Stat_AR2:*/
on frPDU MsgChannel1.CHASSIS::ORC_Disp_Stat_AR2
{
	if (@sysvar::CH_NM::CH__NMAppl_EIS != 2) @sysvar::CH_NM::CH__NMAppl_EIS = 2;
	settimer(Timer_CH__NMAppl_EIS, 1100);
	if (@sysvar::CH_NM::CH__NMNm_EIS == 2)
	{
		if (@sysvar::CH_NM::CH__NMStat_EIS != 3) @sysvar::CH_NM::CH__NMStat_EIS = 3;
	}
	else
	{
		if (@sysvar::CH_NM::CH__NMStat_EIS != 4) @sysvar::CH_NM::CH__NMStat_EIS = 4;
	}
	output(this);
}
/*@@end*/

/*@@frPDU:MsgChannel1.CHASSIS::ORC_Impact_AR2:*/
on frPDU MsgChannel1.CHASSIS::ORC_Impact_AR2
{
	if (@sysvar::CH_NM::CH__NMAppl_EIS != 2) @sysvar::CH_NM::CH__NMAppl_EIS = 2;
	settimer(Timer_CH__NMAppl_EIS, 1100);
	if (@sysvar::CH_NM::CH__NMNm_EIS == 2)
	{
		if (@sysvar::CH_NM::CH__NMStat_EIS != 3) @sysvar::CH_NM::CH__NMStat_EIS = 3;
	}
	else
	{
		if (@sysvar::CH_NM::CH__NMStat_EIS != 4) @sysvar::CH_NM::CH__NMStat_EIS = 4;
	}
	output(this);
}
/*@@end*/

/*@@frPDU:MsgChannel1.CHASSIS::Park_Disp_Rs_AR2:*/
on frPDU MsgChannel1.CHASSIS::Park_Disp_Rs_AR2
{
	if (@sysvar::CH_NM::CH__NMAppl_EIS != 2) @sysvar::CH_NM::CH__NMAppl_EIS = 2;
	settimer(Timer_CH__NMAppl_EIS, 1100);
	if (@sysvar::CH_NM::CH__NMNm_EIS == 2)
	{
		if (@sysvar::CH_NM::CH__NMStat_EIS != 3) @sysvar::CH_NM::CH__NMStat_EIS = 3;
	}
	else
	{
		if (@sysvar::CH_NM::CH__NMStat_EIS != 4) @sysvar::CH_NM::CH__NMStat_EIS = 4;
	}
	output(this);
}
/*@@end*/

/*@@frPDU:MsgChannel1.CHASSIS::PHB_IHC_Plus_Tunnel_3_4_AR2:*/
on frPDU MsgChannel1.CHASSIS::PHB_IHC_Plus_Tunnel_3_4_AR2
{
	if (@sysvar::CH_NM::CH__NMAppl_EIS != 2) @sysvar::CH_NM::CH__NMAppl_EIS = 2;
	settimer(Timer_CH__NMAppl_EIS, 1100);
	if (@sysvar::CH_NM::CH__NMNm_EIS == 2)
	{
		if (@sysvar::CH_NM::CH__NMStat_EIS != 3) @sysvar::CH_NM::CH__NMStat_EIS = 3;
	}
	else
	{
		if (@sysvar::CH_NM::CH__NMStat_EIS != 4) @sysvar::CH_NM::CH__NMStat_EIS = 4;
	}
	output(this);
}
/*@@end*/

/*@@frPDU:MsgChannel1.CHASSIS::PHB_IHC_Plus_Tunnel_AR2:*/
on frPDU MsgChannel1.CHASSIS::PHB_IHC_Plus_Tunnel_AR2
{
	if (@sysvar::CH_NM::CH__NMAppl_EIS != 2) @sysvar::CH_NM::CH__NMAppl_EIS = 2;
	settimer(Timer_CH__NMAppl_EIS, 1100);
	if (@sysvar::CH_NM::CH__NMNm_EIS == 2)
	{
		if (@sysvar::CH_NM::CH__NMStat_EIS != 3) @sysvar::CH_NM::CH__NMStat_EIS = 3;
	}
	else
	{
		if (@sysvar::CH_NM::CH__NMStat_EIS != 4) @sysvar::CH_NM::CH__NMStat_EIS = 4;
	}
	output(this);
}
/*@@end*/

/*@@frPDU:MsgChannel1.CHASSIS::PN14_Disp_Rq_AR:*/
on frPDU MsgChannel1.CHASSIS::PN14_Disp_Rq_AR
{
	if (@sysvar::CH_NM::CH__NMAppl_EIS != 2) @sysvar::CH_NM::CH__NMAppl_EIS = 2;
	settimer(Timer_CH__NMAppl_EIS, 1100);
	if (@sysvar::CH_NM::CH__NMNm_EIS == 2)
	{
		if (@sysvar::CH_NM::CH__NMStat_EIS != 3) @sysvar::CH_NM::CH__NMStat_EIS = 3;
	}
	else
	{
		if (@sysvar::CH_NM::CH__NMStat_EIS != 4) @sysvar::CH_NM::CH__NMStat_EIS = 4;
	}
	output(this);
}
/*@@end*/

/*@@frPDU:MsgChannel1.CHASSIS::PN14_Rs1_AR2:*/
on frPDU MsgChannel1.CHASSIS::PN14_Rs1_AR2
{
	if (@sysvar::CH_NM::CH__NMAppl_EIS != 2) @sysvar::CH_NM::CH__NMAppl_EIS = 2;
	settimer(Timer_CH__NMAppl_EIS, 1100);
	if (@sysvar::CH_NM::CH__NMNm_EIS == 2)
	{
		if (@sysvar::CH_NM::CH__NMStat_EIS != 3) @sysvar::CH_NM::CH__NMStat_EIS = 3;
	}
	else
	{
		if (@sysvar::CH_NM::CH__NMStat_EIS != 4) @sysvar::CH_NM::CH__NMStat_EIS = 4;
	}
	output(this);
}
/*@@end*/

/*@@frPDU:MsgChannel1.CHASSIS::PN14_Rs2_AR:*/
on frPDU MsgChannel1.CHASSIS::PN14_Rs2_AR
{
	if (@sysvar::CH_NM::CH__NMAppl_EIS != 2) @sysvar::CH_NM::CH__NMAppl_EIS = 2;
	settimer(Timer_CH__NMAppl_EIS, 1100);
	if (@sysvar::CH_NM::CH__NMNm_EIS == 2)
	{
		if (@sysvar::CH_NM::CH__NMStat_EIS != 3) @sysvar::CH_NM::CH__NMStat_EIS = 3;
	}
	else
	{
		if (@sysvar::CH_NM::CH__NMStat_EIS != 4) @sysvar::CH_NM::CH__NMStat_EIS = 4;
	}
	output(this);
}
/*@@end*/

/*@@frPDU:MsgChannel1.CHASSIS::PN14_Stat2_AR2:*/
on frPDU MsgChannel1.CHASSIS::PN14_Stat2_AR2
{
	if (@sysvar::CH_NM::CH__NMAppl_EIS != 2) @sysvar::CH_NM::CH__NMAppl_EIS = 2;
	settimer(Timer_CH__NMAppl_EIS, 1100);
	if (@sysvar::CH_NM::CH__NMNm_EIS == 2)
	{
		if (@sysvar::CH_NM::CH__NMStat_EIS != 3) @sysvar::CH_NM::CH__NMStat_EIS = 3;
	}
	else
	{
		if (@sysvar::CH_NM::CH__NMStat_EIS != 4) @sysvar::CH_NM::CH__NMStat_EIS = 4;
	}
	output(this);
}
/*@@end*/

/*@@frPDU:MsgChannel1.CHASSIS::PN14_Stat_AR:*/
on frPDU MsgChannel1.CHASSIS::PN14_Stat_AR
{
	if (@sysvar::CH_NM::CH__NMAppl_EIS != 2) @sysvar::CH_NM::CH__NMAppl_EIS = 2;
	settimer(Timer_CH__NMAppl_EIS, 1100);
	if (@sysvar::CH_NM::CH__NMNm_EIS == 2)
	{
		if (@sysvar::CH_NM::CH__NMStat_EIS != 3) @sysvar::CH_NM::CH__NMStat_EIS = 3;
	}
	else
	{
		if (@sysvar::CH_NM::CH__NMStat_EIS != 4) @sysvar::CH_NM::CH__NMStat_EIS = 4;
	}
	output(this);
}
/*@@end*/

/*@@frPDU:MsgChannel1.CHASSIS::PN48_Bat_Stat2_AR2:*/
on frPDU MsgChannel1.CHASSIS::PN48_Bat_Stat2_AR2
{
	if (@sysvar::CH_NM::CH__NMAppl_EIS != 2) @sysvar::CH_NM::CH__NMAppl_EIS = 2;
	settimer(Timer_CH__NMAppl_EIS, 1100);
	if (@sysvar::CH_NM::CH__NMNm_EIS == 2)
	{
		if (@sysvar::CH_NM::CH__NMStat_EIS != 3) @sysvar::CH_NM::CH__NMStat_EIS = 3;
	}
	else
	{
		if (@sysvar::CH_NM::CH__NMStat_EIS != 4) @sysvar::CH_NM::CH__NMStat_EIS = 4;
	}
	output(this);
}
/*@@end*/

/*@@frPDU:MsgChannel1.CHASSIS::PN48_Bat_Stat_AR:*/
on frPDU MsgChannel1.CHASSIS::PN48_Bat_Stat_AR
{
	if (@sysvar::CH_NM::CH__NMAppl_EIS != 2) @sysvar::CH_NM::CH__NMAppl_EIS = 2;
	settimer(Timer_CH__NMAppl_EIS, 1100);
	if (@sysvar::CH_NM::CH__NMNm_EIS == 2)
	{
		if (@sysvar::CH_NM::CH__NMStat_EIS != 3) @sysvar::CH_NM::CH__NMStat_EIS = 3;
	}
	else
	{
		if (@sysvar::CH_NM::CH__NMStat_EIS != 4) @sysvar::CH_NM::CH__NMStat_EIS = 4;
	}
	output(this);
}
/*@@end*/

/*@@frPDU:MsgChannel1.CHASSIS::PN48_BatLim_Stat_AR:*/
on frPDU MsgChannel1.CHASSIS::PN48_BatLim_Stat_AR
{
	if (@sysvar::CH_NM::CH__NMAppl_EIS != 2) @sysvar::CH_NM::CH__NMAppl_EIS = 2;
	settimer(Timer_CH__NMAppl_EIS, 1100);
	if (@sysvar::CH_NM::CH__NMNm_EIS == 2)
	{
		if (@sysvar::CH_NM::CH__NMStat_EIS != 3) @sysvar::CH_NM::CH__NMStat_EIS = 3;
	}
	else
	{
		if (@sysvar::CH_NM::CH__NMStat_EIS != 4) @sysvar::CH_NM::CH__NMStat_EIS = 4;
	}
	output(this);
}
/*@@end*/

/*@@frPDU:MsgChannel1.CHASSIS::PN48_DCDC48_LISB48_Stat_AR:*/
on frPDU MsgChannel1.CHASSIS::PN48_DCDC48_LISB48_Stat_AR
{
	if (@sysvar::CH_NM::CH__NMAppl_EIS != 2) @sysvar::CH_NM::CH__NMAppl_EIS = 2;
	settimer(Timer_CH__NMAppl_EIS, 1100);
	if (@sysvar::CH_NM::CH__NMNm_EIS == 2)
	{
		if (@sysvar::CH_NM::CH__NMStat_EIS != 3) @sysvar::CH_NM::CH__NMStat_EIS = 3;
	}
	else
	{
		if (@sysvar::CH_NM::CH__NMStat_EIS != 4) @sysvar::CH_NM::CH__NMStat_EIS = 4;
	}
	output(this);
}
/*@@end*/

/*@@frPDU:MsgChannel1.CHASSIS::PN48_Stat_AR:*/
on frPDU MsgChannel1.CHASSIS::PN48_Stat_AR
{
	if (@sysvar::CH_NM::CH__NMAppl_EIS != 2) @sysvar::CH_NM::CH__NMAppl_EIS = 2;
	settimer(Timer_CH__NMAppl_EIS, 1100);
	if (@sysvar::CH_NM::CH__NMNm_EIS == 2)
	{
		if (@sysvar::CH_NM::CH__NMStat_EIS != 3) @sysvar::CH_NM::CH__NMStat_EIS = 3;
	}
	else
	{
		if (@sysvar::CH_NM::CH__NMStat_EIS != 4) @sysvar::CH_NM::CH__NMStat_EIS = 4;
	}
	output(this);
}
/*@@end*/

/*@@frPDU:MsgChannel1.CHASSIS::PNHV_WeekDepTmTbl_Rq_HU_AR2:*/
on frPDU MsgChannel1.CHASSIS::PNHV_WeekDepTmTbl_Rq_HU_AR2
{
	if (@sysvar::CH_NM::CH__NMAppl_EIS != 2) @sysvar::CH_NM::CH__NMAppl_EIS = 2;
	settimer(Timer_CH__NMAppl_EIS, 1100);
	if (@sysvar::CH_NM::CH__NMNm_EIS == 2)
	{
		if (@sysvar::CH_NM::CH__NMStat_EIS != 3) @sysvar::CH_NM::CH__NMStat_EIS = 3;
	}
	else
	{
		if (@sysvar::CH_NM::CH__NMStat_EIS != 4) @sysvar::CH_NM::CH__NMStat_EIS = 4;
	}
	output(this);
}
/*@@end*/

/*@@frPDU:MsgChannel1.CHASSIS::PreCond_On_Rq_AR:*/
on frPDU MsgChannel1.CHASSIS::PreCond_On_Rq_AR
{
	if (@sysvar::CH_NM::CH__NMAppl_EIS != 2) @sysvar::CH_NM::CH__NMAppl_EIS = 2;
	settimer(Timer_CH__NMAppl_EIS, 1100);
	if (@sysvar::CH_NM::CH__NMNm_EIS == 2)
	{
		if (@sysvar::CH_NM::CH__NMStat_EIS != 3) @sysvar::CH_NM::CH__NMStat_EIS = 3;
	}
	else
	{
		if (@sysvar::CH_NM::CH__NMStat_EIS != 4) @sysvar::CH_NM::CH__NMStat_EIS = 4;
	}
	output(this);
}
/*@@end*/

/*@@frPDU:MsgChannel1.CHASSIS::PreCond_Rq_HU_AR2:*/
on frPDU MsgChannel1.CHASSIS::PreCond_Rq_HU_AR2
{
	if (@sysvar::CH_NM::CH__NMAppl_EIS != 2) @sysvar::CH_NM::CH__NMAppl_EIS = 2;
	settimer(Timer_CH__NMAppl_EIS, 1100);
	if (@sysvar::CH_NM::CH__NMNm_EIS == 2)
	{
		if (@sysvar::CH_NM::CH__NMStat_EIS != 3) @sysvar::CH_NM::CH__NMStat_EIS = 3;
	}
	else
	{
		if (@sysvar::CH_NM::CH__NMStat_EIS != 4) @sysvar::CH_NM::CH__NMStat_EIS = 4;
	}
	output(this);
}
/*@@end*/

/*@@frPDU:MsgChannel1.CHASSIS::PT_ObjIntrst_Gw_AR2:*/
on frPDU MsgChannel1.CHASSIS::PT_ObjIntrst_Gw_AR2
{
	if (@sysvar::CH_NM::CH__NMAppl_EIS != 2) @sysvar::CH_NM::CH__NMAppl_EIS = 2;
	settimer(Timer_CH__NMAppl_EIS, 1100);
	if (@sysvar::CH_NM::CH__NMNm_EIS == 2)
	{
		if (@sysvar::CH_NM::CH__NMStat_EIS != 3) @sysvar::CH_NM::CH__NMStat_EIS = 3;
	}
	else
	{
		if (@sysvar::CH_NM::CH__NMStat_EIS != 4) @sysvar::CH_NM::CH__NMStat_EIS = 4;
	}
	output(this);
}
/*@@end*/

/*@@frPDU:MsgChannel1.CHASSIS::RemPark_Auth_Rs_AR2:*/
on frPDU MsgChannel1.CHASSIS::RemPark_Auth_Rs_AR2
{
	if (@sysvar::CH_NM::CH__NMAppl_EIS != 2) @sysvar::CH_NM::CH__NMAppl_EIS = 2;
	settimer(Timer_CH__NMAppl_EIS, 1100);
	if (@sysvar::CH_NM::CH__NMNm_EIS == 2)
	{
		if (@sysvar::CH_NM::CH__NMStat_EIS != 3) @sysvar::CH_NM::CH__NMStat_EIS = 3;
	}
	else
	{
		if (@sysvar::CH_NM::CH__NMStat_EIS != 4) @sysvar::CH_NM::CH__NMStat_EIS = 4;
	}
	output(this);
}
/*@@end*/

/*@@frPDU:MsgChannel1.CHASSIS::RemPark_Stat_EIS_AR2:*/
on frPDU MsgChannel1.CHASSIS::RemPark_Stat_EIS_AR2
{
	if (@sysvar::CH_NM::CH__NMAppl_EIS != 2) @sysvar::CH_NM::CH__NMAppl_EIS = 2;
	settimer(Timer_CH__NMAppl_EIS, 1100);
	if (@sysvar::CH_NM::CH__NMNm_EIS == 2)
	{
		if (@sysvar::CH_NM::CH__NMStat_EIS != 3) @sysvar::CH_NM::CH__NMStat_EIS = 3;
	}
	else
	{
		if (@sysvar::CH_NM::CH__NMStat_EIS != 4) @sysvar::CH_NM::CH__NMStat_EIS = 4;
	}
	output(this);
}
/*@@end*/

/*@@frPDU:MsgChannel1.CHASSIS::RTC_Date_Time_AR2:*/
on frPDU MsgChannel1.CHASSIS::RTC_Date_Time_AR2
{
	if (@sysvar::CH_NM::CH__NMAppl_EIS != 2) @sysvar::CH_NM::CH__NMAppl_EIS = 2;
	settimer(Timer_CH__NMAppl_EIS, 1100);
	if (@sysvar::CH_NM::CH__NMNm_EIS == 2)
	{
		if (@sysvar::CH_NM::CH__NMStat_EIS != 3) @sysvar::CH_NM::CH__NMStat_EIS = 3;
	}
	else
	{
		if (@sysvar::CH_NM::CH__NMStat_EIS != 4) @sysvar::CH_NM::CH__NMStat_EIS = 4;
	}
	output(this);
}
/*@@end*/

/*@@frPDU:MsgChannel1.CHASSIS::RTC_Stat1_AR2:*/
on frPDU MsgChannel1.CHASSIS::RTC_Stat1_AR2
{
	if (@sysvar::CH_NM::CH__NMAppl_EIS != 2) @sysvar::CH_NM::CH__NMAppl_EIS = 2;
	settimer(Timer_CH__NMAppl_EIS, 1100);
	if (@sysvar::CH_NM::CH__NMNm_EIS == 2)
	{
		if (@sysvar::CH_NM::CH__NMStat_EIS != 3) @sysvar::CH_NM::CH__NMStat_EIS = 3;
	}
	else
	{
		if (@sysvar::CH_NM::CH__NMStat_EIS != 4) @sysvar::CH_NM::CH__NMStat_EIS = 4;
	}
	output(this);
}
/*@@end*/

/*@@frPDU:MsgChannel1.CHASSIS::SADR_Trgr_FCW_AR2:*/
on frPDU MsgChannel1.CHASSIS::SADR_Trgr_FCW_AR2
{
	if (@sysvar::CH_NM::CH__NMAppl_EIS != 2) @sysvar::CH_NM::CH__NMAppl_EIS = 2;
	settimer(Timer_CH__NMAppl_EIS, 1100);
	if (@sysvar::CH_NM::CH__NMNm_EIS == 2)
	{
		if (@sysvar::CH_NM::CH__NMStat_EIS != 3) @sysvar::CH_NM::CH__NMStat_EIS = 3;
	}
	else
	{
		if (@sysvar::CH_NM::CH__NMStat_EIS != 4) @sysvar::CH_NM::CH__NMStat_EIS = 4;
	}
	output(this);
}
/*@@end*/

/*@@frPDU:MsgChannel1.CHASSIS::SeatAdj_FL_Rq_AR:*/
on frPDU MsgChannel1.CHASSIS::SeatAdj_FL_Rq_AR
{
	if (@sysvar::CH_NM::CH__NMAppl_EIS != 2) @sysvar::CH_NM::CH__NMAppl_EIS = 2;
	settimer(Timer_CH__NMAppl_EIS, 1100);
	if (@sysvar::CH_NM::CH__NMNm_EIS == 2)
	{
		if (@sysvar::CH_NM::CH__NMStat_EIS != 3) @sysvar::CH_NM::CH__NMStat_EIS = 3;
	}
	else
	{
		if (@sysvar::CH_NM::CH__NMStat_EIS != 4) @sysvar::CH_NM::CH__NMStat_EIS = 4;
	}
	output(this);
}
/*@@end*/

/*@@frPDU:MsgChannel1.CHASSIS::SeatAdj_FR_Rq_AR:*/
on frPDU MsgChannel1.CHASSIS::SeatAdj_FR_Rq_AR
{
	if (@sysvar::CH_NM::CH__NMAppl_EIS != 2) @sysvar::CH_NM::CH__NMAppl_EIS = 2;
	settimer(Timer_CH__NMAppl_EIS, 1100);
	if (@sysvar::CH_NM::CH__NMNm_EIS == 2)
	{
		if (@sysvar::CH_NM::CH__NMStat_EIS != 3) @sysvar::CH_NM::CH__NMStat_EIS = 3;
	}
	else
	{
		if (@sysvar::CH_NM::CH__NMStat_EIS != 4) @sysvar::CH_NM::CH__NMStat_EIS = 4;
	}
	output(this);
}
/*@@end*/

/*@@frPDU:MsgChannel1.CHASSIS::SPCR_Stat_BC_F_AR2:*/
on frPDU MsgChannel1.CHASSIS::SPCR_Stat_BC_F_AR2
{
	if (@sysvar::CH_NM::CH__NMAppl_EIS != 2) @sysvar::CH_NM::CH__NMAppl_EIS = 2;
	settimer(Timer_CH__NMAppl_EIS, 1100);
	if (@sysvar::CH_NM::CH__NMNm_EIS == 2)
	{
		if (@sysvar::CH_NM::CH__NMStat_EIS != 3) @sysvar::CH_NM::CH__NMStat_EIS = 3;
	}
	else
	{
		if (@sysvar::CH_NM::CH__NMStat_EIS != 4) @sysvar::CH_NM::CH__NMStat_EIS = 4;
	}
	output(this);
}
/*@@end*/

/*@@frPDU:MsgChannel1.CHASSIS::SPL_Obj1_Obj2_NV_AR2:*/
on frPDU MsgChannel1.CHASSIS::SPL_Obj1_Obj2_NV_AR2
{
	if (@sysvar::CH_NM::CH__NMAppl_EIS != 2) @sysvar::CH_NM::CH__NMAppl_EIS = 2;
	settimer(Timer_CH__NMAppl_EIS, 1100);
	if (@sysvar::CH_NM::CH__NMNm_EIS == 2)
	{
		if (@sysvar::CH_NM::CH__NMStat_EIS != 3) @sysvar::CH_NM::CH__NMStat_EIS = 3;
	}
	else
	{
		if (@sysvar::CH_NM::CH__NMStat_EIS != 4) @sysvar::CH_NM::CH__NMStat_EIS = 4;
	}
	output(this);
}
/*@@end*/

/*@@frPDU:MsgChannel1.CHASSIS::SPV_Actn_Rq_AR2:*/
on frPDU MsgChannel1.CHASSIS::SPV_Actn_Rq_AR2
{
	if (@sysvar::CH_NM::CH__NMAppl_EIS != 2) @sysvar::CH_NM::CH__NMAppl_EIS = 2;
	settimer(Timer_CH__NMAppl_EIS, 1100);
	if (@sysvar::CH_NM::CH__NMNm_EIS == 2)
	{
		if (@sysvar::CH_NM::CH__NMStat_EIS != 3) @sysvar::CH_NM::CH__NMStat_EIS = 3;
	}
	else
	{
		if (@sysvar::CH_NM::CH__NMStat_EIS != 4) @sysvar::CH_NM::CH__NMStat_EIS = 4;
	}
	output(this);
}
/*@@end*/

/*@@frPDU:MsgChannel1.CHASSIS::SPV_Alm_Rq_AR:*/
on frPDU MsgChannel1.CHASSIS::SPV_Alm_Rq_AR
{
	if (@sysvar::CH_NM::CH__NMAppl_EIS != 2) @sysvar::CH_NM::CH__NMAppl_EIS = 2;
	settimer(Timer_CH__NMAppl_EIS, 1100);
	if (@sysvar::CH_NM::CH__NMNm_EIS == 2)
	{
		if (@sysvar::CH_NM::CH__NMStat_EIS != 3) @sysvar::CH_NM::CH__NMStat_EIS = 3;
	}
	else
	{
		if (@sysvar::CH_NM::CH__NMStat_EIS != 4) @sysvar::CH_NM::CH__NMStat_EIS = 4;
	}
	output(this);
}
/*@@end*/

/*@@frPDU:MsgChannel1.CHASSIS::SPV_Stat_AR2:*/
on frPDU MsgChannel1.CHASSIS::SPV_Stat_AR2
{
	if (@sysvar::CH_NM::CH__NMAppl_EIS != 2) @sysvar::CH_NM::CH__NMAppl_EIS = 2;
	settimer(Timer_CH__NMAppl_EIS, 1100);
	if (@sysvar::CH_NM::CH__NMNm_EIS == 2)
	{
		if (@sysvar::CH_NM::CH__NMStat_EIS != 3) @sysvar::CH_NM::CH__NMStat_EIS = 3;
	}
	else
	{
		if (@sysvar::CH_NM::CH__NMStat_EIS != 4) @sysvar::CH_NM::CH__NMStat_EIS = 4;
	}
	output(this);
}
/*@@end*/

/*@@frPDU:MsgChannel1.CHASSIS::SVS_Rq_HU_AR2:*/
on frPDU MsgChannel1.CHASSIS::SVS_Rq_HU_AR2
{
	if (@sysvar::CH_NM::CH__NMAppl_EIS != 2) @sysvar::CH_NM::CH__NMAppl_EIS = 2;
	settimer(Timer_CH__NMAppl_EIS, 1100);
	if (@sysvar::CH_NM::CH__NMNm_EIS == 2)
	{
		if (@sysvar::CH_NM::CH__NMStat_EIS != 3) @sysvar::CH_NM::CH__NMStat_EIS = 3;
	}
	else
	{
		if (@sysvar::CH_NM::CH__NMStat_EIS != 4) @sysvar::CH_NM::CH__NMStat_EIS = 4;
	}
	output(this);
}
/*@@end*/

/*@@frPDU:MsgChannel1.CHASSIS::TBCSC_DAC_EPS_AR2:*/
on frPDU MsgChannel1.CHASSIS::TBCSC_DAC_EPS_AR2
{
	if (@sysvar::CH_NM::CH__NMAppl_EIS != 2) @sysvar::CH_NM::CH__NMAppl_EIS = 2;
	settimer(Timer_CH__NMAppl_EIS, 1100);
	if (@sysvar::CH_NM::CH__NMNm_EIS == 2)
	{
		if (@sysvar::CH_NM::CH__NMStat_EIS != 3) @sysvar::CH_NM::CH__NMStat_EIS = 3;
	}
	else
	{
		if (@sysvar::CH_NM::CH__NMStat_EIS != 4) @sysvar::CH_NM::CH__NMStat_EIS = 4;
	}
	output(this);
}
/*@@end*/

/*@@frPDU:MsgChannel1.CHASSIS::TBCSC_DAC_ESP_AR2:*/
on frPDU MsgChannel1.CHASSIS::TBCSC_DAC_ESP_AR2
{
	if (@sysvar::CH_NM::CH__NMAppl_EIS != 2) @sysvar::CH_NM::CH__NMAppl_EIS = 2;
	settimer(Timer_CH__NMAppl_EIS, 1100);
	if (@sysvar::CH_NM::CH__NMNm_EIS == 2)
	{
		if (@sysvar::CH_NM::CH__NMStat_EIS != 3) @sysvar::CH_NM::CH__NMStat_EIS = 3;
	}
	else
	{
		if (@sysvar::CH_NM::CH__NMStat_EIS != 4) @sysvar::CH_NM::CH__NMStat_EIS = 4;
	}
	output(this);
}
/*@@end*/

/*@@frPDU:MsgChannel1.CHASSIS::TBCSC_Hi_Rq1_AR2:*/
on frPDU MsgChannel1.CHASSIS::TBCSC_Hi_Rq1_AR2
{
	if (@sysvar::CH_NM::CH__NMAppl_EIS != 2) @sysvar::CH_NM::CH__NMAppl_EIS = 2;
	settimer(Timer_CH__NMAppl_EIS, 1100);
	if (@sysvar::CH_NM::CH__NMNm_EIS == 2)
	{
		if (@sysvar::CH_NM::CH__NMStat_EIS != 3) @sysvar::CH_NM::CH__NMStat_EIS = 3;
	}
	else
	{
		if (@sysvar::CH_NM::CH__NMStat_EIS != 4) @sysvar::CH_NM::CH__NMStat_EIS = 4;
	}
	output(this);
}
/*@@end*/

/*@@frPDU:MsgChannel1.CHASSIS::TBCSC_Hi_Rq2_AR2:*/
on frPDU MsgChannel1.CHASSIS::TBCSC_Hi_Rq2_AR2
{
	if (@sysvar::CH_NM::CH__NMAppl_EIS != 2) @sysvar::CH_NM::CH__NMAppl_EIS = 2;
	settimer(Timer_CH__NMAppl_EIS, 1100);
	if (@sysvar::CH_NM::CH__NMNm_EIS == 2)
	{
		if (@sysvar::CH_NM::CH__NMStat_EIS != 3) @sysvar::CH_NM::CH__NMStat_EIS = 3;
	}
	else
	{
		if (@sysvar::CH_NM::CH__NMStat_EIS != 4) @sysvar::CH_NM::CH__NMStat_EIS = 4;
	}
	output(this);
}
/*@@end*/

/*@@frPDU:MsgChannel1.CHASSIS::TBCSC_Lo_Rq1_AR2:*/
on frPDU MsgChannel1.CHASSIS::TBCSC_Lo_Rq1_AR2
{
	if (@sysvar::CH_NM::CH__NMAppl_EIS != 2) @sysvar::CH_NM::CH__NMAppl_EIS = 2;
	settimer(Timer_CH__NMAppl_EIS, 1100);
	if (@sysvar::CH_NM::CH__NMNm_EIS == 2)
	{
		if (@sysvar::CH_NM::CH__NMStat_EIS != 3) @sysvar::CH_NM::CH__NMStat_EIS = 3;
	}
	else
	{
		if (@sysvar::CH_NM::CH__NMStat_EIS != 4) @sysvar::CH_NM::CH__NMStat_EIS = 4;
	}
	output(this);
}
/*@@end*/

/*@@frPDU:MsgChannel1.CHASSIS::TBCSC_Lo_Rq2_AR2:*/
on frPDU MsgChannel1.CHASSIS::TBCSC_Lo_Rq2_AR2
{
	if (@sysvar::CH_NM::CH__NMAppl_EIS != 2) @sysvar::CH_NM::CH__NMAppl_EIS = 2;
	settimer(Timer_CH__NMAppl_EIS, 1100);
	if (@sysvar::CH_NM::CH__NMNm_EIS == 2)
	{
		if (@sysvar::CH_NM::CH__NMStat_EIS != 3) @sysvar::CH_NM::CH__NMStat_EIS = 3;
	}
	else
	{
		if (@sysvar::CH_NM::CH__NMStat_EIS != 4) @sysvar::CH_NM::CH__NMStat_EIS = 4;
	}
	output(this);
}
/*@@end*/

/*@@frPDU:MsgChannel1.CHASSIS::TC_Distance_AR:*/
on frPDU MsgChannel1.CHASSIS::TC_Distance_AR
{
	if (@sysvar::CH_NM::CH__NMAppl_EIS != 2) @sysvar::CH_NM::CH__NMAppl_EIS = 2;
	settimer(Timer_CH__NMAppl_EIS, 1100);
	if (@sysvar::CH_NM::CH__NMNm_EIS == 2)
	{
		if (@sysvar::CH_NM::CH__NMStat_EIS != 3) @sysvar::CH_NM::CH__NMStat_EIS = 3;
	}
	else
	{
		if (@sysvar::CH_NM::CH__NMStat_EIS != 4) @sysvar::CH_NM::CH__NMStat_EIS = 4;
	}
	output(this);
}
/*@@end*/

/*@@frPDU:MsgChannel1.CHASSIS::TGW_DateTm_Stat_AR:*/
on frPDU MsgChannel1.CHASSIS::TGW_DateTm_Stat_AR
{
	if (@sysvar::CH_NM::CH__NMAppl_EIS != 2) @sysvar::CH_NM::CH__NMAppl_EIS = 2;
	settimer(Timer_CH__NMAppl_EIS, 1100);
	if (@sysvar::CH_NM::CH__NMNm_EIS == 2)
	{
		if (@sysvar::CH_NM::CH__NMStat_EIS != 3) @sysvar::CH_NM::CH__NMStat_EIS = 3;
	}
	else
	{
		if (@sysvar::CH_NM::CH__NMStat_EIS != 4) @sysvar::CH_NM::CH__NMStat_EIS = 4;
	}
	output(this);
}
/*@@end*/

/*@@frPDU:MsgChannel1.CHASSIS::Tire_State_AR2:*/
on frPDU MsgChannel1.CHASSIS::Tire_State_AR2
{
	if (@sysvar::CH_NM::CH__NMAppl_EIS != 2) @sysvar::CH_NM::CH__NMAppl_EIS = 2;
	settimer(Timer_CH__NMAppl_EIS, 1100);
	if (@sysvar::CH_NM::CH__NMNm_EIS == 2)
	{
		if (@sysvar::CH_NM::CH__NMStat_EIS != 3) @sysvar::CH_NM::CH__NMStat_EIS = 3;
	}
	else
	{
		if (@sysvar::CH_NM::CH__NMStat_EIS != 4) @sysvar::CH_NM::CH__NMStat_EIS = 4;
	}
	output(this);
}
/*@@end*/

/*@@frPDU:MsgChannel1.CHASSIS::TrafficInfo_AR:*/
on frPDU MsgChannel1.CHASSIS::TrafficInfo_AR
{
	if (@sysvar::CH_NM::CH__NMAppl_EIS != 2) @sysvar::CH_NM::CH__NMAppl_EIS = 2;
	settimer(Timer_CH__NMAppl_EIS, 1100);
	if (@sysvar::CH_NM::CH__NMNm_EIS == 2)
	{
		if (@sysvar::CH_NM::CH__NMStat_EIS != 3) @sysvar::CH_NM::CH__NMStat_EIS = 3;
	}
	else
	{
		if (@sysvar::CH_NM::CH__NMStat_EIS != 4) @sysvar::CH_NM::CH__NMStat_EIS = 4;
	}
	output(this);
}
/*@@end*/

/*@@frPDU:MsgChannel1.CHASSIS::Trailer_Stat_AR2:*/
on frPDU MsgChannel1.CHASSIS::Trailer_Stat_AR2
{
	if (@sysvar::CH_NM::CH__NMAppl_EIS != 2) @sysvar::CH_NM::CH__NMAppl_EIS = 2;
	settimer(Timer_CH__NMAppl_EIS, 1100);
	if (@sysvar::CH_NM::CH__NMNm_EIS == 2)
	{
		if (@sysvar::CH_NM::CH__NMStat_EIS != 3) @sysvar::CH_NM::CH__NMStat_EIS = 3;
	}
	else
	{
		if (@sysvar::CH_NM::CH__NMStat_EIS != 4) @sysvar::CH_NM::CH__NMStat_EIS = 4;
	}
	output(this);
}
/*@@end*/

/*@@frPDU:MsgChannel1.CHASSIS::TSA_Disp_Rq1_AR2:*/
on frPDU MsgChannel1.CHASSIS::TSA_Disp_Rq1_AR2
{
	if (@sysvar::CH_NM::CH__NMAppl_EIS != 2) @sysvar::CH_NM::CH__NMAppl_EIS = 2;
	settimer(Timer_CH__NMAppl_EIS, 1100);
	if (@sysvar::CH_NM::CH__NMNm_EIS == 2)
	{
		if (@sysvar::CH_NM::CH__NMStat_EIS != 3) @sysvar::CH_NM::CH__NMStat_EIS = 3;
	}
	else
	{
		if (@sysvar::CH_NM::CH__NMStat_EIS != 4) @sysvar::CH_NM::CH__NMStat_EIS = 4;
	}
	output(this);
}
/*@@end*/

/*@@frPDU:MsgChannel1.CHASSIS::TSA_Disp_Rq2_AR:*/
on frPDU MsgChannel1.CHASSIS::TSA_Disp_Rq2_AR
{
	if (@sysvar::CH_NM::CH__NMAppl_EIS != 2) @sysvar::CH_NM::CH__NMAppl_EIS = 2;
	settimer(Timer_CH__NMAppl_EIS, 1100);
	if (@sysvar::CH_NM::CH__NMNm_EIS == 2)
	{
		if (@sysvar::CH_NM::CH__NMStat_EIS != 3) @sysvar::CH_NM::CH__NMStat_EIS = 3;
	}
	else
	{
		if (@sysvar::CH_NM::CH__NMStat_EIS != 4) @sysvar::CH_NM::CH__NMStat_EIS = 4;
	}
	output(this);
}
/*@@end*/

/*@@frPDU:MsgChannel1.CHASSIS::TSA_Disp_Rq3_AR:*/
on frPDU MsgChannel1.CHASSIS::TSA_Disp_Rq3_AR
{
	if (@sysvar::CH_NM::CH__NMAppl_EIS != 2) @sysvar::CH_NM::CH__NMAppl_EIS = 2;
	settimer(Timer_CH__NMAppl_EIS, 1100);
	if (@sysvar::CH_NM::CH__NMNm_EIS == 2)
	{
		if (@sysvar::CH_NM::CH__NMStat_EIS != 3) @sysvar::CH_NM::CH__NMStat_EIS = 3;
	}
	else
	{
		if (@sysvar::CH_NM::CH__NMStat_EIS != 4) @sysvar::CH_NM::CH__NMStat_EIS = 4;
	}
	output(this);
}
/*@@end*/

/*@@frPDU:MsgChannel1.CHASSIS::VehAccel_X_Rq_Gw_AR2:*/
on frPDU MsgChannel1.CHASSIS::VehAccel_X_Rq_Gw_AR2
{
	if (@sysvar::CH_NM::CH__NMAppl_EIS != 2) @sysvar::CH_NM::CH__NMAppl_EIS = 2;
	settimer(Timer_CH__NMAppl_EIS, 1100);
	if (@sysvar::CH_NM::CH__NMNm_EIS == 2)
	{
		if (@sysvar::CH_NM::CH__NMStat_EIS != 3) @sysvar::CH_NM::CH__NMStat_EIS = 3;
	}
	else
	{
		if (@sysvar::CH_NM::CH__NMStat_EIS != 4) @sysvar::CH_NM::CH__NMStat_EIS = 4;
	}
	output(this);
}
/*@@end*/

/*@@frPDU:MsgChannel1.CHASSIS::VIN_AR:*/
on frPDU MsgChannel1.CHASSIS::VIN_AR
{
	if (@sysvar::CH_NM::CH__NMAppl_EIS != 2) @sysvar::CH_NM::CH__NMAppl_EIS = 2;
	settimer(Timer_CH__NMAppl_EIS, 1100);
	if (@sysvar::CH_NM::CH__NMNm_EIS == 2)
	{
		if (@sysvar::CH_NM::CH__NMStat_EIS != 3) @sysvar::CH_NM::CH__NMStat_EIS = 3;
	}
	else
	{
		if (@sysvar::CH_NM::CH__NMStat_EIS != 4) @sysvar::CH_NM::CH__NMStat_EIS = 4;
	}
	output(this);
}
/*@@end*/

/*@@frPDU:MsgChannel1.CHASSIS::Wiper_Stat_AR:*/
on frPDU MsgChannel1.CHASSIS::Wiper_Stat_AR
{
	if (@sysvar::CH_NM::CH__NMAppl_EIS != 2) @sysvar::CH_NM::CH__NMAppl_EIS = 2;
	settimer(Timer_CH__NMAppl_EIS, 1100);
	if (@sysvar::CH_NM::CH__NMNm_EIS == 2)
	{
		if (@sysvar::CH_NM::CH__NMStat_EIS != 3) @sysvar::CH_NM::CH__NMStat_EIS = 3;
	}
	else
	{
		if (@sysvar::CH_NM::CH__NMStat_EIS != 4) @sysvar::CH_NM::CH__NMStat_EIS = 4;
	}
	output(this);
}
/*@@end*/

/*@@frPDU:MsgChannel1.CHASSIS::WUDOP_EIS_FR:*/
on frPDU MsgChannel1.CHASSIS::WUDOP_EIS_FR
{
	if (@sysvar::CH_NM::CH__NMAppl_EIS != 2) @sysvar::CH_NM::CH__NMAppl_EIS = 2;
	settimer(Timer_CH__NMAppl_EIS, 1100);
	if (@sysvar::CH_NM::CH__NMNm_EIS == 2)
	{
		if (@sysvar::CH_NM::CH__NMStat_EIS != 3) @sysvar::CH_NM::CH__NMStat_EIS = 3;
	}
	else
	{
		if (@sysvar::CH_NM::CH__NMStat_EIS != 4) @sysvar::CH_NM::CH__NMStat_EIS = 4;
	}
	output(this);
}
/*@@end*/

/*@@frPDU:MsgChannel1.CHASSIS::YMAS_Rq_MPC_AR2:*/
on frPDU MsgChannel1.CHASSIS::YMAS_Rq_MPC_AR2
{
	if (@sysvar::CH_NM::CH__NMAppl_EIS != 2) @sysvar::CH_NM::CH__NMAppl_EIS = 2;
	settimer(Timer_CH__NMAppl_EIS, 1100);
	if (@sysvar::CH_NM::CH__NMNm_EIS == 2)
	{
		if (@sysvar::CH_NM::CH__NMStat_EIS != 3) @sysvar::CH_NM::CH__NMStat_EIS = 3;
	}
	else
	{
		if (@sysvar::CH_NM::CH__NMStat_EIS != 4) @sysvar::CH_NM::CH__NMStat_EIS = 4;
	}
	output(this);
}
/*@@end*/

/*@@frPDU:MsgChannel1.CHASSIS::DTQ_Rs_AR2:*/
on frPDU MsgChannel1.CHASSIS::DTQ_Rs_AR2
{
	if (@sysvar::CH_NM::CH__NMAppl_EPS != 2) @sysvar::CH_NM::CH__NMAppl_EPS = 2;
	settimer(Timer_CH__NMAppl_EPS, 1100);
	if (@sysvar::CH_NM::CH__NMNm_EPS == 2)
	{
		if (@sysvar::CH_NM::CH__NMStat_EPS != 3) @sysvar::CH_NM::CH__NMStat_EPS = 3;
	}
	else
	{
		if (@sysvar::CH_NM::CH__NMStat_EPS != 4) @sysvar::CH_NM::CH__NMStat_EPS = 4;
	}
	output(this);
}
/*@@end*/

/*@@frPDU:MsgChannel1.CHASSIS::EPS_Stat_Disp_Rq_AR2:*/
on frPDU MsgChannel1.CHASSIS::EPS_Stat_Disp_Rq_AR2
{
	if (@sysvar::CH_NM::CH__NMAppl_EPS != 2) @sysvar::CH_NM::CH__NMAppl_EPS = 2;
	settimer(Timer_CH__NMAppl_EPS, 1100);
	if (@sysvar::CH_NM::CH__NMNm_EPS == 2)
	{
		if (@sysvar::CH_NM::CH__NMStat_EPS != 3) @sysvar::CH_NM::CH__NMStat_EPS = 3;
	}
	else
	{
		if (@sysvar::CH_NM::CH__NMStat_EPS != 4) @sysvar::CH_NM::CH__NMStat_EPS = 4;
	}
	output(this);
}
/*@@end*/

/*@@frPDU:MsgChannel1.CHASSIS::PARK_St_Rs_AR2:*/
on frPDU MsgChannel1.CHASSIS::PARK_St_Rs_AR2
{
	if (@sysvar::CH_NM::CH__NMAppl_EPS != 2) @sysvar::CH_NM::CH__NMAppl_EPS = 2;
	settimer(Timer_CH__NMAppl_EPS, 1100);
	if (@sysvar::CH_NM::CH__NMNm_EPS == 2)
	{
		if (@sysvar::CH_NM::CH__NMStat_EPS != 3) @sysvar::CH_NM::CH__NMStat_EPS = 3;
	}
	else
	{
		if (@sysvar::CH_NM::CH__NMStat_EPS != 4) @sysvar::CH_NM::CH__NMStat_EPS = 4;
	}
	output(this);
}
/*@@end*/

/*@@frPDU:MsgChannel1.CHASSIS::ROE_EPS:*/
on frPDU MsgChannel1.CHASSIS::ROE_EPS
{
	if (@sysvar::CH_NM::CH__NMAppl_EPS != 2) @sysvar::CH_NM::CH__NMAppl_EPS = 2;
	settimer(Timer_CH__NMAppl_EPS, 1100);
	if (@sysvar::CH_NM::CH__NMNm_EPS == 2)
	{
		if (@sysvar::CH_NM::CH__NMStat_EPS != 3) @sysvar::CH_NM::CH__NMStat_EPS = 3;
	}
	else
	{
		if (@sysvar::CH_NM::CH__NMStat_EPS != 4) @sysvar::CH_NM::CH__NMStat_EPS = 4;
	}
	output(this);
}
/*@@end*/

/*@@frPDU:MsgChannel1.CHASSIS::STA_Rs1_AR2:*/
on frPDU MsgChannel1.CHASSIS::STA_Rs1_AR2
{
	if (@sysvar::CH_NM::CH__NMAppl_EPS != 2) @sysvar::CH_NM::CH__NMAppl_EPS = 2;
	settimer(Timer_CH__NMAppl_EPS, 1100);
	if (@sysvar::CH_NM::CH__NMNm_EPS == 2)
	{
		if (@sysvar::CH_NM::CH__NMStat_EPS != 3) @sysvar::CH_NM::CH__NMStat_EPS = 3;
	}
	else
	{
		if (@sysvar::CH_NM::CH__NMStat_EPS != 4) @sysvar::CH_NM::CH__NMStat_EPS = 4;
	}
	output(this);
}
/*@@end*/

/*@@frPDU:MsgChannel1.CHASSIS::TBCSC_EPS_DAC_AR2:*/
on frPDU MsgChannel1.CHASSIS::TBCSC_EPS_DAC_AR2
{
	if (@sysvar::CH_NM::CH__NMAppl_EPS != 2) @sysvar::CH_NM::CH__NMAppl_EPS = 2;
	settimer(Timer_CH__NMAppl_EPS, 1100);
	if (@sysvar::CH_NM::CH__NMNm_EPS == 2)
	{
		if (@sysvar::CH_NM::CH__NMStat_EPS != 3) @sysvar::CH_NM::CH__NMStat_EPS = 3;
	}
	else
	{
		if (@sysvar::CH_NM::CH__NMStat_EPS != 4) @sysvar::CH_NM::CH__NMStat_EPS = 4;
	}
	output(this);
}
/*@@end*/

/*@@frPDU:MsgChannel1.CHASSIS::TBCSC_Rs_EPS_AR2:*/
on frPDU MsgChannel1.CHASSIS::TBCSC_Rs_EPS_AR2
{
	if (@sysvar::CH_NM::CH__NMAppl_EPS != 2) @sysvar::CH_NM::CH__NMAppl_EPS = 2;
	settimer(Timer_CH__NMAppl_EPS, 1100);
	if (@sysvar::CH_NM::CH__NMNm_EPS == 2)
	{
		if (@sysvar::CH_NM::CH__NMStat_EPS != 3) @sysvar::CH_NM::CH__NMStat_EPS = 3;
	}
	else
	{
		if (@sysvar::CH_NM::CH__NMStat_EPS != 4) @sysvar::CH_NM::CH__NMStat_EPS = 4;
	}
	output(this);
}
/*@@end*/

/*@@frPDU:MsgChannel1.CHASSIS::WUDOP_EPS_FR:*/
on frPDU MsgChannel1.CHASSIS::WUDOP_EPS_FR
{
	if (@sysvar::CH_NM::CH__NMAppl_EPS != 2) @sysvar::CH_NM::CH__NMAppl_EPS = 2;
	settimer(Timer_CH__NMAppl_EPS, 1100);
	if (@sysvar::CH_NM::CH__NMNm_EPS == 2)
	{
		if (@sysvar::CH_NM::CH__NMStat_EPS != 3) @sysvar::CH_NM::CH__NMStat_EPS = 3;
	}
	else
	{
		if (@sysvar::CH_NM::CH__NMStat_EPS != 4) @sysvar::CH_NM::CH__NMStat_EPS = 4;
	}
	output(this);
}
/*@@end*/

/*@@frPDU:MsgChannel1.CHASSIS::AWD_TCASE_Rq_ESP_AR2:*/
on frPDU MsgChannel1.CHASSIS::AWD_TCASE_Rq_ESP_AR2
{
	if (@sysvar::CH_NM::CH__NMAppl_ESP != 2) @sysvar::CH_NM::CH__NMAppl_ESP = 2;
	settimer(Timer_CH__NMAppl_ESP, 1100);
	if (@sysvar::CH_NM::CH__NMNm_ESP == 2)
	{
		if (@sysvar::CH_NM::CH__NMStat_ESP != 3) @sysvar::CH_NM::CH__NMStat_ESP = 3;
	}
	else
	{
		if (@sysvar::CH_NM::CH__NMStat_ESP != 4) @sysvar::CH_NM::CH__NMStat_ESP = 4;
	}
	output(this);
}
/*@@end*/

/*@@frPDU:MsgChannel1.CHASSIS::BrkSys_Stat_AR2:*/
on frPDU MsgChannel1.CHASSIS::BrkSys_Stat_AR2
{
	if (@sysvar::CH_NM::CH__NMAppl_ESP != 2) @sysvar::CH_NM::CH__NMAppl_ESP = 2;
	settimer(Timer_CH__NMAppl_ESP, 1100);
	if (@sysvar::CH_NM::CH__NMNm_ESP == 2)
	{
		if (@sysvar::CH_NM::CH__NMStat_ESP != 3) @sysvar::CH_NM::CH__NMStat_ESP = 3;
	}
	else
	{
		if (@sysvar::CH_NM::CH__NMStat_ESP != 4) @sysvar::CH_NM::CH__NMStat_ESP = 4;
	}
	output(this);
}
/*@@end*/

/*@@frPDU:MsgChannel1.CHASSIS::DPC_Disp_Rq_AR2:*/
on frPDU MsgChannel1.CHASSIS::DPC_Disp_Rq_AR2
{
	if (@sysvar::CH_NM::CH__NMAppl_ESP != 2) @sysvar::CH_NM::CH__NMAppl_ESP = 2;
	settimer(Timer_CH__NMAppl_ESP, 1100);
	if (@sysvar::CH_NM::CH__NMNm_ESP == 2)
	{
		if (@sysvar::CH_NM::CH__NMStat_ESP != 3) @sysvar::CH_NM::CH__NMStat_ESP = 3;
	}
	else
	{
		if (@sysvar::CH_NM::CH__NMStat_ESP != 4) @sysvar::CH_NM::CH__NMStat_ESP = 4;
	}
	output(this);
}
/*@@end*/

/*@@frPDU:MsgChannel1.CHASSIS::DPC_IndMd_Stat_AR2:*/
on frPDU MsgChannel1.CHASSIS::DPC_IndMd_Stat_AR2
{
	if (@sysvar::CH_NM::CH__NMAppl_ESP != 2) @sysvar::CH_NM::CH__NMAppl_ESP = 2;
	settimer(Timer_CH__NMAppl_ESP, 1100);
	if (@sysvar::CH_NM::CH__NMNm_ESP == 2)
	{
		if (@sysvar::CH_NM::CH__NMStat_ESP != 3) @sysvar::CH_NM::CH__NMStat_ESP = 3;
	}
	else
	{
		if (@sysvar::CH_NM::CH__NMStat_ESP != 4) @sysvar::CH_NM::CH__NMStat_ESP = 4;
	}
	output(this);
}
/*@@end*/

/*@@frPDU:MsgChannel1.CHASSIS::DPC_IndMd_Style2_AR2:*/
on frPDU MsgChannel1.CHASSIS::DPC_IndMd_Style2_AR2
{
	if (@sysvar::CH_NM::CH__NMAppl_ESP != 2) @sysvar::CH_NM::CH__NMAppl_ESP = 2;
	settimer(Timer_CH__NMAppl_ESP, 1100);
	if (@sysvar::CH_NM::CH__NMNm_ESP == 2)
	{
		if (@sysvar::CH_NM::CH__NMStat_ESP != 3) @sysvar::CH_NM::CH__NMStat_ESP = 3;
	}
	else
	{
		if (@sysvar::CH_NM::CH__NMStat_ESP != 4) @sysvar::CH_NM::CH__NMStat_ESP = 4;
	}
	output(this);
}
/*@@end*/

/*@@frPDU:MsgChannel1.CHASSIS::DPC_IndMd_Style_AR2:*/
on frPDU MsgChannel1.CHASSIS::DPC_IndMd_Style_AR2
{
	if (@sysvar::CH_NM::CH__NMAppl_ESP != 2) @sysvar::CH_NM::CH__NMAppl_ESP = 2;
	settimer(Timer_CH__NMAppl_ESP, 1100);
	if (@sysvar::CH_NM::CH__NMNm_ESP == 2)
	{
		if (@sysvar::CH_NM::CH__NMStat_ESP != 3) @sysvar::CH_NM::CH__NMStat_ESP = 3;
	}
	else
	{
		if (@sysvar::CH_NM::CH__NMStat_ESP != 4) @sysvar::CH_NM::CH__NMStat_ESP = 4;
	}
	output(this);
}
/*@@end*/

/*@@frPDU:MsgChannel1.CHASSIS::DPC_Master_Rq_AR2:*/
on frPDU MsgChannel1.CHASSIS::DPC_Master_Rq_AR2
{
	if (@sysvar::CH_NM::CH__NMAppl_ESP != 2) @sysvar::CH_NM::CH__NMAppl_ESP = 2;
	settimer(Timer_CH__NMAppl_ESP, 1100);
	if (@sysvar::CH_NM::CH__NMNm_ESP == 2)
	{
		if (@sysvar::CH_NM::CH__NMStat_ESP != 3) @sysvar::CH_NM::CH__NMStat_ESP = 3;
	}
	else
	{
		if (@sysvar::CH_NM::CH__NMStat_ESP != 4) @sysvar::CH_NM::CH__NMStat_ESP = 4;
	}
	output(this);
}
/*@@end*/

/*@@frPDU:MsgChannel1.CHASSIS::Eng_Susp_Rq_AS_AR2:*/
on frPDU MsgChannel1.CHASSIS::Eng_Susp_Rq_AS_AR2
{
	if (@sysvar::CH_NM::CH__NMAppl_ESP != 2) @sysvar::CH_NM::CH__NMAppl_ESP = 2;
	settimer(Timer_CH__NMAppl_ESP, 1100);
	if (@sysvar::CH_NM::CH__NMNm_ESP == 2)
	{
		if (@sysvar::CH_NM::CH__NMStat_ESP != 3) @sysvar::CH_NM::CH__NMStat_ESP = 3;
	}
	else
	{
		if (@sysvar::CH_NM::CH__NMStat_ESP != 4) @sysvar::CH_NM::CH__NMStat_ESP = 4;
	}
	output(this);
}
/*@@end*/

/*@@frPDU:MsgChannel1.CHASSIS::EPKB_Disp_IndLmp_Rq_2_AR2:*/
on frPDU MsgChannel1.CHASSIS::EPKB_Disp_IndLmp_Rq_2_AR2
{
	if (@sysvar::CH_NM::CH__NMAppl_ESP != 2) @sysvar::CH_NM::CH__NMAppl_ESP = 2;
	settimer(Timer_CH__NMAppl_ESP, 1100);
	if (@sysvar::CH_NM::CH__NMNm_ESP == 2)
	{
		if (@sysvar::CH_NM::CH__NMStat_ESP != 3) @sysvar::CH_NM::CH__NMStat_ESP = 3;
	}
	else
	{
		if (@sysvar::CH_NM::CH__NMStat_ESP != 4) @sysvar::CH_NM::CH__NMStat_ESP = 4;
	}
	output(this);
}
/*@@end*/

/*@@frPDU:MsgChannel1.CHASSIS::EPKB_Stat_Gw_AR2:*/
on frPDU MsgChannel1.CHASSIS::EPKB_Stat_Gw_AR2
{
	if (@sysvar::CH_NM::CH__NMAppl_ESP != 2) @sysvar::CH_NM::CH__NMAppl_ESP = 2;
	settimer(Timer_CH__NMAppl_ESP, 1100);
	if (@sysvar::CH_NM::CH__NMNm_ESP == 2)
	{
		if (@sysvar::CH_NM::CH__NMStat_ESP != 3) @sysvar::CH_NM::CH__NMStat_ESP = 3;
	}
	else
	{
		if (@sysvar::CH_NM::CH__NMStat_ESP != 4) @sysvar::CH_NM::CH__NMStat_ESP = 4;
	}
	output(this);
}
/*@@end*/

/*@@frPDU:MsgChannel1.CHASSIS::ESP_Disp_Rq2_AR2:*/
on frPDU MsgChannel1.CHASSIS::ESP_Disp_Rq2_AR2
{
	if (@sysvar::CH_NM::CH__NMAppl_ESP != 2) @sysvar::CH_NM::CH__NMAppl_ESP = 2;
	settimer(Timer_CH__NMAppl_ESP, 1100);
	if (@sysvar::CH_NM::CH__NMNm_ESP == 2)
	{
		if (@sysvar::CH_NM::CH__NMStat_ESP != 3) @sysvar::CH_NM::CH__NMStat_ESP = 3;
	}
	else
	{
		if (@sysvar::CH_NM::CH__NMStat_ESP != 4) @sysvar::CH_NM::CH__NMStat_ESP = 4;
	}
	output(this);
}
/*@@end*/

/*@@frPDU:MsgChannel1.CHASSIS::ESP_Disp_Rq3_AR:*/
on frPDU MsgChannel1.CHASSIS::ESP_Disp_Rq3_AR
{
	if (@sysvar::CH_NM::CH__NMAppl_ESP != 2) @sysvar::CH_NM::CH__NMAppl_ESP = 2;
	settimer(Timer_CH__NMAppl_ESP, 1100);
	if (@sysvar::CH_NM::CH__NMNm_ESP == 2)
	{
		if (@sysvar::CH_NM::CH__NMStat_ESP != 3) @sysvar::CH_NM::CH__NMStat_ESP = 3;
	}
	else
	{
		if (@sysvar::CH_NM::CH__NMStat_ESP != 4) @sysvar::CH_NM::CH__NMStat_ESP = 4;
	}
	output(this);
}
/*@@end*/

/*@@frPDU:MsgChannel1.CHASSIS::ESP_Disp_Rq_AMG_AR2:*/
on frPDU MsgChannel1.CHASSIS::ESP_Disp_Rq_AMG_AR2
{
	if (@sysvar::CH_NM::CH__NMAppl_ESP != 2) @sysvar::CH_NM::CH__NMAppl_ESP = 2;
	settimer(Timer_CH__NMAppl_ESP, 1100);
	if (@sysvar::CH_NM::CH__NMNm_ESP == 2)
	{
		if (@sysvar::CH_NM::CH__NMStat_ESP != 3) @sysvar::CH_NM::CH__NMStat_ESP = 3;
	}
	else
	{
		if (@sysvar::CH_NM::CH__NMStat_ESP != 4) @sysvar::CH_NM::CH__NMStat_ESP = 4;
	}
	output(this);
}
/*@@end*/

/*@@frPDU:MsgChannel1.CHASSIS::ESP_Disp_Rq_AR2:*/
on frPDU MsgChannel1.CHASSIS::ESP_Disp_Rq_AR2
{
	if (@sysvar::CH_NM::CH__NMAppl_ESP != 2) @sysvar::CH_NM::CH__NMAppl_ESP = 2;
	settimer(Timer_CH__NMAppl_ESP, 1100);
	if (@sysvar::CH_NM::CH__NMNm_ESP == 2)
	{
		if (@sysvar::CH_NM::CH__NMStat_ESP != 3) @sysvar::CH_NM::CH__NMStat_ESP = 3;
	}
	else
	{
		if (@sysvar::CH_NM::CH__NMStat_ESP != 4) @sysvar::CH_NM::CH__NMStat_ESP = 4;
	}
	output(this);
}
/*@@end*/

/*@@frPDU:MsgChannel1.CHASSIS::ESP_OBD_Stat_AR:*/
on frPDU MsgChannel1.CHASSIS::ESP_OBD_Stat_AR
{
	if (@sysvar::CH_NM::CH__NMAppl_ESP != 2) @sysvar::CH_NM::CH__NMAppl_ESP = 2;
	settimer(Timer_CH__NMAppl_ESP, 1100);
	if (@sysvar::CH_NM::CH__NMNm_ESP == 2)
	{
		if (@sysvar::CH_NM::CH__NMStat_ESP != 3) @sysvar::CH_NM::CH__NMStat_ESP = 3;
	}
	else
	{
		if (@sysvar::CH_NM::CH__NMStat_ESP != 4) @sysvar::CH_NM::CH__NMStat_ESP = 4;
	}
	output(this);
}
/*@@end*/

/*@@frPDU:MsgChannel1.CHASSIS::ESP_Stat1_AR2:*/
on frPDU MsgChannel1.CHASSIS::ESP_Stat1_AR2
{
	if (@sysvar::CH_NM::CH__NMAppl_ESP != 2) @sysvar::CH_NM::CH__NMAppl_ESP = 2;
	settimer(Timer_CH__NMAppl_ESP, 1100);
	if (@sysvar::CH_NM::CH__NMNm_ESP == 2)
	{
		if (@sysvar::CH_NM::CH__NMStat_ESP != 3) @sysvar::CH_NM::CH__NMStat_ESP = 3;
	}
	else
	{
		if (@sysvar::CH_NM::CH__NMStat_ESP != 4) @sysvar::CH_NM::CH__NMStat_ESP = 4;
	}
	output(this);
}
/*@@end*/

/*@@frPDU:MsgChannel1.CHASSIS::LDC_Disp_Rq_ESP_AR:*/
on frPDU MsgChannel1.CHASSIS::LDC_Disp_Rq_ESP_AR
{
	if (@sysvar::CH_NM::CH__NMAppl_ESP != 2) @sysvar::CH_NM::CH__NMAppl_ESP = 2;
	settimer(Timer_CH__NMAppl_ESP, 1100);
	if (@sysvar::CH_NM::CH__NMNm_ESP == 2)
	{
		if (@sysvar::CH_NM::CH__NMStat_ESP != 3) @sysvar::CH_NM::CH__NMStat_ESP = 3;
	}
	else
	{
		if (@sysvar::CH_NM::CH__NMStat_ESP != 4) @sysvar::CH_NM::CH__NMStat_ESP = 4;
	}
	output(this);
}
/*@@end*/

/*@@frPDU:MsgChannel1.CHASSIS::PARK_Brk_Rs_AR2:*/
on frPDU MsgChannel1.CHASSIS::PARK_Brk_Rs_AR2
{
	if (@sysvar::CH_NM::CH__NMAppl_ESP != 2) @sysvar::CH_NM::CH__NMAppl_ESP = 2;
	settimer(Timer_CH__NMAppl_ESP, 1100);
	if (@sysvar::CH_NM::CH__NMNm_ESP == 2)
	{
		if (@sysvar::CH_NM::CH__NMStat_ESP != 3) @sysvar::CH_NM::CH__NMStat_ESP = 3;
	}
	else
	{
		if (@sysvar::CH_NM::CH__NMStat_ESP != 4) @sysvar::CH_NM::CH__NMStat_ESP = 4;
	}
	output(this);
}
/*@@end*/

/*@@frPDU:MsgChannel1.CHASSIS::PARK_Drv_Rq_ESP_AR2:*/
on frPDU MsgChannel1.CHASSIS::PARK_Drv_Rq_ESP_AR2
{
	if (@sysvar::CH_NM::CH__NMAppl_ESP != 2) @sysvar::CH_NM::CH__NMAppl_ESP = 2;
	settimer(Timer_CH__NMAppl_ESP, 1100);
	if (@sysvar::CH_NM::CH__NMNm_ESP == 2)
	{
		if (@sysvar::CH_NM::CH__NMStat_ESP != 3) @sysvar::CH_NM::CH__NMStat_ESP = 3;
	}
	else
	{
		if (@sysvar::CH_NM::CH__NMStat_ESP != 4) @sysvar::CH_NM::CH__NMStat_ESP = 4;
	}
	output(this);
}
/*@@end*/

/*@@frPDU:MsgChannel1.CHASSIS::PresfCtrl_Rq_ESP_AR2:*/
on frPDU MsgChannel1.CHASSIS::PresfCtrl_Rq_ESP_AR2
{
	if (@sysvar::CH_NM::CH__NMAppl_ESP != 2) @sysvar::CH_NM::CH__NMAppl_ESP = 2;
	settimer(Timer_CH__NMAppl_ESP, 1100);
	if (@sysvar::CH_NM::CH__NMNm_ESP == 2)
	{
		if (@sysvar::CH_NM::CH__NMStat_ESP != 3) @sysvar::CH_NM::CH__NMStat_ESP = 3;
	}
	else
	{
		if (@sysvar::CH_NM::CH__NMStat_ESP != 4) @sysvar::CH_NM::CH__NMStat_ESP = 4;
	}
	output(this);
}
/*@@end*/

/*@@frPDU:MsgChannel1.CHASSIS::PT_Rq_ESP_AR2:*/
on frPDU MsgChannel1.CHASSIS::PT_Rq_ESP_AR2
{
	if (@sysvar::CH_NM::CH__NMAppl_ESP != 2) @sysvar::CH_NM::CH__NMAppl_ESP = 2;
	settimer(Timer_CH__NMAppl_ESP, 1100);
	if (@sysvar::CH_NM::CH__NMNm_ESP == 2)
	{
		if (@sysvar::CH_NM::CH__NMStat_ESP != 3) @sysvar::CH_NM::CH__NMStat_ESP = 3;
	}
	else
	{
		if (@sysvar::CH_NM::CH__NMStat_ESP != 4) @sysvar::CH_NM::CH__NMStat_ESP = 4;
	}
	output(this);
}
/*@@end*/

/*@@frPDU:MsgChannel1.CHASSIS::ROE_ESP:*/
on frPDU MsgChannel1.CHASSIS::ROE_ESP
{
	if (@sysvar::CH_NM::CH__NMAppl_ESP != 2) @sysvar::CH_NM::CH__NMAppl_ESP = 2;
	settimer(Timer_CH__NMAppl_ESP, 1100);
	if (@sysvar::CH_NM::CH__NMNm_ESP == 2)
	{
		if (@sysvar::CH_NM::CH__NMStat_ESP != 3) @sysvar::CH_NM::CH__NMStat_ESP = 3;
	}
	else
	{
		if (@sysvar::CH_NM::CH__NMStat_ESP != 4) @sysvar::CH_NM::CH__NMStat_ESP = 4;
	}
	output(this);
}
/*@@end*/

/*@@frPDU:MsgChannel1.CHASSIS::SADR_Trgr_ESP_AR2:*/
on frPDU MsgChannel1.CHASSIS::SADR_Trgr_ESP_AR2
{
	if (@sysvar::CH_NM::CH__NMAppl_ESP != 2) @sysvar::CH_NM::CH__NMAppl_ESP = 2;
	settimer(Timer_CH__NMAppl_ESP, 1100);
	if (@sysvar::CH_NM::CH__NMNm_ESP == 2)
	{
		if (@sysvar::CH_NM::CH__NMStat_ESP != 3) @sysvar::CH_NM::CH__NMStat_ESP = 3;
	}
	else
	{
		if (@sysvar::CH_NM::CH__NMStat_ESP != 4) @sysvar::CH_NM::CH__NMStat_ESP = 4;
	}
	output(this);
}
/*@@end*/

/*@@frPDU:MsgChannel1.CHASSIS::St_Rq_STA_AR2:*/
on frPDU MsgChannel1.CHASSIS::St_Rq_STA_AR2
{
	if (@sysvar::CH_NM::CH__NMAppl_ESP != 2) @sysvar::CH_NM::CH__NMAppl_ESP = 2;
	settimer(Timer_CH__NMAppl_ESP, 1100);
	if (@sysvar::CH_NM::CH__NMNm_ESP == 2)
	{
		if (@sysvar::CH_NM::CH__NMStat_ESP != 3) @sysvar::CH_NM::CH__NMStat_ESP = 3;
	}
	else
	{
		if (@sysvar::CH_NM::CH__NMStat_ESP != 4) @sysvar::CH_NM::CH__NMStat_ESP = 4;
	}
	output(this);
}
/*@@end*/

/*@@frPDU:MsgChannel1.CHASSIS::TBCSC_ESP_DAC_AR2:*/
on frPDU MsgChannel1.CHASSIS::TBCSC_ESP_DAC_AR2
{
	if (@sysvar::CH_NM::CH__NMAppl_ESP != 2) @sysvar::CH_NM::CH__NMAppl_ESP = 2;
	settimer(Timer_CH__NMAppl_ESP, 1100);
	if (@sysvar::CH_NM::CH__NMNm_ESP == 2)
	{
		if (@sysvar::CH_NM::CH__NMStat_ESP != 3) @sysvar::CH_NM::CH__NMStat_ESP = 3;
	}
	else
	{
		if (@sysvar::CH_NM::CH__NMStat_ESP != 4) @sysvar::CH_NM::CH__NMStat_ESP = 4;
	}
	output(this);
}
/*@@end*/

/*@@frPDU:MsgChannel1.CHASSIS::TBCSC_Rs1_ESP_AR2:*/
on frPDU MsgChannel1.CHASSIS::TBCSC_Rs1_ESP_AR2
{
	if (@sysvar::CH_NM::CH__NMAppl_ESP != 2) @sysvar::CH_NM::CH__NMAppl_ESP = 2;
	settimer(Timer_CH__NMAppl_ESP, 1100);
	if (@sysvar::CH_NM::CH__NMNm_ESP == 2)
	{
		if (@sysvar::CH_NM::CH__NMStat_ESP != 3) @sysvar::CH_NM::CH__NMStat_ESP = 3;
	}
	else
	{
		if (@sysvar::CH_NM::CH__NMStat_ESP != 4) @sysvar::CH_NM::CH__NMStat_ESP = 4;
	}
	output(this);
}
/*@@end*/

/*@@frPDU:MsgChannel1.CHASSIS::TBCSC_Rs2_ESP_AR2:*/
on frPDU MsgChannel1.CHASSIS::TBCSC_Rs2_ESP_AR2
{
	if (@sysvar::CH_NM::CH__NMAppl_ESP != 2) @sysvar::CH_NM::CH__NMAppl_ESP = 2;
	settimer(Timer_CH__NMAppl_ESP, 1100);
	if (@sysvar::CH_NM::CH__NMNm_ESP == 2)
	{
		if (@sysvar::CH_NM::CH__NMStat_ESP != 3) @sysvar::CH_NM::CH__NMStat_ESP = 3;
	}
	else
	{
		if (@sysvar::CH_NM::CH__NMStat_ESP != 4) @sysvar::CH_NM::CH__NMStat_ESP = 4;
	}
	output(this);
}
/*@@end*/

/*@@frPDU:MsgChannel1.CHASSIS::VehAccel_X_Rs1_AR2:*/
on frPDU MsgChannel1.CHASSIS::VehAccel_X_Rs1_AR2
{
	if (@sysvar::CH_NM::CH__NMAppl_ESP != 2) @sysvar::CH_NM::CH__NMAppl_ESP = 2;
	settimer(Timer_CH__NMAppl_ESP, 1100);
	if (@sysvar::CH_NM::CH__NMNm_ESP == 2)
	{
		if (@sysvar::CH_NM::CH__NMStat_ESP != 3) @sysvar::CH_NM::CH__NMStat_ESP = 3;
	}
	else
	{
		if (@sysvar::CH_NM::CH__NMStat_ESP != 4) @sysvar::CH_NM::CH__NMStat_ESP = 4;
	}
	output(this);
}
/*@@end*/

/*@@frPDU:MsgChannel1.CHASSIS::VehAccel_X_Rs2_AR2:*/
on frPDU MsgChannel1.CHASSIS::VehAccel_X_Rs2_AR2
{
	if (@sysvar::CH_NM::CH__NMAppl_ESP != 2) @sysvar::CH_NM::CH__NMAppl_ESP = 2;
	settimer(Timer_CH__NMAppl_ESP, 1100);
	if (@sysvar::CH_NM::CH__NMNm_ESP == 2)
	{
		if (@sysvar::CH_NM::CH__NMStat_ESP != 3) @sysvar::CH_NM::CH__NMStat_ESP = 3;
	}
	else
	{
		if (@sysvar::CH_NM::CH__NMStat_ESP != 4) @sysvar::CH_NM::CH__NMStat_ESP = 4;
	}
	output(this);
}
/*@@end*/

/*@@frPDU:MsgChannel1.CHASSIS::VehDyn_Stat1_AR2:*/
on frPDU MsgChannel1.CHASSIS::VehDyn_Stat1_AR2
{
	if (@sysvar::CH_NM::CH__NMAppl_ESP != 2) @sysvar::CH_NM::CH__NMAppl_ESP = 2;
	settimer(Timer_CH__NMAppl_ESP, 1100);
	if (@sysvar::CH_NM::CH__NMNm_ESP == 2)
	{
		if (@sysvar::CH_NM::CH__NMStat_ESP != 3) @sysvar::CH_NM::CH__NMStat_ESP = 3;
	}
	else
	{
		if (@sysvar::CH_NM::CH__NMStat_ESP != 4) @sysvar::CH_NM::CH__NMStat_ESP = 4;
	}
	output(this);
}
/*@@end*/

/*@@frPDU:MsgChannel1.CHASSIS::VehDyn_Stat2_AR2:*/
on frPDU MsgChannel1.CHASSIS::VehDyn_Stat2_AR2
{
	if (@sysvar::CH_NM::CH__NMAppl_ESP != 2) @sysvar::CH_NM::CH__NMAppl_ESP = 2;
	settimer(Timer_CH__NMAppl_ESP, 1100);
	if (@sysvar::CH_NM::CH__NMNm_ESP == 2)
	{
		if (@sysvar::CH_NM::CH__NMStat_ESP != 3) @sysvar::CH_NM::CH__NMStat_ESP = 3;
	}
	else
	{
		if (@sysvar::CH_NM::CH__NMStat_ESP != 4) @sysvar::CH_NM::CH__NMStat_ESP = 4;
	}
	output(this);
}
/*@@end*/

/*@@frPDU:MsgChannel1.CHASSIS::VehSpd_X_AR2:*/
on frPDU MsgChannel1.CHASSIS::VehSpd_X_AR2
{
	if (@sysvar::CH_NM::CH__NMAppl_ESP != 2) @sysvar::CH_NM::CH__NMAppl_ESP = 2;
	settimer(Timer_CH__NMAppl_ESP, 1100);
	if (@sysvar::CH_NM::CH__NMNm_ESP == 2)
	{
		if (@sysvar::CH_NM::CH__NMStat_ESP != 3) @sysvar::CH_NM::CH__NMStat_ESP = 3;
	}
	else
	{
		if (@sysvar::CH_NM::CH__NMStat_ESP != 4) @sysvar::CH_NM::CH__NMStat_ESP = 4;
	}
	output(this);
}
/*@@end*/

/*@@frPDU:MsgChannel1.CHASSIS::Whl_Lt_Stat_AR2:*/
on frPDU MsgChannel1.CHASSIS::Whl_Lt_Stat_AR2
{
	if (@sysvar::CH_NM::CH__NMAppl_ESP != 2) @sysvar::CH_NM::CH__NMAppl_ESP = 2;
	settimer(Timer_CH__NMAppl_ESP, 1100);
	if (@sysvar::CH_NM::CH__NMNm_ESP == 2)
	{
		if (@sysvar::CH_NM::CH__NMStat_ESP != 3) @sysvar::CH_NM::CH__NMStat_ESP = 3;
	}
	else
	{
		if (@sysvar::CH_NM::CH__NMStat_ESP != 4) @sysvar::CH_NM::CH__NMStat_ESP = 4;
	}
	output(this);
}
/*@@end*/

/*@@frPDU:MsgChannel1.CHASSIS::Whl_Rt_Stat_AR2:*/
on frPDU MsgChannel1.CHASSIS::Whl_Rt_Stat_AR2
{
	if (@sysvar::CH_NM::CH__NMAppl_ESP != 2) @sysvar::CH_NM::CH__NMAppl_ESP = 2;
	settimer(Timer_CH__NMAppl_ESP, 1100);
	if (@sysvar::CH_NM::CH__NMNm_ESP == 2)
	{
		if (@sysvar::CH_NM::CH__NMStat_ESP != 3) @sysvar::CH_NM::CH__NMStat_ESP = 3;
	}
	else
	{
		if (@sysvar::CH_NM::CH__NMStat_ESP != 4) @sysvar::CH_NM::CH__NMStat_ESP = 4;
	}
	output(this);
}
/*@@end*/

/*@@frPDU:MsgChannel1.CHASSIS::WhlPlsCnt_TPM_AR2:*/
on frPDU MsgChannel1.CHASSIS::WhlPlsCnt_TPM_AR2
{
	if (@sysvar::CH_NM::CH__NMAppl_ESP != 2) @sysvar::CH_NM::CH__NMAppl_ESP = 2;
	settimer(Timer_CH__NMAppl_ESP, 1100);
	if (@sysvar::CH_NM::CH__NMNm_ESP == 2)
	{
		if (@sysvar::CH_NM::CH__NMStat_ESP != 3) @sysvar::CH_NM::CH__NMStat_ESP = 3;
	}
	else
	{
		if (@sysvar::CH_NM::CH__NMStat_ESP != 4) @sysvar::CH_NM::CH__NMStat_ESP = 4;
	}
	output(this);
}
/*@@end*/

/*@@frPDU:MsgChannel1.CHASSIS::WUDOP_ESP_FR:*/
on frPDU MsgChannel1.CHASSIS::WUDOP_ESP_FR
{
	if (@sysvar::CH_NM::CH__NMAppl_ESP != 2) @sysvar::CH_NM::CH__NMAppl_ESP = 2;
	settimer(Timer_CH__NMAppl_ESP, 1100);
	if (@sysvar::CH_NM::CH__NMNm_ESP == 2)
	{
		if (@sysvar::CH_NM::CH__NMStat_ESP != 3) @sysvar::CH_NM::CH__NMStat_ESP = 3;
	}
	else
	{
		if (@sysvar::CH_NM::CH__NMStat_ESP != 4) @sysvar::CH_NM::CH__NMStat_ESP = 4;
	}
	output(this);
}
/*@@end*/

/*@@frPDU:MsgChannel1.CHASSIS::YMAS_Rs_AR2:*/
on frPDU MsgChannel1.CHASSIS::YMAS_Rs_AR2
{
	if (@sysvar::CH_NM::CH__NMAppl_ESP != 2) @sysvar::CH_NM::CH__NMAppl_ESP = 2;
	settimer(Timer_CH__NMAppl_ESP, 1100);
	if (@sysvar::CH_NM::CH__NMNm_ESP == 2)
	{
		if (@sysvar::CH_NM::CH__NMStat_ESP != 3) @sysvar::CH_NM::CH__NMStat_ESP = 3;
	}
	else
	{
		if (@sysvar::CH_NM::CH__NMStat_ESP != 4) @sysvar::CH_NM::CH__NMStat_ESP = 4;
	}
	output(this);
}
/*@@end*/

/*@@frPDU:MsgChannel1.CHASSIS::CMS_PI_State_AR2:*/
on frPDU MsgChannel1.CHASSIS::CMS_PI_State_AR2
{
	if (@sysvar::CH_NM::CH__NMAppl_FCWRDUSDTR != 2) @sysvar::CH_NM::CH__NMAppl_FCWRDUSDTR = 2;
	settimer(Timer_CH__NMAppl_FCWRDUSDTR, 1100);
	if (@sysvar::CH_NM::CH__NMNm_FCWRDUSDTR == 2)
	{
		if (@sysvar::CH_NM::CH__NMStat_FCWRDUSDTR != 3) @sysvar::CH_NM::CH__NMStat_FCWRDUSDTR = 3;
	}
	else
	{
		if (@sysvar::CH_NM::CH__NMStat_FCWRDUSDTR != 4) @sysvar::CH_NM::CH__NMStat_FCWRDUSDTR = 4;
	}
	output(this);
}
/*@@end*/

/*@@frPDU:MsgChannel1.CHASSIS::FCW_Disp_Rq_Gw_AR:*/
on frPDU MsgChannel1.CHASSIS::FCW_Disp_Rq_Gw_AR
{
	if (@sysvar::CH_NM::CH__NMAppl_FCWRDUSDTR != 2) @sysvar::CH_NM::CH__NMAppl_FCWRDUSDTR = 2;
	settimer(Timer_CH__NMAppl_FCWRDUSDTR, 1100);
	if (@sysvar::CH_NM::CH__NMNm_FCWRDUSDTR == 2)
	{
		if (@sysvar::CH_NM::CH__NMStat_FCWRDUSDTR != 3) @sysvar::CH_NM::CH__NMStat_FCWRDUSDTR = 3;
	}
	else
	{
		if (@sysvar::CH_NM::CH__NMStat_FCWRDUSDTR != 4) @sysvar::CH_NM::CH__NMStat_FCWRDUSDTR = 4;
	}
	output(this);
}
/*@@end*/

/*@@frPDU:MsgChannel1.CHASSIS::PT_ObjIntrst_AR2:*/
on frPDU MsgChannel1.CHASSIS::PT_ObjIntrst_AR2
{
	if (@sysvar::CH_NM::CH__NMAppl_FCWRDUSDTR != 2) @sysvar::CH_NM::CH__NMAppl_FCWRDUSDTR = 2;
	settimer(Timer_CH__NMAppl_FCWRDUSDTR, 1100);
	if (@sysvar::CH_NM::CH__NMNm_FCWRDUSDTR == 2)
	{
		if (@sysvar::CH_NM::CH__NMStat_FCWRDUSDTR != 3) @sysvar::CH_NM::CH__NMStat_FCWRDUSDTR = 3;
	}
	else
	{
		if (@sysvar::CH_NM::CH__NMStat_FCWRDUSDTR != 4) @sysvar::CH_NM::CH__NMStat_FCWRDUSDTR = 4;
	}
	output(this);
}
/*@@end*/

/*@@frPDU:MsgChannel1.CHASSIS::RDU_Disp_Rq_AR:*/
on frPDU MsgChannel1.CHASSIS::RDU_Disp_Rq_AR
{
	if (@sysvar::CH_NM::CH__NMAppl_FCWRDUSDTR != 2) @sysvar::CH_NM::CH__NMAppl_FCWRDUSDTR = 2;
	settimer(Timer_CH__NMAppl_FCWRDUSDTR, 1100);
	if (@sysvar::CH_NM::CH__NMNm_FCWRDUSDTR == 2)
	{
		if (@sysvar::CH_NM::CH__NMStat_FCWRDUSDTR != 3) @sysvar::CH_NM::CH__NMStat_FCWRDUSDTR = 3;
	}
	else
	{
		if (@sysvar::CH_NM::CH__NMStat_FCWRDUSDTR != 4) @sysvar::CH_NM::CH__NMStat_FCWRDUSDTR = 4;
	}
	output(this);
}
/*@@end*/

/*@@frPDU:MsgChannel1.CHASSIS::ROE_RDU:*/
on frPDU MsgChannel1.CHASSIS::ROE_RDU
{
	if (@sysvar::CH_NM::CH__NMAppl_FCWRDUSDTR != 2) @sysvar::CH_NM::CH__NMAppl_FCWRDUSDTR = 2;
	settimer(Timer_CH__NMAppl_FCWRDUSDTR, 1100);
	if (@sysvar::CH_NM::CH__NMNm_FCWRDUSDTR == 2)
	{
		if (@sysvar::CH_NM::CH__NMStat_FCWRDUSDTR != 3) @sysvar::CH_NM::CH__NMStat_FCWRDUSDTR = 3;
	}
	else
	{
		if (@sysvar::CH_NM::CH__NMStat_FCWRDUSDTR != 4) @sysvar::CH_NM::CH__NMStat_FCWRDUSDTR = 4;
	}
	output(this);
}
/*@@end*/

/*@@frPDU:MsgChannel1.CHASSIS::SADR_Trgr_RDU_AR2:*/
on frPDU MsgChannel1.CHASSIS::SADR_Trgr_RDU_AR2
{
	if (@sysvar::CH_NM::CH__NMAppl_FCWRDUSDTR != 2) @sysvar::CH_NM::CH__NMAppl_FCWRDUSDTR = 2;
	settimer(Timer_CH__NMAppl_FCWRDUSDTR, 1100);
	if (@sysvar::CH_NM::CH__NMNm_FCWRDUSDTR == 2)
	{
		if (@sysvar::CH_NM::CH__NMStat_FCWRDUSDTR != 3) @sysvar::CH_NM::CH__NMStat_FCWRDUSDTR = 3;
	}
	else
	{
		if (@sysvar::CH_NM::CH__NMStat_FCWRDUSDTR != 4) @sysvar::CH_NM::CH__NMStat_FCWRDUSDTR = 4;
	}
	output(this);
}
/*@@end*/

/*@@frPDU:MsgChannel1.CHASSIS::VehAccel_X_Rq_AR2:*/
on frPDU MsgChannel1.CHASSIS::VehAccel_X_Rq_AR2
{
	if (@sysvar::CH_NM::CH__NMAppl_FCWRDUSDTR != 2) @sysvar::CH_NM::CH__NMAppl_FCWRDUSDTR = 2;
	settimer(Timer_CH__NMAppl_FCWRDUSDTR, 1100);
	if (@sysvar::CH_NM::CH__NMNm_FCWRDUSDTR == 2)
	{
		if (@sysvar::CH_NM::CH__NMStat_FCWRDUSDTR != 3) @sysvar::CH_NM::CH__NMStat_FCWRDUSDTR = 3;
	}
	else
	{
		if (@sysvar::CH_NM::CH__NMStat_FCWRDUSDTR != 4) @sysvar::CH_NM::CH__NMStat_FCWRDUSDTR = 4;
	}
	output(this);
}
/*@@end*/

/*@@frPDU:MsgChannel1.CHASSIS::DTR_Obj_A_FR2:*/
on frPDU MsgChannel1.CHASSIS::DTR_Obj_A_FR2
{
	if (@sysvar::CH_NM::CH__NMAppl_LRR != 2) @sysvar::CH_NM::CH__NMAppl_LRR = 2;
	settimer(Timer_CH__NMAppl_LRR, 1100);
	if (@sysvar::CH_NM::CH__NMNm_LRR == 2)
	{
		if (@sysvar::CH_NM::CH__NMStat_LRR != 3) @sysvar::CH_NM::CH__NMStat_LRR = 3;
	}
	else
	{
		if (@sysvar::CH_NM::CH__NMStat_LRR != 4) @sysvar::CH_NM::CH__NMStat_LRR = 4;
	}
	output(this);
}
/*@@end*/

/*@@frPDU:MsgChannel1.CHASSIS::DTR_Obj_B_FR2:*/
on frPDU MsgChannel1.CHASSIS::DTR_Obj_B_FR2
{
	if (@sysvar::CH_NM::CH__NMAppl_LRR != 2) @sysvar::CH_NM::CH__NMAppl_LRR = 2;
	settimer(Timer_CH__NMAppl_LRR, 1100);
	if (@sysvar::CH_NM::CH__NMNm_LRR == 2)
	{
		if (@sysvar::CH_NM::CH__NMStat_LRR != 3) @sysvar::CH_NM::CH__NMStat_LRR = 3;
	}
	else
	{
		if (@sysvar::CH_NM::CH__NMStat_LRR != 4) @sysvar::CH_NM::CH__NMStat_LRR = 4;
	}
	output(this);
}
/*@@end*/

/*@@frPDU:MsgChannel1.CHASSIS::DTR_Obj_C_FR2:*/
on frPDU MsgChannel1.CHASSIS::DTR_Obj_C_FR2
{
	if (@sysvar::CH_NM::CH__NMAppl_LRR != 2) @sysvar::CH_NM::CH__NMAppl_LRR = 2;
	settimer(Timer_CH__NMAppl_LRR, 1100);
	if (@sysvar::CH_NM::CH__NMNm_LRR == 2)
	{
		if (@sysvar::CH_NM::CH__NMStat_LRR != 3) @sysvar::CH_NM::CH__NMStat_LRR = 3;
	}
	else
	{
		if (@sysvar::CH_NM::CH__NMStat_LRR != 4) @sysvar::CH_NM::CH__NMStat_LRR = 4;
	}
	output(this);
}
/*@@end*/

/*@@frPDU:MsgChannel1.CHASSIS::DTR_Obj_D_FR2:*/
on frPDU MsgChannel1.CHASSIS::DTR_Obj_D_FR2
{
	if (@sysvar::CH_NM::CH__NMAppl_LRR != 2) @sysvar::CH_NM::CH__NMAppl_LRR = 2;
	settimer(Timer_CH__NMAppl_LRR, 1100);
	if (@sysvar::CH_NM::CH__NMNm_LRR == 2)
	{
		if (@sysvar::CH_NM::CH__NMStat_LRR != 3) @sysvar::CH_NM::CH__NMStat_LRR = 3;
	}
	else
	{
		if (@sysvar::CH_NM::CH__NMStat_LRR != 4) @sysvar::CH_NM::CH__NMStat_LRR = 4;
	}
	output(this);
}
/*@@end*/

/*@@frPDU:MsgChannel1.CHASSIS::DTR_Obj_E_FR2:*/
on frPDU MsgChannel1.CHASSIS::DTR_Obj_E_FR2
{
	if (@sysvar::CH_NM::CH__NMAppl_LRR != 2) @sysvar::CH_NM::CH__NMAppl_LRR = 2;
	settimer(Timer_CH__NMAppl_LRR, 1100);
	if (@sysvar::CH_NM::CH__NMNm_LRR == 2)
	{
		if (@sysvar::CH_NM::CH__NMStat_LRR != 3) @sysvar::CH_NM::CH__NMStat_LRR = 3;
	}
	else
	{
		if (@sysvar::CH_NM::CH__NMStat_LRR != 4) @sysvar::CH_NM::CH__NMStat_LRR = 4;
	}
	output(this);
}
/*@@end*/

/*@@frPDU:MsgChannel1.CHASSIS::DTR_Obj_F_FR2:*/
on frPDU MsgChannel1.CHASSIS::DTR_Obj_F_FR2
{
	if (@sysvar::CH_NM::CH__NMAppl_LRR != 2) @sysvar::CH_NM::CH__NMAppl_LRR = 2;
	settimer(Timer_CH__NMAppl_LRR, 1100);
	if (@sysvar::CH_NM::CH__NMNm_LRR == 2)
	{
		if (@sysvar::CH_NM::CH__NMStat_LRR != 3) @sysvar::CH_NM::CH__NMStat_LRR = 3;
	}
	else
	{
		if (@sysvar::CH_NM::CH__NMStat_LRR != 4) @sysvar::CH_NM::CH__NMStat_LRR = 4;
	}
	output(this);
}
/*@@end*/

/*@@frPDU:MsgChannel1.CHASSIS::DTR_Obj_G_FR2:*/
on frPDU MsgChannel1.CHASSIS::DTR_Obj_G_FR2
{
	if (@sysvar::CH_NM::CH__NMAppl_LRR != 2) @sysvar::CH_NM::CH__NMAppl_LRR = 2;
	settimer(Timer_CH__NMAppl_LRR, 1100);
	if (@sysvar::CH_NM::CH__NMNm_LRR == 2)
	{
		if (@sysvar::CH_NM::CH__NMStat_LRR != 3) @sysvar::CH_NM::CH__NMStat_LRR = 3;
	}
	else
	{
		if (@sysvar::CH_NM::CH__NMStat_LRR != 4) @sysvar::CH_NM::CH__NMStat_LRR = 4;
	}
	output(this);
}
/*@@end*/

/*@@frPDU:MsgChannel1.CHASSIS::DTR_ObjStat_FR2:*/
on frPDU MsgChannel1.CHASSIS::DTR_ObjStat_FR2
{
	if (@sysvar::CH_NM::CH__NMAppl_LRR != 2) @sysvar::CH_NM::CH__NMAppl_LRR = 2;
	settimer(Timer_CH__NMAppl_LRR, 1100);
	if (@sysvar::CH_NM::CH__NMNm_LRR == 2)
	{
		if (@sysvar::CH_NM::CH__NMStat_LRR != 3) @sysvar::CH_NM::CH__NMStat_LRR = 3;
	}
	else
	{
		if (@sysvar::CH_NM::CH__NMStat_LRR != 4) @sysvar::CH_NM::CH__NMStat_LRR = 4;
	}
	output(this);
}
/*@@end*/

/*@@frPDU:MsgChannel1.CHASSIS::DTR_Polyg_Lt_FR2:*/
on frPDU MsgChannel1.CHASSIS::DTR_Polyg_Lt_FR2
{
	if (@sysvar::CH_NM::CH__NMAppl_LRR != 2) @sysvar::CH_NM::CH__NMAppl_LRR = 2;
	settimer(Timer_CH__NMAppl_LRR, 1100);
	if (@sysvar::CH_NM::CH__NMNm_LRR == 2)
	{
		if (@sysvar::CH_NM::CH__NMStat_LRR != 3) @sysvar::CH_NM::CH__NMStat_LRR = 3;
	}
	else
	{
		if (@sysvar::CH_NM::CH__NMStat_LRR != 4) @sysvar::CH_NM::CH__NMStat_LRR = 4;
	}
	output(this);
}
/*@@end*/

/*@@frPDU:MsgChannel1.CHASSIS::DTR_Polyg_Rt_FR2:*/
on frPDU MsgChannel1.CHASSIS::DTR_Polyg_Rt_FR2
{
	if (@sysvar::CH_NM::CH__NMAppl_LRR != 2) @sysvar::CH_NM::CH__NMAppl_LRR = 2;
	settimer(Timer_CH__NMAppl_LRR, 1100);
	if (@sysvar::CH_NM::CH__NMNm_LRR == 2)
	{
		if (@sysvar::CH_NM::CH__NMStat_LRR != 3) @sysvar::CH_NM::CH__NMStat_LRR = 3;
	}
	else
	{
		if (@sysvar::CH_NM::CH__NMStat_LRR != 4) @sysvar::CH_NM::CH__NMStat_LRR = 4;
	}
	output(this);
}
/*@@end*/

/*@@frPDU:MsgChannel1.CHASSIS::DTR_Stat_FR2:*/
on frPDU MsgChannel1.CHASSIS::DTR_Stat_FR2
{
	if (@sysvar::CH_NM::CH__NMAppl_LRR != 2) @sysvar::CH_NM::CH__NMAppl_LRR = 2;
	settimer(Timer_CH__NMAppl_LRR, 1100);
	if (@sysvar::CH_NM::CH__NMNm_LRR == 2)
	{
		if (@sysvar::CH_NM::CH__NMStat_LRR != 3) @sysvar::CH_NM::CH__NMStat_LRR = 3;
	}
	else
	{
		if (@sysvar::CH_NM::CH__NMStat_LRR != 4) @sysvar::CH_NM::CH__NMStat_LRR = 4;
	}
	output(this);
}
/*@@end*/

/*@@frPDU:MsgChannel1.CHASSIS::ROE_LRR:*/
on frPDU MsgChannel1.CHASSIS::ROE_LRR
{
	if (@sysvar::CH_NM::CH__NMAppl_LRR != 2) @sysvar::CH_NM::CH__NMAppl_LRR = 2;
	settimer(Timer_CH__NMAppl_LRR, 1100);
	if (@sysvar::CH_NM::CH__NMNm_LRR == 2)
	{
		if (@sysvar::CH_NM::CH__NMStat_LRR != 3) @sysvar::CH_NM::CH__NMStat_LRR = 3;
	}
	else
	{
		if (@sysvar::CH_NM::CH__NMStat_LRR != 4) @sysvar::CH_NM::CH__NMStat_LRR = 4;
	}
	output(this);
}
/*@@end*/

/*@@frPDU:MsgChannel1.CHASSIS::Cam_Stat_AR2:*/
on frPDU MsgChannel1.CHASSIS::Cam_Stat_AR2
{
	if (@sysvar::CH_NM::CH__NMAppl_MPC != 2) @sysvar::CH_NM::CH__NMAppl_MPC = 2;
	settimer(Timer_CH__NMAppl_MPC, 1100);
	if (@sysvar::CH_NM::CH__NMNm_MPC == 2)
	{
		if (@sysvar::CH_NM::CH__NMStat_MPC != 3) @sysvar::CH_NM::CH__NMStat_MPC = 3;
	}
	else
	{
		if (@sysvar::CH_NM::CH__NMStat_MPC != 4) @sysvar::CH_NM::CH__NMStat_MPC = 4;
	}
	output(this);
}
/*@@end*/

/*@@frPDU:MsgChannel1.CHASSIS::CamLane_Disp_Warn_Rq_Gw_AR2:*/
on frPDU MsgChannel1.CHASSIS::CamLane_Disp_Warn_Rq_Gw_AR2
{
	if (@sysvar::CH_NM::CH__NMAppl_MPC != 2) @sysvar::CH_NM::CH__NMAppl_MPC = 2;
	settimer(Timer_CH__NMAppl_MPC, 1100);
	if (@sysvar::CH_NM::CH__NMNm_MPC == 2)
	{
		if (@sysvar::CH_NM::CH__NMStat_MPC != 3) @sysvar::CH_NM::CH__NMStat_MPC = 3;
	}
	else
	{
		if (@sysvar::CH_NM::CH__NMStat_MPC != 4) @sysvar::CH_NM::CH__NMStat_MPC = 4;
	}
	output(this);
}
/*@@end*/

/*@@frPDU:MsgChannel1.CHASSIS::CamLane_FastAttr1_FR2:*/
on frPDU MsgChannel1.CHASSIS::CamLane_FastAttr1_FR2
{
	if (@sysvar::CH_NM::CH__NMAppl_MPC != 2) @sysvar::CH_NM::CH__NMAppl_MPC = 2;
	settimer(Timer_CH__NMAppl_MPC, 1100);
	if (@sysvar::CH_NM::CH__NMNm_MPC == 2)
	{
		if (@sysvar::CH_NM::CH__NMStat_MPC != 3) @sysvar::CH_NM::CH__NMStat_MPC = 3;
	}
	else
	{
		if (@sysvar::CH_NM::CH__NMStat_MPC != 4) @sysvar::CH_NM::CH__NMStat_MPC = 4;
	}
	output(this);
}
/*@@end*/

/*@@frPDU:MsgChannel1.CHASSIS::CamLane_FastAttr2_FR2:*/
on frPDU MsgChannel1.CHASSIS::CamLane_FastAttr2_FR2
{
	if (@sysvar::CH_NM::CH__NMAppl_MPC != 2) @sysvar::CH_NM::CH__NMAppl_MPC = 2;
	settimer(Timer_CH__NMAppl_MPC, 1100);
	if (@sysvar::CH_NM::CH__NMNm_MPC == 2)
	{
		if (@sysvar::CH_NM::CH__NMStat_MPC != 3) @sysvar::CH_NM::CH__NMStat_MPC = 3;
	}
	else
	{
		if (@sysvar::CH_NM::CH__NMStat_MPC != 4) @sysvar::CH_NM::CH__NMStat_MPC = 4;
	}
	output(this);
}
/*@@end*/

/*@@frPDU:MsgChannel1.CHASSIS::CamLane_LaneAttr1_Gw_AR2:*/
on frPDU MsgChannel1.CHASSIS::CamLane_LaneAttr1_Gw_AR2
{
	if (@sysvar::CH_NM::CH__NMAppl_MPC != 2) @sysvar::CH_NM::CH__NMAppl_MPC = 2;
	settimer(Timer_CH__NMAppl_MPC, 1100);
	if (@sysvar::CH_NM::CH__NMNm_MPC == 2)
	{
		if (@sysvar::CH_NM::CH__NMStat_MPC != 3) @sysvar::CH_NM::CH__NMStat_MPC = 3;
	}
	else
	{
		if (@sysvar::CH_NM::CH__NMStat_MPC != 4) @sysvar::CH_NM::CH__NMStat_MPC = 4;
	}
	output(this);
}
/*@@end*/

/*@@frPDU:MsgChannel1.CHASSIS::CamLane_LaneAttr2_Gw_AR2:*/
on frPDU MsgChannel1.CHASSIS::CamLane_LaneAttr2_Gw_AR2
{
	if (@sysvar::CH_NM::CH__NMAppl_MPC != 2) @sysvar::CH_NM::CH__NMAppl_MPC = 2;
	settimer(Timer_CH__NMAppl_MPC, 1100);
	if (@sysvar::CH_NM::CH__NMNm_MPC == 2)
	{
		if (@sysvar::CH_NM::CH__NMStat_MPC != 3) @sysvar::CH_NM::CH__NMStat_MPC = 3;
	}
	else
	{
		if (@sysvar::CH_NM::CH__NMStat_MPC != 4) @sysvar::CH_NM::CH__NMStat_MPC = 4;
	}
	output(this);
}
/*@@end*/

/*@@frPDU:MsgChannel1.CHASSIS::CamLane_LaneAttr3_Gw_AR2:*/
on frPDU MsgChannel1.CHASSIS::CamLane_LaneAttr3_Gw_AR2
{
	if (@sysvar::CH_NM::CH__NMAppl_MPC != 2) @sysvar::CH_NM::CH__NMAppl_MPC = 2;
	settimer(Timer_CH__NMAppl_MPC, 1100);
	if (@sysvar::CH_NM::CH__NMNm_MPC == 2)
	{
		if (@sysvar::CH_NM::CH__NMStat_MPC != 3) @sysvar::CH_NM::CH__NMStat_MPC = 3;
	}
	else
	{
		if (@sysvar::CH_NM::CH__NMStat_MPC != 4) @sysvar::CH_NM::CH__NMStat_MPC = 4;
	}
	output(this);
}
/*@@end*/

/*@@frPDU:MsgChannel1.CHASSIS::CamLane_LaneAttr4_FR2:*/
on frPDU MsgChannel1.CHASSIS::CamLane_LaneAttr4_FR2
{
	if (@sysvar::CH_NM::CH__NMAppl_MPC != 2) @sysvar::CH_NM::CH__NMAppl_MPC = 2;
	settimer(Timer_CH__NMAppl_MPC, 1100);
	if (@sysvar::CH_NM::CH__NMNm_MPC == 2)
	{
		if (@sysvar::CH_NM::CH__NMStat_MPC != 3) @sysvar::CH_NM::CH__NMStat_MPC = 3;
	}
	else
	{
		if (@sysvar::CH_NM::CH__NMStat_MPC != 4) @sysvar::CH_NM::CH__NMStat_MPC = 4;
	}
	output(this);
}
/*@@end*/

/*@@frPDU:MsgChannel1.CHASSIS::CamLane_LaneAttr5_FR2:*/
on frPDU MsgChannel1.CHASSIS::CamLane_LaneAttr5_FR2
{
	if (@sysvar::CH_NM::CH__NMAppl_MPC != 2) @sysvar::CH_NM::CH__NMAppl_MPC = 2;
	settimer(Timer_CH__NMAppl_MPC, 1100);
	if (@sysvar::CH_NM::CH__NMNm_MPC == 2)
	{
		if (@sysvar::CH_NM::CH__NMStat_MPC != 3) @sysvar::CH_NM::CH__NMStat_MPC = 3;
	}
	else
	{
		if (@sysvar::CH_NM::CH__NMStat_MPC != 4) @sysvar::CH_NM::CH__NMStat_MPC = 4;
	}
	output(this);
}
/*@@end*/

/*@@frPDU:MsgChannel1.CHASSIS::CamLane_LaneAttr6_Gw_AR2:*/
on frPDU MsgChannel1.CHASSIS::CamLane_LaneAttr6_Gw_AR2
{
	if (@sysvar::CH_NM::CH__NMAppl_MPC != 2) @sysvar::CH_NM::CH__NMAppl_MPC = 2;
	settimer(Timer_CH__NMAppl_MPC, 1100);
	if (@sysvar::CH_NM::CH__NMNm_MPC == 2)
	{
		if (@sysvar::CH_NM::CH__NMStat_MPC != 3) @sysvar::CH_NM::CH__NMStat_MPC = 3;
	}
	else
	{
		if (@sysvar::CH_NM::CH__NMStat_MPC != 4) @sysvar::CH_NM::CH__NMStat_MPC = 4;
	}
	output(this);
}
/*@@end*/

/*@@frPDU:MsgChannel1.CHASSIS::CamLane_LaneAttr7_Gw_AR2:*/
on frPDU MsgChannel1.CHASSIS::CamLane_LaneAttr7_Gw_AR2
{
	if (@sysvar::CH_NM::CH__NMAppl_MPC != 2) @sysvar::CH_NM::CH__NMAppl_MPC = 2;
	settimer(Timer_CH__NMAppl_MPC, 1100);
	if (@sysvar::CH_NM::CH__NMNm_MPC == 2)
	{
		if (@sysvar::CH_NM::CH__NMStat_MPC != 3) @sysvar::CH_NM::CH__NMStat_MPC = 3;
	}
	else
	{
		if (@sysvar::CH_NM::CH__NMStat_MPC != 4) @sysvar::CH_NM::CH__NMStat_MPC = 4;
	}
	output(this);
}
/*@@end*/

/*@@frPDU:MsgChannel1.CHASSIS::CamObj_A_Mtn_FR2:*/
on frPDU MsgChannel1.CHASSIS::CamObj_A_Mtn_FR2
{
	if (@sysvar::CH_NM::CH__NMAppl_MPC != 2) @sysvar::CH_NM::CH__NMAppl_MPC = 2;
	settimer(Timer_CH__NMAppl_MPC, 1100);
	if (@sysvar::CH_NM::CH__NMNm_MPC == 2)
	{
		if (@sysvar::CH_NM::CH__NMStat_MPC != 3) @sysvar::CH_NM::CH__NMStat_MPC = 3;
	}
	else
	{
		if (@sysvar::CH_NM::CH__NMStat_MPC != 4) @sysvar::CH_NM::CH__NMStat_MPC = 4;
	}
	output(this);
}
/*@@end*/

/*@@frPDU:MsgChannel1.CHASSIS::CamObj_A_Posn_FR2:*/
on frPDU MsgChannel1.CHASSIS::CamObj_A_Posn_FR2
{
	if (@sysvar::CH_NM::CH__NMAppl_MPC != 2) @sysvar::CH_NM::CH__NMAppl_MPC = 2;
	settimer(Timer_CH__NMAppl_MPC, 1100);
	if (@sysvar::CH_NM::CH__NMNm_MPC == 2)
	{
		if (@sysvar::CH_NM::CH__NMStat_MPC != 3) @sysvar::CH_NM::CH__NMStat_MPC = 3;
	}
	else
	{
		if (@sysvar::CH_NM::CH__NMStat_MPC != 4) @sysvar::CH_NM::CH__NMStat_MPC = 4;
	}
	output(this);
}
/*@@end*/

/*@@frPDU:MsgChannel1.CHASSIS::CamObj_B_Mtn_FR2:*/
on frPDU MsgChannel1.CHASSIS::CamObj_B_Mtn_FR2
{
	if (@sysvar::CH_NM::CH__NMAppl_MPC != 2) @sysvar::CH_NM::CH__NMAppl_MPC = 2;
	settimer(Timer_CH__NMAppl_MPC, 1100);
	if (@sysvar::CH_NM::CH__NMNm_MPC == 2)
	{
		if (@sysvar::CH_NM::CH__NMStat_MPC != 3) @sysvar::CH_NM::CH__NMStat_MPC = 3;
	}
	else
	{
		if (@sysvar::CH_NM::CH__NMStat_MPC != 4) @sysvar::CH_NM::CH__NMStat_MPC = 4;
	}
	output(this);
}
/*@@end*/

/*@@frPDU:MsgChannel1.CHASSIS::CamObj_B_Posn_FR2:*/
on frPDU MsgChannel1.CHASSIS::CamObj_B_Posn_FR2
{
	if (@sysvar::CH_NM::CH__NMAppl_MPC != 2) @sysvar::CH_NM::CH__NMAppl_MPC = 2;
	settimer(Timer_CH__NMAppl_MPC, 1100);
	if (@sysvar::CH_NM::CH__NMNm_MPC == 2)
	{
		if (@sysvar::CH_NM::CH__NMStat_MPC != 3) @sysvar::CH_NM::CH__NMStat_MPC = 3;
	}
	else
	{
		if (@sysvar::CH_NM::CH__NMStat_MPC != 4) @sysvar::CH_NM::CH__NMStat_MPC = 4;
	}
	output(this);
}
/*@@end*/

/*@@frPDU:MsgChannel1.CHASSIS::CamObj_C_Mtn_FR2:*/
on frPDU MsgChannel1.CHASSIS::CamObj_C_Mtn_FR2
{
	if (@sysvar::CH_NM::CH__NMAppl_MPC != 2) @sysvar::CH_NM::CH__NMAppl_MPC = 2;
	settimer(Timer_CH__NMAppl_MPC, 1100);
	if (@sysvar::CH_NM::CH__NMNm_MPC == 2)
	{
		if (@sysvar::CH_NM::CH__NMStat_MPC != 3) @sysvar::CH_NM::CH__NMStat_MPC = 3;
	}
	else
	{
		if (@sysvar::CH_NM::CH__NMStat_MPC != 4) @sysvar::CH_NM::CH__NMStat_MPC = 4;
	}
	output(this);
}
/*@@end*/

/*@@frPDU:MsgChannel1.CHASSIS::CamObj_C_Posn_FR2:*/
on frPDU MsgChannel1.CHASSIS::CamObj_C_Posn_FR2
{
	if (@sysvar::CH_NM::CH__NMAppl_MPC != 2) @sysvar::CH_NM::CH__NMAppl_MPC = 2;
	settimer(Timer_CH__NMAppl_MPC, 1100);
	if (@sysvar::CH_NM::CH__NMNm_MPC == 2)
	{
		if (@sysvar::CH_NM::CH__NMStat_MPC != 3) @sysvar::CH_NM::CH__NMStat_MPC = 3;
	}
	else
	{
		if (@sysvar::CH_NM::CH__NMStat_MPC != 4) @sysvar::CH_NM::CH__NMStat_MPC = 4;
	}
	output(this);
}
/*@@end*/

/*@@frPDU:MsgChannel1.CHASSIS::IHC_Lgt_Stat_MPC_Gw_AR2:*/
on frPDU MsgChannel1.CHASSIS::IHC_Lgt_Stat_MPC_Gw_AR2
{
	if (@sysvar::CH_NM::CH__NMAppl_MPC != 2) @sysvar::CH_NM::CH__NMAppl_MPC = 2;
	settimer(Timer_CH__NMAppl_MPC, 1100);
	if (@sysvar::CH_NM::CH__NMNm_MPC == 2)
	{
		if (@sysvar::CH_NM::CH__NMStat_MPC != 3) @sysvar::CH_NM::CH__NMStat_MPC = 3;
	}
	else
	{
		if (@sysvar::CH_NM::CH__NMStat_MPC != 4) @sysvar::CH_NM::CH__NMStat_MPC = 4;
	}
	output(this);
}
/*@@end*/

/*@@frPDU:MsgChannel1.CHASSIS::IHC_Plus_HL_Stat_AR2:*/
on frPDU MsgChannel1.CHASSIS::IHC_Plus_HL_Stat_AR2
{
	if (@sysvar::CH_NM::CH__NMAppl_MPC != 2) @sysvar::CH_NM::CH__NMAppl_MPC = 2;
	settimer(Timer_CH__NMAppl_MPC, 1100);
	if (@sysvar::CH_NM::CH__NMNm_MPC == 2)
	{
		if (@sysvar::CH_NM::CH__NMStat_MPC != 3) @sysvar::CH_NM::CH__NMStat_MPC = 3;
	}
	else
	{
		if (@sysvar::CH_NM::CH__NMStat_MPC != 4) @sysvar::CH_NM::CH__NMStat_MPC = 4;
	}
	output(this);
}
/*@@end*/

/*@@frPDU:MsgChannel1.CHASSIS::Preview_Header1_FR2:*/
on frPDU MsgChannel1.CHASSIS::Preview_Header1_FR2
{
	if (@sysvar::CH_NM::CH__NMAppl_MPC != 2) @sysvar::CH_NM::CH__NMAppl_MPC = 2;
	settimer(Timer_CH__NMAppl_MPC, 1100);
	if (@sysvar::CH_NM::CH__NMNm_MPC == 2)
	{
		if (@sysvar::CH_NM::CH__NMStat_MPC != 3) @sysvar::CH_NM::CH__NMStat_MPC = 3;
	}
	else
	{
		if (@sysvar::CH_NM::CH__NMStat_MPC != 4) @sysvar::CH_NM::CH__NMStat_MPC = 4;
	}
	output(this);
}
/*@@end*/

/*@@frPDU:MsgChannel1.CHASSIS::Preview_Header2_FR2:*/
on frPDU MsgChannel1.CHASSIS::Preview_Header2_FR2
{
	if (@sysvar::CH_NM::CH__NMAppl_MPC != 2) @sysvar::CH_NM::CH__NMAppl_MPC = 2;
	settimer(Timer_CH__NMAppl_MPC, 1100);
	if (@sysvar::CH_NM::CH__NMNm_MPC == 2)
	{
		if (@sysvar::CH_NM::CH__NMStat_MPC != 3) @sysvar::CH_NM::CH__NMStat_MPC = 3;
	}
	else
	{
		if (@sysvar::CH_NM::CH__NMStat_MPC != 4) @sysvar::CH_NM::CH__NMStat_MPC = 4;
	}
	output(this);
}
/*@@end*/

/*@@frPDU:MsgChannel1.CHASSIS::Preview_ProfData1_FR2:*/
on frPDU MsgChannel1.CHASSIS::Preview_ProfData1_FR2
{
	if (@sysvar::CH_NM::CH__NMAppl_MPC != 2) @sysvar::CH_NM::CH__NMAppl_MPC = 2;
	settimer(Timer_CH__NMAppl_MPC, 1100);
	if (@sysvar::CH_NM::CH__NMNm_MPC == 2)
	{
		if (@sysvar::CH_NM::CH__NMStat_MPC != 3) @sysvar::CH_NM::CH__NMStat_MPC = 3;
	}
	else
	{
		if (@sysvar::CH_NM::CH__NMStat_MPC != 4) @sysvar::CH_NM::CH__NMStat_MPC = 4;
	}
	output(this);
}
/*@@end*/

/*@@frPDU:MsgChannel1.CHASSIS::Preview_ProfData2_FR2:*/
on frPDU MsgChannel1.CHASSIS::Preview_ProfData2_FR2
{
	if (@sysvar::CH_NM::CH__NMAppl_MPC != 2) @sysvar::CH_NM::CH__NMAppl_MPC = 2;
	settimer(Timer_CH__NMAppl_MPC, 1100);
	if (@sysvar::CH_NM::CH__NMNm_MPC == 2)
	{
		if (@sysvar::CH_NM::CH__NMStat_MPC != 3) @sysvar::CH_NM::CH__NMStat_MPC = 3;
	}
	else
	{
		if (@sysvar::CH_NM::CH__NMStat_MPC != 4) @sysvar::CH_NM::CH__NMStat_MPC = 4;
	}
	output(this);
}
/*@@end*/

/*@@frPDU:MsgChannel1.CHASSIS::ROE_SMPC:*/
on frPDU MsgChannel1.CHASSIS::ROE_SMPC
{
	if (@sysvar::CH_NM::CH__NMAppl_MPC != 2) @sysvar::CH_NM::CH__NMAppl_MPC = 2;
	settimer(Timer_CH__NMAppl_MPC, 1100);
	if (@sysvar::CH_NM::CH__NMNm_MPC == 2)
	{
		if (@sysvar::CH_NM::CH__NMStat_MPC != 3) @sysvar::CH_NM::CH__NMStat_MPC = 3;
	}
	else
	{
		if (@sysvar::CH_NM::CH__NMStat_MPC != 4) @sysvar::CH_NM::CH__NMStat_MPC = 4;
	}
	output(this);
}
/*@@end*/

/*@@frPDU:MsgChannel1.CHASSIS::SPL_Obj1_Obj2_MPC_AR2:*/
on frPDU MsgChannel1.CHASSIS::SPL_Obj1_Obj2_MPC_AR2
{
	if (@sysvar::CH_NM::CH__NMAppl_MPC != 2) @sysvar::CH_NM::CH__NMAppl_MPC = 2;
	settimer(Timer_CH__NMAppl_MPC, 1100);
	if (@sysvar::CH_NM::CH__NMNm_MPC == 2)
	{
		if (@sysvar::CH_NM::CH__NMStat_MPC != 3) @sysvar::CH_NM::CH__NMStat_MPC = 3;
	}
	else
	{
		if (@sysvar::CH_NM::CH__NMStat_MPC != 4) @sysvar::CH_NM::CH__NMStat_MPC = 4;
	}
	output(this);
}
/*@@end*/

/*@@frPDU:MsgChannel1.CHASSIS::TSA_Disp_Rq1_Gw_AR2:*/
on frPDU MsgChannel1.CHASSIS::TSA_Disp_Rq1_Gw_AR2
{
	if (@sysvar::CH_NM::CH__NMAppl_MPC != 2) @sysvar::CH_NM::CH__NMAppl_MPC = 2;
	settimer(Timer_CH__NMAppl_MPC, 1100);
	if (@sysvar::CH_NM::CH__NMNm_MPC == 2)
	{
		if (@sysvar::CH_NM::CH__NMStat_MPC != 3) @sysvar::CH_NM::CH__NMStat_MPC = 3;
	}
	else
	{
		if (@sysvar::CH_NM::CH__NMStat_MPC != 4) @sysvar::CH_NM::CH__NMStat_MPC = 4;
	}
	output(this);
}
/*@@end*/

/*@@frPDU:MsgChannel1.CHASSIS::TSA_Disp_Rq2_Gw_AR:*/
on frPDU MsgChannel1.CHASSIS::TSA_Disp_Rq2_Gw_AR
{
	if (@sysvar::CH_NM::CH__NMAppl_MPC != 2) @sysvar::CH_NM::CH__NMAppl_MPC = 2;
	settimer(Timer_CH__NMAppl_MPC, 1100);
	if (@sysvar::CH_NM::CH__NMNm_MPC == 2)
	{
		if (@sysvar::CH_NM::CH__NMStat_MPC != 3) @sysvar::CH_NM::CH__NMStat_MPC = 3;
	}
	else
	{
		if (@sysvar::CH_NM::CH__NMStat_MPC != 4) @sysvar::CH_NM::CH__NMStat_MPC = 4;
	}
	output(this);
}
/*@@end*/

/*@@frPDU:MsgChannel1.CHASSIS::TSA_Disp_Rq3_Gw_AR:*/
on frPDU MsgChannel1.CHASSIS::TSA_Disp_Rq3_Gw_AR
{
	if (@sysvar::CH_NM::CH__NMAppl_MPC != 2) @sysvar::CH_NM::CH__NMAppl_MPC = 2;
	settimer(Timer_CH__NMAppl_MPC, 1100);
	if (@sysvar::CH_NM::CH__NMNm_MPC == 2)
	{
		if (@sysvar::CH_NM::CH__NMStat_MPC != 3) @sysvar::CH_NM::CH__NMStat_MPC = 3;
	}
	else
	{
		if (@sysvar::CH_NM::CH__NMStat_MPC != 4) @sysvar::CH_NM::CH__NMStat_MPC = 4;
	}
	output(this);
}
/*@@end*/

/*@@frPDU:MsgChannel1.CHASSIS::YMAS_Rq_MPC_Gw_AR2:*/
on frPDU MsgChannel1.CHASSIS::YMAS_Rq_MPC_Gw_AR2
{
	if (@sysvar::CH_NM::CH__NMAppl_MPC != 2) @sysvar::CH_NM::CH__NMAppl_MPC = 2;
	settimer(Timer_CH__NMAppl_MPC, 1100);
	if (@sysvar::CH_NM::CH__NMNm_MPC == 2)
	{
		if (@sysvar::CH_NM::CH__NMStat_MPC != 3) @sysvar::CH_NM::CH__NMStat_MPC = 3;
	}
	else
	{
		if (@sysvar::CH_NM::CH__NMStat_MPC != 4) @sysvar::CH_NM::CH__NMStat_MPC = 4;
	}
	output(this);
}
/*@@end*/

/*@@frPDU:MsgChannel1.CHASSIS::Brk_Rq_PARK_AR2:*/
on frPDU MsgChannel1.CHASSIS::Brk_Rq_PARK_AR2
{
	if (@sysvar::CH_NM::CH__NMAppl_PARK != 2) @sysvar::CH_NM::CH__NMAppl_PARK = 2;
	settimer(Timer_CH__NMAppl_PARK, 1100);
	if (@sysvar::CH_NM::CH__NMNm_PARK == 2)
	{
		if (@sysvar::CH_NM::CH__NMStat_PARK != 3) @sysvar::CH_NM::CH__NMStat_PARK = 3;
	}
	else
	{
		if (@sysvar::CH_NM::CH__NMStat_PARK != 4) @sysvar::CH_NM::CH__NMStat_PARK = 4;
	}
	output(this);
}
/*@@end*/

/*@@frPDU:MsgChannel1.CHASSIS::ECU_INFO_RVC_AR:*/
on frPDU MsgChannel1.CHASSIS::ECU_INFO_RVC_AR
{
	if (@sysvar::CH_NM::CH__NMAppl_PARK != 2) @sysvar::CH_NM::CH__NMAppl_PARK = 2;
	settimer(Timer_CH__NMAppl_PARK, 1100);
	if (@sysvar::CH_NM::CH__NMNm_PARK == 2)
	{
		if (@sysvar::CH_NM::CH__NMStat_PARK != 3) @sysvar::CH_NM::CH__NMStat_PARK = 3;
	}
	else
	{
		if (@sysvar::CH_NM::CH__NMStat_PARK != 4) @sysvar::CH_NM::CH__NMStat_PARK = 4;
	}
	output(this);
}
/*@@end*/

/*@@frPDU:MsgChannel1.CHASSIS::Park_Disp_Rq_AR2:*/
on frPDU MsgChannel1.CHASSIS::Park_Disp_Rq_AR2
{
	if (@sysvar::CH_NM::CH__NMAppl_PARK != 2) @sysvar::CH_NM::CH__NMAppl_PARK = 2;
	settimer(Timer_CH__NMAppl_PARK, 1100);
	if (@sysvar::CH_NM::CH__NMNm_PARK == 2)
	{
		if (@sysvar::CH_NM::CH__NMStat_PARK != 3) @sysvar::CH_NM::CH__NMStat_PARK = 3;
	}
	else
	{
		if (@sysvar::CH_NM::CH__NMStat_PARK != 4) @sysvar::CH_NM::CH__NMStat_PARK = 4;
	}
	output(this);
}
/*@@end*/

/*@@frPDU:MsgChannel1.CHASSIS::Park_Set_Stat_AR2:*/
on frPDU MsgChannel1.CHASSIS::Park_Set_Stat_AR2
{
	if (@sysvar::CH_NM::CH__NMAppl_PARK != 2) @sysvar::CH_NM::CH__NMAppl_PARK = 2;
	settimer(Timer_CH__NMAppl_PARK, 1100);
	if (@sysvar::CH_NM::CH__NMNm_PARK == 2)
	{
		if (@sysvar::CH_NM::CH__NMStat_PARK != 3) @sysvar::CH_NM::CH__NMStat_PARK = 3;
	}
	else
	{
		if (@sysvar::CH_NM::CH__NMStat_PARK != 4) @sysvar::CH_NM::CH__NMStat_PARK = 4;
	}
	output(this);
}
/*@@end*/

/*@@frPDU:MsgChannel1.CHASSIS::Park_Stat_AR2:*/
on frPDU MsgChannel1.CHASSIS::Park_Stat_AR2
{
	if (@sysvar::CH_NM::CH__NMAppl_PARK != 2) @sysvar::CH_NM::CH__NMAppl_PARK = 2;
	settimer(Timer_CH__NMAppl_PARK, 1100);
	if (@sysvar::CH_NM::CH__NMNm_PARK == 2)
	{
		if (@sysvar::CH_NM::CH__NMStat_PARK != 3) @sysvar::CH_NM::CH__NMStat_PARK = 3;
	}
	else
	{
		if (@sysvar::CH_NM::CH__NMStat_PARK != 4) @sysvar::CH_NM::CH__NMStat_PARK = 4;
	}
	output(this);
}
/*@@end*/

/*@@frPDU:MsgChannel1.CHASSIS::ParkSensObj_Stat1_FR2:*/
on frPDU MsgChannel1.CHASSIS::ParkSensObj_Stat1_FR2
{
	if (@sysvar::CH_NM::CH__NMAppl_PARK != 2) @sysvar::CH_NM::CH__NMAppl_PARK = 2;
	settimer(Timer_CH__NMAppl_PARK, 1100);
	if (@sysvar::CH_NM::CH__NMNm_PARK == 2)
	{
		if (@sysvar::CH_NM::CH__NMStat_PARK != 3) @sysvar::CH_NM::CH__NMStat_PARK = 3;
	}
	else
	{
		if (@sysvar::CH_NM::CH__NMStat_PARK != 4) @sysvar::CH_NM::CH__NMStat_PARK = 4;
	}
	output(this);
}
/*@@end*/

/*@@frPDU:MsgChannel1.CHASSIS::ParkSensObj_Stat2_FR2:*/
on frPDU MsgChannel1.CHASSIS::ParkSensObj_Stat2_FR2
{
	if (@sysvar::CH_NM::CH__NMAppl_PARK != 2) @sysvar::CH_NM::CH__NMAppl_PARK = 2;
	settimer(Timer_CH__NMAppl_PARK, 1100);
	if (@sysvar::CH_NM::CH__NMNm_PARK == 2)
	{
		if (@sysvar::CH_NM::CH__NMStat_PARK != 3) @sysvar::CH_NM::CH__NMStat_PARK = 3;
	}
	else
	{
		if (@sysvar::CH_NM::CH__NMStat_PARK != 4) @sysvar::CH_NM::CH__NMStat_PARK = 4;
	}
	output(this);
}
/*@@end*/

/*@@frPDU:MsgChannel1.CHASSIS::ParkSpaceMeas_Stat_AR:*/
on frPDU MsgChannel1.CHASSIS::ParkSpaceMeas_Stat_AR
{
	if (@sysvar::CH_NM::CH__NMAppl_PARK != 2) @sysvar::CH_NM::CH__NMAppl_PARK = 2;
	settimer(Timer_CH__NMAppl_PARK, 1100);
	if (@sysvar::CH_NM::CH__NMNm_PARK == 2)
	{
		if (@sysvar::CH_NM::CH__NMStat_PARK != 3) @sysvar::CH_NM::CH__NMStat_PARK = 3;
	}
	else
	{
		if (@sysvar::CH_NM::CH__NMStat_PARK != 4) @sysvar::CH_NM::CH__NMStat_PARK = 4;
	}
	output(this);
}
/*@@end*/

/*@@frPDU:MsgChannel1.CHASSIS::ParkWarn_AR2:*/
on frPDU MsgChannel1.CHASSIS::ParkWarn_AR2
{
	if (@sysvar::CH_NM::CH__NMAppl_PARK != 2) @sysvar::CH_NM::CH__NMAppl_PARK = 2;
	settimer(Timer_CH__NMAppl_PARK, 1100);
	if (@sysvar::CH_NM::CH__NMNm_PARK == 2)
	{
		if (@sysvar::CH_NM::CH__NMStat_PARK != 3) @sysvar::CH_NM::CH__NMStat_PARK = 3;
	}
	else
	{
		if (@sysvar::CH_NM::CH__NMStat_PARK != 4) @sysvar::CH_NM::CH__NMStat_PARK = 4;
	}
	output(this);
}
/*@@end*/

/*@@frPDU:MsgChannel1.CHASSIS::RemPark_Rq_AR2:*/
on frPDU MsgChannel1.CHASSIS::RemPark_Rq_AR2
{
	if (@sysvar::CH_NM::CH__NMAppl_PARK != 2) @sysvar::CH_NM::CH__NMAppl_PARK = 2;
	settimer(Timer_CH__NMAppl_PARK, 1100);
	if (@sysvar::CH_NM::CH__NMNm_PARK == 2)
	{
		if (@sysvar::CH_NM::CH__NMStat_PARK != 3) @sysvar::CH_NM::CH__NMStat_PARK = 3;
	}
	else
	{
		if (@sysvar::CH_NM::CH__NMStat_PARK != 4) @sysvar::CH_NM::CH__NMStat_PARK = 4;
	}
	output(this);
}
/*@@end*/

/*@@frPDU:MsgChannel1.CHASSIS::ROE_PARK:*/
on frPDU MsgChannel1.CHASSIS::ROE_PARK
{
	if (@sysvar::CH_NM::CH__NMAppl_PARK != 2) @sysvar::CH_NM::CH__NMAppl_PARK = 2;
	settimer(Timer_CH__NMAppl_PARK, 1100);
	if (@sysvar::CH_NM::CH__NMNm_PARK == 2)
	{
		if (@sysvar::CH_NM::CH__NMStat_PARK != 3) @sysvar::CH_NM::CH__NMStat_PARK = 3;
	}
	else
	{
		if (@sysvar::CH_NM::CH__NMStat_PARK != 4) @sysvar::CH_NM::CH__NMStat_PARK = 4;
	}
	output(this);
}
/*@@end*/

/*@@frPDU:MsgChannel1.CHASSIS::RVC_SVS_Park_Stat_AR2:*/
on frPDU MsgChannel1.CHASSIS::RVC_SVS_Park_Stat_AR2
{
	if (@sysvar::CH_NM::CH__NMAppl_PARK != 2) @sysvar::CH_NM::CH__NMAppl_PARK = 2;
	settimer(Timer_CH__NMAppl_PARK, 1100);
	if (@sysvar::CH_NM::CH__NMNm_PARK == 2)
	{
		if (@sysvar::CH_NM::CH__NMStat_PARK != 3) @sysvar::CH_NM::CH__NMStat_PARK = 3;
	}
	else
	{
		if (@sysvar::CH_NM::CH__NMStat_PARK != 4) @sysvar::CH_NM::CH__NMStat_PARK = 4;
	}
	output(this);
}
/*@@end*/

/*@@frPDU:MsgChannel1.CHASSIS::SADR_Trgr_PARK_AR2:*/
on frPDU MsgChannel1.CHASSIS::SADR_Trgr_PARK_AR2
{
	if (@sysvar::CH_NM::CH__NMAppl_PARK != 2) @sysvar::CH_NM::CH__NMAppl_PARK = 2;
	settimer(Timer_CH__NMAppl_PARK, 1100);
	if (@sysvar::CH_NM::CH__NMNm_PARK == 2)
	{
		if (@sysvar::CH_NM::CH__NMStat_PARK != 3) @sysvar::CH_NM::CH__NMStat_PARK = 3;
	}
	else
	{
		if (@sysvar::CH_NM::CH__NMStat_PARK != 4) @sysvar::CH_NM::CH__NMStat_PARK = 4;
	}
	output(this);
}
/*@@end*/

/*@@frPDU:MsgChannel1.CHASSIS::St_Rq_PARK_AR2:*/
on frPDU MsgChannel1.CHASSIS::St_Rq_PARK_AR2
{
	if (@sysvar::CH_NM::CH__NMAppl_PARK != 2) @sysvar::CH_NM::CH__NMAppl_PARK = 2;
	settimer(Timer_CH__NMAppl_PARK, 1100);
	if (@sysvar::CH_NM::CH__NMNm_PARK == 2)
	{
		if (@sysvar::CH_NM::CH__NMStat_PARK != 3) @sysvar::CH_NM::CH__NMStat_PARK = 3;
	}
	else
	{
		if (@sysvar::CH_NM::CH__NMStat_PARK != 4) @sysvar::CH_NM::CH__NMStat_PARK = 4;
	}
	output(this);
}
/*@@end*/

/*@@frPDU:MsgChannel1.CHASSIS::BrkSys_Rq_YMAS_AR2:*/
on frPDU MsgChannel1.CHASSIS::BrkSys_Rq_YMAS_AR2
{
	if (@sysvar::CH_NM::CH__NMAppl_FCWRDUSDTR != 2) @sysvar::CH_NM::CH__NMAppl_FCWRDUSDTR = 2;
	settimer(Timer_CH__NMAppl_FCWRDUSDTR, 1100);
	if (@sysvar::CH_NM::CH__NMNm_FCWRDUSDTR == 2)
	{
		if (@sysvar::CH_NM::CH__NMStat_FCWRDUSDTR != 3) @sysvar::CH_NM::CH__NMStat_FCWRDUSDTR = 3;
	}
	else
	{
		if (@sysvar::CH_NM::CH__NMStat_FCWRDUSDTR != 4) @sysvar::CH_NM::CH__NMStat_FCWRDUSDTR = 4;
	}
	output(this);
}
/*@@end*/

/*@@frPDU:MsgChannel1.CHASSIS::BSM_Disp_Warn_Rq_Gw_AR2:*/
on frPDU MsgChannel1.CHASSIS::BSM_Disp_Warn_Rq_Gw_AR2
{
	if (@sysvar::CH_NM::CH__NMAppl_FCWRDUSDTR != 2) @sysvar::CH_NM::CH__NMAppl_FCWRDUSDTR = 2;
	settimer(Timer_CH__NMAppl_FCWRDUSDTR, 1100);
	if (@sysvar::CH_NM::CH__NMNm_FCWRDUSDTR == 2)
	{
		if (@sysvar::CH_NM::CH__NMStat_FCWRDUSDTR != 3) @sysvar::CH_NM::CH__NMStat_FCWRDUSDTR = 3;
	}
	else
	{
		if (@sysvar::CH_NM::CH__NMStat_FCWRDUSDTR != 4) @sysvar::CH_NM::CH__NMStat_FCWRDUSDTR = 4;
	}
	output(this);
}
/*@@end*/

/*@@frPDU:MsgChannel1.CHASSIS::CMS_PI_Sd_Stat_MMR_F1_AR2:*/
on frPDU MsgChannel1.CHASSIS::CMS_PI_Sd_Stat_MMR_F1_AR2
{
	if (@sysvar::CH_NM::CH__NMAppl_FCWRDUSDTR != 2) @sysvar::CH_NM::CH__NMAppl_FCWRDUSDTR = 2;
	settimer(Timer_CH__NMAppl_FCWRDUSDTR, 1100);
	if (@sysvar::CH_NM::CH__NMNm_FCWRDUSDTR == 2)
	{
		if (@sysvar::CH_NM::CH__NMStat_FCWRDUSDTR != 3) @sysvar::CH_NM::CH__NMStat_FCWRDUSDTR = 3;
	}
	else
	{
		if (@sysvar::CH_NM::CH__NMStat_FCWRDUSDTR != 4) @sysvar::CH_NM::CH__NMStat_FCWRDUSDTR = 4;
	}
	output(this);
}
/*@@end*/

/*@@frPDU:MsgChannel1.CHASSIS::CMS_PI_Sd_Stat_MMR_F4_AR2:*/
on frPDU MsgChannel1.CHASSIS::CMS_PI_Sd_Stat_MMR_F4_AR2
{
	if (@sysvar::CH_NM::CH__NMAppl_FCWRDUSDTR != 2) @sysvar::CH_NM::CH__NMAppl_FCWRDUSDTR = 2;
	settimer(Timer_CH__NMAppl_FCWRDUSDTR, 1100);
	if (@sysvar::CH_NM::CH__NMNm_FCWRDUSDTR == 2)
	{
		if (@sysvar::CH_NM::CH__NMStat_FCWRDUSDTR != 3) @sysvar::CH_NM::CH__NMStat_FCWRDUSDTR = 3;
	}
	else
	{
		if (@sysvar::CH_NM::CH__NMStat_FCWRDUSDTR != 4) @sysvar::CH_NM::CH__NMStat_FCWRDUSDTR = 4;
	}
	output(this);
}
/*@@end*/

/*@@frPDU:MsgChannel1.CHASSIS::DTQ_Disp_Warn_Rq_AR2:*/
on frPDU MsgChannel1.CHASSIS::DTQ_Disp_Warn_Rq_AR2
{
	if (@sysvar::CH_NM::CH__NMAppl_FCWRDUSDTR != 2) @sysvar::CH_NM::CH__NMAppl_FCWRDUSDTR = 2;
	settimer(Timer_CH__NMAppl_FCWRDUSDTR, 1100);
	if (@sysvar::CH_NM::CH__NMNm_FCWRDUSDTR == 2)
	{
		if (@sysvar::CH_NM::CH__NMStat_FCWRDUSDTR != 3) @sysvar::CH_NM::CH__NMStat_FCWRDUSDTR = 3;
	}
	else
	{
		if (@sysvar::CH_NM::CH__NMStat_FCWRDUSDTR != 4) @sysvar::CH_NM::CH__NMStat_FCWRDUSDTR = 4;
	}
	output(this);
}
/*@@end*/

/*@@frPDU:MsgChannel1.CHASSIS::DTQ_Rq1_AR2:*/
on frPDU MsgChannel1.CHASSIS::DTQ_Rq1_AR2
{
	if (@sysvar::CH_NM::CH__NMAppl_FCWRDUSDTR != 2) @sysvar::CH_NM::CH__NMAppl_FCWRDUSDTR = 2;
	settimer(Timer_CH__NMAppl_FCWRDUSDTR, 1100);
	if (@sysvar::CH_NM::CH__NMNm_FCWRDUSDTR == 2)
	{
		if (@sysvar::CH_NM::CH__NMStat_FCWRDUSDTR != 3) @sysvar::CH_NM::CH__NMStat_FCWRDUSDTR = 3;
	}
	else
	{
		if (@sysvar::CH_NM::CH__NMStat_FCWRDUSDTR != 4) @sysvar::CH_NM::CH__NMStat_FCWRDUSDTR = 4;
	}
	output(this);
}
/*@@end*/

/*@@frPDU:MsgChannel1.CHASSIS::DTQ_Rq2_AR2:*/
on frPDU MsgChannel1.CHASSIS::DTQ_Rq2_AR2
{
	if (@sysvar::CH_NM::CH__NMAppl_FCWRDUSDTR != 2) @sysvar::CH_NM::CH__NMAppl_FCWRDUSDTR = 2;
	settimer(Timer_CH__NMAppl_FCWRDUSDTR, 1100);
	if (@sysvar::CH_NM::CH__NMNm_FCWRDUSDTR == 2)
	{
		if (@sysvar::CH_NM::CH__NMStat_FCWRDUSDTR != 3) @sysvar::CH_NM::CH__NMStat_FCWRDUSDTR = 3;
	}
	else
	{
		if (@sysvar::CH_NM::CH__NMStat_FCWRDUSDTR != 4) @sysvar::CH_NM::CH__NMStat_FCWRDUSDTR = 4;
	}
	output(this);
}
/*@@end*/

/*@@frPDU:MsgChannel1.CHASSIS::LDC_Disp_Rq_RDU_AR2:*/
on frPDU MsgChannel1.CHASSIS::LDC_Disp_Rq_RDU_AR2
{
	if (@sysvar::CH_NM::CH__NMAppl_FCWRDUSDTR != 2) @sysvar::CH_NM::CH__NMAppl_FCWRDUSDTR = 2;
	settimer(Timer_CH__NMAppl_FCWRDUSDTR, 1100);
	if (@sysvar::CH_NM::CH__NMNm_FCWRDUSDTR == 2)
	{
		if (@sysvar::CH_NM::CH__NMStat_FCWRDUSDTR != 3) @sysvar::CH_NM::CH__NMStat_FCWRDUSDTR = 3;
	}
	else
	{
		if (@sysvar::CH_NM::CH__NMStat_FCWRDUSDTR != 4) @sysvar::CH_NM::CH__NMStat_FCWRDUSDTR = 4;
	}
	output(this);
}
/*@@end*/

/*@@frPDU:MsgChannel1.CHASSIS::LDP_Warn_Rq_AR2:*/
on frPDU MsgChannel1.CHASSIS::LDP_Warn_Rq_AR2
{
	if (@sysvar::CH_NM::CH__NMAppl_FCWRDUSDTR != 2) @sysvar::CH_NM::CH__NMAppl_FCWRDUSDTR = 2;
	settimer(Timer_CH__NMAppl_FCWRDUSDTR, 1100);
	if (@sysvar::CH_NM::CH__NMNm_FCWRDUSDTR == 2)
	{
		if (@sysvar::CH_NM::CH__NMStat_FCWRDUSDTR != 3) @sysvar::CH_NM::CH__NMStat_FCWRDUSDTR = 3;
	}
	else
	{
		if (@sysvar::CH_NM::CH__NMStat_FCWRDUSDTR != 4) @sysvar::CH_NM::CH__NMStat_FCWRDUSDTR = 4;
	}
	output(this);
}
/*@@end*/

/*@@frPDU:MsgChannel1.CHASSIS::RDU_GlobalAttr_AR2:*/
on frPDU MsgChannel1.CHASSIS::RDU_GlobalAttr_AR2
{
	if (@sysvar::CH_NM::CH__NMAppl_FCWRDUSDTR != 2) @sysvar::CH_NM::CH__NMAppl_FCWRDUSDTR = 2;
	settimer(Timer_CH__NMAppl_FCWRDUSDTR, 1100);
	if (@sysvar::CH_NM::CH__NMNm_FCWRDUSDTR == 2)
	{
		if (@sysvar::CH_NM::CH__NMStat_FCWRDUSDTR != 3) @sysvar::CH_NM::CH__NMStat_FCWRDUSDTR = 3;
	}
	else
	{
		if (@sysvar::CH_NM::CH__NMStat_FCWRDUSDTR != 4) @sysvar::CH_NM::CH__NMStat_FCWRDUSDTR = 4;
	}
	output(this);
}
/*@@end*/

/*@@frPDU:MsgChannel1.CHASSIS::RDU_Stat1_AR:*/
on frPDU MsgChannel1.CHASSIS::RDU_Stat1_AR
{
	if (@sysvar::CH_NM::CH__NMAppl_FCWRDUSDTR != 2) @sysvar::CH_NM::CH__NMAppl_FCWRDUSDTR = 2;
	settimer(Timer_CH__NMAppl_FCWRDUSDTR, 1100);
	if (@sysvar::CH_NM::CH__NMNm_FCWRDUSDTR == 2)
	{
		if (@sysvar::CH_NM::CH__NMStat_FCWRDUSDTR != 3) @sysvar::CH_NM::CH__NMStat_FCWRDUSDTR = 3;
	}
	else
	{
		if (@sysvar::CH_NM::CH__NMStat_FCWRDUSDTR != 4) @sysvar::CH_NM::CH__NMStat_FCWRDUSDTR = 4;
	}
	output(this);
}
/*@@end*/

/*@@frPDU:MsgChannel1.CHASSIS::ROE_MMR_F1:*/
on frPDU MsgChannel1.CHASSIS::ROE_MMR_F1
{
	if (@sysvar::CH_NM::CH__NMAppl_FCWRDUSDTR != 2) @sysvar::CH_NM::CH__NMAppl_FCWRDUSDTR = 2;
	settimer(Timer_CH__NMAppl_FCWRDUSDTR, 1100);
	if (@sysvar::CH_NM::CH__NMNm_FCWRDUSDTR == 2)
	{
		if (@sysvar::CH_NM::CH__NMStat_FCWRDUSDTR != 3) @sysvar::CH_NM::CH__NMStat_FCWRDUSDTR = 3;
	}
	else
	{
		if (@sysvar::CH_NM::CH__NMStat_FCWRDUSDTR != 4) @sysvar::CH_NM::CH__NMStat_FCWRDUSDTR = 4;
	}
	output(this);
}
/*@@end*/

/*@@frPDU:MsgChannel1.CHASSIS::ROE_MMR_F4:*/
on frPDU MsgChannel1.CHASSIS::ROE_MMR_F4
{
	if (@sysvar::CH_NM::CH__NMAppl_FCWRDUSDTR != 2) @sysvar::CH_NM::CH__NMAppl_FCWRDUSDTR = 2;
	settimer(Timer_CH__NMAppl_FCWRDUSDTR, 1100);
	if (@sysvar::CH_NM::CH__NMNm_FCWRDUSDTR == 2)
	{
		if (@sysvar::CH_NM::CH__NMStat_FCWRDUSDTR != 3) @sysvar::CH_NM::CH__NMStat_FCWRDUSDTR = 3;
	}
	else
	{
		if (@sysvar::CH_NM::CH__NMStat_FCWRDUSDTR != 4) @sysvar::CH_NM::CH__NMStat_FCWRDUSDTR = 4;
	}
	output(this);
}
/*@@end*/

/*@@frPDU:MsgChannel1.CHASSIS::ROE_MMR_RM:*/
on frPDU MsgChannel1.CHASSIS::ROE_MMR_RM
{
	if (@sysvar::CH_NM::CH__NMAppl_FCWRDUSDTR != 2) @sysvar::CH_NM::CH__NMAppl_FCWRDUSDTR = 2;
	settimer(Timer_CH__NMAppl_FCWRDUSDTR, 1100);
	if (@sysvar::CH_NM::CH__NMNm_FCWRDUSDTR == 2)
	{
		if (@sysvar::CH_NM::CH__NMStat_FCWRDUSDTR != 3) @sysvar::CH_NM::CH__NMStat_FCWRDUSDTR = 3;
	}
	else
	{
		if (@sysvar::CH_NM::CH__NMStat_FCWRDUSDTR != 4) @sysvar::CH_NM::CH__NMStat_FCWRDUSDTR = 4;
	}
	output(this);
}
/*@@end*/

/*@@frPDU:MsgChannel1.CHASSIS::ROE_MMR_RS:*/
on frPDU MsgChannel1.CHASSIS::ROE_MMR_RS
{
	if (@sysvar::CH_NM::CH__NMAppl_FCWRDUSDTR != 2) @sysvar::CH_NM::CH__NMAppl_FCWRDUSDTR = 2;
	settimer(Timer_CH__NMAppl_FCWRDUSDTR, 1100);
	if (@sysvar::CH_NM::CH__NMNm_FCWRDUSDTR == 2)
	{
		if (@sysvar::CH_NM::CH__NMStat_FCWRDUSDTR != 3) @sysvar::CH_NM::CH__NMStat_FCWRDUSDTR = 3;
	}
	else
	{
		if (@sysvar::CH_NM::CH__NMStat_FCWRDUSDTR != 4) @sysvar::CH_NM::CH__NMStat_FCWRDUSDTR = 4;
	}
	output(this);
}
/*@@end*/

/*@@frPDU:MsgChannel1.CHASSIS::SCS_Stat1_RDU_AR2:*/
on frPDU MsgChannel1.CHASSIS::SCS_Stat1_RDU_AR2
{
	if (@sysvar::CH_NM::CH__NMAppl_FCWRDUSDTR != 2) @sysvar::CH_NM::CH__NMAppl_FCWRDUSDTR = 2;
	settimer(Timer_CH__NMAppl_FCWRDUSDTR, 1100);
	if (@sysvar::CH_NM::CH__NMNm_FCWRDUSDTR == 2)
	{
		if (@sysvar::CH_NM::CH__NMStat_FCWRDUSDTR != 3) @sysvar::CH_NM::CH__NMStat_FCWRDUSDTR = 3;
	}
	else
	{
		if (@sysvar::CH_NM::CH__NMStat_FCWRDUSDTR != 4) @sysvar::CH_NM::CH__NMStat_FCWRDUSDTR = 4;
	}
	output(this);
}
/*@@end*/

/*@@frPDU:MsgChannel1.CHASSIS::SCS_Stat2_RDU_AR2:*/
on frPDU MsgChannel1.CHASSIS::SCS_Stat2_RDU_AR2
{
	if (@sysvar::CH_NM::CH__NMAppl_FCWRDUSDTR != 2) @sysvar::CH_NM::CH__NMAppl_FCWRDUSDTR = 2;
	settimer(Timer_CH__NMAppl_FCWRDUSDTR, 1100);
	if (@sysvar::CH_NM::CH__NMNm_FCWRDUSDTR == 2)
	{
		if (@sysvar::CH_NM::CH__NMStat_FCWRDUSDTR != 3) @sysvar::CH_NM::CH__NMStat_FCWRDUSDTR = 3;
	}
	else
	{
		if (@sysvar::CH_NM::CH__NMStat_FCWRDUSDTR != 4) @sysvar::CH_NM::CH__NMStat_FCWRDUSDTR = 4;
	}
	output(this);
}
/*@@end*/

/*@@frPDU:MsgChannel1.CHASSIS::Veh_Stat_RDU_FR2:*/
on frPDU MsgChannel1.CHASSIS::Veh_Stat_RDU_FR2
{
	if (@sysvar::CH_NM::CH__NMAppl_FCWRDUSDTR != 2) @sysvar::CH_NM::CH__NMAppl_FCWRDUSDTR = 2;
	settimer(Timer_CH__NMAppl_FCWRDUSDTR, 1100);
	if (@sysvar::CH_NM::CH__NMNm_FCWRDUSDTR == 2)
	{
		if (@sysvar::CH_NM::CH__NMStat_FCWRDUSDTR != 3) @sysvar::CH_NM::CH__NMStat_FCWRDUSDTR = 3;
	}
	else
	{
		if (@sysvar::CH_NM::CH__NMStat_FCWRDUSDTR != 4) @sysvar::CH_NM::CH__NMStat_FCWRDUSDTR = 4;
	}
	output(this);
}
/*@@end*/

/*@@frPDU:MsgChannel1.CHASSIS::LDC_Rq_StWhl_AR2:*/
on frPDU MsgChannel1.CHASSIS::LDC_Rq_StWhl_AR2
{
	if (@sysvar::CH_NM::CH__NMAppl_SCCM != 2) @sysvar::CH_NM::CH__NMAppl_SCCM = 2;
	settimer(Timer_CH__NMAppl_SCCM, 1100);
	if (@sysvar::CH_NM::CH__NMNm_SCCM == 2)
	{
		if (@sysvar::CH_NM::CH__NMStat_SCCM != 3) @sysvar::CH_NM::CH__NMStat_SCCM = 3;
	}
	else
	{
		if (@sysvar::CH_NM::CH__NMStat_SCCM != 4) @sysvar::CH_NM::CH__NMStat_SCCM = 4;
	}
	output(this);
}
/*@@end*/

/*@@frPDU:MsgChannel1.CHASSIS::LDC_SBW_Rq_SCCM_AR2:*/
on frPDU MsgChannel1.CHASSIS::LDC_SBW_Rq_SCCM_AR2
{
	if (@sysvar::CH_NM::CH__NMAppl_SCCM != 2) @sysvar::CH_NM::CH__NMAppl_SCCM = 2;
	settimer(Timer_CH__NMAppl_SCCM, 1100);
	if (@sysvar::CH_NM::CH__NMNm_SCCM == 2)
	{
		if (@sysvar::CH_NM::CH__NMStat_SCCM != 3) @sysvar::CH_NM::CH__NMStat_SCCM = 3;
	}
	else
	{
		if (@sysvar::CH_NM::CH__NMStat_SCCM != 4) @sysvar::CH_NM::CH__NMStat_SCCM = 4;
	}
	output(this);
}
/*@@end*/

/*@@frPDU:MsgChannel1.CHASSIS::ROE_SCCM:*/
on frPDU MsgChannel1.CHASSIS::ROE_SCCM
{
	if (@sysvar::CH_NM::CH__NMAppl_SCCM != 2) @sysvar::CH_NM::CH__NMAppl_SCCM = 2;
	settimer(Timer_CH__NMAppl_SCCM, 1100);
	if (@sysvar::CH_NM::CH__NMNm_SCCM == 2)
	{
		if (@sysvar::CH_NM::CH__NMStat_SCCM != 3) @sysvar::CH_NM::CH__NMStat_SCCM = 3;
	}
	else
	{
		if (@sysvar::CH_NM::CH__NMStat_SCCM != 4) @sysvar::CH_NM::CH__NMStat_SCCM = 4;
	}
	output(this);
}
/*@@end*/

/*@@frPDU:MsgChannel1.CHASSIS::ROE_SWSP:*/
on frPDU MsgChannel1.CHASSIS::ROE_SWSP
{
	if (@sysvar::CH_NM::CH__NMAppl_SCCM != 2) @sysvar::CH_NM::CH__NMAppl_SCCM = 2;
	settimer(Timer_CH__NMAppl_SCCM, 1100);
	if (@sysvar::CH_NM::CH__NMNm_SCCM == 2)
	{
		if (@sysvar::CH_NM::CH__NMStat_SCCM != 3) @sysvar::CH_NM::CH__NMStat_SCCM = 3;
	}
	else
	{
		if (@sysvar::CH_NM::CH__NMStat_SCCM != 4) @sysvar::CH_NM::CH__NMStat_SCCM = 4;
	}
	output(this);
}
/*@@end*/

/*@@frPDU:MsgChannel1.CHASSIS::SCCM_Sw_Stat_AR2:*/
on frPDU MsgChannel1.CHASSIS::SCCM_Sw_Stat_AR2
{
	if (@sysvar::CH_NM::CH__NMAppl_SCCM != 2) @sysvar::CH_NM::CH__NMAppl_SCCM = 2;
	settimer(Timer_CH__NMAppl_SCCM, 1100);
	if (@sysvar::CH_NM::CH__NMNm_SCCM == 2)
	{
		if (@sysvar::CH_NM::CH__NMStat_SCCM != 3) @sysvar::CH_NM::CH__NMStat_SCCM = 3;
	}
	else
	{
		if (@sysvar::CH_NM::CH__NMStat_SCCM != 4) @sysvar::CH_NM::CH__NMStat_SCCM = 4;
	}
	output(this);
}
/*@@end*/

/*@@frPDU:MsgChannel1.CHASSIS::StWhl_Angl_Stat_AR2:*/
on frPDU MsgChannel1.CHASSIS::StWhl_Angl_Stat_AR2
{
	if (@sysvar::CH_NM::CH__NMAppl_SCCM != 2) @sysvar::CH_NM::CH__NMAppl_SCCM = 2;
	settimer(Timer_CH__NMAppl_SCCM, 1100);
	if (@sysvar::CH_NM::CH__NMNm_SCCM == 2)
	{
		if (@sysvar::CH_NM::CH__NMStat_SCCM != 3) @sysvar::CH_NM::CH__NMStat_SCCM = 3;
	}
	else
	{
		if (@sysvar::CH_NM::CH__NMStat_SCCM != 4) @sysvar::CH_NM::CH__NMStat_SCCM = 4;
	}
	output(this);
}
/*@@end*/

/*@@frPDU:MsgChannel1.CHASSIS::StWhl_OFN_Stat_AR2:*/
on frPDU MsgChannel1.CHASSIS::StWhl_OFN_Stat_AR2
{
	if (@sysvar::CH_NM::CH__NMAppl_SCCM != 2) @sysvar::CH_NM::CH__NMAppl_SCCM = 2;
	settimer(Timer_CH__NMAppl_SCCM, 1100);
	if (@sysvar::CH_NM::CH__NMNm_SCCM == 2)
	{
		if (@sysvar::CH_NM::CH__NMStat_SCCM != 3) @sysvar::CH_NM::CH__NMStat_SCCM = 3;
	}
	else
	{
		if (@sysvar::CH_NM::CH__NMStat_SCCM != 4) @sysvar::CH_NM::CH__NMStat_SCCM = 4;
	}
	output(this);
}
/*@@end*/

/*@@frPDU:MsgChannel1.CHASSIS::StWhl_Sw_Stat_AR2:*/
on frPDU MsgChannel1.CHASSIS::StWhl_Sw_Stat_AR2
{
	if (@sysvar::CH_NM::CH__NMAppl_SCCM != 2) @sysvar::CH_NM::CH__NMAppl_SCCM = 2;
	settimer(Timer_CH__NMAppl_SCCM, 1100);
	if (@sysvar::CH_NM::CH__NMNm_SCCM == 2)
	{
		if (@sysvar::CH_NM::CH__NMStat_SCCM != 3) @sysvar::CH_NM::CH__NMStat_SCCM = 3;
	}
	else
	{
		if (@sysvar::CH_NM::CH__NMStat_SCCM != 4) @sysvar::CH_NM::CH__NMStat_SCCM = 4;
	}
	output(this);
}
/*@@end*/

/*@@frPDU:MsgChannel1.CHASSIS::WUDOP_SCCM_FR:*/
on frPDU MsgChannel1.CHASSIS::WUDOP_SCCM_FR
{
	if (@sysvar::CH_NM::CH__NMAppl_SCCM != 2) @sysvar::CH_NM::CH__NMAppl_SCCM = 2;
	settimer(Timer_CH__NMAppl_SCCM, 1100);
	if (@sysvar::CH_NM::CH__NMNm_SCCM == 2)
	{
		if (@sysvar::CH_NM::CH__NMStat_SCCM != 3) @sysvar::CH_NM::CH__NMStat_SCCM = 3;
	}
	else
	{
		if (@sysvar::CH_NM::CH__NMStat_SCCM != 4) @sysvar::CH_NM::CH__NMStat_SCCM = 4;
	}
	output(this);
}
/*@@end*/

/*@@frPDU:MsgChannel1.CHASSIS::Eng_Rq_ABC_AR2:*/
on frPDU MsgChannel1.CHASSIS::Eng_Rq_ABC_AR2
{
	if (@sysvar::CH_NM::CH__NMAppl_SPC != 2) @sysvar::CH_NM::CH__NMAppl_SPC = 2;
	settimer(Timer_CH__NMAppl_SPC, 1100);
	if (@sysvar::CH_NM::CH__NMNm_SPC == 2)
	{
		if (@sysvar::CH_NM::CH__NMStat_SPC != 3) @sysvar::CH_NM::CH__NMStat_SPC = 3;
	}
	else
	{
		if (@sysvar::CH_NM::CH__NMStat_SPC != 4) @sysvar::CH_NM::CH__NMStat_SPC = 4;
	}
	output(this);
}
/*@@end*/

/*@@frPDU:MsgChannel1.CHASSIS::OffRoad_Disp_Rq_AR:*/
on frPDU MsgChannel1.CHASSIS::OffRoad_Disp_Rq_AR
{
	if (@sysvar::CH_NM::CH__NMAppl_SPC != 2) @sysvar::CH_NM::CH__NMAppl_SPC = 2;
	settimer(Timer_CH__NMAppl_SPC, 1100);
	if (@sysvar::CH_NM::CH__NMNm_SPC == 2)
	{
		if (@sysvar::CH_NM::CH__NMStat_SPC != 3) @sysvar::CH_NM::CH__NMStat_SPC = 3;
	}
	else
	{
		if (@sysvar::CH_NM::CH__NMStat_SPC != 4) @sysvar::CH_NM::CH__NMStat_SPC = 4;
	}
	output(this);
}
/*@@end*/

/*@@frPDU:MsgChannel1.CHASSIS::Preview_Data_SPC_AR:*/
on frPDU MsgChannel1.CHASSIS::Preview_Data_SPC_AR
{
	if (@sysvar::CH_NM::CH__NMAppl_SPC != 2) @sysvar::CH_NM::CH__NMAppl_SPC = 2;
	settimer(Timer_CH__NMAppl_SPC, 1100);
	if (@sysvar::CH_NM::CH__NMNm_SPC == 2)
	{
		if (@sysvar::CH_NM::CH__NMStat_SPC != 3) @sysvar::CH_NM::CH__NMStat_SPC = 3;
	}
	else
	{
		if (@sysvar::CH_NM::CH__NMStat_SPC != 4) @sysvar::CH_NM::CH__NMStat_SPC = 4;
	}
	output(this);
}
/*@@end*/

/*@@frPDU:MsgChannel1.CHASSIS::ROE_MPU_FL:*/
on frPDU MsgChannel1.CHASSIS::ROE_MPU_FL
{
	if (@sysvar::CH_NM::CH__NMAppl_SPC != 2) @sysvar::CH_NM::CH__NMAppl_SPC = 2;
	settimer(Timer_CH__NMAppl_SPC, 1100);
	if (@sysvar::CH_NM::CH__NMNm_SPC == 2)
	{
		if (@sysvar::CH_NM::CH__NMStat_SPC != 3) @sysvar::CH_NM::CH__NMStat_SPC = 3;
	}
	else
	{
		if (@sysvar::CH_NM::CH__NMStat_SPC != 4) @sysvar::CH_NM::CH__NMStat_SPC = 4;
	}
	output(this);
}
/*@@end*/

/*@@frPDU:MsgChannel1.CHASSIS::ROE_MPU_FR:*/
on frPDU MsgChannel1.CHASSIS::ROE_MPU_FR
{
	if (@sysvar::CH_NM::CH__NMAppl_SPC != 2) @sysvar::CH_NM::CH__NMAppl_SPC = 2;
	settimer(Timer_CH__NMAppl_SPC, 1100);
	if (@sysvar::CH_NM::CH__NMNm_SPC == 2)
	{
		if (@sysvar::CH_NM::CH__NMStat_SPC != 3) @sysvar::CH_NM::CH__NMStat_SPC = 3;
	}
	else
	{
		if (@sysvar::CH_NM::CH__NMStat_SPC != 4) @sysvar::CH_NM::CH__NMStat_SPC = 4;
	}
	output(this);
}
/*@@end*/

/*@@frPDU:MsgChannel1.CHASSIS::ROE_MPU_RL:*/
on frPDU MsgChannel1.CHASSIS::ROE_MPU_RL
{
	if (@sysvar::CH_NM::CH__NMAppl_SPC != 2) @sysvar::CH_NM::CH__NMAppl_SPC = 2;
	settimer(Timer_CH__NMAppl_SPC, 1100);
	if (@sysvar::CH_NM::CH__NMNm_SPC == 2)
	{
		if (@sysvar::CH_NM::CH__NMStat_SPC != 3) @sysvar::CH_NM::CH__NMStat_SPC = 3;
	}
	else
	{
		if (@sysvar::CH_NM::CH__NMStat_SPC != 4) @sysvar::CH_NM::CH__NMStat_SPC = 4;
	}
	output(this);
}
/*@@end*/

/*@@frPDU:MsgChannel1.CHASSIS::ROE_MPU_RR:*/
on frPDU MsgChannel1.CHASSIS::ROE_MPU_RR
{
	if (@sysvar::CH_NM::CH__NMAppl_SPC != 2) @sysvar::CH_NM::CH__NMAppl_SPC = 2;
	settimer(Timer_CH__NMAppl_SPC, 1100);
	if (@sysvar::CH_NM::CH__NMNm_SPC == 2)
	{
		if (@sysvar::CH_NM::CH__NMStat_SPC != 3) @sysvar::CH_NM::CH__NMStat_SPC = 3;
	}
	else
	{
		if (@sysvar::CH_NM::CH__NMStat_SPC != 4) @sysvar::CH_NM::CH__NMStat_SPC = 4;
	}
	output(this);
}
/*@@end*/

/*@@frPDU:MsgChannel1.CHASSIS::ROE_SPC:*/
on frPDU MsgChannel1.CHASSIS::ROE_SPC
{
	if (@sysvar::CH_NM::CH__NMAppl_SPC != 2) @sysvar::CH_NM::CH__NMAppl_SPC = 2;
	settimer(Timer_CH__NMAppl_SPC, 1100);
	if (@sysvar::CH_NM::CH__NMNm_SPC == 2)
	{
		if (@sysvar::CH_NM::CH__NMStat_SPC != 3) @sysvar::CH_NM::CH__NMStat_SPC = 3;
	}
	else
	{
		if (@sysvar::CH_NM::CH__NMStat_SPC != 4) @sysvar::CH_NM::CH__NMStat_SPC = 4;
	}
	output(this);
}
/*@@end*/

/*@@frPDU:MsgChannel1.CHASSIS::SPC_Disp_Rq_AR:*/
on frPDU MsgChannel1.CHASSIS::SPC_Disp_Rq_AR
{
	if (@sysvar::CH_NM::CH__NMAppl_SPC != 2) @sysvar::CH_NM::CH__NMAppl_SPC = 2;
	settimer(Timer_CH__NMAppl_SPC, 1100);
	if (@sysvar::CH_NM::CH__NMNm_SPC == 2)
	{
		if (@sysvar::CH_NM::CH__NMStat_SPC != 3) @sysvar::CH_NM::CH__NMStat_SPC = 3;
	}
	else
	{
		if (@sysvar::CH_NM::CH__NMStat_SPC != 4) @sysvar::CH_NM::CH__NMStat_SPC = 4;
	}
	output(this);
}
/*@@end*/

/*@@frPDU:MsgChannel1.CHASSIS::SPC_SwLED_Msg_Rq_AR2:*/
on frPDU MsgChannel1.CHASSIS::SPC_SwLED_Msg_Rq_AR2
{
	if (@sysvar::CH_NM::CH__NMAppl_SPC != 2) @sysvar::CH_NM::CH__NMAppl_SPC = 2;
	settimer(Timer_CH__NMAppl_SPC, 1100);
	if (@sysvar::CH_NM::CH__NMNm_SPC == 2)
	{
		if (@sysvar::CH_NM::CH__NMStat_SPC != 3) @sysvar::CH_NM::CH__NMStat_SPC = 3;
	}
	else
	{
		if (@sysvar::CH_NM::CH__NMStat_SPC != 4) @sysvar::CH_NM::CH__NMStat_SPC = 4;
	}
	output(this);
}
/*@@end*/

/*@@frPDU:MsgChannel1.CHASSIS::SpringVlv_Rq_AR:*/
on frPDU MsgChannel1.CHASSIS::SpringVlv_Rq_AR
{
	if (@sysvar::CH_NM::CH__NMAppl_SPC != 2) @sysvar::CH_NM::CH__NMAppl_SPC = 2;
	settimer(Timer_CH__NMAppl_SPC, 1100);
	if (@sysvar::CH_NM::CH__NMNm_SPC == 2)
	{
		if (@sysvar::CH_NM::CH__NMStat_SPC != 3) @sysvar::CH_NM::CH__NMStat_SPC = 3;
	}
	else
	{
		if (@sysvar::CH_NM::CH__NMStat_SPC != 4) @sysvar::CH_NM::CH__NMStat_SPC = 4;
	}
	output(this);
}
/*@@end*/

/*@@frPDU:MsgChannel1.CHASSIS::VehCarv_Stat_AR:*/
on frPDU MsgChannel1.CHASSIS::VehCarv_Stat_AR
{
	if (@sysvar::CH_NM::CH__NMAppl_SPC != 2) @sysvar::CH_NM::CH__NMAppl_SPC = 2;
	settimer(Timer_CH__NMAppl_SPC, 1100);
	if (@sysvar::CH_NM::CH__NMNm_SPC == 2)
	{
		if (@sysvar::CH_NM::CH__NMStat_SPC != 3) @sysvar::CH_NM::CH__NMStat_SPC = 3;
	}
	else
	{
		if (@sysvar::CH_NM::CH__NMStat_SPC != 4) @sysvar::CH_NM::CH__NMStat_SPC = 4;
	}
	output(this);
}
/*@@end*/

/*@@frPDU:MsgChannel1.CHASSIS::VehLvl_Stat_AR2:*/
on frPDU MsgChannel1.CHASSIS::VehLvl_Stat_AR2
{
	if (@sysvar::CH_NM::CH__NMAppl_SPC != 2) @sysvar::CH_NM::CH__NMAppl_SPC = 2;
	settimer(Timer_CH__NMAppl_SPC, 1100);
	if (@sysvar::CH_NM::CH__NMNm_SPC == 2)
	{
		if (@sysvar::CH_NM::CH__NMStat_SPC != 3) @sysvar::CH_NM::CH__NMStat_SPC = 3;
	}
	else
	{
		if (@sysvar::CH_NM::CH__NMStat_SPC != 4) @sysvar::CH_NM::CH__NMStat_SPC = 4;
	}
	output(this);
}
/*@@end*/

/*@@frPDU:MsgChannel1.CHASSIS::ROE_SPC_VX:*/
on frPDU MsgChannel1.CHASSIS::ROE_SPC_VX
{
	if (@sysvar::CH_NM::CH__NMAppl_SPC_VX != 2) @sysvar::CH_NM::CH__NMAppl_SPC_VX = 2;
	settimer(Timer_CH__NMAppl_SPC_VX, 1100);
	if (@sysvar::CH_NM::CH__NMNm_SPC_VX == 2)
	{
		if (@sysvar::CH_NM::CH__NMStat_SPC_VX != 3) @sysvar::CH_NM::CH__NMStat_SPC_VX = 3;
	}
	else
	{
		if (@sysvar::CH_NM::CH__NMStat_SPC_VX != 4) @sysvar::CH_NM::CH__NMStat_SPC_VX = 4;
	}
	output(this);
}
/*@@end*/

/*@@frPDU:MsgChannel1.CHASSIS::SPC_VX_Stat1_AR:*/
on frPDU MsgChannel1.CHASSIS::SPC_VX_Stat1_AR
{
	if (@sysvar::CH_NM::CH__NMAppl_SPC_VX != 2) @sysvar::CH_NM::CH__NMAppl_SPC_VX = 2;
	settimer(Timer_CH__NMAppl_SPC_VX, 1100);
	if (@sysvar::CH_NM::CH__NMNm_SPC_VX == 2)
	{
		if (@sysvar::CH_NM::CH__NMStat_SPC_VX != 3) @sysvar::CH_NM::CH__NMStat_SPC_VX = 3;
	}
	else
	{
		if (@sysvar::CH_NM::CH__NMStat_SPC_VX != 4) @sysvar::CH_NM::CH__NMStat_SPC_VX = 4;
	}
	output(this);
}
/*@@end*/

/*@@frPDU:MsgChannel1.CHASSIS::SpringVlv_Stat_AR:*/
on frPDU MsgChannel1.CHASSIS::SpringVlv_Stat_AR
{
	if (@sysvar::CH_NM::CH__NMAppl_SPC_VX != 2) @sysvar::CH_NM::CH__NMAppl_SPC_VX = 2;
	settimer(Timer_CH__NMAppl_SPC_VX, 1100);
	if (@sysvar::CH_NM::CH__NMNm_SPC_VX == 2)
	{
		if (@sysvar::CH_NM::CH__NMStat_SPC_VX != 3) @sysvar::CH_NM::CH__NMStat_SPC_VX = 3;
	}
	else
	{
		if (@sysvar::CH_NM::CH__NMStat_SPC_VX != 4) @sysvar::CH_NM::CH__NMStat_SPC_VX = 4;
	}
	output(this);
}
/*@@end*/


/*@@caplFunc:RecognizeNMPduRxInd(dword,dword,long,byte[]):*///function
void RecognizeNMPduRxInd( DWORD slotId, DWORD identifier, long bRepeatMessageBit, BYTE data[])
{
	// Empfang von NM-Botschaften für den Empfang von nicht im xml enthaltenen NM-ECUs
	if (identifier == 0x0)
	{
		@sysvar::CH_NM::CH__NMNm_00 = 3;
		settimer(Timer_CH__NMNm_00, 5000);
	}
	// Empfang von NM-Botschaften für den Empfang von nicht im xml enthaltenen NM-ECUs
	if (identifier == 0x1)
	{
		@sysvar::CH_NM::CH__NMNm_01 = 3;
		settimer(Timer_CH__NMNm_01, 5000);
	}
	// Empfang von NM-Botschaften für den Empfang von nicht im xml enthaltenen NM-ECUs
	if (identifier == 0x2)
	{
		@sysvar::CH_NM::CH__NMNm_02 = 3;
		settimer(Timer_CH__NMNm_02, 5000);
	}
	// Empfang von NM-Botschaften für den Empfang von nicht im xml enthaltenen NM-ECUs
	if (identifier == 0x3)
	{
		@sysvar::CH_NM::CH__NMNm_03 = 3;
		settimer(Timer_CH__NMNm_03, 5000);
	}
	// Empfang von NM-Botschaften für den Empfang von nicht im xml enthaltenen NM-ECUs
	if (identifier == 0x4)
	{
		@sysvar::CH_NM::CH__NMNm_04 = 3;
		settimer(Timer_CH__NMNm_04, 5000);
	}
	// Empfang von NM-Botschaften für den Empfang von nicht im xml enthaltenen NM-ECUs
	if (identifier == 0x5)
	{
		@sysvar::CH_NM::CH__NMNm_05 = 3;
		settimer(Timer_CH__NMNm_05, 5000);
	}
	// Empfang von NM-Botschaften für den Empfang von nicht im xml enthaltenen NM-ECUs
	if (identifier == 0x6)
	{
		@sysvar::CH_NM::CH__NMNm_06 = 3;
		settimer(Timer_CH__NMNm_06, 5000);
	}
	// Empfang von NM-Botschaften für in der Datenbank enthaltene NM-ECUs
	if (identifier == 0x7)
	{
		if (@sysvar::CH_NM::CH__NMNm_EIS != 2) @sysvar::CH_NM::CH__NMNm_EIS = 2;
		settimer(Timer_CH__NMNm_EIS, 5000);
		if (@sysvar::CH_NM::CH__NMAppl_EIS == 2)
		{
			if (@sysvar::CH_NM::CH__NMStat_EIS != 3) @sysvar::CH_NM::CH__NMStat_EIS = 3;
		}
		else
		{
			if (@sysvar::CH_NM::CH__NMStat_EIS != 4) @sysvar::CH_NM::CH__NMStat_EIS = 4;
		}
	}
	// Empfang von NM-Botschaften für den Empfang von nicht im xml enthaltenen NM-ECUs
	if (identifier == 0x8)
	{
		@sysvar::CH_NM::CH__NMNm_08 = 3;
		settimer(Timer_CH__NMNm_08, 5000);
	}
	// Empfang von NM-Botschaften für den Empfang von nicht im xml enthaltenen NM-ECUs
	if (identifier == 0x9)
	{
		@sysvar::CH_NM::CH__NMNm_09 = 3;
		settimer(Timer_CH__NMNm_09, 5000);
	}
	// Empfang von NM-Botschaften für den Empfang von nicht im xml enthaltenen NM-ECUs
	if (identifier == 0xa)
	{
		@sysvar::CH_NM::CH__NMNm_0A = 3;
		settimer(Timer_CH__NMNm_0A, 5000);
	}
	// Empfang von NM-Botschaften für den Empfang von nicht im xml enthaltenen NM-ECUs
	if (identifier == 0xb)
	{
		@sysvar::CH_NM::CH__NMNm_0B = 3;
		settimer(Timer_CH__NMNm_0B, 5000);
	}
	// Empfang von NM-Botschaften für den Empfang von nicht im xml enthaltenen NM-ECUs
	if (identifier == 0xc)
	{
		@sysvar::CH_NM::CH__NMNm_0C = 3;
		settimer(Timer_CH__NMNm_0C, 5000);
	}
	// Empfang von NM-Botschaften für den Empfang von nicht im xml enthaltenen NM-ECUs
	if (identifier == 0xd)
	{
		@sysvar::CH_NM::CH__NMNm_0D = 3;
		settimer(Timer_CH__NMNm_0D, 5000);
	}
	// Empfang von NM-Botschaften für den Empfang von nicht im xml enthaltenen NM-ECUs
	if (identifier == 0xe)
	{
		@sysvar::CH_NM::CH__NMNm_0E = 3;
		settimer(Timer_CH__NMNm_0E, 5000);
	}
	// Empfang von NM-Botschaften für den Empfang von nicht im xml enthaltenen NM-ECUs
	if (identifier == 0xf)
	{
		@sysvar::CH_NM::CH__NMNm_0F = 3;
		settimer(Timer_CH__NMNm_0F, 5000);
	}
	// Empfang von NM-Botschaften für den Empfang von nicht im xml enthaltenen NM-ECUs
	if (identifier == 0x10)
	{
		@sysvar::CH_NM::CH__NMNm_10 = 3;
		settimer(Timer_CH__NMNm_10, 5000);
	}
	// Empfang von NM-Botschaften für den Empfang von nicht im xml enthaltenen NM-ECUs
	if (identifier == 0x11)
	{
		@sysvar::CH_NM::CH__NMNm_11 = 3;
		settimer(Timer_CH__NMNm_11, 5000);
	}
	// Empfang von NM-Botschaften für den Empfang von nicht im xml enthaltenen NM-ECUs
	if (identifier == 0x12)
	{
		@sysvar::CH_NM::CH__NMNm_12 = 3;
		settimer(Timer_CH__NMNm_12, 5000);
	}
	// Empfang von NM-Botschaften für den Empfang von nicht im xml enthaltenen NM-ECUs
	if (identifier == 0x13)
	{
		@sysvar::CH_NM::CH__NMNm_13 = 3;
		settimer(Timer_CH__NMNm_13, 5000);
	}
	// Empfang von NM-Botschaften für den Empfang von nicht im xml enthaltenen NM-ECUs
	if (identifier == 0x14)
	{
		@sysvar::CH_NM::CH__NMNm_14 = 3;
		settimer(Timer_CH__NMNm_14, 5000);
	}
	// Empfang von NM-Botschaften für den Empfang von nicht im xml enthaltenen NM-ECUs
	if (identifier == 0x15)
	{
		@sysvar::CH_NM::CH__NMNm_15 = 3;
		settimer(Timer_CH__NMNm_15, 5000);
	}
	// Empfang von NM-Botschaften für den Empfang von nicht im xml enthaltenen NM-ECUs
	if (identifier == 0x16)
	{
		@sysvar::CH_NM::CH__NMNm_16 = 3;
		settimer(Timer_CH__NMNm_16, 5000);
	}
	// Empfang von NM-Botschaften für den Empfang von nicht im xml enthaltenen NM-ECUs
	if (identifier == 0x17)
	{
		@sysvar::CH_NM::CH__NMNm_17 = 3;
		settimer(Timer_CH__NMNm_17, 5000);
	}
	// Empfang von NM-Botschaften für den Empfang von nicht im xml enthaltenen NM-ECUs
	if (identifier == 0x18)
	{
		@sysvar::CH_NM::CH__NMNm_18 = 3;
		settimer(Timer_CH__NMNm_18, 5000);
	}
	// Empfang von NM-Botschaften für den Empfang von nicht im xml enthaltenen NM-ECUs
	if (identifier == 0x19)
	{
		@sysvar::CH_NM::CH__NMNm_19 = 3;
		settimer(Timer_CH__NMNm_19, 5000);
	}
	// Empfang von NM-Botschaften für den Empfang von nicht im xml enthaltenen NM-ECUs
	if (identifier == 0x1a)
	{
		@sysvar::CH_NM::CH__NMNm_1A = 3;
		settimer(Timer_CH__NMNm_1A, 5000);
	}
	// Empfang von NM-Botschaften für den Empfang von nicht im xml enthaltenen NM-ECUs
	if (identifier == 0x1b)
	{
		@sysvar::CH_NM::CH__NMNm_1B = 3;
		settimer(Timer_CH__NMNm_1B, 5000);
	}
	// Empfang von NM-Botschaften für den Empfang von nicht im xml enthaltenen NM-ECUs
	if (identifier == 0x1c)
	{
		@sysvar::CH_NM::CH__NMNm_1C = 3;
		settimer(Timer_CH__NMNm_1C, 5000);
	}
	// Empfang von NM-Botschaften für den Empfang von nicht im xml enthaltenen NM-ECUs
	if (identifier == 0x1d)
	{
		@sysvar::CH_NM::CH__NMNm_1D = 3;
		settimer(Timer_CH__NMNm_1D, 5000);
	}
	// Empfang von NM-Botschaften für den Empfang von nicht im xml enthaltenen NM-ECUs
	if (identifier == 0x1e)
	{
		@sysvar::CH_NM::CH__NMNm_1E = 3;
		settimer(Timer_CH__NMNm_1E, 5000);
	}
	// Empfang von NM-Botschaften für den Empfang von nicht im xml enthaltenen NM-ECUs
	if (identifier == 0x1f)
	{
		@sysvar::CH_NM::CH__NMNm_1F = 3;
		settimer(Timer_CH__NMNm_1F, 5000);
	}
	// Empfang von NM-Botschaften für den Empfang von nicht im xml enthaltenen NM-ECUs
	if (identifier == 0x20)
	{
		@sysvar::CH_NM::CH__NMNm_20 = 3;
		settimer(Timer_CH__NMNm_20, 5000);
	}
	// Empfang von NM-Botschaften für den Empfang von nicht im xml enthaltenen NM-ECUs
	if (identifier == 0x21)
	{
		@sysvar::CH_NM::CH__NMNm_21 = 3;
		settimer(Timer_CH__NMNm_21, 5000);
	}
	// Empfang von NM-Botschaften für den Empfang von nicht im xml enthaltenen NM-ECUs
	if (identifier == 0x22)
	{
		@sysvar::CH_NM::CH__NMNm_22 = 3;
		settimer(Timer_CH__NMNm_22, 5000);
	}
	// Empfang von NM-Botschaften für den Empfang von nicht im xml enthaltenen NM-ECUs
	if (identifier == 0x23)
	{
		@sysvar::CH_NM::CH__NMNm_23 = 3;
		settimer(Timer_CH__NMNm_23, 5000);
	}
	// Empfang von NM-Botschaften für den Empfang von nicht im xml enthaltenen NM-ECUs
	if (identifier == 0x24)
	{
		@sysvar::CH_NM::CH__NMNm_24 = 3;
		settimer(Timer_CH__NMNm_24, 5000);
	}
	// Empfang von NM-Botschaften für den Empfang von nicht im xml enthaltenen NM-ECUs
	if (identifier == 0x25)
	{
		@sysvar::CH_NM::CH__NMNm_25 = 3;
		settimer(Timer_CH__NMNm_25, 5000);
	}
	// Empfang von NM-Botschaften für den Empfang von nicht im xml enthaltenen NM-ECUs
	if (identifier == 0x26)
	{
		@sysvar::CH_NM::CH__NMNm_26 = 3;
		settimer(Timer_CH__NMNm_26, 5000);
	}
	// Empfang von NM-Botschaften für den Empfang von nicht im xml enthaltenen NM-ECUs
	if (identifier == 0x27)
	{
		@sysvar::CH_NM::CH__NMNm_27 = 3;
		settimer(Timer_CH__NMNm_27, 5000);
	}
	// Empfang von NM-Botschaften für den Empfang von nicht im xml enthaltenen NM-ECUs
	if (identifier == 0x28)
	{
		@sysvar::CH_NM::CH__NMNm_28 = 3;
		settimer(Timer_CH__NMNm_28, 5000);
	}
	// Empfang von NM-Botschaften für den Empfang von nicht im xml enthaltenen NM-ECUs
	if (identifier == 0x29)
	{
		@sysvar::CH_NM::CH__NMNm_29 = 3;
		settimer(Timer_CH__NMNm_29, 5000);
	}
	// Empfang von NM-Botschaften für den Empfang von nicht im xml enthaltenen NM-ECUs
	if (identifier == 0x2a)
	{
		@sysvar::CH_NM::CH__NMNm_2A = 3;
		settimer(Timer_CH__NMNm_2A, 5000);
	}
	// Empfang von NM-Botschaften für den Empfang von nicht im xml enthaltenen NM-ECUs
	if (identifier == 0x2b)
	{
		@sysvar::CH_NM::CH__NMNm_2B = 3;
		settimer(Timer_CH__NMNm_2B, 5000);
	}
	// Empfang von NM-Botschaften für den Empfang von nicht im xml enthaltenen NM-ECUs
	if (identifier == 0x2c)
	{
		@sysvar::CH_NM::CH__NMNm_2C = 3;
		settimer(Timer_CH__NMNm_2C, 5000);
	}
	// Empfang von NM-Botschaften für den Empfang von nicht im xml enthaltenen NM-ECUs
	if (identifier == 0x2d)
	{
		@sysvar::CH_NM::CH__NMNm_2D = 3;
		settimer(Timer_CH__NMNm_2D, 5000);
	}
	// Empfang von NM-Botschaften für den Empfang von nicht im xml enthaltenen NM-ECUs
	if (identifier == 0x2e)
	{
		@sysvar::CH_NM::CH__NMNm_2E = 3;
		settimer(Timer_CH__NMNm_2E, 5000);
	}
	// Empfang von NM-Botschaften für den Empfang von nicht im xml enthaltenen NM-ECUs
	if (identifier == 0x2f)
	{
		@sysvar::CH_NM::CH__NMNm_2F = 3;
		settimer(Timer_CH__NMNm_2F, 5000);
	}
	// Empfang von NM-Botschaften für den Empfang von nicht im xml enthaltenen NM-ECUs
	if (identifier == 0x30)
	{
		@sysvar::CH_NM::CH__NMNm_30 = 3;
		settimer(Timer_CH__NMNm_30, 5000);
	}
	// Empfang von NM-Botschaften für den Empfang von nicht im xml enthaltenen NM-ECUs
	if (identifier == 0x31)
	{
		@sysvar::CH_NM::CH__NMNm_31 = 3;
		settimer(Timer_CH__NMNm_31, 5000);
	}
	// Empfang von NM-Botschaften für den Empfang von nicht im xml enthaltenen NM-ECUs
	if (identifier == 0x32)
	{
		@sysvar::CH_NM::CH__NMNm_32 = 3;
		settimer(Timer_CH__NMNm_32, 5000);
	}
	// Empfang von NM-Botschaften für den Empfang von nicht im xml enthaltenen NM-ECUs
	if (identifier == 0x33)
	{
		@sysvar::CH_NM::CH__NMNm_33 = 3;
		settimer(Timer_CH__NMNm_33, 5000);
	}
	// Empfang von NM-Botschaften für den Empfang von nicht im xml enthaltenen NM-ECUs
	if (identifier == 0x34)
	{
		@sysvar::CH_NM::CH__NMNm_34 = 3;
		settimer(Timer_CH__NMNm_34, 5000);
	}
	// Empfang von NM-Botschaften für den Empfang von nicht im xml enthaltenen NM-ECUs
	if (identifier == 0x35)
	{
		@sysvar::CH_NM::CH__NMNm_35 = 3;
		settimer(Timer_CH__NMNm_35, 5000);
	}
	// Empfang von NM-Botschaften für den Empfang von nicht im xml enthaltenen NM-ECUs
	if (identifier == 0x36)
	{
		@sysvar::CH_NM::CH__NMNm_36 = 3;
		settimer(Timer_CH__NMNm_36, 5000);
	}
	// Empfang von NM-Botschaften für den Empfang von nicht im xml enthaltenen NM-ECUs
	if (identifier == 0x37)
	{
		@sysvar::CH_NM::CH__NMNm_37 = 3;
		settimer(Timer_CH__NMNm_37, 5000);
	}
	// Empfang von NM-Botschaften für den Empfang von nicht im xml enthaltenen NM-ECUs
	if (identifier == 0x38)
	{
		@sysvar::CH_NM::CH__NMNm_38 = 3;
		settimer(Timer_CH__NMNm_38, 5000);
	}
	// Empfang von NM-Botschaften für den Empfang von nicht im xml enthaltenen NM-ECUs
	if (identifier == 0x39)
	{
		@sysvar::CH_NM::CH__NMNm_39 = 3;
		settimer(Timer_CH__NMNm_39, 5000);
	}
	// Empfang von NM-Botschaften für den Empfang von nicht im xml enthaltenen NM-ECUs
	if (identifier == 0x3a)
	{
		@sysvar::CH_NM::CH__NMNm_3A = 3;
		settimer(Timer_CH__NMNm_3A, 5000);
	}
	// Empfang von NM-Botschaften für den Empfang von nicht im xml enthaltenen NM-ECUs
	if (identifier == 0x3b)
	{
		@sysvar::CH_NM::CH__NMNm_3B = 3;
		settimer(Timer_CH__NMNm_3B, 5000);
	}
	// Empfang von NM-Botschaften für den Empfang von nicht im xml enthaltenen NM-ECUs
	if (identifier == 0x3c)
	{
		@sysvar::CH_NM::CH__NMNm_3C = 3;
		settimer(Timer_CH__NMNm_3C, 5000);
	}
	// Empfang von NM-Botschaften für den Empfang von nicht im xml enthaltenen NM-ECUs
	if (identifier == 0x3d)
	{
		@sysvar::CH_NM::CH__NMNm_3D = 3;
		settimer(Timer_CH__NMNm_3D, 5000);
	}
	// Empfang von NM-Botschaften für den Empfang von nicht im xml enthaltenen NM-ECUs
	if (identifier == 0x3e)
	{
		@sysvar::CH_NM::CH__NMNm_3E = 3;
		settimer(Timer_CH__NMNm_3E, 5000);
	}
	// Empfang von NM-Botschaften für den Empfang von nicht im xml enthaltenen NM-ECUs
	if (identifier == 0x3f)
	{
		@sysvar::CH_NM::CH__NMNm_3F = 3;
		settimer(Timer_CH__NMNm_3F, 5000);
	}
	// Empfang von NM-Botschaften für den Empfang von nicht im xml enthaltenen NM-ECUs
	if (identifier == 0x40)
	{
		@sysvar::CH_NM::CH__NMNm_40 = 3;
		settimer(Timer_CH__NMNm_40, 5000);
	}
	// Empfang von NM-Botschaften für den Empfang von nicht im xml enthaltenen NM-ECUs
	if (identifier == 0x41)
	{
		@sysvar::CH_NM::CH__NMNm_41 = 3;
		settimer(Timer_CH__NMNm_41, 5000);
	}
	// Empfang von NM-Botschaften für den Empfang von nicht im xml enthaltenen NM-ECUs
	if (identifier == 0x42)
	{
		@sysvar::CH_NM::CH__NMNm_42 = 3;
		settimer(Timer_CH__NMNm_42, 5000);
	}
	// Empfang von NM-Botschaften für den Empfang von nicht im xml enthaltenen NM-ECUs
	if (identifier == 0x43)
	{
		@sysvar::CH_NM::CH__NMNm_43 = 3;
		settimer(Timer_CH__NMNm_43, 5000);
	}
	// Empfang von NM-Botschaften für den Empfang von nicht im xml enthaltenen NM-ECUs
	if (identifier == 0x44)
	{
		@sysvar::CH_NM::CH__NMNm_44 = 3;
		settimer(Timer_CH__NMNm_44, 5000);
	}
	// Empfang von NM-Botschaften für den Empfang von nicht im xml enthaltenen NM-ECUs
	if (identifier == 0x45)
	{
		@sysvar::CH_NM::CH__NMNm_45 = 3;
		settimer(Timer_CH__NMNm_45, 5000);
	}
	// Empfang von NM-Botschaften für den Empfang von nicht im xml enthaltenen NM-ECUs
	if (identifier == 0x46)
	{
		@sysvar::CH_NM::CH__NMNm_46 = 3;
		settimer(Timer_CH__NMNm_46, 5000);
	}
	// Empfang von NM-Botschaften für den Empfang von nicht im xml enthaltenen NM-ECUs
	if (identifier == 0x47)
	{
		@sysvar::CH_NM::CH__NMNm_47 = 3;
		settimer(Timer_CH__NMNm_47, 5000);
	}
	// Empfang von NM-Botschaften für den Empfang von nicht im xml enthaltenen NM-ECUs
	if (identifier == 0x48)
	{
		@sysvar::CH_NM::CH__NMNm_48 = 3;
		settimer(Timer_CH__NMNm_48, 5000);
	}
	// Empfang von NM-Botschaften für den Empfang von nicht im xml enthaltenen NM-ECUs
	if (identifier == 0x49)
	{
		@sysvar::CH_NM::CH__NMNm_49 = 3;
		settimer(Timer_CH__NMNm_49, 5000);
	}
	// Empfang von NM-Botschaften für den Empfang von nicht im xml enthaltenen NM-ECUs
	if (identifier == 0x4a)
	{
		@sysvar::CH_NM::CH__NMNm_4A = 3;
		settimer(Timer_CH__NMNm_4A, 5000);
	}
	// Empfang von NM-Botschaften für den Empfang von nicht im xml enthaltenen NM-ECUs
	if (identifier == 0x4b)
	{
		@sysvar::CH_NM::CH__NMNm_4B = 3;
		settimer(Timer_CH__NMNm_4B, 5000);
	}
	// Empfang von NM-Botschaften für den Empfang von nicht im xml enthaltenen NM-ECUs
	if (identifier == 0x4c)
	{
		@sysvar::CH_NM::CH__NMNm_4C = 3;
		settimer(Timer_CH__NMNm_4C, 5000);
	}
	// Empfang von NM-Botschaften für in der Datenbank enthaltene NM-ECUs
	if (identifier == 0x4d)
	{
		if (@sysvar::CH_NM::CH__NMNm_DRVU != 2) @sysvar::CH_NM::CH__NMNm_DRVU = 2;
		settimer(Timer_CH__NMNm_DRVU, 5000);
		if (@sysvar::CH_NM::CH__NMAppl_DRVU == 2)
		{
			if (@sysvar::CH_NM::CH__NMStat_DRVU != 3) @sysvar::CH_NM::CH__NMStat_DRVU = 3;
		}
		else
		{
			if (@sysvar::CH_NM::CH__NMStat_DRVU != 4) @sysvar::CH_NM::CH__NMStat_DRVU = 4;
		}
	}
	// Empfang von NM-Botschaften für den Empfang von nicht im xml enthaltenen NM-ECUs
	if (identifier == 0x4e)
	{
		@sysvar::CH_NM::CH__NMNm_4E = 3;
		settimer(Timer_CH__NMNm_4E, 5000);
	}
	// Empfang von NM-Botschaften für den Empfang von nicht im xml enthaltenen NM-ECUs
	if (identifier == 0x4f)
	{
		@sysvar::CH_NM::CH__NMNm_4F = 3;
		settimer(Timer_CH__NMNm_4F, 5000);
	}
	// Empfang von NM-Botschaften für den Empfang von nicht im xml enthaltenen NM-ECUs
	if (identifier == 0x50)
	{
		@sysvar::CH_NM::CH__NMNm_50 = 3;
		settimer(Timer_CH__NMNm_50, 5000);
	}
	// Empfang von NM-Botschaften für den Empfang von nicht im xml enthaltenen NM-ECUs
	if (identifier == 0x51)
	{
		@sysvar::CH_NM::CH__NMNm_51 = 3;
		settimer(Timer_CH__NMNm_51, 5000);
	}
	// Empfang von NM-Botschaften für den Empfang von nicht im xml enthaltenen NM-ECUs
	if (identifier == 0x52)
	{
		@sysvar::CH_NM::CH__NMNm_52 = 3;
		settimer(Timer_CH__NMNm_52, 5000);
	}
	// Empfang von NM-Botschaften für den Empfang von nicht im xml enthaltenen NM-ECUs
	if (identifier == 0x53)
	{
		@sysvar::CH_NM::CH__NMNm_53 = 3;
		settimer(Timer_CH__NMNm_53, 5000);
	}
	// Empfang von NM-Botschaften für den Empfang von nicht im xml enthaltenen NM-ECUs
	if (identifier == 0x54)
	{
		@sysvar::CH_NM::CH__NMNm_54 = 3;
		settimer(Timer_CH__NMNm_54, 5000);
	}
	// Empfang von NM-Botschaften für den Empfang von nicht im xml enthaltenen NM-ECUs
	if (identifier == 0x55)
	{
		@sysvar::CH_NM::CH__NMNm_55 = 3;
		settimer(Timer_CH__NMNm_55, 5000);
	}
	// Empfang von NM-Botschaften für den Empfang von nicht im xml enthaltenen NM-ECUs
	if (identifier == 0x56)
	{
		@sysvar::CH_NM::CH__NMNm_56 = 3;
		settimer(Timer_CH__NMNm_56, 5000);
	}
	// Empfang von NM-Botschaften für den Empfang von nicht im xml enthaltenen NM-ECUs
	if (identifier == 0x57)
	{
		@sysvar::CH_NM::CH__NMNm_57 = 3;
		settimer(Timer_CH__NMNm_57, 5000);
	}
	// Empfang von NM-Botschaften für den Empfang von nicht im xml enthaltenen NM-ECUs
	if (identifier == 0x58)
	{
		@sysvar::CH_NM::CH__NMNm_58 = 3;
		settimer(Timer_CH__NMNm_58, 5000);
	}
	// Empfang von NM-Botschaften für in der Datenbank enthaltene NM-ECUs
	if (identifier == 0x59)
	{
		if (@sysvar::CH_NM::CH__NMNm_CPC != 2) @sysvar::CH_NM::CH__NMNm_CPC = 2;
		settimer(Timer_CH__NMNm_CPC, 5000);
		if (@sysvar::CH_NM::CH__NMAppl_CPC == 2)
		{
			if (@sysvar::CH_NM::CH__NMStat_CPC != 3) @sysvar::CH_NM::CH__NMStat_CPC = 3;
		}
		else
		{
			if (@sysvar::CH_NM::CH__NMStat_CPC != 4) @sysvar::CH_NM::CH__NMStat_CPC = 4;
		}
	}
	// Empfang von NM-Botschaften für den Empfang von nicht im xml enthaltenen NM-ECUs
	if (identifier == 0x5a)
	{
		@sysvar::CH_NM::CH__NMNm_5A = 3;
		settimer(Timer_CH__NMNm_5A, 5000);
	}
	// Empfang von NM-Botschaften für den Empfang von nicht im xml enthaltenen NM-ECUs
	if (identifier == 0x5b)
	{
		@sysvar::CH_NM::CH__NMNm_5B = 3;
		settimer(Timer_CH__NMNm_5B, 5000);
	}
	// Empfang von NM-Botschaften für den Empfang von nicht im xml enthaltenen NM-ECUs
	if (identifier == 0x5c)
	{
		@sysvar::CH_NM::CH__NMNm_5C = 3;
		settimer(Timer_CH__NMNm_5C, 5000);
	}
	// Empfang von NM-Botschaften für den Empfang von nicht im xml enthaltenen NM-ECUs
	if (identifier == 0x5d)
	{
		@sysvar::CH_NM::CH__NMNm_5D = 3;
		settimer(Timer_CH__NMNm_5D, 5000);
	}
	// Empfang von NM-Botschaften für den Empfang von nicht im xml enthaltenen NM-ECUs
	if (identifier == 0x5e)
	{
		@sysvar::CH_NM::CH__NMNm_5E = 3;
		settimer(Timer_CH__NMNm_5E, 5000);
	}
	// Empfang von NM-Botschaften für den Empfang von nicht im xml enthaltenen NM-ECUs
	if (identifier == 0x5f)
	{
		@sysvar::CH_NM::CH__NMNm_5F = 3;
		settimer(Timer_CH__NMNm_5F, 5000);
	}
	// Empfang von NM-Botschaften für den Empfang von nicht im xml enthaltenen NM-ECUs
	if (identifier == 0x60)
	{
		@sysvar::CH_NM::CH__NMNm_60 = 3;
		settimer(Timer_CH__NMNm_60, 5000);
	}
	// Empfang von NM-Botschaften für den Empfang von nicht im xml enthaltenen NM-ECUs
	if (identifier == 0x61)
	{
		@sysvar::CH_NM::CH__NMNm_61 = 3;
		settimer(Timer_CH__NMNm_61, 5000);
	}
	// Empfang von NM-Botschaften für den Empfang von nicht im xml enthaltenen NM-ECUs
	if (identifier == 0x62)
	{
		@sysvar::CH_NM::CH__NMNm_62 = 3;
		settimer(Timer_CH__NMNm_62, 5000);
	}
	// Empfang von NM-Botschaften für den Empfang von nicht im xml enthaltenen NM-ECUs
	if (identifier == 0x63)
	{
		@sysvar::CH_NM::CH__NMNm_63 = 3;
		settimer(Timer_CH__NMNm_63, 5000);
	}
	// Empfang von NM-Botschaften für den Empfang von nicht im xml enthaltenen NM-ECUs
	if (identifier == 0x64)
	{
		@sysvar::CH_NM::CH__NMNm_64 = 3;
		settimer(Timer_CH__NMNm_64, 5000);
	}
	// Empfang von NM-Botschaften für den Empfang von nicht im xml enthaltenen NM-ECUs
	if (identifier == 0x65)
	{
		@sysvar::CH_NM::CH__NMNm_65 = 3;
		settimer(Timer_CH__NMNm_65, 5000);
	}
	// Empfang von NM-Botschaften für den Empfang von nicht im xml enthaltenen NM-ECUs
	if (identifier == 0x66)
	{
		@sysvar::CH_NM::CH__NMNm_66 = 3;
		settimer(Timer_CH__NMNm_66, 5000);
	}
	// Empfang von NM-Botschaften für den Empfang von nicht im xml enthaltenen NM-ECUs
	if (identifier == 0x67)
	{
		@sysvar::CH_NM::CH__NMNm_67 = 3;
		settimer(Timer_CH__NMNm_67, 5000);
	}
	// Empfang von NM-Botschaften für den Empfang von nicht im xml enthaltenen NM-ECUs
	if (identifier == 0x68)
	{
		@sysvar::CH_NM::CH__NMNm_68 = 3;
		settimer(Timer_CH__NMNm_68, 5000);
	}
	// Empfang von NM-Botschaften für den Empfang von nicht im xml enthaltenen NM-ECUs
	if (identifier == 0x69)
	{
		@sysvar::CH_NM::CH__NMNm_69 = 3;
		settimer(Timer_CH__NMNm_69, 5000);
	}
	// Empfang von NM-Botschaften für den Empfang von nicht im xml enthaltenen NM-ECUs
	if (identifier == 0x6a)
	{
		@sysvar::CH_NM::CH__NMNm_6A = 3;
		settimer(Timer_CH__NMNm_6A, 5000);
	}
	// Empfang von NM-Botschaften für den Empfang von nicht im xml enthaltenen NM-ECUs
	if (identifier == 0x6b)
	{
		@sysvar::CH_NM::CH__NMNm_6B = 3;
		settimer(Timer_CH__NMNm_6B, 5000);
	}
	// Empfang von NM-Botschaften für den Empfang von nicht im xml enthaltenen NM-ECUs
	if (identifier == 0x6c)
	{
		@sysvar::CH_NM::CH__NMNm_6C = 3;
		settimer(Timer_CH__NMNm_6C, 5000);
	}
	// Empfang von NM-Botschaften für den Empfang von nicht im xml enthaltenen NM-ECUs
	if (identifier == 0x6d)
	{
		@sysvar::CH_NM::CH__NMNm_6D = 3;
		settimer(Timer_CH__NMNm_6D, 5000);
	}
	// Empfang von NM-Botschaften für den Empfang von nicht im xml enthaltenen NM-ECUs
	if (identifier == 0x6e)
	{
		@sysvar::CH_NM::CH__NMNm_6E = 3;
		settimer(Timer_CH__NMNm_6E, 5000);
	}
	// Empfang von NM-Botschaften für den Empfang von nicht im xml enthaltenen NM-ECUs
	if (identifier == 0x6f)
	{
		@sysvar::CH_NM::CH__NMNm_6F = 3;
		settimer(Timer_CH__NMNm_6F, 5000);
	}
	// Empfang von NM-Botschaften für den Empfang von nicht im xml enthaltenen NM-ECUs
	if (identifier == 0x70)
	{
		@sysvar::CH_NM::CH__NMNm_70 = 3;
		settimer(Timer_CH__NMNm_70, 5000);
	}
	// Empfang von NM-Botschaften für den Empfang von nicht im xml enthaltenen NM-ECUs
	if (identifier == 0x71)
	{
		@sysvar::CH_NM::CH__NMNm_71 = 3;
		settimer(Timer_CH__NMNm_71, 5000);
	}
	// Empfang von NM-Botschaften für den Empfang von nicht im xml enthaltenen NM-ECUs
	if (identifier == 0x72)
	{
		@sysvar::CH_NM::CH__NMNm_72 = 3;
		settimer(Timer_CH__NMNm_72, 5000);
	}
	// Empfang von NM-Botschaften für den Empfang von nicht im xml enthaltenen NM-ECUs
	if (identifier == 0x73)
	{
		@sysvar::CH_NM::CH__NMNm_73 = 3;
		settimer(Timer_CH__NMNm_73, 5000);
	}
	// Empfang von NM-Botschaften für den Empfang von nicht im xml enthaltenen NM-ECUs
	if (identifier == 0x74)
	{
		@sysvar::CH_NM::CH__NMNm_74 = 3;
		settimer(Timer_CH__NMNm_74, 5000);
	}
	// Empfang von NM-Botschaften für den Empfang von nicht im xml enthaltenen NM-ECUs
	if (identifier == 0x75)
	{
		@sysvar::CH_NM::CH__NMNm_75 = 3;
		settimer(Timer_CH__NMNm_75, 5000);
	}
	// Empfang von NM-Botschaften für den Empfang von nicht im xml enthaltenen NM-ECUs
	if (identifier == 0x76)
	{
		@sysvar::CH_NM::CH__NMNm_76 = 3;
		settimer(Timer_CH__NMNm_76, 5000);
	}
	// Empfang von NM-Botschaften für den Empfang von nicht im xml enthaltenen NM-ECUs
	if (identifier == 0x77)
	{
		@sysvar::CH_NM::CH__NMNm_77 = 3;
		settimer(Timer_CH__NMNm_77, 5000);
	}
	// Empfang von NM-Botschaften für den Empfang von nicht im xml enthaltenen NM-ECUs
	if (identifier == 0x78)
	{
		@sysvar::CH_NM::CH__NMNm_78 = 3;
		settimer(Timer_CH__NMNm_78, 5000);
	}
	// Empfang von NM-Botschaften für den Empfang von nicht im xml enthaltenen NM-ECUs
	if (identifier == 0x79)
	{
		@sysvar::CH_NM::CH__NMNm_79 = 3;
		settimer(Timer_CH__NMNm_79, 5000);
	}
	// Empfang von NM-Botschaften für den Empfang von nicht im xml enthaltenen NM-ECUs
	if (identifier == 0x7a)
	{
		@sysvar::CH_NM::CH__NMNm_7A = 3;
		settimer(Timer_CH__NMNm_7A, 5000);
	}
	// Empfang von NM-Botschaften für den Empfang von nicht im xml enthaltenen NM-ECUs
	if (identifier == 0x7b)
	{
		@sysvar::CH_NM::CH__NMNm_7B = 3;
		settimer(Timer_CH__NMNm_7B, 5000);
	}
	// Empfang von NM-Botschaften für den Empfang von nicht im xml enthaltenen NM-ECUs
	if (identifier == 0x7c)
	{
		@sysvar::CH_NM::CH__NMNm_7C = 3;
		settimer(Timer_CH__NMNm_7C, 5000);
	}
	// Empfang von NM-Botschaften für den Empfang von nicht im xml enthaltenen NM-ECUs
	if (identifier == 0x7d)
	{
		@sysvar::CH_NM::CH__NMNm_7D = 3;
		settimer(Timer_CH__NMNm_7D, 5000);
	}
	// Empfang von NM-Botschaften für den Empfang von nicht im xml enthaltenen NM-ECUs
	if (identifier == 0x7e)
	{
		@sysvar::CH_NM::CH__NMNm_7E = 3;
		settimer(Timer_CH__NMNm_7E, 5000);
	}
	// Empfang von NM-Botschaften für in der Datenbank enthaltene NM-ECUs
	if (identifier == 0x7f)
	{
		if (@sysvar::CH_NM::CH__NMNm_NM != 2) @sysvar::CH_NM::CH__NMNm_NM = 2;
		settimer(Timer_CH__NMNm_NM, 5000);
		if (@sysvar::CH_NM::CH__NMAppl_NM == 2)
		{
			if (@sysvar::CH_NM::CH__NMStat_NM != 3) @sysvar::CH_NM::CH__NMStat_NM = 3;
		}
		else
		{
			if (@sysvar::CH_NM::CH__NMStat_NM != 4) @sysvar::CH_NM::CH__NMStat_NM = 4;
		}
	}
	// Empfang von NM-Botschaften für in der Datenbank enthaltene NM-ECUs
	if (identifier == 0x80)
	{
		if (@sysvar::CH_NM::CH__NMNm_MPC != 2) @sysvar::CH_NM::CH__NMNm_MPC = 2;
		settimer(Timer_CH__NMNm_MPC, 5000);
		if (@sysvar::CH_NM::CH__NMAppl_MPC == 2)
		{
			if (@sysvar::CH_NM::CH__NMStat_MPC != 3) @sysvar::CH_NM::CH__NMStat_MPC = 3;
		}
		else
		{
			if (@sysvar::CH_NM::CH__NMStat_MPC != 4) @sysvar::CH_NM::CH__NMStat_MPC = 4;
		}
	}
	// Empfang von NM-Botschaften für in der Datenbank enthaltene NM-ECUs
	if (identifier == 0x81)
	{
		if (@sysvar::CH_NM::CH__NMNm_LRR != 2) @sysvar::CH_NM::CH__NMNm_LRR = 2;
		settimer(Timer_CH__NMNm_LRR, 5000);
		if (@sysvar::CH_NM::CH__NMAppl_LRR == 2)
		{
			if (@sysvar::CH_NM::CH__NMStat_LRR != 3) @sysvar::CH_NM::CH__NMStat_LRR = 3;
		}
		else
		{
			if (@sysvar::CH_NM::CH__NMStat_LRR != 4) @sysvar::CH_NM::CH__NMStat_LRR = 4;
		}
	}
	// Empfang von NM-Botschaften für in der Datenbank enthaltene NM-ECUs
	if (identifier == 0x82)
	{
		if (@sysvar::CH_NM::CH__NMNm_FCWRDUSDTR != 2) @sysvar::CH_NM::CH__NMNm_FCWRDUSDTR = 2;
		settimer(Timer_CH__NMNm_FCWRDUSDTR, 5000);
		if (@sysvar::CH_NM::CH__NMAppl_FCWRDUSDTR == 2)
		{
			if (@sysvar::CH_NM::CH__NMStat_FCWRDUSDTR != 3) @sysvar::CH_NM::CH__NMStat_FCWRDUSDTR = 3;
		}
		else
		{
			if (@sysvar::CH_NM::CH__NMStat_FCWRDUSDTR != 4) @sysvar::CH_NM::CH__NMStat_FCWRDUSDTR = 4;
		}
	}
	// Empfang von NM-Botschaften für in der Datenbank enthaltene NM-ECUs
	if (identifier == 0x83)
	{
		if (@sysvar::CH_NM::CH__NMNm_PARK != 2) @sysvar::CH_NM::CH__NMNm_PARK = 2;
		settimer(Timer_CH__NMNm_PARK, 5000);
		if (@sysvar::CH_NM::CH__NMAppl_PARK == 2)
		{
			if (@sysvar::CH_NM::CH__NMStat_PARK != 3) @sysvar::CH_NM::CH__NMStat_PARK = 3;
		}
		else
		{
			if (@sysvar::CH_NM::CH__NMStat_PARK != 4) @sysvar::CH_NM::CH__NMStat_PARK = 4;
		}
	}
	// Empfang von NM-Botschaften für in der Datenbank enthaltene NM-ECUs
	if (identifier == 0x84)
	{
		if (@sysvar::CH_NM::CH__NMNm_SPC != 2) @sysvar::CH_NM::CH__NMNm_SPC = 2;
		settimer(Timer_CH__NMNm_SPC, 5000);
		if (@sysvar::CH_NM::CH__NMAppl_SPC == 2)
		{
			if (@sysvar::CH_NM::CH__NMStat_SPC != 3) @sysvar::CH_NM::CH__NMStat_SPC = 3;
		}
		else
		{
			if (@sysvar::CH_NM::CH__NMStat_SPC != 4) @sysvar::CH_NM::CH__NMStat_SPC = 4;
		}
	}
	// Empfang von NM-Botschaften für in der Datenbank enthaltene NM-ECUs
	if (identifier == 0x85)
	{
		if (@sysvar::CH_NM::CH__NMNm_EPS != 2) @sysvar::CH_NM::CH__NMNm_EPS = 2;
		settimer(Timer_CH__NMNm_EPS, 5000);
		if (@sysvar::CH_NM::CH__NMAppl_EPS == 2)
		{
			if (@sysvar::CH_NM::CH__NMStat_EPS != 3) @sysvar::CH_NM::CH__NMStat_EPS = 3;
		}
		else
		{
			if (@sysvar::CH_NM::CH__NMStat_EPS != 4) @sysvar::CH_NM::CH__NMStat_EPS = 4;
		}
	}
	// Empfang von NM-Botschaften für in der Datenbank enthaltene NM-ECUs
	if (identifier == 0x86)
	{
		if (@sysvar::CH_NM::CH__NMNm_SCCM != 2) @sysvar::CH_NM::CH__NMNm_SCCM = 2;
		settimer(Timer_CH__NMNm_SCCM, 5000);
		if (@sysvar::CH_NM::CH__NMAppl_SCCM == 2)
		{
			if (@sysvar::CH_NM::CH__NMStat_SCCM != 3) @sysvar::CH_NM::CH__NMStat_SCCM = 3;
		}
		else
		{
			if (@sysvar::CH_NM::CH__NMStat_SCCM != 4) @sysvar::CH_NM::CH__NMStat_SCCM = 4;
		}
	}
	// Empfang von NM-Botschaften für in der Datenbank enthaltene NM-ECUs
	if (identifier == 0x87)
	{
		if (@sysvar::CH_NM::CH__NMNm_ESP != 2) @sysvar::CH_NM::CH__NMNm_ESP = 2;
		settimer(Timer_CH__NMNm_ESP, 5000);
		if (@sysvar::CH_NM::CH__NMAppl_ESP == 2)
		{
			if (@sysvar::CH_NM::CH__NMStat_ESP != 3) @sysvar::CH_NM::CH__NMStat_ESP = 3;
		}
		else
		{
			if (@sysvar::CH_NM::CH__NMStat_ESP != 4) @sysvar::CH_NM::CH__NMStat_ESP = 4;
		}
	}
	// Empfang von NM-Botschaften für in der Datenbank enthaltene NM-ECUs
	if (identifier == 0x88)
	{
		if (@sysvar::CH_NM::CH__NMNm_SPC_VX != 2) @sysvar::CH_NM::CH__NMNm_SPC_VX = 2;
		settimer(Timer_CH__NMNm_SPC_VX, 5000);
		if (@sysvar::CH_NM::CH__NMAppl_SPC_VX == 2)
		{
			if (@sysvar::CH_NM::CH__NMStat_SPC_VX != 3) @sysvar::CH_NM::CH__NMStat_SPC_VX = 3;
		}
		else
		{
			if (@sysvar::CH_NM::CH__NMStat_SPC_VX != 4) @sysvar::CH_NM::CH__NMStat_SPC_VX = 4;
		}
	}
	// Empfang von NM-Botschaften für in der Datenbank enthaltene NM-ECUs
	if (identifier == 0x89)
	{
		if (@sysvar::CH_NM::CH__NMNm_AWD_TCASE != 2) @sysvar::CH_NM::CH__NMNm_AWD_TCASE = 2;
		settimer(Timer_CH__NMNm_AWD_TCASE, 5000);
		if (@sysvar::CH_NM::CH__NMAppl_AWD_TCASE == 2)
		{
			if (@sysvar::CH_NM::CH__NMStat_AWD_TCASE != 3) @sysvar::CH_NM::CH__NMStat_AWD_TCASE = 3;
		}
		else
		{
			if (@sysvar::CH_NM::CH__NMStat_AWD_TCASE != 4) @sysvar::CH_NM::CH__NMStat_AWD_TCASE = 4;
		}
	}
}
/*@@end*/

/*@@frFrame:*:*/
on frFrame *
{
	//Damit auch FlexRay-Frames durch diesen Knoten kommen. Ohne diese Funktion wirkt der Knoten wie ein Filter für FlexRay-Frames.
	output(this);
}

/*@@frPDU:*:*/
on frPDU *
{
	RecognizeNMPduRxInd(this.FR_SlotID, this.Byte(1), (this.Byte(0) & 0x01 ? 1: 0), this.FR_Payload);
	output(this);
}
/*@@end*/

on linMessage *
{
	//Keeps LIN messages passing through.
	output(this);
}

/*@@msg:*:*/
on message *
{
	//Damit auch CAN-Botschaften durch diesen Knoten kommen. Ohne diese Funktion wirkt der Knoten wie ein Filter für CAN-PDUs.
	output(this);
}
/*@@end*/

// AWD_TCASE
/*@@timer:Timer_CH__NMNm_00:*/
on timer Timer_CH__NMNm_00
{
// Timer für den Empfang von nicht im xml enthaltenen NM-ECUs
	@sysvar::CH_NM::CH__NMNm_00 = 2;
}
/*@@end*/

// AWD_TCASE
/*@@timer:Timer_CH__NMNm_01:*/
on timer Timer_CH__NMNm_01
{
// Timer für den Empfang von nicht im xml enthaltenen NM-ECUs
	@sysvar::CH_NM::CH__NMNm_01 = 2;
}
/*@@end*/

// AWD_TCASE
/*@@timer:Timer_CH__NMNm_02:*/
on timer Timer_CH__NMNm_02
{
// Timer für den Empfang von nicht im xml enthaltenen NM-ECUs
	@sysvar::CH_NM::CH__NMNm_02 = 2;
}
/*@@end*/

// AWD_TCASE
/*@@timer:Timer_CH__NMNm_03:*/
on timer Timer_CH__NMNm_03
{
// Timer für den Empfang von nicht im xml enthaltenen NM-ECUs
	@sysvar::CH_NM::CH__NMNm_03 = 2;
}
/*@@end*/

// AWD_TCASE
/*@@timer:Timer_CH__NMNm_04:*/
on timer Timer_CH__NMNm_04
{
// Timer für den Empfang von nicht im xml enthaltenen NM-ECUs
	@sysvar::CH_NM::CH__NMNm_04 = 2;
}
/*@@end*/

// AWD_TCASE
/*@@timer:Timer_CH__NMNm_05:*/
on timer Timer_CH__NMNm_05
{
// Timer für den Empfang von nicht im xml enthaltenen NM-ECUs
	@sysvar::CH_NM::CH__NMNm_05 = 2;
}
/*@@end*/

// AWD_TCASE
/*@@timer:Timer_CH__NMNm_06:*/
on timer Timer_CH__NMNm_06
{
// Timer für den Empfang von nicht im xml enthaltenen NM-ECUs
	@sysvar::CH_NM::CH__NMNm_06 = 2;
}
/*@@end*/

// EIS
/*@@timer:Timer_CH__NMAppl_EIS:*/
on timer Timer_CH__NMAppl_EIS
{
	@sysvar::CH_NM::CH__NMAppl_EIS = 1;
	@sysvar::CH_NM::CH__NMStat_EIS = 0;
}
/*@@end*/
// EIS
/*@@timer:Timer_CH__NMNm_EIS:*/
on timer Timer_CH__NMNm_EIS
{
	if (@sysvar::CH_NM::CH__NMNm_EIS != 1) @sysvar::CH_NM::CH__NMNm_EIS = 1;
	if (@sysvar::CH_NM::CH__NMAppl_EIS == 2)
	{
		if (@sysvar::CH_NM::CH__NMStat_EIS != 4) @sysvar::CH_NM::CH__NMStat_EIS = 4;
	}
	else
	{
		if (@sysvar::CH_NM::CH__NMStat_EIS != 0) @sysvar::CH_NM::CH__NMStat_EIS = 0;
	}
}
/*@@end*/

// EIS
/*@@timer:Timer_CH__NMNm_08:*/
on timer Timer_CH__NMNm_08
{
// Timer für den Empfang von nicht im xml enthaltenen NM-ECUs
	@sysvar::CH_NM::CH__NMNm_08 = 2;
}
/*@@end*/

// EIS
/*@@timer:Timer_CH__NMNm_09:*/
on timer Timer_CH__NMNm_09
{
// Timer für den Empfang von nicht im xml enthaltenen NM-ECUs
	@sysvar::CH_NM::CH__NMNm_09 = 2;
}
/*@@end*/

// EIS
/*@@timer:Timer_CH__NMNm_0A:*/
on timer Timer_CH__NMNm_0A
{
// Timer für den Empfang von nicht im xml enthaltenen NM-ECUs
	@sysvar::CH_NM::CH__NMNm_0A = 2;
}
/*@@end*/

// EIS
/*@@timer:Timer_CH__NMNm_0B:*/
on timer Timer_CH__NMNm_0B
{
// Timer für den Empfang von nicht im xml enthaltenen NM-ECUs
	@sysvar::CH_NM::CH__NMNm_0B = 2;
}
/*@@end*/

// EIS
/*@@timer:Timer_CH__NMNm_0C:*/
on timer Timer_CH__NMNm_0C
{
// Timer für den Empfang von nicht im xml enthaltenen NM-ECUs
	@sysvar::CH_NM::CH__NMNm_0C = 2;
}
/*@@end*/

// EIS
/*@@timer:Timer_CH__NMNm_0D:*/
on timer Timer_CH__NMNm_0D
{
// Timer für den Empfang von nicht im xml enthaltenen NM-ECUs
	@sysvar::CH_NM::CH__NMNm_0D = 2;
}
/*@@end*/

// EIS
/*@@timer:Timer_CH__NMNm_0E:*/
on timer Timer_CH__NMNm_0E
{
// Timer für den Empfang von nicht im xml enthaltenen NM-ECUs
	@sysvar::CH_NM::CH__NMNm_0E = 2;
}
/*@@end*/

// EIS
/*@@timer:Timer_CH__NMNm_0F:*/
on timer Timer_CH__NMNm_0F
{
// Timer für den Empfang von nicht im xml enthaltenen NM-ECUs
	@sysvar::CH_NM::CH__NMNm_0F = 2;
}
/*@@end*/

// EIS
/*@@timer:Timer_CH__NMNm_10:*/
on timer Timer_CH__NMNm_10
{
// Timer für den Empfang von nicht im xml enthaltenen NM-ECUs
	@sysvar::CH_NM::CH__NMNm_10 = 2;
}
/*@@end*/

// EIS
/*@@timer:Timer_CH__NMNm_11:*/
on timer Timer_CH__NMNm_11
{
// Timer für den Empfang von nicht im xml enthaltenen NM-ECUs
	@sysvar::CH_NM::CH__NMNm_11 = 2;
}
/*@@end*/

// EIS
/*@@timer:Timer_CH__NMNm_12:*/
on timer Timer_CH__NMNm_12
{
// Timer für den Empfang von nicht im xml enthaltenen NM-ECUs
	@sysvar::CH_NM::CH__NMNm_12 = 2;
}
/*@@end*/

// EIS
/*@@timer:Timer_CH__NMNm_13:*/
on timer Timer_CH__NMNm_13
{
// Timer für den Empfang von nicht im xml enthaltenen NM-ECUs
	@sysvar::CH_NM::CH__NMNm_13 = 2;
}
/*@@end*/

// EIS
/*@@timer:Timer_CH__NMNm_14:*/
on timer Timer_CH__NMNm_14
{
// Timer für den Empfang von nicht im xml enthaltenen NM-ECUs
	@sysvar::CH_NM::CH__NMNm_14 = 2;
}
/*@@end*/

// EIS
/*@@timer:Timer_CH__NMNm_15:*/
on timer Timer_CH__NMNm_15
{
// Timer für den Empfang von nicht im xml enthaltenen NM-ECUs
	@sysvar::CH_NM::CH__NMNm_15 = 2;
}
/*@@end*/

// EIS
/*@@timer:Timer_CH__NMNm_16:*/
on timer Timer_CH__NMNm_16
{
// Timer für den Empfang von nicht im xml enthaltenen NM-ECUs
	@sysvar::CH_NM::CH__NMNm_16 = 2;
}
/*@@end*/

// EIS
/*@@timer:Timer_CH__NMNm_17:*/
on timer Timer_CH__NMNm_17
{
// Timer für den Empfang von nicht im xml enthaltenen NM-ECUs
	@sysvar::CH_NM::CH__NMNm_17 = 2;
}
/*@@end*/

// EIS
/*@@timer:Timer_CH__NMNm_18:*/
on timer Timer_CH__NMNm_18
{
// Timer für den Empfang von nicht im xml enthaltenen NM-ECUs
	@sysvar::CH_NM::CH__NMNm_18 = 2;
}
/*@@end*/

// EIS
/*@@timer:Timer_CH__NMNm_19:*/
on timer Timer_CH__NMNm_19
{
// Timer für den Empfang von nicht im xml enthaltenen NM-ECUs
	@sysvar::CH_NM::CH__NMNm_19 = 2;
}
/*@@end*/

// EIS
/*@@timer:Timer_CH__NMNm_1A:*/
on timer Timer_CH__NMNm_1A
{
// Timer für den Empfang von nicht im xml enthaltenen NM-ECUs
	@sysvar::CH_NM::CH__NMNm_1A = 2;
}
/*@@end*/

// EIS
/*@@timer:Timer_CH__NMNm_1B:*/
on timer Timer_CH__NMNm_1B
{
// Timer für den Empfang von nicht im xml enthaltenen NM-ECUs
	@sysvar::CH_NM::CH__NMNm_1B = 2;
}
/*@@end*/

// EIS
/*@@timer:Timer_CH__NMNm_1C:*/
on timer Timer_CH__NMNm_1C
{
// Timer für den Empfang von nicht im xml enthaltenen NM-ECUs
	@sysvar::CH_NM::CH__NMNm_1C = 2;
}
/*@@end*/

// EIS
/*@@timer:Timer_CH__NMNm_1D:*/
on timer Timer_CH__NMNm_1D
{
// Timer für den Empfang von nicht im xml enthaltenen NM-ECUs
	@sysvar::CH_NM::CH__NMNm_1D = 2;
}
/*@@end*/

// EIS
/*@@timer:Timer_CH__NMNm_1E:*/
on timer Timer_CH__NMNm_1E
{
// Timer für den Empfang von nicht im xml enthaltenen NM-ECUs
	@sysvar::CH_NM::CH__NMNm_1E = 2;
}
/*@@end*/

// EIS
/*@@timer:Timer_CH__NMNm_1F:*/
on timer Timer_CH__NMNm_1F
{
// Timer für den Empfang von nicht im xml enthaltenen NM-ECUs
	@sysvar::CH_NM::CH__NMNm_1F = 2;
}
/*@@end*/

// EIS
/*@@timer:Timer_CH__NMNm_20:*/
on timer Timer_CH__NMNm_20
{
// Timer für den Empfang von nicht im xml enthaltenen NM-ECUs
	@sysvar::CH_NM::CH__NMNm_20 = 2;
}
/*@@end*/

// EIS
/*@@timer:Timer_CH__NMNm_21:*/
on timer Timer_CH__NMNm_21
{
// Timer für den Empfang von nicht im xml enthaltenen NM-ECUs
	@sysvar::CH_NM::CH__NMNm_21 = 2;
}
/*@@end*/

// EIS
/*@@timer:Timer_CH__NMNm_22:*/
on timer Timer_CH__NMNm_22
{
// Timer für den Empfang von nicht im xml enthaltenen NM-ECUs
	@sysvar::CH_NM::CH__NMNm_22 = 2;
}
/*@@end*/

// EIS
/*@@timer:Timer_CH__NMNm_23:*/
on timer Timer_CH__NMNm_23
{
// Timer für den Empfang von nicht im xml enthaltenen NM-ECUs
	@sysvar::CH_NM::CH__NMNm_23 = 2;
}
/*@@end*/

// EIS
/*@@timer:Timer_CH__NMNm_24:*/
on timer Timer_CH__NMNm_24
{
// Timer für den Empfang von nicht im xml enthaltenen NM-ECUs
	@sysvar::CH_NM::CH__NMNm_24 = 2;
}
/*@@end*/

// EIS
/*@@timer:Timer_CH__NMNm_25:*/
on timer Timer_CH__NMNm_25
{
// Timer für den Empfang von nicht im xml enthaltenen NM-ECUs
	@sysvar::CH_NM::CH__NMNm_25 = 2;
}
/*@@end*/

// EIS
/*@@timer:Timer_CH__NMNm_26:*/
on timer Timer_CH__NMNm_26
{
// Timer für den Empfang von nicht im xml enthaltenen NM-ECUs
	@sysvar::CH_NM::CH__NMNm_26 = 2;
}
/*@@end*/

// EIS
/*@@timer:Timer_CH__NMNm_27:*/
on timer Timer_CH__NMNm_27
{
// Timer für den Empfang von nicht im xml enthaltenen NM-ECUs
	@sysvar::CH_NM::CH__NMNm_27 = 2;
}
/*@@end*/

// EIS
/*@@timer:Timer_CH__NMNm_28:*/
on timer Timer_CH__NMNm_28
{
// Timer für den Empfang von nicht im xml enthaltenen NM-ECUs
	@sysvar::CH_NM::CH__NMNm_28 = 2;
}
/*@@end*/

// EIS
/*@@timer:Timer_CH__NMNm_29:*/
on timer Timer_CH__NMNm_29
{
// Timer für den Empfang von nicht im xml enthaltenen NM-ECUs
	@sysvar::CH_NM::CH__NMNm_29 = 2;
}
/*@@end*/

// EIS
/*@@timer:Timer_CH__NMNm_2A:*/
on timer Timer_CH__NMNm_2A
{
// Timer für den Empfang von nicht im xml enthaltenen NM-ECUs
	@sysvar::CH_NM::CH__NMNm_2A = 2;
}
/*@@end*/

// EIS
/*@@timer:Timer_CH__NMNm_2B:*/
on timer Timer_CH__NMNm_2B
{
// Timer für den Empfang von nicht im xml enthaltenen NM-ECUs
	@sysvar::CH_NM::CH__NMNm_2B = 2;
}
/*@@end*/

// EIS
/*@@timer:Timer_CH__NMNm_2C:*/
on timer Timer_CH__NMNm_2C
{
// Timer für den Empfang von nicht im xml enthaltenen NM-ECUs
	@sysvar::CH_NM::CH__NMNm_2C = 2;
}
/*@@end*/

// EIS
/*@@timer:Timer_CH__NMNm_2D:*/
on timer Timer_CH__NMNm_2D
{
// Timer für den Empfang von nicht im xml enthaltenen NM-ECUs
	@sysvar::CH_NM::CH__NMNm_2D = 2;
}
/*@@end*/

// EIS
/*@@timer:Timer_CH__NMNm_2E:*/
on timer Timer_CH__NMNm_2E
{
// Timer für den Empfang von nicht im xml enthaltenen NM-ECUs
	@sysvar::CH_NM::CH__NMNm_2E = 2;
}
/*@@end*/

// EIS
/*@@timer:Timer_CH__NMNm_2F:*/
on timer Timer_CH__NMNm_2F
{
// Timer für den Empfang von nicht im xml enthaltenen NM-ECUs
	@sysvar::CH_NM::CH__NMNm_2F = 2;
}
/*@@end*/

// EIS
/*@@timer:Timer_CH__NMNm_30:*/
on timer Timer_CH__NMNm_30
{
// Timer für den Empfang von nicht im xml enthaltenen NM-ECUs
	@sysvar::CH_NM::CH__NMNm_30 = 2;
}
/*@@end*/

// EIS
/*@@timer:Timer_CH__NMNm_31:*/
on timer Timer_CH__NMNm_31
{
// Timer für den Empfang von nicht im xml enthaltenen NM-ECUs
	@sysvar::CH_NM::CH__NMNm_31 = 2;
}
/*@@end*/

// EIS
/*@@timer:Timer_CH__NMNm_32:*/
on timer Timer_CH__NMNm_32
{
// Timer für den Empfang von nicht im xml enthaltenen NM-ECUs
	@sysvar::CH_NM::CH__NMNm_32 = 2;
}
/*@@end*/

// EIS
/*@@timer:Timer_CH__NMNm_33:*/
on timer Timer_CH__NMNm_33
{
// Timer für den Empfang von nicht im xml enthaltenen NM-ECUs
	@sysvar::CH_NM::CH__NMNm_33 = 2;
}
/*@@end*/

// EIS
/*@@timer:Timer_CH__NMNm_34:*/
on timer Timer_CH__NMNm_34
{
// Timer für den Empfang von nicht im xml enthaltenen NM-ECUs
	@sysvar::CH_NM::CH__NMNm_34 = 2;
}
/*@@end*/

// EIS
/*@@timer:Timer_CH__NMNm_35:*/
on timer Timer_CH__NMNm_35
{
// Timer für den Empfang von nicht im xml enthaltenen NM-ECUs
	@sysvar::CH_NM::CH__NMNm_35 = 2;
}
/*@@end*/

// EIS
/*@@timer:Timer_CH__NMNm_36:*/
on timer Timer_CH__NMNm_36
{
// Timer für den Empfang von nicht im xml enthaltenen NM-ECUs
	@sysvar::CH_NM::CH__NMNm_36 = 2;
}
/*@@end*/

// EIS
/*@@timer:Timer_CH__NMNm_37:*/
on timer Timer_CH__NMNm_37
{
// Timer für den Empfang von nicht im xml enthaltenen NM-ECUs
	@sysvar::CH_NM::CH__NMNm_37 = 2;
}
/*@@end*/

// EIS
/*@@timer:Timer_CH__NMNm_38:*/
on timer Timer_CH__NMNm_38
{
// Timer für den Empfang von nicht im xml enthaltenen NM-ECUs
	@sysvar::CH_NM::CH__NMNm_38 = 2;
}
/*@@end*/

// EIS
/*@@timer:Timer_CH__NMNm_39:*/
on timer Timer_CH__NMNm_39
{
// Timer für den Empfang von nicht im xml enthaltenen NM-ECUs
	@sysvar::CH_NM::CH__NMNm_39 = 2;
}
/*@@end*/

// EIS
/*@@timer:Timer_CH__NMNm_3A:*/
on timer Timer_CH__NMNm_3A
{
// Timer für den Empfang von nicht im xml enthaltenen NM-ECUs
	@sysvar::CH_NM::CH__NMNm_3A = 2;
}
/*@@end*/

// EIS
/*@@timer:Timer_CH__NMNm_3B:*/
on timer Timer_CH__NMNm_3B
{
// Timer für den Empfang von nicht im xml enthaltenen NM-ECUs
	@sysvar::CH_NM::CH__NMNm_3B = 2;
}
/*@@end*/

// EIS
/*@@timer:Timer_CH__NMNm_3C:*/
on timer Timer_CH__NMNm_3C
{
// Timer für den Empfang von nicht im xml enthaltenen NM-ECUs
	@sysvar::CH_NM::CH__NMNm_3C = 2;
}
/*@@end*/

// EIS
/*@@timer:Timer_CH__NMNm_3D:*/
on timer Timer_CH__NMNm_3D
{
// Timer für den Empfang von nicht im xml enthaltenen NM-ECUs
	@sysvar::CH_NM::CH__NMNm_3D = 2;
}
/*@@end*/

// EIS
/*@@timer:Timer_CH__NMNm_3E:*/
on timer Timer_CH__NMNm_3E
{
// Timer für den Empfang von nicht im xml enthaltenen NM-ECUs
	@sysvar::CH_NM::CH__NMNm_3E = 2;
}
/*@@end*/

// EIS
/*@@timer:Timer_CH__NMNm_3F:*/
on timer Timer_CH__NMNm_3F
{
// Timer für den Empfang von nicht im xml enthaltenen NM-ECUs
	@sysvar::CH_NM::CH__NMNm_3F = 2;
}
/*@@end*/

// EIS
/*@@timer:Timer_CH__NMNm_40:*/
on timer Timer_CH__NMNm_40
{
// Timer für den Empfang von nicht im xml enthaltenen NM-ECUs
	@sysvar::CH_NM::CH__NMNm_40 = 2;
}
/*@@end*/

// EIS
/*@@timer:Timer_CH__NMNm_41:*/
on timer Timer_CH__NMNm_41
{
// Timer für den Empfang von nicht im xml enthaltenen NM-ECUs
	@sysvar::CH_NM::CH__NMNm_41 = 2;
}
/*@@end*/

// EIS
/*@@timer:Timer_CH__NMNm_42:*/
on timer Timer_CH__NMNm_42
{
// Timer für den Empfang von nicht im xml enthaltenen NM-ECUs
	@sysvar::CH_NM::CH__NMNm_42 = 2;
}
/*@@end*/

// EIS
/*@@timer:Timer_CH__NMNm_43:*/
on timer Timer_CH__NMNm_43
{
// Timer für den Empfang von nicht im xml enthaltenen NM-ECUs
	@sysvar::CH_NM::CH__NMNm_43 = 2;
}
/*@@end*/

// EIS
/*@@timer:Timer_CH__NMNm_44:*/
on timer Timer_CH__NMNm_44
{
// Timer für den Empfang von nicht im xml enthaltenen NM-ECUs
	@sysvar::CH_NM::CH__NMNm_44 = 2;
}
/*@@end*/

// EIS
/*@@timer:Timer_CH__NMNm_45:*/
on timer Timer_CH__NMNm_45
{
// Timer für den Empfang von nicht im xml enthaltenen NM-ECUs
	@sysvar::CH_NM::CH__NMNm_45 = 2;
}
/*@@end*/

// EIS
/*@@timer:Timer_CH__NMNm_46:*/
on timer Timer_CH__NMNm_46
{
// Timer für den Empfang von nicht im xml enthaltenen NM-ECUs
	@sysvar::CH_NM::CH__NMNm_46 = 2;
}
/*@@end*/

// EIS
/*@@timer:Timer_CH__NMNm_47:*/
on timer Timer_CH__NMNm_47
{
// Timer für den Empfang von nicht im xml enthaltenen NM-ECUs
	@sysvar::CH_NM::CH__NMNm_47 = 2;
}
/*@@end*/

// EIS
/*@@timer:Timer_CH__NMNm_48:*/
on timer Timer_CH__NMNm_48
{
// Timer für den Empfang von nicht im xml enthaltenen NM-ECUs
	@sysvar::CH_NM::CH__NMNm_48 = 2;
}
/*@@end*/

// EIS
/*@@timer:Timer_CH__NMNm_49:*/
on timer Timer_CH__NMNm_49
{
// Timer für den Empfang von nicht im xml enthaltenen NM-ECUs
	@sysvar::CH_NM::CH__NMNm_49 = 2;
}
/*@@end*/

// EIS
/*@@timer:Timer_CH__NMNm_4A:*/
on timer Timer_CH__NMNm_4A
{
// Timer für den Empfang von nicht im xml enthaltenen NM-ECUs
	@sysvar::CH_NM::CH__NMNm_4A = 2;
}
/*@@end*/

// EIS
/*@@timer:Timer_CH__NMNm_4B:*/
on timer Timer_CH__NMNm_4B
{
// Timer für den Empfang von nicht im xml enthaltenen NM-ECUs
	@sysvar::CH_NM::CH__NMNm_4B = 2;
}
/*@@end*/

// EIS
/*@@timer:Timer_CH__NMNm_4C:*/
on timer Timer_CH__NMNm_4C
{
// Timer für den Empfang von nicht im xml enthaltenen NM-ECUs
	@sysvar::CH_NM::CH__NMNm_4C = 2;
}
/*@@end*/

// DRVU
/*@@timer:Timer_CH__NMAppl_DRVU:*/
on timer Timer_CH__NMAppl_DRVU
{
	@sysvar::CH_NM::CH__NMAppl_DRVU = 1;
	@sysvar::CH_NM::CH__NMStat_DRVU = 0;
}
/*@@end*/
// DRVU
/*@@timer:Timer_CH__NMNm_DRVU:*/
on timer Timer_CH__NMNm_DRVU
{
	if (@sysvar::CH_NM::CH__NMNm_DRVU != 1) @sysvar::CH_NM::CH__NMNm_DRVU = 1;
	if (@sysvar::CH_NM::CH__NMAppl_DRVU == 2)
	{
		if (@sysvar::CH_NM::CH__NMStat_DRVU != 4) @sysvar::CH_NM::CH__NMStat_DRVU = 4;
	}
	else
	{
		if (@sysvar::CH_NM::CH__NMStat_DRVU != 0) @sysvar::CH_NM::CH__NMStat_DRVU = 0;
	}
}
/*@@end*/

// DRVU
/*@@timer:Timer_CH__NMNm_4E:*/
on timer Timer_CH__NMNm_4E
{
// Timer für den Empfang von nicht im xml enthaltenen NM-ECUs
	@sysvar::CH_NM::CH__NMNm_4E = 2;
}
/*@@end*/

// DRVU
/*@@timer:Timer_CH__NMNm_4F:*/
on timer Timer_CH__NMNm_4F
{
// Timer für den Empfang von nicht im xml enthaltenen NM-ECUs
	@sysvar::CH_NM::CH__NMNm_4F = 2;
}
/*@@end*/

// DRVU
/*@@timer:Timer_CH__NMNm_50:*/
on timer Timer_CH__NMNm_50
{
// Timer für den Empfang von nicht im xml enthaltenen NM-ECUs
	@sysvar::CH_NM::CH__NMNm_50 = 2;
}
/*@@end*/

// DRVU
/*@@timer:Timer_CH__NMNm_51:*/
on timer Timer_CH__NMNm_51
{
// Timer für den Empfang von nicht im xml enthaltenen NM-ECUs
	@sysvar::CH_NM::CH__NMNm_51 = 2;
}
/*@@end*/

// DRVU
/*@@timer:Timer_CH__NMNm_52:*/
on timer Timer_CH__NMNm_52
{
// Timer für den Empfang von nicht im xml enthaltenen NM-ECUs
	@sysvar::CH_NM::CH__NMNm_52 = 2;
}
/*@@end*/

// DRVU
/*@@timer:Timer_CH__NMNm_53:*/
on timer Timer_CH__NMNm_53
{
// Timer für den Empfang von nicht im xml enthaltenen NM-ECUs
	@sysvar::CH_NM::CH__NMNm_53 = 2;
}
/*@@end*/

// DRVU
/*@@timer:Timer_CH__NMNm_54:*/
on timer Timer_CH__NMNm_54
{
// Timer für den Empfang von nicht im xml enthaltenen NM-ECUs
	@sysvar::CH_NM::CH__NMNm_54 = 2;
}
/*@@end*/

// DRVU
/*@@timer:Timer_CH__NMNm_55:*/
on timer Timer_CH__NMNm_55
{
// Timer für den Empfang von nicht im xml enthaltenen NM-ECUs
	@sysvar::CH_NM::CH__NMNm_55 = 2;
}
/*@@end*/

// DRVU
/*@@timer:Timer_CH__NMNm_56:*/
on timer Timer_CH__NMNm_56
{
// Timer für den Empfang von nicht im xml enthaltenen NM-ECUs
	@sysvar::CH_NM::CH__NMNm_56 = 2;
}
/*@@end*/

// DRVU
/*@@timer:Timer_CH__NMNm_57:*/
on timer Timer_CH__NMNm_57
{
// Timer für den Empfang von nicht im xml enthaltenen NM-ECUs
	@sysvar::CH_NM::CH__NMNm_57 = 2;
}
/*@@end*/

// DRVU
/*@@timer:Timer_CH__NMNm_58:*/
on timer Timer_CH__NMNm_58
{
// Timer für den Empfang von nicht im xml enthaltenen NM-ECUs
	@sysvar::CH_NM::CH__NMNm_58 = 2;
}
/*@@end*/

// CPC
/*@@timer:Timer_CH__NMAppl_CPC:*/
on timer Timer_CH__NMAppl_CPC
{
	@sysvar::CH_NM::CH__NMAppl_CPC = 1;
	@sysvar::CH_NM::CH__NMStat_CPC = 0;
}
/*@@end*/
// CPC
/*@@timer:Timer_CH__NMNm_CPC:*/
on timer Timer_CH__NMNm_CPC
{
	if (@sysvar::CH_NM::CH__NMNm_CPC != 1) @sysvar::CH_NM::CH__NMNm_CPC = 1;
	if (@sysvar::CH_NM::CH__NMAppl_CPC == 2)
	{
		if (@sysvar::CH_NM::CH__NMStat_CPC != 4) @sysvar::CH_NM::CH__NMStat_CPC = 4;
	}
	else
	{
		if (@sysvar::CH_NM::CH__NMStat_CPC != 0) @sysvar::CH_NM::CH__NMStat_CPC = 0;
	}
}
/*@@end*/

// CPC
/*@@timer:Timer_CH__NMNm_5A:*/
on timer Timer_CH__NMNm_5A
{
// Timer für den Empfang von nicht im xml enthaltenen NM-ECUs
	@sysvar::CH_NM::CH__NMNm_5A = 2;
}
/*@@end*/

// CPC
/*@@timer:Timer_CH__NMNm_5B:*/
on timer Timer_CH__NMNm_5B
{
// Timer für den Empfang von nicht im xml enthaltenen NM-ECUs
	@sysvar::CH_NM::CH__NMNm_5B = 2;
}
/*@@end*/

// CPC
/*@@timer:Timer_CH__NMNm_5C:*/
on timer Timer_CH__NMNm_5C
{
// Timer für den Empfang von nicht im xml enthaltenen NM-ECUs
	@sysvar::CH_NM::CH__NMNm_5C = 2;
}
/*@@end*/

// CPC
/*@@timer:Timer_CH__NMNm_5D:*/
on timer Timer_CH__NMNm_5D
{
// Timer für den Empfang von nicht im xml enthaltenen NM-ECUs
	@sysvar::CH_NM::CH__NMNm_5D = 2;
}
/*@@end*/

// CPC
/*@@timer:Timer_CH__NMNm_5E:*/
on timer Timer_CH__NMNm_5E
{
// Timer für den Empfang von nicht im xml enthaltenen NM-ECUs
	@sysvar::CH_NM::CH__NMNm_5E = 2;
}
/*@@end*/

// CPC
/*@@timer:Timer_CH__NMNm_5F:*/
on timer Timer_CH__NMNm_5F
{
// Timer für den Empfang von nicht im xml enthaltenen NM-ECUs
	@sysvar::CH_NM::CH__NMNm_5F = 2;
}
/*@@end*/

// CPC
/*@@timer:Timer_CH__NMNm_60:*/
on timer Timer_CH__NMNm_60
{
// Timer für den Empfang von nicht im xml enthaltenen NM-ECUs
	@sysvar::CH_NM::CH__NMNm_60 = 2;
}
/*@@end*/

// CPC
/*@@timer:Timer_CH__NMNm_61:*/
on timer Timer_CH__NMNm_61
{
// Timer für den Empfang von nicht im xml enthaltenen NM-ECUs
	@sysvar::CH_NM::CH__NMNm_61 = 2;
}
/*@@end*/

// CPC
/*@@timer:Timer_CH__NMNm_62:*/
on timer Timer_CH__NMNm_62
{
// Timer für den Empfang von nicht im xml enthaltenen NM-ECUs
	@sysvar::CH_NM::CH__NMNm_62 = 2;
}
/*@@end*/

// CPC
/*@@timer:Timer_CH__NMNm_63:*/
on timer Timer_CH__NMNm_63
{
// Timer für den Empfang von nicht im xml enthaltenen NM-ECUs
	@sysvar::CH_NM::CH__NMNm_63 = 2;
}
/*@@end*/

// CPC
/*@@timer:Timer_CH__NMNm_64:*/
on timer Timer_CH__NMNm_64
{
// Timer für den Empfang von nicht im xml enthaltenen NM-ECUs
	@sysvar::CH_NM::CH__NMNm_64 = 2;
}
/*@@end*/

// CPC
/*@@timer:Timer_CH__NMNm_65:*/
on timer Timer_CH__NMNm_65
{
// Timer für den Empfang von nicht im xml enthaltenen NM-ECUs
	@sysvar::CH_NM::CH__NMNm_65 = 2;
}
/*@@end*/

// CPC
/*@@timer:Timer_CH__NMNm_66:*/
on timer Timer_CH__NMNm_66
{
// Timer für den Empfang von nicht im xml enthaltenen NM-ECUs
	@sysvar::CH_NM::CH__NMNm_66 = 2;
}
/*@@end*/

// CPC
/*@@timer:Timer_CH__NMNm_67:*/
on timer Timer_CH__NMNm_67
{
// Timer für den Empfang von nicht im xml enthaltenen NM-ECUs
	@sysvar::CH_NM::CH__NMNm_67 = 2;
}
/*@@end*/

// CPC
/*@@timer:Timer_CH__NMNm_68:*/
on timer Timer_CH__NMNm_68
{
// Timer für den Empfang von nicht im xml enthaltenen NM-ECUs
	@sysvar::CH_NM::CH__NMNm_68 = 2;
}
/*@@end*/

// CPC
/*@@timer:Timer_CH__NMNm_69:*/
on timer Timer_CH__NMNm_69
{
// Timer für den Empfang von nicht im xml enthaltenen NM-ECUs
	@sysvar::CH_NM::CH__NMNm_69 = 2;
}
/*@@end*/

// CPC
/*@@timer:Timer_CH__NMNm_6A:*/
on timer Timer_CH__NMNm_6A
{
// Timer für den Empfang von nicht im xml enthaltenen NM-ECUs
	@sysvar::CH_NM::CH__NMNm_6A = 2;
}
/*@@end*/

// CPC
/*@@timer:Timer_CH__NMNm_6B:*/
on timer Timer_CH__NMNm_6B
{
// Timer für den Empfang von nicht im xml enthaltenen NM-ECUs
	@sysvar::CH_NM::CH__NMNm_6B = 2;
}
/*@@end*/

// CPC
/*@@timer:Timer_CH__NMNm_6C:*/
on timer Timer_CH__NMNm_6C
{
// Timer für den Empfang von nicht im xml enthaltenen NM-ECUs
	@sysvar::CH_NM::CH__NMNm_6C = 2;
}
/*@@end*/

// CPC
/*@@timer:Timer_CH__NMNm_6D:*/
on timer Timer_CH__NMNm_6D
{
// Timer für den Empfang von nicht im xml enthaltenen NM-ECUs
	@sysvar::CH_NM::CH__NMNm_6D = 2;
}
/*@@end*/

// CPC
/*@@timer:Timer_CH__NMNm_6E:*/
on timer Timer_CH__NMNm_6E
{
// Timer für den Empfang von nicht im xml enthaltenen NM-ECUs
	@sysvar::CH_NM::CH__NMNm_6E = 2;
}
/*@@end*/

// CPC
/*@@timer:Timer_CH__NMNm_6F:*/
on timer Timer_CH__NMNm_6F
{
// Timer für den Empfang von nicht im xml enthaltenen NM-ECUs
	@sysvar::CH_NM::CH__NMNm_6F = 2;
}
/*@@end*/

// CPC
/*@@timer:Timer_CH__NMNm_70:*/
on timer Timer_CH__NMNm_70
{
// Timer für den Empfang von nicht im xml enthaltenen NM-ECUs
	@sysvar::CH_NM::CH__NMNm_70 = 2;
}
/*@@end*/

// CPC
/*@@timer:Timer_CH__NMNm_71:*/
on timer Timer_CH__NMNm_71
{
// Timer für den Empfang von nicht im xml enthaltenen NM-ECUs
	@sysvar::CH_NM::CH__NMNm_71 = 2;
}
/*@@end*/

// CPC
/*@@timer:Timer_CH__NMNm_72:*/
on timer Timer_CH__NMNm_72
{
// Timer für den Empfang von nicht im xml enthaltenen NM-ECUs
	@sysvar::CH_NM::CH__NMNm_72 = 2;
}
/*@@end*/

// CPC
/*@@timer:Timer_CH__NMNm_73:*/
on timer Timer_CH__NMNm_73
{
// Timer für den Empfang von nicht im xml enthaltenen NM-ECUs
	@sysvar::CH_NM::CH__NMNm_73 = 2;
}
/*@@end*/

// CPC
/*@@timer:Timer_CH__NMNm_74:*/
on timer Timer_CH__NMNm_74
{
// Timer für den Empfang von nicht im xml enthaltenen NM-ECUs
	@sysvar::CH_NM::CH__NMNm_74 = 2;
}
/*@@end*/

// CPC
/*@@timer:Timer_CH__NMNm_75:*/
on timer Timer_CH__NMNm_75
{
// Timer für den Empfang von nicht im xml enthaltenen NM-ECUs
	@sysvar::CH_NM::CH__NMNm_75 = 2;
}
/*@@end*/

// CPC
/*@@timer:Timer_CH__NMNm_76:*/
on timer Timer_CH__NMNm_76
{
// Timer für den Empfang von nicht im xml enthaltenen NM-ECUs
	@sysvar::CH_NM::CH__NMNm_76 = 2;
}
/*@@end*/

// CPC
/*@@timer:Timer_CH__NMNm_77:*/
on timer Timer_CH__NMNm_77
{
// Timer für den Empfang von nicht im xml enthaltenen NM-ECUs
	@sysvar::CH_NM::CH__NMNm_77 = 2;
}
/*@@end*/

// CPC
/*@@timer:Timer_CH__NMNm_78:*/
on timer Timer_CH__NMNm_78
{
// Timer für den Empfang von nicht im xml enthaltenen NM-ECUs
	@sysvar::CH_NM::CH__NMNm_78 = 2;
}
/*@@end*/

// CPC
/*@@timer:Timer_CH__NMNm_79:*/
on timer Timer_CH__NMNm_79
{
// Timer für den Empfang von nicht im xml enthaltenen NM-ECUs
	@sysvar::CH_NM::CH__NMNm_79 = 2;
}
/*@@end*/

// CPC
/*@@timer:Timer_CH__NMNm_7A:*/
on timer Timer_CH__NMNm_7A
{
// Timer für den Empfang von nicht im xml enthaltenen NM-ECUs
	@sysvar::CH_NM::CH__NMNm_7A = 2;
}
/*@@end*/

// CPC
/*@@timer:Timer_CH__NMNm_7B:*/
on timer Timer_CH__NMNm_7B
{
// Timer für den Empfang von nicht im xml enthaltenen NM-ECUs
	@sysvar::CH_NM::CH__NMNm_7B = 2;
}
/*@@end*/

// CPC
/*@@timer:Timer_CH__NMNm_7C:*/
on timer Timer_CH__NMNm_7C
{
// Timer für den Empfang von nicht im xml enthaltenen NM-ECUs
	@sysvar::CH_NM::CH__NMNm_7C = 2;
}
/*@@end*/

// CPC
/*@@timer:Timer_CH__NMNm_7D:*/
on timer Timer_CH__NMNm_7D
{
// Timer für den Empfang von nicht im xml enthaltenen NM-ECUs
	@sysvar::CH_NM::CH__NMNm_7D = 2;
}
/*@@end*/

// CPC
/*@@timer:Timer_CH__NMNm_7E:*/
on timer Timer_CH__NMNm_7E
{
// Timer für den Empfang von nicht im xml enthaltenen NM-ECUs
	@sysvar::CH_NM::CH__NMNm_7E = 2;
}
/*@@end*/

// MPC
/*@@timer:Timer_CH__NMAppl_MPC:*/
on timer Timer_CH__NMAppl_MPC
{
	@sysvar::CH_NM::CH__NMAppl_MPC = 1;
	@sysvar::CH_NM::CH__NMStat_MPC = 0;
}
/*@@end*/
// MPC
/*@@timer:Timer_CH__NMNm_MPC:*/
on timer Timer_CH__NMNm_MPC
{
	if (@sysvar::CH_NM::CH__NMNm_MPC != 1) @sysvar::CH_NM::CH__NMNm_MPC = 1;
	if (@sysvar::CH_NM::CH__NMAppl_MPC == 2)
	{
		if (@sysvar::CH_NM::CH__NMStat_MPC != 4) @sysvar::CH_NM::CH__NMStat_MPC = 4;
	}
	else
	{
		if (@sysvar::CH_NM::CH__NMStat_MPC != 0) @sysvar::CH_NM::CH__NMStat_MPC = 0;
	}
}
/*@@end*/

// LRR
/*@@timer:Timer_CH__NMAppl_LRR:*/
on timer Timer_CH__NMAppl_LRR
{
	@sysvar::CH_NM::CH__NMAppl_LRR = 1;
	@sysvar::CH_NM::CH__NMStat_LRR = 0;
}
/*@@end*/
// LRR
/*@@timer:Timer_CH__NMNm_LRR:*/
on timer Timer_CH__NMNm_LRR
{
	if (@sysvar::CH_NM::CH__NMNm_LRR != 1) @sysvar::CH_NM::CH__NMNm_LRR = 1;
	if (@sysvar::CH_NM::CH__NMAppl_LRR == 2)
	{
		if (@sysvar::CH_NM::CH__NMStat_LRR != 4) @sysvar::CH_NM::CH__NMStat_LRR = 4;
	}
	else
	{
		if (@sysvar::CH_NM::CH__NMStat_LRR != 0) @sysvar::CH_NM::CH__NMStat_LRR = 0;
	}
}
/*@@end*/

// FCWRDUSDTR
/*@@timer:Timer_CH__NMAppl_FCWRDUSDTR:*/
on timer Timer_CH__NMAppl_FCWRDUSDTR
{
	@sysvar::CH_NM::CH__NMAppl_FCWRDUSDTR = 1;
	@sysvar::CH_NM::CH__NMStat_FCWRDUSDTR = 0;
}
/*@@end*/
// FCWRDUSDTR
/*@@timer:Timer_CH__NMNm_FCWRDUSDTR:*/
on timer Timer_CH__NMNm_FCWRDUSDTR
{
	if (@sysvar::CH_NM::CH__NMNm_FCWRDUSDTR != 1) @sysvar::CH_NM::CH__NMNm_FCWRDUSDTR = 1;
	if (@sysvar::CH_NM::CH__NMAppl_FCWRDUSDTR == 2)
	{
		if (@sysvar::CH_NM::CH__NMStat_FCWRDUSDTR != 4) @sysvar::CH_NM::CH__NMStat_FCWRDUSDTR = 4;
	}
	else
	{
		if (@sysvar::CH_NM::CH__NMStat_FCWRDUSDTR != 0) @sysvar::CH_NM::CH__NMStat_FCWRDUSDTR = 0;
	}
}
/*@@end*/

// PARK
/*@@timer:Timer_CH__NMAppl_PARK:*/
on timer Timer_CH__NMAppl_PARK
{
	@sysvar::CH_NM::CH__NMAppl_PARK = 1;
	@sysvar::CH_NM::CH__NMStat_PARK = 0;
}
/*@@end*/
// PARK
/*@@timer:Timer_CH__NMNm_PARK:*/
on timer Timer_CH__NMNm_PARK
{
	if (@sysvar::CH_NM::CH__NMNm_PARK != 1) @sysvar::CH_NM::CH__NMNm_PARK = 1;
	if (@sysvar::CH_NM::CH__NMAppl_PARK == 2)
	{
		if (@sysvar::CH_NM::CH__NMStat_PARK != 4) @sysvar::CH_NM::CH__NMStat_PARK = 4;
	}
	else
	{
		if (@sysvar::CH_NM::CH__NMStat_PARK != 0) @sysvar::CH_NM::CH__NMStat_PARK = 0;
	}
}
/*@@end*/

// SPC
/*@@timer:Timer_CH__NMAppl_SPC:*/
on timer Timer_CH__NMAppl_SPC
{
	@sysvar::CH_NM::CH__NMAppl_SPC = 1;
	@sysvar::CH_NM::CH__NMStat_SPC = 0;
}
/*@@end*/
// SPC
/*@@timer:Timer_CH__NMNm_SPC:*/
on timer Timer_CH__NMNm_SPC
{
	if (@sysvar::CH_NM::CH__NMNm_SPC != 1) @sysvar::CH_NM::CH__NMNm_SPC = 1;
	if (@sysvar::CH_NM::CH__NMAppl_SPC == 2)
	{
		if (@sysvar::CH_NM::CH__NMStat_SPC != 4) @sysvar::CH_NM::CH__NMStat_SPC = 4;
	}
	else
	{
		if (@sysvar::CH_NM::CH__NMStat_SPC != 0) @sysvar::CH_NM::CH__NMStat_SPC = 0;
	}
}
/*@@end*/

// EPS
/*@@timer:Timer_CH__NMAppl_EPS:*/
on timer Timer_CH__NMAppl_EPS
{
	@sysvar::CH_NM::CH__NMAppl_EPS = 1;
	@sysvar::CH_NM::CH__NMStat_EPS = 0;
}
/*@@end*/
// EPS
/*@@timer:Timer_CH__NMNm_EPS:*/
on timer Timer_CH__NMNm_EPS
{
	if (@sysvar::CH_NM::CH__NMNm_EPS != 1) @sysvar::CH_NM::CH__NMNm_EPS = 1;
	if (@sysvar::CH_NM::CH__NMAppl_EPS == 2)
	{
		if (@sysvar::CH_NM::CH__NMStat_EPS != 4) @sysvar::CH_NM::CH__NMStat_EPS = 4;
	}
	else
	{
		if (@sysvar::CH_NM::CH__NMStat_EPS != 0) @sysvar::CH_NM::CH__NMStat_EPS = 0;
	}
}
/*@@end*/

// SCCM
/*@@timer:Timer_CH__NMAppl_SCCM:*/
on timer Timer_CH__NMAppl_SCCM
{
	@sysvar::CH_NM::CH__NMAppl_SCCM = 1;
	@sysvar::CH_NM::CH__NMStat_SCCM = 0;
}
/*@@end*/
// SCCM
/*@@timer:Timer_CH__NMNm_SCCM:*/
on timer Timer_CH__NMNm_SCCM
{
	if (@sysvar::CH_NM::CH__NMNm_SCCM != 1) @sysvar::CH_NM::CH__NMNm_SCCM = 1;
	if (@sysvar::CH_NM::CH__NMAppl_SCCM == 2)
	{
		if (@sysvar::CH_NM::CH__NMStat_SCCM != 4) @sysvar::CH_NM::CH__NMStat_SCCM = 4;
	}
	else
	{
		if (@sysvar::CH_NM::CH__NMStat_SCCM != 0) @sysvar::CH_NM::CH__NMStat_SCCM = 0;
	}
}
/*@@end*/

// ESP
/*@@timer:Timer_CH__NMAppl_ESP:*/
on timer Timer_CH__NMAppl_ESP
{
	@sysvar::CH_NM::CH__NMAppl_ESP = 1;
	@sysvar::CH_NM::CH__NMStat_ESP = 0;
}
/*@@end*/
// ESP
/*@@timer:Timer_CH__NMNm_ESP:*/
on timer Timer_CH__NMNm_ESP
{
	if (@sysvar::CH_NM::CH__NMNm_ESP != 1) @sysvar::CH_NM::CH__NMNm_ESP = 1;
	if (@sysvar::CH_NM::CH__NMAppl_ESP == 2)
	{
		if (@sysvar::CH_NM::CH__NMStat_ESP != 4) @sysvar::CH_NM::CH__NMStat_ESP = 4;
	}
	else
	{
		if (@sysvar::CH_NM::CH__NMStat_ESP != 0) @sysvar::CH_NM::CH__NMStat_ESP = 0;
	}
}
/*@@end*/

// SPC_VX
/*@@timer:Timer_CH__NMAppl_SPC_VX:*/
on timer Timer_CH__NMAppl_SPC_VX
{
	@sysvar::CH_NM::CH__NMAppl_SPC_VX = 1;
	@sysvar::CH_NM::CH__NMStat_SPC_VX = 0;
}
/*@@end*/
// SPC_VX
/*@@timer:Timer_CH__NMNm_SPC_VX:*/
on timer Timer_CH__NMNm_SPC_VX
{
	if (@sysvar::CH_NM::CH__NMNm_SPC_VX != 1) @sysvar::CH_NM::CH__NMNm_SPC_VX = 1;
	if (@sysvar::CH_NM::CH__NMAppl_SPC_VX == 2)
	{
		if (@sysvar::CH_NM::CH__NMStat_SPC_VX != 4) @sysvar::CH_NM::CH__NMStat_SPC_VX = 4;
	}
	else
	{
		if (@sysvar::CH_NM::CH__NMStat_SPC_VX != 0) @sysvar::CH_NM::CH__NMStat_SPC_VX = 0;
	}
}
/*@@end*/

// AWD_TCASE
/*@@timer:Timer_CH__NMAppl_AWD_TCASE:*/
on timer Timer_CH__NMAppl_AWD_TCASE
{
	@sysvar::CH_NM::CH__NMAppl_AWD_TCASE = 1;
	@sysvar::CH_NM::CH__NMStat_AWD_TCASE = 0;
}
/*@@end*/
// AWD_TCASE
/*@@timer:Timer_CH__NMNm_AWD_TCASE:*/
on timer Timer_CH__NMNm_AWD_TCASE
{
	if (@sysvar::CH_NM::CH__NMNm_AWD_TCASE != 1) @sysvar::CH_NM::CH__NMNm_AWD_TCASE = 1;
	if (@sysvar::CH_NM::CH__NMAppl_AWD_TCASE == 2)
	{
		if (@sysvar::CH_NM::CH__NMStat_AWD_TCASE != 4) @sysvar::CH_NM::CH__NMStat_AWD_TCASE = 4;
	}
	else
	{
		if (@sysvar::CH_NM::CH__NMStat_AWD_TCASE != 0) @sysvar::CH_NM::CH__NMStat_AWD_TCASE = 0;
	}
}
/*@@end*/


// NM
/*@@timer:Timer_CH__NMAppl_NM:*/
on timer Timer_CH__NMAppl_NM
{
	@sysvar::CH_NM::CH__NMAppl_NM = 1;
	@sysvar::CH_NM::CH__NMStat_NM = 0;
}
/*@@end*/

// NM
/*@@timer:Timer_CH__NMNm_NM:*/
on timer Timer_CH__NMNm_NM
{
	if (@sysvar::CH_NM::CH__NMNm_NM != 1) @sysvar::CH_NM::CH__NMNm_NM = 1;
	if (@sysvar::CH_NM::CH__NMAppl_NM == 2)
	{
		if (@sysvar::CH_NM::CH__NMStat_NM != 4) @sysvar::CH_NM::CH__NMStat_NM = 4;
	}
	else
	{
		if (@sysvar::CH_NM::CH__NMStat_NM != 0) @sysvar::CH_NM::CH__NMStat_NM = 0;
	}
}
/*@@end*/

/*@@sysvarChange:CH_NM::CH__NMAppl_FCWRDUSDTR:*/
on sysvar sysvar::CH_NM::CH__NMAppl_FCWRDUSDTR
{
	@sysvar::CH_NM::CH__NMAppl_FCW = @sysvar::CH_NM::CH__NMAppl_FCWRDUSDTR;
	@sysvar::CH_NM::CH__NMAppl_RDU = @sysvar::CH_NM::CH__NMAppl_FCWRDUSDTR;
	@sysvar::CH_NM::CH__NMAppl_SDTR = @sysvar::CH_NM::CH__NMAppl_FCWRDUSDTR;
}
/*@@end*/

/*@@sysvarChange:CH_NM::CH__NMNm_FCWRDUSDTR:*/
on sysvar sysvar::CH_NM::CH__NMNm_FCWRDUSDTR
{
	@sysvar::CH_NM::CH__NMNm_FCW = @sysvar::CH_NM::CH__NMNm_FCWRDUSDTR;
	@sysvar::CH_NM::CH__NMNm_RDU = @sysvar::CH_NM::CH__NMNm_FCWRDUSDTR;
	@sysvar::CH_NM::CH__NMNm_SDTR = @sysvar::CH_NM::CH__NMNm_FCWRDUSDTR;
}
/*@@end*/

/*@@sysvarChange:CH_NM::CH__NMSimStat_FCWRDUSDTR:*/
on sysvar sysvar::CH_NM::CH__NMSimStat_FCWRDUSDTR
{
	@sysvar::CH_NM::CH__NMSimStat_FCW = @sysvar::CH_NM::CH__NMSimStat_FCWRDUSDTR;
	@sysvar::CH_NM::CH__NMSimStat_RDU = @sysvar::CH_NM::CH__NMSimStat_FCWRDUSDTR;
	@sysvar::CH_NM::CH__NMSimStat_SDTR = @sysvar::CH_NM::CH__NMSimStat_FCWRDUSDTR;
}
/*@@end*/

/*@@sysvarChange:CH_NM::CH__NMStat_FCWRDUSDTR:*/
on sysvar sysvar::CH_NM::CH__NMStat_FCWRDUSDTR
{
	@sysvar::CH_NM::CH__NMStat_FCW = @sysvar::CH_NM::CH__NMStat_FCWRDUSDTR;
	@sysvar::CH_NM::CH__NMStat_RDU = @sysvar::CH_NM::CH__NMStat_FCWRDUSDTR;
	@sysvar::CH_NM::CH__NMStat_SDTR = @sysvar::CH_NM::CH__NMStat_FCWRDUSDTR;
}
/*@@end*/

/*@@sysvarChange:CH_Nodes::CH__NMActive_FCWRDUSDTR:*/
on sysvar sysvar::CH_Nodes::CH__NMActive_FCWRDUSDTR
{
	@sysvar::CH_Nodes::CH__NMActive_FCW = @sysvar::CH_Nodes::CH__NMActive_FCWRDUSDTR;
	@sysvar::CH_Nodes::CH__NMActive_RDU = @sysvar::CH_Nodes::CH__NMActive_FCWRDUSDTR;
	@sysvar::CH_Nodes::CH__NMActive_SDTR = @sysvar::CH_Nodes::CH__NMActive_FCWRDUSDTR;
}
/*@@end*/

/*@@sysvarChange:CH_Nodes::CH__NMAwake_FCWRDUSDTR:*/
on sysvar sysvar::CH_Nodes::CH__NMAwake_FCWRDUSDTR
{
	@sysvar::CH_Nodes::CH__NMAwake_FCW = @sysvar::CH_Nodes::CH__NMAwake_FCWRDUSDTR;
	@sysvar::CH_Nodes::CH__NMAwake_RDU = @sysvar::CH_Nodes::CH__NMAwake_FCWRDUSDTR;
	@sysvar::CH_Nodes::CH__NMAwake_SDTR = @sysvar::CH_Nodes::CH__NMAwake_FCWRDUSDTR;
}
/*@@end*/
/*@@sysvarChange:CH_NM::CH__NMAppl_FCW:*/
on sysvar sysvar::CH_NM::CH__NMAppl_FCW
{
	@sysvar::CH_NM::CH__NMAppl_FCWRDUSDTR = @sysvar::CH_NM::CH__NMAppl_FCW;
}
/*@@end*/

/*@@sysvarChange:CH_NM::CH__NMNm_FCW:*/
on sysvar sysvar::CH_NM::CH__NMNm_FCW
{
	@sysvar::CH_NM::CH__NMNm_FCWRDUSDTR = @sysvar::CH_NM::CH__NMNm_FCW;
}
/*@@end*/

/*@@sysvarChange:CH_NM::CH__NMSimStat_FCW:*/
on sysvar sysvar::CH_NM::CH__NMSimStat_FCW
{
	@sysvar::CH_NM::CH__NMSimStat_FCWRDUSDTR = @sysvar::CH_NM::CH__NMSimStat_FCW;
}
/*@@end*/
	
/*@@sysvarChange:CH_NM::CH__NMStat_FCW:*/
on sysvar sysvar::CH_NM::CH__NMStat_FCW
{
	@sysvar::CH_NM::CH__NMStat_FCWRDUSDTR = @sysvar::CH_NM::CH__NMStat_FCW;
}
/*@@end*/

/*@@sysvarChange:CH_Nodes::CH__NMActive_FCW:*/
on sysvar sysvar::CH_Nodes::CH__NMActive_FCW
{
	@sysvar::CH_Nodes::CH__NMActive_FCWRDUSDTR = @sysvar::CH_Nodes::CH__NMActive_FCW;
}
/*@@end*/

/*@@sysvarChange:CH_Nodes::CH__NMAwake_FCW:*/
on sysvar sysvar::CH_Nodes::CH__NMAwake_FCW
{
	@sysvar::CH_Nodes::CH__NMAwake_FCWRDUSDTR = @sysvar::CH_Nodes::CH__NMAwake_FCW;
}
/*@@end*/

/*@@sysvarChange:CH_NM::CH__NMAppl_RDU:*/
on sysvar sysvar::CH_NM::CH__NMAppl_RDU
{
	@sysvar::CH_NM::CH__NMAppl_FCWRDUSDTR = @sysvar::CH_NM::CH__NMAppl_RDU;
}
/*@@end*/

/*@@sysvarChange:CH_NM::CH__NMNm_RDU:*/
on sysvar sysvar::CH_NM::CH__NMNm_RDU
{
	@sysvar::CH_NM::CH__NMNm_FCWRDUSDTR = @sysvar::CH_NM::CH__NMNm_RDU;
}
/*@@end*/

/*@@sysvarChange:CH_NM::CH__NMSimStat_RDU:*/
on sysvar sysvar::CH_NM::CH__NMSimStat_RDU
{
	@sysvar::CH_NM::CH__NMSimStat_FCWRDUSDTR = @sysvar::CH_NM::CH__NMSimStat_RDU;
}
/*@@end*/
	
/*@@sysvarChange:CH_NM::CH__NMStat_RDU:*/
on sysvar sysvar::CH_NM::CH__NMStat_RDU
{
	@sysvar::CH_NM::CH__NMStat_FCWRDUSDTR = @sysvar::CH_NM::CH__NMStat_RDU;
}
/*@@end*/

/*@@sysvarChange:CH_Nodes::CH__NMActive_RDU:*/
on sysvar sysvar::CH_Nodes::CH__NMActive_RDU
{
	@sysvar::CH_Nodes::CH__NMActive_FCWRDUSDTR = @sysvar::CH_Nodes::CH__NMActive_RDU;
}
/*@@end*/

/*@@sysvarChange:CH_Nodes::CH__NMAwake_RDU:*/
on sysvar sysvar::CH_Nodes::CH__NMAwake_RDU
{
	@sysvar::CH_Nodes::CH__NMAwake_FCWRDUSDTR = @sysvar::CH_Nodes::CH__NMAwake_RDU;
}
/*@@end*/

/*@@sysvarChange:CH_NM::CH__NMAppl_SDTR:*/
on sysvar sysvar::CH_NM::CH__NMAppl_SDTR
{
	@sysvar::CH_NM::CH__NMAppl_FCWRDUSDTR = @sysvar::CH_NM::CH__NMAppl_SDTR;
}
/*@@end*/

/*@@sysvarChange:CH_NM::CH__NMNm_SDTR:*/
on sysvar sysvar::CH_NM::CH__NMNm_SDTR
{
	@sysvar::CH_NM::CH__NMNm_FCWRDUSDTR = @sysvar::CH_NM::CH__NMNm_SDTR;
}
/*@@end*/

/*@@sysvarChange:CH_NM::CH__NMSimStat_SDTR:*/
on sysvar sysvar::CH_NM::CH__NMSimStat_SDTR
{
	@sysvar::CH_NM::CH__NMSimStat_FCWRDUSDTR = @sysvar::CH_NM::CH__NMSimStat_SDTR;
}
/*@@end*/
	
/*@@sysvarChange:CH_NM::CH__NMStat_SDTR:*/
on sysvar sysvar::CH_NM::CH__NMStat_SDTR
{
	@sysvar::CH_NM::CH__NMStat_FCWRDUSDTR = @sysvar::CH_NM::CH__NMStat_SDTR;
}
/*@@end*/

/*@@sysvarChange:CH_Nodes::CH__NMActive_SDTR:*/
on sysvar sysvar::CH_Nodes::CH__NMActive_SDTR
{
	@sysvar::CH_Nodes::CH__NMActive_FCWRDUSDTR = @sysvar::CH_Nodes::CH__NMActive_SDTR;
}
/*@@end*/

/*@@sysvarChange:CH_Nodes::CH__NMAwake_SDTR:*/
on sysvar sysvar::CH_Nodes::CH__NMAwake_SDTR
{
	@sysvar::CH_Nodes::CH__NMAwake_FCWRDUSDTR = @sysvar::CH_Nodes::CH__NMAwake_SDTR;
}
/*@@end*/



