/*@@var:*/
/*
|==========================================================================================|
|                                                                                          |
|                                                                                          |
|                                         COPYRIGHT                                        |
|                                                                                          |
|                   Copyright (c) by Daimler AG Abt. RD/EEV 2015                           |
|                                                                                          |
|                                                                                          |
|==========================================================================================|
|                                                                                          |
|                                   CAPL AUTHOR IDENTITY                                   |
|                                   --------------------                                   |
|                                                                                          |
| Initials   | Name                 | Company                                              |
| -----------+----------------------+----------------------------------------------------- |
| BH         | Björn Haßelkus       | Firma TZM (EXTERN im Auftrag der Daimler AG)         |
| RS         | Rainer Schulte       | Firma TZM (EXTERN im Auftrag der Daimler AG)         |
|            |                      |                                                      |
|                                                                                          |
|==========================================================================================|
|                                                                                          |
|                                     REVISION HISTORY                                     |
|                                     ----------------                                     |
|                                                                                          |
| Date       | Ver   | Author       | Description                                          |
| -----------+-------+--------------+----------------------------------------------------- |
| 27.04.15   | 1.0   | RS           | creation                                             |
|            |       |              |                                                      |
|                                                                                          |
|------------------------------------------------------------------------------------------|
*/


variables
{
	mstimer Timer_AWD_TCASEAWD_TCASE_Disp_Rq_AR2_ReceiptPDU;
	mstimer Timer_AWD_TCASEAWD_TCASE_Stat1_AR2_ReceiptPDU;
	mstimer Timer_AWD_TCASEAWD_TCASE_Stat2_AR2_ReceiptPDU;
	mstimer Timer_AWD_TCASEROE_AWD_TCASE_ReceiptPDU;
	mstimer Timer_CPCAdblue_Disp_Rq_AR_ReceiptPDU;
	mstimer Timer_CPCAdblue_Disp_Warn_Rq_AR_ReceiptPDU;
	mstimer Timer_CPCAssyst_Stat2_AR_ReceiptPDU;
	mstimer Timer_CPCAssyst_Stat3_AR2_ReceiptPDU;
	mstimer Timer_CPCAssyst_Stat_AR_ReceiptPDU;
	mstimer Timer_CPCCNG_Disp_Rq_AR2_ReceiptPDU;
	mstimer Timer_CPCCPC_CHASSIS_R1_AR2_ReceiptPDU;
	mstimer Timer_CPCCPC_CHASSIS_R2_AR2_ReceiptPDU;
	mstimer Timer_CPCDCDC1_Rs1_AR2_ReceiptPDU;
	mstimer Timer_CPCDPC_PT_Rs_AR_ReceiptPDU;
	mstimer Timer_CPCECM_DAC4_AR_ReceiptPDU;
	mstimer Timer_CPCECO_Homepage_Data_ReceiptPDU;
	mstimer Timer_CPCECO_Score_Disp_Rq_AR_ReceiptPDU;
	mstimer Timer_CPCEM01_Stat1_AR2_ReceiptPDU;
	mstimer Timer_CPCEM01_Stat2_AR2_ReceiptPDU;
	mstimer Timer_CPCEM01_Trq_Rs_AR2_ReceiptPDU;
	mstimer Timer_CPCEM_DAC4_AR_ReceiptPDU;
	mstimer Timer_CPCEMM_Data1_AR2_ReceiptPDU;
	mstimer Timer_CPCEnergyMngmnt_PreCond_Stat_AR2_ReceiptPDU;
	mstimer Timer_CPCEng_Rs_1_AR2_ReceiptPDU;
	mstimer Timer_CPCEng_Rs_2_AR2_ReceiptPDU;
	mstimer Timer_CPCEng_Rs_3_AR2_ReceiptPDU;
	mstimer Timer_CPCEng_Rs_EM_AR2_ReceiptPDU;
	mstimer Timer_CPCEng_Rs_EngCtrl_AR2_ReceiptPDU;
	mstimer Timer_CPCEngCtrl_Disp_Rq_AR2_ReceiptPDU;
	mstimer Timer_CPCEngCtrl_OBD1_AR_ReceiptPDU;
	mstimer Timer_CPCEngCtrl_Stat_AR2_ReceiptPDU;
	mstimer Timer_CPCESP_OBD_Data_AR_ReceiptPDU;
	mstimer Timer_CPCFuel_Stat2_AR2_ReceiptPDU;
	mstimer Timer_CPCFuelLvl_Stat_AR2_ReceiptPDU;
	mstimer Timer_CPCHumanMachineIfc_AR2_ReceiptPDU;
	mstimer Timer_CPCHumanMachineIfc_Rq_AR_ReceiptPDU;
	mstimer Timer_CPCISM_DAC4_AR_ReceiptPDU;
	mstimer Timer_CPCOBL_DC_Output_AR_ReceiptPDU;
	mstimer Timer_CPCPARK_Drv_Rs_TCM_AR2_ReceiptPDU;
	mstimer Timer_CPCPN14_Gen_Rs_AR_ReceiptPDU;
	mstimer Timer_CPCPNHV_BMS_Stat_AR2_ReceiptPDU;
	mstimer Timer_CPCPNHV_EnergyMngmnt_Disp_Rq_AR_ReceiptPDU;
	mstimer Timer_CPCPNHV_EnergyMngmnt_Stat2_AR2_ReceiptPDU;
	mstimer Timer_CPCPNHV_EnergyMngmnt_Stat3_AR2_ReceiptPDU;
	mstimer Timer_CPCPNHV_EnergyMngmntSet_Rs1_AR2_ReceiptPDU;
	mstimer Timer_CPCPNHV_EnergyMngmntSet_Rs2_AR_ReceiptPDU;
	mstimer Timer_CPCPNHV_Stat_AR2_ReceiptPDU;
	mstimer Timer_CPCPNHV_WeekDepTmTbl_Stat_AR2_ReceiptPDU;
	mstimer Timer_CPCPT_DataContain_Rq_AR2_ReceiptPDU;
	mstimer Timer_CPCPT_Disp_Rq2_AR_ReceiptPDU;
	mstimer Timer_CPCPT_ThermM_AR2_ReceiptPDU;
	mstimer Timer_CPCPT_ThermM_Rq_AR2_ReceiptPDU;
	mstimer Timer_CPCPtHyb_Mngmnt_Rq1_AR_ReceiptPDU;
	mstimer Timer_CPCPtMngmnt_Disp_Rq_AR2_ReceiptPDU;
	mstimer Timer_CPCPtMngmnt_Rq_AR2_ReceiptPDU;
	mstimer Timer_CPCPtMngmnt_Stat2_AR2_ReceiptPDU;
	mstimer Timer_CPCPtMngmnt_Stat_AR2_ReceiptPDU;
	mstimer Timer_CPCSBW_DrvPosn_Disp_Rq_ISM_AR2_ReceiptPDU;
	mstimer Timer_CPCSBW_DrvPosn_Disp_Rq_TCM_AR2_ReceiptPDU;
	mstimer Timer_CPCSBW_Stat_AR2_ReceiptPDU;
	mstimer Timer_CPCSND_GEN_Stat_AR_ReceiptPDU;
	mstimer Timer_CPCTC_Disp_Rq_ECM_AR_ReceiptPDU;
	mstimer Timer_CPCTC_EBBC_Disp_Rq_ECM_AR_ReceiptPDU;
	mstimer Timer_CPCTC_EEBBC_Disp_Rq_AR_ReceiptPDU;
	mstimer Timer_CPCTCM_DAC4_AR_ReceiptPDU;
	mstimer Timer_CPCTCM_Data2_AR2_ReceiptPDU;
	mstimer Timer_CPCTCM_Data3_AR2_ReceiptPDU;
	mstimer Timer_CPCTCM_Disp_Rq_AMG_AR_ReceiptPDU;
	mstimer Timer_CPCTCM_State3_AR2_ReceiptPDU;
	mstimer Timer_CPCTCU_Disp_Rq_AR2_ReceiptPDU;
	mstimer Timer_CPCThermMngmnt_1_AR2_ReceiptPDU;
	mstimer Timer_CPCThermMngmnt_4_AR_ReceiptPDU;
	mstimer Timer_CPCThermMngmnt_EV_1_AR2_ReceiptPDU;
	mstimer Timer_CPCVehPwrMngmnt_EMM_Stat2_AR2_ReceiptPDU;
	mstimer Timer_CPCVehPwrMngmnt_Rq_AR_ReceiptPDU;
	mstimer Timer_CPCWIA_EngTrq_AR_ReceiptPDU;
	mstimer Timer_CPCWPT_Stat2_AR2_ReceiptPDU;
	mstimer Timer_DRVUDPC_Disp_Rq_AMG_AR2_ReceiptPDU;
	mstimer Timer_DRVUDPC_IndMd_Stat_AMG_AR2_ReceiptPDU;
	mstimer Timer_DRVUDPC_IndMd_Style2_AMG_AR2_ReceiptPDU;
	mstimer Timer_DRVUDPC_IndMd_Style_AMG_AR2_ReceiptPDU;
	mstimer Timer_DRVUDPC_Master_Rq_AMG_AR2_ReceiptPDU;
	mstimer Timer_DRVUDRVU_Stat_AR_ReceiptPDU;
	mstimer Timer_DRVUESP_EDIFF_Rs_AR_ReceiptPDU;
	mstimer Timer_EISActvComf_Rq_AR2_ReceiptPDU;
	mstimer Timer_EISADAS_CURRENT_ATTRIBUTES_AR_ReceiptPDU;
	mstimer Timer_EISADAS_POSITION_AR_ReceiptPDU;
	mstimer Timer_EISADAS_PREDICTION_AR_ReceiptPDU;
	mstimer Timer_EISADAS_PROFILE_LONG_AR_ReceiptPDU;
	mstimer Timer_EISADAS_PROFILE_SHORT_AR_ReceiptPDU;
	mstimer Timer_EISADASLR_POSITION_AR_ReceiptPDU;
	mstimer Timer_EISADASLR_PROFILE_LONG_AR_ReceiptPDU;
	mstimer Timer_EISAssyst_Rq_AR2_ReceiptPDU;
	mstimer Timer_EISBC_F_Disp_Rq_AR_ReceiptPDU;
	mstimer Timer_EISBC_F_Stat1_AR_ReceiptPDU;
	mstimer Timer_EISBC_F_Stat2_AR2_ReceiptPDU;
	mstimer Timer_EISBC_R_Stat1_AR_ReceiptPDU;
	mstimer Timer_EISBLSM_Disp_Stat_AR_ReceiptPDU;
	mstimer Timer_EISBODY_CHASSIS_R1_AR_ReceiptPDU;
	mstimer Timer_EISBSM_Disp_Warn_Rq_AR2_ReceiptPDU;
	mstimer Timer_EISCamLane_Disp_Warn_Rq_AR2_ReceiptPDU;
	mstimer Timer_EISCamLane_LaneAttr1_AR2_ReceiptPDU;
	mstimer Timer_EISCamLane_LaneAttr2_AR2_ReceiptPDU;
	mstimer Timer_EISCamLane_LaneAttr3_AR2_ReceiptPDU;
	mstimer Timer_EISCamLane_LaneAttr6_AR2_ReceiptPDU;
	mstimer Timer_EISCamLane_LaneAttr7_AR2_ReceiptPDU;
	mstimer Timer_EISCLkS_Rq_AR_ReceiptPDU;
	mstimer Timer_EISCLkS_State_AR_ReceiptPDU;
	mstimer Timer_EISClockSync_Stat_FR2_ReceiptPDU;
	mstimer Timer_EISCMS_PI_State_Gw_AR2_ReceiptPDU;
	mstimer Timer_EISConfig_HU4_AR2_ReceiptPDU;
	mstimer Timer_EISConfig_HU5_AR2_ReceiptPDU;
	mstimer Timer_EISCRCM_Stat_AR_ReceiptPDU;
	mstimer Timer_EISCTRL_C_Stat1_AR_ReceiptPDU;
	mstimer Timer_EISDAC4_ECM_AR_ReceiptPDU;
	mstimer Timer_EISDAC4_EM2_AR_ReceiptPDU;
	mstimer Timer_EISDAC4_ISM_AR_ReceiptPDU;
	mstimer Timer_EISDAC4_TCM_AR_ReceiptPDU;
	mstimer Timer_EISDimming_Stat_AR2_ReceiptPDU;
	mstimer Timer_EISDoor_FL_Stat_AR2_ReceiptPDU;
	mstimer Timer_EISDoor_FR_Stat_AR2_ReceiptPDU;
	mstimer Timer_EISDoor_RL_Stat_AR2_ReceiptPDU;
	mstimer Timer_EISDoor_RR_Stat_AR2_ReceiptPDU;
	mstimer Timer_EISDPC_IndMd_Rq_AR_ReceiptPDU;
	mstimer Timer_EISEAC_Stat_AR_ReceiptPDU;
	mstimer Timer_EISEL_Stat_AR2_ReceiptPDU;
	mstimer Timer_EISEL_TurnInd_Rq_AR2_ReceiptPDU;
	mstimer Timer_EISEPKB_Stat_AR2_ReceiptPDU;
	mstimer Timer_EISEVC_CfgBit_01_32_AR2_ReceiptPDU;
	mstimer Timer_EISEVC_CfgBit_33_64_AR2_ReceiptPDU;
	mstimer Timer_EISEVC_CfgBit_65_96_AR2_ReceiptPDU;
	mstimer Timer_EISEVC_CfgBit_97_C8_AR2_ReceiptPDU;
	mstimer Timer_EISEVC_CfgList_01_0C_AR2_ReceiptPDU;
	mstimer Timer_EISFCW_Disp_Rq_AR_ReceiptPDU;
	mstimer Timer_EISHMI_CHASSIS_R1_AR2_ReceiptPDU;
	mstimer Timer_EISHU_Comf_Rq_AR2_ReceiptPDU;
	mstimer Timer_EISHU_State_AR_ReceiptPDU;
	mstimer Timer_EISHVAC_Disp_Stat1_AR_ReceiptPDU;
	mstimer Timer_EISHVAC_OBD_DTC_AR_ReceiptPDU;
	mstimer Timer_EISHVAC_Rs2_AR_ReceiptPDU;
	mstimer Timer_EISHVAC_Rs3_AR2_ReceiptPDU;
	mstimer Timer_EISHVAC_Rs_AR2_ReceiptPDU;
	mstimer Timer_EISHVAC_State1_AR_ReceiptPDU;
	mstimer Timer_EISIC_BasicInfo_AR2_ReceiptPDU;
	mstimer Timer_EISIC_DriveAssistSys_AR2_ReceiptPDU;
	mstimer Timer_EISIC_Settings_AR2_ReceiptPDU;
	mstimer Timer_EISICH_Stat_AR_ReceiptPDU;
	mstimer Timer_EISIgn_Veh_Stat_AR2_ReceiptPDU;
	mstimer Timer_EISIHC_Lgt_Stat_HLI_2_AR2_ReceiptPDU;
	mstimer Timer_EISIHC_Lgt_Stat_HLI_AR2_ReceiptPDU;
	mstimer Timer_EISKG_State_AR2_ReceiptPDU;
	mstimer Timer_EISLDC_Disp_Stat_IC_AR2_ReceiptPDU;
	mstimer Timer_EISLgtSens_State_AR_ReceiptPDU;
	mstimer Timer_EISMirr_Adj_Lt_Rq_AR_ReceiptPDU;
	mstimer Timer_EISMirr_Adj_Rt_Rq_AR_ReceiptPDU;
	mstimer Timer_EISNAVI_Pos1_AR_ReceiptPDU;
	mstimer Timer_EISNAVI_Pos2_AR_ReceiptPDU;
	mstimer Timer_EISNAVI_Pos3_AR_ReceiptPDU;
	mstimer Timer_EISNAVI_Pos4_AR_ReceiptPDU;
	mstimer Timer_EISNAVI_Pos5_AR_ReceiptPDU;
	mstimer Timer_EISNVP_Stat1_AR2_ReceiptPDU;
	mstimer Timer_EISOHCM_Stat_AR2_ReceiptPDU;
	mstimer Timer_EISORC_Disp_Stat_AR2_ReceiptPDU;
	mstimer Timer_EISORC_Impact_AR2_ReceiptPDU;
	mstimer Timer_EISPark_Disp_Rs_AR2_ReceiptPDU;
	mstimer Timer_EISPHB_IHC_Plus_Tunnel_3_4_AR2_ReceiptPDU;
	mstimer Timer_EISPHB_IHC_Plus_Tunnel_AR2_ReceiptPDU;
	mstimer Timer_EISPN14_Disp_Rq_AR_ReceiptPDU;
	mstimer Timer_EISPN14_Rs1_AR2_ReceiptPDU;
	mstimer Timer_EISPN14_Rs2_AR_ReceiptPDU;
	mstimer Timer_EISPN14_Stat2_AR2_ReceiptPDU;
	mstimer Timer_EISPN14_Stat_AR_ReceiptPDU;
	mstimer Timer_EISPN48_Bat_Stat2_AR2_ReceiptPDU;
	mstimer Timer_EISPN48_Bat_Stat_AR_ReceiptPDU;
	mstimer Timer_EISPN48_BatLim_Stat_AR_ReceiptPDU;
	mstimer Timer_EISPN48_DCDC48_LISB48_Stat_AR_ReceiptPDU;
	mstimer Timer_EISPN48_Stat_AR_ReceiptPDU;
	mstimer Timer_EISPNHV_WeekDepTmTbl_Rq_HU_AR2_ReceiptPDU;
	mstimer Timer_EISPreCond_On_Rq_AR_ReceiptPDU;
	mstimer Timer_EISPreCond_Rq_HU_AR2_ReceiptPDU;
	mstimer Timer_EISPreCond_Stat_AR_ReceiptPDU;
	mstimer Timer_EISPT_ObjIntrst_Gw_AR2_ReceiptPDU;
	mstimer Timer_EISRemPark_Auth_Rs_AR2_ReceiptPDU;
	mstimer Timer_EISRemPark_Stat_EIS_AR2_ReceiptPDU;
	mstimer Timer_EISRTC_Date_Time_AR2_ReceiptPDU;
	mstimer Timer_EISRTC_Stat1_AR2_ReceiptPDU;
	mstimer Timer_EISSADR_Trgr_FCW_AR2_ReceiptPDU;
	mstimer Timer_EISSeatAdj_FL_Rq_AR_ReceiptPDU;
	mstimer Timer_EISSeatAdj_FR_Rq_AR_ReceiptPDU;
	mstimer Timer_EISSPCR_Stat_BC_F_AR2_ReceiptPDU;
	mstimer Timer_EISSPL_Obj1_Obj2_NV_AR2_ReceiptPDU;
	mstimer Timer_EISSPV_Actn_Rq_AR2_ReceiptPDU;
	mstimer Timer_EISSPV_Alm_Rq_AR_ReceiptPDU;
	mstimer Timer_EISSPV_Stat_AR2_ReceiptPDU;
	mstimer Timer_EISSVS_Rq_HU_AR2_ReceiptPDU;
	mstimer Timer_EISTBCSC_DAC_EPS_AR2_ReceiptPDU;
	mstimer Timer_EISTBCSC_DAC_ESP_AR2_ReceiptPDU;
	mstimer Timer_EISTBCSC_Hi_Rq1_AR2_ReceiptPDU;
	mstimer Timer_EISTBCSC_Hi_Rq2_AR2_ReceiptPDU;
	mstimer Timer_EISTBCSC_Lo_Rq1_AR2_ReceiptPDU;
	mstimer Timer_EISTBCSC_Lo_Rq2_AR2_ReceiptPDU;
	mstimer Timer_EISTC_Distance_AR_ReceiptPDU;
	mstimer Timer_EISTGW_DateTm_Stat_AR_ReceiptPDU;
	mstimer Timer_EISTire_State_AR2_ReceiptPDU;
	mstimer Timer_EISTrafficInfo_AR_ReceiptPDU;
	mstimer Timer_EISTrailer_Stat_AR2_ReceiptPDU;
	mstimer Timer_EISTSA_Disp_Rq1_AR2_ReceiptPDU;
	mstimer Timer_EISTSA_Disp_Rq2_AR_ReceiptPDU;
	mstimer Timer_EISTSA_Disp_Rq3_AR_ReceiptPDU;
	mstimer Timer_EISVehAccel_X_Rq_Gw_AR2_ReceiptPDU;
	mstimer Timer_EISVIN_AR_ReceiptPDU;
	mstimer Timer_EISWiper_Stat_AR_ReceiptPDU;
	mstimer Timer_EISWUDOP_EIS_FR_ReceiptPDU;
	mstimer Timer_EISYMAS_Rq_MPC_AR2_ReceiptPDU;
	mstimer Timer_EPSDTQ_Rs_AR2_ReceiptPDU;
	mstimer Timer_EPSEPS_Stat_Disp_Rq_AR2_ReceiptPDU;
	mstimer Timer_EPSPARK_St_Rs_AR2_ReceiptPDU;
	mstimer Timer_EPSROE_EPS_ReceiptPDU;
	mstimer Timer_EPSSTA_Rs1_AR2_ReceiptPDU;
	mstimer Timer_EPSTBCSC_EPS_DAC_AR2_ReceiptPDU;
	mstimer Timer_EPSTBCSC_Rs_EPS_AR2_ReceiptPDU;
	mstimer Timer_EPSWUDOP_EPS_FR_ReceiptPDU;
	mstimer Timer_ESPAWD_TCASE_Rq_ESP_AR2_ReceiptPDU;
	mstimer Timer_ESPBrkSys_Stat_AR2_ReceiptPDU;
	mstimer Timer_ESPDPC_Disp_Rq_AR2_ReceiptPDU;
	mstimer Timer_ESPDPC_IndMd_Stat_AR2_ReceiptPDU;
	mstimer Timer_ESPDPC_IndMd_Style2_AR2_ReceiptPDU;
	mstimer Timer_ESPDPC_IndMd_Style_AR2_ReceiptPDU;
	mstimer Timer_ESPDPC_Master_Rq_AR2_ReceiptPDU;
	mstimer Timer_ESPEng_Susp_Rq_AS_AR2_ReceiptPDU;
	mstimer Timer_ESPEPKB_Disp_IndLmp_Rq_2_AR2_ReceiptPDU;
	mstimer Timer_ESPEPKB_Stat_Gw_AR2_ReceiptPDU;
	mstimer Timer_ESPESP_Disp_Rq2_AR2_ReceiptPDU;
	mstimer Timer_ESPESP_Disp_Rq3_AR_ReceiptPDU;
	mstimer Timer_ESPESP_Disp_Rq_AMG_AR2_ReceiptPDU;
	mstimer Timer_ESPESP_Disp_Rq_AR2_ReceiptPDU;
	mstimer Timer_ESPESP_OBD_Stat_AR_ReceiptPDU;
	mstimer Timer_ESPESP_Stat1_AR2_ReceiptPDU;
	mstimer Timer_ESPLDC_Disp_Rq_ESP_AR_ReceiptPDU;
	mstimer Timer_ESPPARK_Brk_Rs_AR2_ReceiptPDU;
	mstimer Timer_ESPPARK_Drv_Rq_ESP_AR2_ReceiptPDU;
	mstimer Timer_ESPPresfCtrl_Rq_ESP_AR2_ReceiptPDU;
	mstimer Timer_ESPPT_Rq_ESP_AR2_ReceiptPDU;
	mstimer Timer_ESPROE_ESP_ReceiptPDU;
	mstimer Timer_ESPSADR_Trgr_ESP_AR2_ReceiptPDU;
	mstimer Timer_ESPSt_Rq_STA_AR2_ReceiptPDU;
	mstimer Timer_ESPTBCSC_ESP_DAC_AR2_ReceiptPDU;
	mstimer Timer_ESPTBCSC_Rs1_ESP_AR2_ReceiptPDU;
	mstimer Timer_ESPTBCSC_Rs2_ESP_AR2_ReceiptPDU;
	mstimer Timer_ESPVehAccel_X_Rs1_AR2_ReceiptPDU;
	mstimer Timer_ESPVehAccel_X_Rs2_AR2_ReceiptPDU;
	mstimer Timer_ESPVehDyn_Stat1_AR2_ReceiptPDU;
	mstimer Timer_ESPVehDyn_Stat2_AR2_ReceiptPDU;
	mstimer Timer_ESPVehSpd_X_AR2_ReceiptPDU;
	mstimer Timer_ESPWhl_Lt_Stat_AR2_ReceiptPDU;
	mstimer Timer_ESPWhl_Rt_Stat_AR2_ReceiptPDU;
	mstimer Timer_ESPWhlPlsCnt_TPM_AR2_ReceiptPDU;
	mstimer Timer_ESPWUDOP_ESP_FR_ReceiptPDU;
	mstimer Timer_ESPYMAS_Rs_AR2_ReceiptPDU;
	mstimer Timer_FCWCMS_PI_State_AR2_ReceiptPDU;
	mstimer Timer_FCWFCW_Disp_Rq_Gw_AR_ReceiptPDU;
	mstimer Timer_FCWPT_ObjIntrst_AR2_ReceiptPDU;
	mstimer Timer_FCWRDU_Disp_Rq_AR_ReceiptPDU;
	mstimer Timer_FCWROE_RDU_ReceiptPDU;
	mstimer Timer_FCWSADR_Trgr_RDU_AR2_ReceiptPDU;
	mstimer Timer_FCWVehAccel_X_Rq_AR2_ReceiptPDU;
	mstimer Timer_LRRDTR_Obj_A_FR2_ReceiptPDU;
	mstimer Timer_LRRDTR_Obj_B_FR2_ReceiptPDU;
	mstimer Timer_LRRDTR_Obj_C_FR2_ReceiptPDU;
	mstimer Timer_LRRDTR_Obj_D_FR2_ReceiptPDU;
	mstimer Timer_LRRDTR_Obj_E_FR2_ReceiptPDU;
	mstimer Timer_LRRDTR_Obj_F_FR2_ReceiptPDU;
	mstimer Timer_LRRDTR_Obj_G_FR2_ReceiptPDU;
	mstimer Timer_LRRDTR_ObjStat_FR2_ReceiptPDU;
	mstimer Timer_LRRDTR_Polyg_Lt_FR2_ReceiptPDU;
	mstimer Timer_LRRDTR_Polyg_Rt_FR2_ReceiptPDU;
	mstimer Timer_LRRDTR_Stat_FR2_ReceiptPDU;
	mstimer Timer_LRRROE_LRR_ReceiptPDU;
	mstimer Timer_MPCCam_Stat_AR2_ReceiptPDU;
	mstimer Timer_MPCCamLane_Disp_Warn_Rq_Gw_AR2_ReceiptPDU;
	mstimer Timer_MPCCamLane_FastAttr1_FR2_ReceiptPDU;
	mstimer Timer_MPCCamLane_FastAttr2_FR2_ReceiptPDU;
	mstimer Timer_MPCCamLane_LaneAttr1_Gw_AR2_ReceiptPDU;
	mstimer Timer_MPCCamLane_LaneAttr2_Gw_AR2_ReceiptPDU;
	mstimer Timer_MPCCamLane_LaneAttr3_Gw_AR2_ReceiptPDU;
	mstimer Timer_MPCCamLane_LaneAttr4_FR2_ReceiptPDU;
	mstimer Timer_MPCCamLane_LaneAttr5_FR2_ReceiptPDU;
	mstimer Timer_MPCCamLane_LaneAttr6_Gw_AR2_ReceiptPDU;
	mstimer Timer_MPCCamLane_LaneAttr7_Gw_AR2_ReceiptPDU;
	mstimer Timer_MPCCamObj_A_Mtn_FR2_ReceiptPDU;
	mstimer Timer_MPCCamObj_A_Posn_FR2_ReceiptPDU;
	mstimer Timer_MPCCamObj_B_Mtn_FR2_ReceiptPDU;
	mstimer Timer_MPCCamObj_B_Posn_FR2_ReceiptPDU;
	mstimer Timer_MPCCamObj_C_Mtn_FR2_ReceiptPDU;
	mstimer Timer_MPCCamObj_C_Posn_FR2_ReceiptPDU;
	mstimer Timer_MPCIHC_Lgt_Stat_MPC_Gw_AR2_ReceiptPDU;
	mstimer Timer_MPCIHC_Plus_HL_Stat_AR2_ReceiptPDU;
	mstimer Timer_MPCIHC_Plus_Tunnel_3_4_AR2_ReceiptPDU;
	mstimer Timer_MPCIHC_Plus_Tunnel_AR2_ReceiptPDU;
	mstimer Timer_MPCPreview_Header1_FR2_ReceiptPDU;
	mstimer Timer_MPCPreview_Header2_FR2_ReceiptPDU;
	mstimer Timer_MPCPreview_ProfData1_FR2_ReceiptPDU;
	mstimer Timer_MPCPreview_ProfData2_FR2_ReceiptPDU;
	mstimer Timer_MPCROE_SMPC_ReceiptPDU;
	mstimer Timer_MPCSPL_Obj1_Obj2_MPC_AR2_ReceiptPDU;
	mstimer Timer_MPCTSA_Disp_Rq1_Gw_AR2_ReceiptPDU;
	mstimer Timer_MPCTSA_Disp_Rq2_Gw_AR_ReceiptPDU;
	mstimer Timer_MPCTSA_Disp_Rq3_Gw_AR_ReceiptPDU;
	mstimer Timer_MPCYMAS_Rq_MPC_Gw_AR2_ReceiptPDU;
	mstimer Timer_PARKBrk_Rq_PARK_AR2_ReceiptPDU;
	mstimer Timer_PARKECU_INFO_RVC_AR_ReceiptPDU;
	mstimer Timer_PARKPark_Disp_Rq_AR2_ReceiptPDU;
	mstimer Timer_PARKPark_Set_Stat_AR2_ReceiptPDU;
	mstimer Timer_PARKPark_Stat_AR2_ReceiptPDU;
	mstimer Timer_PARKParkSensObj_Stat1_FR2_ReceiptPDU;
	mstimer Timer_PARKParkSensObj_Stat2_FR2_ReceiptPDU;
	mstimer Timer_PARKParkSpaceMeas_Stat_AR_ReceiptPDU;
	mstimer Timer_PARKParkWarn_AR2_ReceiptPDU;
	mstimer Timer_PARKRemPark_Rq_AR2_ReceiptPDU;
	mstimer Timer_PARKROE_PARK_ReceiptPDU;
	mstimer Timer_PARKRVC_SVS_Park_Stat_AR2_ReceiptPDU;
	mstimer Timer_PARKSADR_Trgr_PARK_AR2_ReceiptPDU;
	mstimer Timer_PARKSt_Rq_PARK_AR2_ReceiptPDU;
	mstimer Timer_RDUBrkSys_Rq_YMAS_AR2_ReceiptPDU;
	mstimer Timer_RDUBSM_Disp_Warn_Rq_Gw_AR2_ReceiptPDU;
	mstimer Timer_RDUCMS_PI_Sd_Stat_MMR_F1_AR2_ReceiptPDU;
	mstimer Timer_RDUCMS_PI_Sd_Stat_MMR_F4_AR2_ReceiptPDU;
	mstimer Timer_RDUCMS_PI_State_AR2_ReceiptPDU;
	mstimer Timer_RDUDTQ_Disp_Warn_Rq_AR2_ReceiptPDU;
	mstimer Timer_RDUDTQ_Rq1_AR2_ReceiptPDU;
	mstimer Timer_RDUDTQ_Rq2_AR2_ReceiptPDU;
	mstimer Timer_RDULDC_Disp_Rq_RDU_AR2_ReceiptPDU;
	mstimer Timer_RDULDP_Warn_Rq_AR2_ReceiptPDU;
	mstimer Timer_RDUPT_ObjIntrst_AR2_ReceiptPDU;
	mstimer Timer_RDURDU_Disp_Rq_AR_ReceiptPDU;
	mstimer Timer_RDURDU_GlobalAttr_AR2_ReceiptPDU;
	mstimer Timer_RDURDU_Stat1_AR_ReceiptPDU;
	mstimer Timer_RDUROE_MMR_F1_ReceiptPDU;
	mstimer Timer_RDUROE_MMR_F4_ReceiptPDU;
	mstimer Timer_RDUROE_MMR_RM_ReceiptPDU;
	mstimer Timer_RDUROE_MMR_RS_ReceiptPDU;
	mstimer Timer_RDUROE_RDU_ReceiptPDU;
	mstimer Timer_RDUSADR_Trgr_RDU_AR2_ReceiptPDU;
	mstimer Timer_RDUSCS_Stat1_RDU_AR2_ReceiptPDU;
	mstimer Timer_RDUSCS_Stat2_RDU_AR2_ReceiptPDU;
	mstimer Timer_RDUVeh_Stat_RDU_FR2_ReceiptPDU;
	mstimer Timer_RDUVehAccel_X_Rq_AR2_ReceiptPDU;
	mstimer Timer_SCCMLDC_Rq_StWhl_AR2_ReceiptPDU;
	mstimer Timer_SCCMLDC_SBW_Rq_SCCM_AR2_ReceiptPDU;
	mstimer Timer_SCCMROE_SCCM_ReceiptPDU;
	mstimer Timer_SCCMROE_SWSP_ReceiptPDU;
	mstimer Timer_SCCMSCCM_Sw_Stat_AR2_ReceiptPDU;
	mstimer Timer_SCCMStWhl_Angl_Stat_AR2_ReceiptPDU;
	mstimer Timer_SCCMStWhl_OFN_Stat_AR2_ReceiptPDU;
	mstimer Timer_SCCMStWhl_Sw_Stat_AR2_ReceiptPDU;
	mstimer Timer_SCCMWUDOP_SCCM_FR_ReceiptPDU;
	mstimer Timer_SDTRCMS_PI_State_AR2_ReceiptPDU;
	mstimer Timer_SDTRLDC_Disp_Rq_RDU_AR2_ReceiptPDU;
	mstimer Timer_SDTRPT_ObjIntrst_AR2_ReceiptPDU;
	mstimer Timer_SDTRRDU_Disp_Rq_AR_ReceiptPDU;
	mstimer Timer_SDTRRDU_Stat1_AR_ReceiptPDU;
	mstimer Timer_SDTRROE_RDU_ReceiptPDU;
	mstimer Timer_SDTRSADR_Trgr_RDU_AR2_ReceiptPDU;
	mstimer Timer_SDTRVehAccel_X_Rq_AR2_ReceiptPDU;
	mstimer Timer_SPCEng_Rq_ABC_AR2_ReceiptPDU;
	mstimer Timer_SPCOffRoad_Disp_Rq_AR_ReceiptPDU;
	mstimer Timer_SPCPreview_Data_SPC_AR_ReceiptPDU;
	mstimer Timer_SPCROE_MPU_FL_ReceiptPDU;
	mstimer Timer_SPCROE_MPU_FR_ReceiptPDU;
	mstimer Timer_SPCROE_MPU_RL_ReceiptPDU;
	mstimer Timer_SPCROE_MPU_RR_ReceiptPDU;
	mstimer Timer_SPCROE_SPC_ReceiptPDU;
	mstimer Timer_SPCSPC_Disp_Rq_AR_ReceiptPDU;
	mstimer Timer_SPCSPC_SwLED_Msg_Rq_AR2_ReceiptPDU;
	mstimer Timer_SPCSpringVlv_Rq_AR_ReceiptPDU;
	mstimer Timer_SPCVehCarv_Stat_AR_ReceiptPDU;
	mstimer Timer_SPCVehLvl_Stat_AR2_ReceiptPDU;
	mstimer Timer_SPC_VXROE_SPC_VX_ReceiptPDU;
	mstimer Timer_SPC_VXSPC_VX_Stat1_AR_ReceiptPDU;
	mstimer Timer_SPC_VXSpringVlv_Stat_AR_ReceiptPDU;
}
/*@@end*/

/*@@preStart:PreStart:*/
on preStart
{
	@sysvar::CH_Nodes::CH__PDURECEIPT_RECEIVE_AWD_TCASE_AWD_TCASE_Disp_Rq_AR2 = 0;
	@sysvar::CH_Nodes::CH__PDURECEIPT_SIM_AWD_TCASE_AWD_TCASE_Disp_Rq_AR2 = 0;
	@sysvar::CH_Nodes::CH__PDURECEIPT_RECEIVE_AWD_TCASE_AWD_TCASE_Stat1_AR2 = 0;
	@sysvar::CH_Nodes::CH__PDURECEIPT_SIM_AWD_TCASE_AWD_TCASE_Stat1_AR2 = 0;
	@sysvar::CH_Nodes::CH__PDURECEIPT_RECEIVE_AWD_TCASE_AWD_TCASE_Stat2_AR2 = 0;
	@sysvar::CH_Nodes::CH__PDURECEIPT_SIM_AWD_TCASE_AWD_TCASE_Stat2_AR2 = 0;
	@sysvar::CH_Nodes::CH__PDURECEIPT_RECEIVE_AWD_TCASE_ROE_AWD_TCASE = 0;
	@sysvar::CH_Nodes::CH__PDURECEIPT_SIM_AWD_TCASE_ROE_AWD_TCASE = 0;
	@sysvar::CH_Nodes::CH__PDURECEIPT_RECEIVE_CPC_Adblue_Disp_Rq_AR = 0;
	@sysvar::CH_Nodes::CH__PDURECEIPT_SIM_CPC_Adblue_Disp_Rq_AR = 0;
	@sysvar::CH_Nodes::CH__PDURECEIPT_RECEIVE_CPC_Adblue_Disp_Warn_Rq_AR = 0;
	@sysvar::CH_Nodes::CH__PDURECEIPT_SIM_CPC_Adblue_Disp_Warn_Rq_AR = 0;
	@sysvar::CH_Nodes::CH__PDURECEIPT_RECEIVE_CPC_Assyst_Stat2_AR = 0;
	@sysvar::CH_Nodes::CH__PDURECEIPT_SIM_CPC_Assyst_Stat2_AR = 0;
	@sysvar::CH_Nodes::CH__PDURECEIPT_RECEIVE_CPC_Assyst_Stat3_AR2 = 0;
	@sysvar::CH_Nodes::CH__PDURECEIPT_SIM_CPC_Assyst_Stat3_AR2 = 0;
	@sysvar::CH_Nodes::CH__PDURECEIPT_RECEIVE_CPC_Assyst_Stat_AR = 0;
	@sysvar::CH_Nodes::CH__PDURECEIPT_SIM_CPC_Assyst_Stat_AR = 0;
	@sysvar::CH_Nodes::CH__PDURECEIPT_RECEIVE_CPC_CNG_Disp_Rq_AR2 = 0;
	@sysvar::CH_Nodes::CH__PDURECEIPT_SIM_CPC_CNG_Disp_Rq_AR2 = 0;
	@sysvar::CH_Nodes::CH__PDURECEIPT_RECEIVE_CPC_CPC_CHASSIS_R1_AR2 = 0;
	@sysvar::CH_Nodes::CH__PDURECEIPT_SIM_CPC_CPC_CHASSIS_R1_AR2 = 0;
	@sysvar::CH_Nodes::CH__PDURECEIPT_RECEIVE_CPC_CPC_CHASSIS_R2_AR2 = 0;
	@sysvar::CH_Nodes::CH__PDURECEIPT_SIM_CPC_CPC_CHASSIS_R2_AR2 = 0;
	@sysvar::CH_Nodes::CH__PDURECEIPT_RECEIVE_CPC_DCDC1_Rs1_AR2 = 0;
	@sysvar::CH_Nodes::CH__PDURECEIPT_SIM_CPC_DCDC1_Rs1_AR2 = 0;
	@sysvar::CH_Nodes::CH__PDURECEIPT_RECEIVE_CPC_DPC_PT_Rs_AR = 0;
	@sysvar::CH_Nodes::CH__PDURECEIPT_SIM_CPC_DPC_PT_Rs_AR = 0;
	@sysvar::CH_Nodes::CH__PDURECEIPT_RECEIVE_CPC_ECM_DAC4_AR = 0;
	@sysvar::CH_Nodes::CH__PDURECEIPT_SIM_CPC_ECM_DAC4_AR = 0;
	@sysvar::CH_Nodes::CH__PDURECEIPT_RECEIVE_CPC_ECO_Homepage_Data = 0;
	@sysvar::CH_Nodes::CH__PDURECEIPT_SIM_CPC_ECO_Homepage_Data = 0;
	@sysvar::CH_Nodes::CH__PDURECEIPT_RECEIVE_CPC_ECO_Score_Disp_Rq_AR = 0;
	@sysvar::CH_Nodes::CH__PDURECEIPT_SIM_CPC_ECO_Score_Disp_Rq_AR = 0;
	@sysvar::CH_Nodes::CH__PDURECEIPT_RECEIVE_CPC_EM01_Stat1_AR2 = 0;
	@sysvar::CH_Nodes::CH__PDURECEIPT_SIM_CPC_EM01_Stat1_AR2 = 0;
	@sysvar::CH_Nodes::CH__PDURECEIPT_RECEIVE_CPC_EM01_Stat2_AR2 = 0;
	@sysvar::CH_Nodes::CH__PDURECEIPT_SIM_CPC_EM01_Stat2_AR2 = 0;
	@sysvar::CH_Nodes::CH__PDURECEIPT_RECEIVE_CPC_EM01_Trq_Rs_AR2 = 0;
	@sysvar::CH_Nodes::CH__PDURECEIPT_SIM_CPC_EM01_Trq_Rs_AR2 = 0;
	@sysvar::CH_Nodes::CH__PDURECEIPT_RECEIVE_CPC_EM_DAC4_AR = 0;
	@sysvar::CH_Nodes::CH__PDURECEIPT_SIM_CPC_EM_DAC4_AR = 0;
	@sysvar::CH_Nodes::CH__PDURECEIPT_RECEIVE_CPC_EMM_Data1_AR2 = 0;
	@sysvar::CH_Nodes::CH__PDURECEIPT_SIM_CPC_EMM_Data1_AR2 = 0;
	@sysvar::CH_Nodes::CH__PDURECEIPT_RECEIVE_CPC_EnergyMngmnt_PreCond_Stat_AR2 = 0;
	@sysvar::CH_Nodes::CH__PDURECEIPT_SIM_CPC_EnergyMngmnt_PreCond_Stat_AR2 = 0;
	@sysvar::CH_Nodes::CH__PDURECEIPT_RECEIVE_CPC_Eng_Rs_1_AR2 = 0;
	@sysvar::CH_Nodes::CH__PDURECEIPT_SIM_CPC_Eng_Rs_1_AR2 = 0;
	@sysvar::CH_Nodes::CH__PDURECEIPT_RECEIVE_CPC_Eng_Rs_2_AR2 = 0;
	@sysvar::CH_Nodes::CH__PDURECEIPT_SIM_CPC_Eng_Rs_2_AR2 = 0;
	@sysvar::CH_Nodes::CH__PDURECEIPT_RECEIVE_CPC_Eng_Rs_3_AR2 = 0;
	@sysvar::CH_Nodes::CH__PDURECEIPT_SIM_CPC_Eng_Rs_3_AR2 = 0;
	@sysvar::CH_Nodes::CH__PDURECEIPT_RECEIVE_CPC_Eng_Rs_EM_AR2 = 0;
	@sysvar::CH_Nodes::CH__PDURECEIPT_SIM_CPC_Eng_Rs_EM_AR2 = 0;
	@sysvar::CH_Nodes::CH__PDURECEIPT_RECEIVE_CPC_Eng_Rs_EngCtrl_AR2 = 0;
	@sysvar::CH_Nodes::CH__PDURECEIPT_SIM_CPC_Eng_Rs_EngCtrl_AR2 = 0;
	@sysvar::CH_Nodes::CH__PDURECEIPT_RECEIVE_CPC_EngCtrl_Disp_Rq_AR2 = 0;
	@sysvar::CH_Nodes::CH__PDURECEIPT_SIM_CPC_EngCtrl_Disp_Rq_AR2 = 0;
	@sysvar::CH_Nodes::CH__PDURECEIPT_RECEIVE_CPC_EngCtrl_OBD1_AR = 0;
	@sysvar::CH_Nodes::CH__PDURECEIPT_SIM_CPC_EngCtrl_OBD1_AR = 0;
	@sysvar::CH_Nodes::CH__PDURECEIPT_RECEIVE_CPC_EngCtrl_Stat_AR2 = 0;
	@sysvar::CH_Nodes::CH__PDURECEIPT_SIM_CPC_EngCtrl_Stat_AR2 = 0;
	@sysvar::CH_Nodes::CH__PDURECEIPT_RECEIVE_CPC_ESP_OBD_Data_AR = 0;
	@sysvar::CH_Nodes::CH__PDURECEIPT_SIM_CPC_ESP_OBD_Data_AR = 0;
	@sysvar::CH_Nodes::CH__PDURECEIPT_RECEIVE_CPC_Fuel_Stat2_AR2 = 0;
	@sysvar::CH_Nodes::CH__PDURECEIPT_SIM_CPC_Fuel_Stat2_AR2 = 0;
	@sysvar::CH_Nodes::CH__PDURECEIPT_RECEIVE_CPC_FuelLvl_Stat_AR2 = 0;
	@sysvar::CH_Nodes::CH__PDURECEIPT_SIM_CPC_FuelLvl_Stat_AR2 = 0;
	@sysvar::CH_Nodes::CH__PDURECEIPT_RECEIVE_CPC_HumanMachineIfc_AR2 = 0;
	@sysvar::CH_Nodes::CH__PDURECEIPT_SIM_CPC_HumanMachineIfc_AR2 = 0;
	@sysvar::CH_Nodes::CH__PDURECEIPT_RECEIVE_CPC_HumanMachineIfc_Rq_AR = 0;
	@sysvar::CH_Nodes::CH__PDURECEIPT_SIM_CPC_HumanMachineIfc_Rq_AR = 0;
	@sysvar::CH_Nodes::CH__PDURECEIPT_RECEIVE_CPC_ISM_DAC4_AR = 0;
	@sysvar::CH_Nodes::CH__PDURECEIPT_SIM_CPC_ISM_DAC4_AR = 0;
	@sysvar::CH_Nodes::CH__PDURECEIPT_RECEIVE_CPC_OBL_DC_Output_AR = 0;
	@sysvar::CH_Nodes::CH__PDURECEIPT_SIM_CPC_OBL_DC_Output_AR = 0;
	@sysvar::CH_Nodes::CH__PDURECEIPT_RECEIVE_CPC_PARK_Drv_Rs_TCM_AR2 = 0;
	@sysvar::CH_Nodes::CH__PDURECEIPT_SIM_CPC_PARK_Drv_Rs_TCM_AR2 = 0;
	@sysvar::CH_Nodes::CH__PDURECEIPT_RECEIVE_CPC_PN14_Gen_Rs_AR = 0;
	@sysvar::CH_Nodes::CH__PDURECEIPT_SIM_CPC_PN14_Gen_Rs_AR = 0;
	@sysvar::CH_Nodes::CH__PDURECEIPT_RECEIVE_CPC_PNHV_BMS_Stat_AR2 = 0;
	@sysvar::CH_Nodes::CH__PDURECEIPT_SIM_CPC_PNHV_BMS_Stat_AR2 = 0;
	@sysvar::CH_Nodes::CH__PDURECEIPT_RECEIVE_CPC_PNHV_EnergyMngmnt_Disp_Rq_AR = 0;
	@sysvar::CH_Nodes::CH__PDURECEIPT_SIM_CPC_PNHV_EnergyMngmnt_Disp_Rq_AR = 0;
	@sysvar::CH_Nodes::CH__PDURECEIPT_RECEIVE_CPC_PNHV_EnergyMngmnt_Stat2_AR2 = 0;
	@sysvar::CH_Nodes::CH__PDURECEIPT_SIM_CPC_PNHV_EnergyMngmnt_Stat2_AR2 = 0;
	@sysvar::CH_Nodes::CH__PDURECEIPT_RECEIVE_CPC_PNHV_EnergyMngmnt_Stat3_AR2 = 0;
	@sysvar::CH_Nodes::CH__PDURECEIPT_SIM_CPC_PNHV_EnergyMngmnt_Stat3_AR2 = 0;
	@sysvar::CH_Nodes::CH__PDURECEIPT_RECEIVE_CPC_PNHV_EnergyMngmntSet_Rs1_AR2 = 0;
	@sysvar::CH_Nodes::CH__PDURECEIPT_SIM_CPC_PNHV_EnergyMngmntSet_Rs1_AR2 = 0;
	@sysvar::CH_Nodes::CH__PDURECEIPT_RECEIVE_CPC_PNHV_EnergyMngmntSet_Rs2_AR = 0;
	@sysvar::CH_Nodes::CH__PDURECEIPT_SIM_CPC_PNHV_EnergyMngmntSet_Rs2_AR = 0;
	@sysvar::CH_Nodes::CH__PDURECEIPT_RECEIVE_CPC_PNHV_Stat_AR2 = 0;
	@sysvar::CH_Nodes::CH__PDURECEIPT_SIM_CPC_PNHV_Stat_AR2 = 0;
	@sysvar::CH_Nodes::CH__PDURECEIPT_RECEIVE_CPC_PNHV_WeekDepTmTbl_Stat_AR2 = 0;
	@sysvar::CH_Nodes::CH__PDURECEIPT_SIM_CPC_PNHV_WeekDepTmTbl_Stat_AR2 = 0;
	@sysvar::CH_Nodes::CH__PDURECEIPT_RECEIVE_CPC_PT_DataContain_Rq_AR2 = 0;
	@sysvar::CH_Nodes::CH__PDURECEIPT_SIM_CPC_PT_DataContain_Rq_AR2 = 0;
	@sysvar::CH_Nodes::CH__PDURECEIPT_RECEIVE_CPC_PT_Disp_Rq2_AR = 0;
	@sysvar::CH_Nodes::CH__PDURECEIPT_SIM_CPC_PT_Disp_Rq2_AR = 0;
	@sysvar::CH_Nodes::CH__PDURECEIPT_RECEIVE_CPC_PT_ThermM_AR2 = 0;
	@sysvar::CH_Nodes::CH__PDURECEIPT_SIM_CPC_PT_ThermM_AR2 = 0;
	@sysvar::CH_Nodes::CH__PDURECEIPT_RECEIVE_CPC_PT_ThermM_Rq_AR2 = 0;
	@sysvar::CH_Nodes::CH__PDURECEIPT_SIM_CPC_PT_ThermM_Rq_AR2 = 0;
	@sysvar::CH_Nodes::CH__PDURECEIPT_RECEIVE_CPC_PtHyb_Mngmnt_Rq1_AR = 0;
	@sysvar::CH_Nodes::CH__PDURECEIPT_SIM_CPC_PtHyb_Mngmnt_Rq1_AR = 0;
	@sysvar::CH_Nodes::CH__PDURECEIPT_RECEIVE_CPC_PtMngmnt_Disp_Rq_AR2 = 0;
	@sysvar::CH_Nodes::CH__PDURECEIPT_SIM_CPC_PtMngmnt_Disp_Rq_AR2 = 0;
	@sysvar::CH_Nodes::CH__PDURECEIPT_RECEIVE_CPC_PtMngmnt_Rq_AR2 = 0;
	@sysvar::CH_Nodes::CH__PDURECEIPT_SIM_CPC_PtMngmnt_Rq_AR2 = 0;
	@sysvar::CH_Nodes::CH__PDURECEIPT_RECEIVE_CPC_PtMngmnt_Stat2_AR2 = 0;
	@sysvar::CH_Nodes::CH__PDURECEIPT_SIM_CPC_PtMngmnt_Stat2_AR2 = 0;
	@sysvar::CH_Nodes::CH__PDURECEIPT_RECEIVE_CPC_PtMngmnt_Stat_AR2 = 0;
	@sysvar::CH_Nodes::CH__PDURECEIPT_SIM_CPC_PtMngmnt_Stat_AR2 = 0;
	@sysvar::CH_Nodes::CH__PDURECEIPT_RECEIVE_CPC_SBW_DrvPosn_Disp_Rq_ISM_AR2 = 0;
	@sysvar::CH_Nodes::CH__PDURECEIPT_SIM_CPC_SBW_DrvPosn_Disp_Rq_ISM_AR2 = 0;
	@sysvar::CH_Nodes::CH__PDURECEIPT_RECEIVE_CPC_SBW_DrvPosn_Disp_Rq_TCM_AR2 = 0;
	@sysvar::CH_Nodes::CH__PDURECEIPT_SIM_CPC_SBW_DrvPosn_Disp_Rq_TCM_AR2 = 0;
	@sysvar::CH_Nodes::CH__PDURECEIPT_RECEIVE_CPC_SBW_Stat_AR2 = 0;
	@sysvar::CH_Nodes::CH__PDURECEIPT_SIM_CPC_SBW_Stat_AR2 = 0;
	@sysvar::CH_Nodes::CH__PDURECEIPT_RECEIVE_CPC_SND_GEN_Stat_AR = 0;
	@sysvar::CH_Nodes::CH__PDURECEIPT_SIM_CPC_SND_GEN_Stat_AR = 0;
	@sysvar::CH_Nodes::CH__PDURECEIPT_RECEIVE_CPC_TC_Disp_Rq_ECM_AR = 0;
	@sysvar::CH_Nodes::CH__PDURECEIPT_SIM_CPC_TC_Disp_Rq_ECM_AR = 0;
	@sysvar::CH_Nodes::CH__PDURECEIPT_RECEIVE_CPC_TC_EBBC_Disp_Rq_ECM_AR = 0;
	@sysvar::CH_Nodes::CH__PDURECEIPT_SIM_CPC_TC_EBBC_Disp_Rq_ECM_AR = 0;
	@sysvar::CH_Nodes::CH__PDURECEIPT_RECEIVE_CPC_TC_EEBBC_Disp_Rq_AR = 0;
	@sysvar::CH_Nodes::CH__PDURECEIPT_SIM_CPC_TC_EEBBC_Disp_Rq_AR = 0;
	@sysvar::CH_Nodes::CH__PDURECEIPT_RECEIVE_CPC_TCM_DAC4_AR = 0;
	@sysvar::CH_Nodes::CH__PDURECEIPT_SIM_CPC_TCM_DAC4_AR = 0;
	@sysvar::CH_Nodes::CH__PDURECEIPT_RECEIVE_CPC_TCM_Data2_AR2 = 0;
	@sysvar::CH_Nodes::CH__PDURECEIPT_SIM_CPC_TCM_Data2_AR2 = 0;
	@sysvar::CH_Nodes::CH__PDURECEIPT_RECEIVE_CPC_TCM_Data3_AR2 = 0;
	@sysvar::CH_Nodes::CH__PDURECEIPT_SIM_CPC_TCM_Data3_AR2 = 0;
	@sysvar::CH_Nodes::CH__PDURECEIPT_RECEIVE_CPC_TCM_Disp_Rq_AMG_AR = 0;
	@sysvar::CH_Nodes::CH__PDURECEIPT_SIM_CPC_TCM_Disp_Rq_AMG_AR = 0;
	@sysvar::CH_Nodes::CH__PDURECEIPT_RECEIVE_CPC_TCM_State3_AR2 = 0;
	@sysvar::CH_Nodes::CH__PDURECEIPT_SIM_CPC_TCM_State3_AR2 = 0;
	@sysvar::CH_Nodes::CH__PDURECEIPT_RECEIVE_CPC_TCU_Disp_Rq_AR2 = 0;
	@sysvar::CH_Nodes::CH__PDURECEIPT_SIM_CPC_TCU_Disp_Rq_AR2 = 0;
	@sysvar::CH_Nodes::CH__PDURECEIPT_RECEIVE_CPC_ThermMngmnt_1_AR2 = 0;
	@sysvar::CH_Nodes::CH__PDURECEIPT_SIM_CPC_ThermMngmnt_1_AR2 = 0;
	@sysvar::CH_Nodes::CH__PDURECEIPT_RECEIVE_CPC_ThermMngmnt_4_AR = 0;
	@sysvar::CH_Nodes::CH__PDURECEIPT_SIM_CPC_ThermMngmnt_4_AR = 0;
	@sysvar::CH_Nodes::CH__PDURECEIPT_RECEIVE_CPC_ThermMngmnt_EV_1_AR2 = 0;
	@sysvar::CH_Nodes::CH__PDURECEIPT_SIM_CPC_ThermMngmnt_EV_1_AR2 = 0;
	@sysvar::CH_Nodes::CH__PDURECEIPT_RECEIVE_CPC_VehPwrMngmnt_EMM_Stat2_AR2 = 0;
	@sysvar::CH_Nodes::CH__PDURECEIPT_SIM_CPC_VehPwrMngmnt_EMM_Stat2_AR2 = 0;
	@sysvar::CH_Nodes::CH__PDURECEIPT_RECEIVE_CPC_VehPwrMngmnt_Rq_AR = 0;
	@sysvar::CH_Nodes::CH__PDURECEIPT_SIM_CPC_VehPwrMngmnt_Rq_AR = 0;
	@sysvar::CH_Nodes::CH__PDURECEIPT_RECEIVE_CPC_WIA_EngTrq_AR = 0;
	@sysvar::CH_Nodes::CH__PDURECEIPT_SIM_CPC_WIA_EngTrq_AR = 0;
	@sysvar::CH_Nodes::CH__PDURECEIPT_RECEIVE_CPC_WPT_Stat2_AR2 = 0;
	@sysvar::CH_Nodes::CH__PDURECEIPT_SIM_CPC_WPT_Stat2_AR2 = 0;
	@sysvar::CH_Nodes::CH__PDURECEIPT_RECEIVE_DRVU_DPC_Disp_Rq_AMG_AR2 = 0;
	@sysvar::CH_Nodes::CH__PDURECEIPT_SIM_DRVU_DPC_Disp_Rq_AMG_AR2 = 0;
	@sysvar::CH_Nodes::CH__PDURECEIPT_RECEIVE_DRVU_DPC_IndMd_Stat_AMG_AR2 = 0;
	@sysvar::CH_Nodes::CH__PDURECEIPT_SIM_DRVU_DPC_IndMd_Stat_AMG_AR2 = 0;
	@sysvar::CH_Nodes::CH__PDURECEIPT_RECEIVE_DRVU_DPC_IndMd_Style2_AMG_AR2 = 0;
	@sysvar::CH_Nodes::CH__PDURECEIPT_SIM_DRVU_DPC_IndMd_Style2_AMG_AR2 = 0;
	@sysvar::CH_Nodes::CH__PDURECEIPT_RECEIVE_DRVU_DPC_IndMd_Style_AMG_AR2 = 0;
	@sysvar::CH_Nodes::CH__PDURECEIPT_SIM_DRVU_DPC_IndMd_Style_AMG_AR2 = 0;
	@sysvar::CH_Nodes::CH__PDURECEIPT_RECEIVE_DRVU_DPC_Master_Rq_AMG_AR2 = 0;
	@sysvar::CH_Nodes::CH__PDURECEIPT_SIM_DRVU_DPC_Master_Rq_AMG_AR2 = 0;
	@sysvar::CH_Nodes::CH__PDURECEIPT_RECEIVE_DRVU_DRVU_Stat_AR = 0;
	@sysvar::CH_Nodes::CH__PDURECEIPT_SIM_DRVU_DRVU_Stat_AR = 0;
	@sysvar::CH_Nodes::CH__PDURECEIPT_RECEIVE_DRVU_ESP_EDIFF_Rs_AR = 0;
	@sysvar::CH_Nodes::CH__PDURECEIPT_SIM_DRVU_ESP_EDIFF_Rs_AR = 0;
	@sysvar::CH_Nodes::CH__PDURECEIPT_RECEIVE_EIS_ActvComf_Rq_AR2 = 0;
	@sysvar::CH_Nodes::CH__PDURECEIPT_SIM_EIS_ActvComf_Rq_AR2 = 0;
	@sysvar::CH_Nodes::CH__PDURECEIPT_RECEIVE_EIS_ADAS_CURRENT_ATTRIBUTES_AR = 0;
	@sysvar::CH_Nodes::CH__PDURECEIPT_SIM_EIS_ADAS_CURRENT_ATTRIBUTES_AR = 0;
	@sysvar::CH_Nodes::CH__PDURECEIPT_RECEIVE_EIS_ADAS_POSITION_AR = 0;
	@sysvar::CH_Nodes::CH__PDURECEIPT_SIM_EIS_ADAS_POSITION_AR = 0;
	@sysvar::CH_Nodes::CH__PDURECEIPT_RECEIVE_EIS_ADAS_PREDICTION_AR = 0;
	@sysvar::CH_Nodes::CH__PDURECEIPT_SIM_EIS_ADAS_PREDICTION_AR = 0;
	@sysvar::CH_Nodes::CH__PDURECEIPT_RECEIVE_EIS_ADAS_PROFILE_LONG_AR = 0;
	@sysvar::CH_Nodes::CH__PDURECEIPT_SIM_EIS_ADAS_PROFILE_LONG_AR = 0;
	@sysvar::CH_Nodes::CH__PDURECEIPT_RECEIVE_EIS_ADAS_PROFILE_SHORT_AR = 0;
	@sysvar::CH_Nodes::CH__PDURECEIPT_SIM_EIS_ADAS_PROFILE_SHORT_AR = 0;
	@sysvar::CH_Nodes::CH__PDURECEIPT_RECEIVE_EIS_ADASLR_POSITION_AR = 0;
	@sysvar::CH_Nodes::CH__PDURECEIPT_SIM_EIS_ADASLR_POSITION_AR = 0;
	@sysvar::CH_Nodes::CH__PDURECEIPT_RECEIVE_EIS_ADASLR_PROFILE_LONG_AR = 0;
	@sysvar::CH_Nodes::CH__PDURECEIPT_SIM_EIS_ADASLR_PROFILE_LONG_AR = 0;
	@sysvar::CH_Nodes::CH__PDURECEIPT_RECEIVE_EIS_Assyst_Rq_AR2 = 0;
	@sysvar::CH_Nodes::CH__PDURECEIPT_SIM_EIS_Assyst_Rq_AR2 = 0;
	@sysvar::CH_Nodes::CH__PDURECEIPT_RECEIVE_EIS_BC_F_Disp_Rq_AR = 0;
	@sysvar::CH_Nodes::CH__PDURECEIPT_SIM_EIS_BC_F_Disp_Rq_AR = 0;
	@sysvar::CH_Nodes::CH__PDURECEIPT_RECEIVE_EIS_BC_F_Stat1_AR = 0;
	@sysvar::CH_Nodes::CH__PDURECEIPT_SIM_EIS_BC_F_Stat1_AR = 0;
	@sysvar::CH_Nodes::CH__PDURECEIPT_RECEIVE_EIS_BC_F_Stat2_AR2 = 0;
	@sysvar::CH_Nodes::CH__PDURECEIPT_SIM_EIS_BC_F_Stat2_AR2 = 0;
	@sysvar::CH_Nodes::CH__PDURECEIPT_RECEIVE_EIS_BC_R_Stat1_AR = 0;
	@sysvar::CH_Nodes::CH__PDURECEIPT_SIM_EIS_BC_R_Stat1_AR = 0;
	@sysvar::CH_Nodes::CH__PDURECEIPT_RECEIVE_EIS_BLSM_Disp_Stat_AR = 0;
	@sysvar::CH_Nodes::CH__PDURECEIPT_SIM_EIS_BLSM_Disp_Stat_AR = 0;
	@sysvar::CH_Nodes::CH__PDURECEIPT_RECEIVE_EIS_BODY_CHASSIS_R1_AR = 0;
	@sysvar::CH_Nodes::CH__PDURECEIPT_SIM_EIS_BODY_CHASSIS_R1_AR = 0;
	@sysvar::CH_Nodes::CH__PDURECEIPT_RECEIVE_EIS_BSM_Disp_Warn_Rq_AR2 = 0;
	@sysvar::CH_Nodes::CH__PDURECEIPT_SIM_EIS_BSM_Disp_Warn_Rq_AR2 = 0;
	@sysvar::CH_Nodes::CH__PDURECEIPT_RECEIVE_EIS_CamLane_Disp_Warn_Rq_AR2 = 0;
	@sysvar::CH_Nodes::CH__PDURECEIPT_SIM_EIS_CamLane_Disp_Warn_Rq_AR2 = 0;
	@sysvar::CH_Nodes::CH__PDURECEIPT_RECEIVE_EIS_CamLane_LaneAttr1_AR2 = 0;
	@sysvar::CH_Nodes::CH__PDURECEIPT_SIM_EIS_CamLane_LaneAttr1_AR2 = 0;
	@sysvar::CH_Nodes::CH__PDURECEIPT_RECEIVE_EIS_CamLane_LaneAttr2_AR2 = 0;
	@sysvar::CH_Nodes::CH__PDURECEIPT_SIM_EIS_CamLane_LaneAttr2_AR2 = 0;
	@sysvar::CH_Nodes::CH__PDURECEIPT_RECEIVE_EIS_CamLane_LaneAttr3_AR2 = 0;
	@sysvar::CH_Nodes::CH__PDURECEIPT_SIM_EIS_CamLane_LaneAttr3_AR2 = 0;
	@sysvar::CH_Nodes::CH__PDURECEIPT_RECEIVE_EIS_CamLane_LaneAttr6_AR2 = 0;
	@sysvar::CH_Nodes::CH__PDURECEIPT_SIM_EIS_CamLane_LaneAttr6_AR2 = 0;
	@sysvar::CH_Nodes::CH__PDURECEIPT_RECEIVE_EIS_CamLane_LaneAttr7_AR2 = 0;
	@sysvar::CH_Nodes::CH__PDURECEIPT_SIM_EIS_CamLane_LaneAttr7_AR2 = 0;
	@sysvar::CH_Nodes::CH__PDURECEIPT_RECEIVE_EIS_CLkS_Rq_AR = 0;
	@sysvar::CH_Nodes::CH__PDURECEIPT_SIM_EIS_CLkS_Rq_AR = 0;
	@sysvar::CH_Nodes::CH__PDURECEIPT_RECEIVE_EIS_CLkS_State_AR = 0;
	@sysvar::CH_Nodes::CH__PDURECEIPT_SIM_EIS_CLkS_State_AR = 0;
	@sysvar::CH_Nodes::CH__PDURECEIPT_RECEIVE_EIS_ClockSync_Stat_FR2 = 0;
	@sysvar::CH_Nodes::CH__PDURECEIPT_SIM_EIS_ClockSync_Stat_FR2 = 0;
	@sysvar::CH_Nodes::CH__PDURECEIPT_RECEIVE_EIS_CMS_PI_State_Gw_AR2 = 0;
	@sysvar::CH_Nodes::CH__PDURECEIPT_SIM_EIS_CMS_PI_State_Gw_AR2 = 0;
	@sysvar::CH_Nodes::CH__PDURECEIPT_RECEIVE_EIS_Config_HU4_AR2 = 0;
	@sysvar::CH_Nodes::CH__PDURECEIPT_SIM_EIS_Config_HU4_AR2 = 0;
	@sysvar::CH_Nodes::CH__PDURECEIPT_RECEIVE_EIS_Config_HU5_AR2 = 0;
	@sysvar::CH_Nodes::CH__PDURECEIPT_SIM_EIS_Config_HU5_AR2 = 0;
	@sysvar::CH_Nodes::CH__PDURECEIPT_RECEIVE_EIS_CRCM_Stat_AR = 0;
	@sysvar::CH_Nodes::CH__PDURECEIPT_SIM_EIS_CRCM_Stat_AR = 0;
	@sysvar::CH_Nodes::CH__PDURECEIPT_RECEIVE_EIS_CTRL_C_Stat1_AR = 0;
	@sysvar::CH_Nodes::CH__PDURECEIPT_SIM_EIS_CTRL_C_Stat1_AR = 0;
	@sysvar::CH_Nodes::CH__PDURECEIPT_RECEIVE_EIS_DAC4_ECM_AR = 0;
	@sysvar::CH_Nodes::CH__PDURECEIPT_SIM_EIS_DAC4_ECM_AR = 0;
	@sysvar::CH_Nodes::CH__PDURECEIPT_RECEIVE_EIS_DAC4_EM2_AR = 0;
	@sysvar::CH_Nodes::CH__PDURECEIPT_SIM_EIS_DAC4_EM2_AR = 0;
	@sysvar::CH_Nodes::CH__PDURECEIPT_RECEIVE_EIS_DAC4_ISM_AR = 0;
	@sysvar::CH_Nodes::CH__PDURECEIPT_SIM_EIS_DAC4_ISM_AR = 0;
	@sysvar::CH_Nodes::CH__PDURECEIPT_RECEIVE_EIS_DAC4_TCM_AR = 0;
	@sysvar::CH_Nodes::CH__PDURECEIPT_SIM_EIS_DAC4_TCM_AR = 0;
	@sysvar::CH_Nodes::CH__PDURECEIPT_RECEIVE_EIS_Dimming_Stat_AR2 = 0;
	@sysvar::CH_Nodes::CH__PDURECEIPT_SIM_EIS_Dimming_Stat_AR2 = 0;
	@sysvar::CH_Nodes::CH__PDURECEIPT_RECEIVE_EIS_Door_FL_Stat_AR2 = 0;
	@sysvar::CH_Nodes::CH__PDURECEIPT_SIM_EIS_Door_FL_Stat_AR2 = 0;
	@sysvar::CH_Nodes::CH__PDURECEIPT_RECEIVE_EIS_Door_FR_Stat_AR2 = 0;
	@sysvar::CH_Nodes::CH__PDURECEIPT_SIM_EIS_Door_FR_Stat_AR2 = 0;
	@sysvar::CH_Nodes::CH__PDURECEIPT_RECEIVE_EIS_Door_RL_Stat_AR2 = 0;
	@sysvar::CH_Nodes::CH__PDURECEIPT_SIM_EIS_Door_RL_Stat_AR2 = 0;
	@sysvar::CH_Nodes::CH__PDURECEIPT_RECEIVE_EIS_Door_RR_Stat_AR2 = 0;
	@sysvar::CH_Nodes::CH__PDURECEIPT_SIM_EIS_Door_RR_Stat_AR2 = 0;
	@sysvar::CH_Nodes::CH__PDURECEIPT_RECEIVE_EIS_DPC_IndMd_Rq_AR = 0;
	@sysvar::CH_Nodes::CH__PDURECEIPT_SIM_EIS_DPC_IndMd_Rq_AR = 0;
	@sysvar::CH_Nodes::CH__PDURECEIPT_RECEIVE_EIS_EAC_Stat_AR = 0;
	@sysvar::CH_Nodes::CH__PDURECEIPT_SIM_EIS_EAC_Stat_AR = 0;
	@sysvar::CH_Nodes::CH__PDURECEIPT_RECEIVE_EIS_EL_Stat_AR2 = 0;
	@sysvar::CH_Nodes::CH__PDURECEIPT_SIM_EIS_EL_Stat_AR2 = 0;
	@sysvar::CH_Nodes::CH__PDURECEIPT_RECEIVE_EIS_EL_TurnInd_Rq_AR2 = 0;
	@sysvar::CH_Nodes::CH__PDURECEIPT_SIM_EIS_EL_TurnInd_Rq_AR2 = 0;
	@sysvar::CH_Nodes::CH__PDURECEIPT_RECEIVE_EIS_EPKB_Stat_AR2 = 0;
	@sysvar::CH_Nodes::CH__PDURECEIPT_SIM_EIS_EPKB_Stat_AR2 = 0;
	@sysvar::CH_Nodes::CH__PDURECEIPT_RECEIVE_EIS_EVC_CfgBit_01_32_AR2 = 0;
	@sysvar::CH_Nodes::CH__PDURECEIPT_SIM_EIS_EVC_CfgBit_01_32_AR2 = 0;
	@sysvar::CH_Nodes::CH__PDURECEIPT_RECEIVE_EIS_EVC_CfgBit_33_64_AR2 = 0;
	@sysvar::CH_Nodes::CH__PDURECEIPT_SIM_EIS_EVC_CfgBit_33_64_AR2 = 0;
	@sysvar::CH_Nodes::CH__PDURECEIPT_RECEIVE_EIS_EVC_CfgBit_65_96_AR2 = 0;
	@sysvar::CH_Nodes::CH__PDURECEIPT_SIM_EIS_EVC_CfgBit_65_96_AR2 = 0;
	@sysvar::CH_Nodes::CH__PDURECEIPT_RECEIVE_EIS_EVC_CfgBit_97_C8_AR2 = 0;
	@sysvar::CH_Nodes::CH__PDURECEIPT_SIM_EIS_EVC_CfgBit_97_C8_AR2 = 0;
	@sysvar::CH_Nodes::CH__PDURECEIPT_RECEIVE_EIS_EVC_CfgList_01_0C_AR2 = 0;
	@sysvar::CH_Nodes::CH__PDURECEIPT_SIM_EIS_EVC_CfgList_01_0C_AR2 = 0;
	@sysvar::CH_Nodes::CH__PDURECEIPT_RECEIVE_EIS_FCW_Disp_Rq_AR = 0;
	@sysvar::CH_Nodes::CH__PDURECEIPT_SIM_EIS_FCW_Disp_Rq_AR = 0;
	@sysvar::CH_Nodes::CH__PDURECEIPT_RECEIVE_EIS_HMI_CHASSIS_R1_AR2 = 0;
	@sysvar::CH_Nodes::CH__PDURECEIPT_SIM_EIS_HMI_CHASSIS_R1_AR2 = 0;
	@sysvar::CH_Nodes::CH__PDURECEIPT_RECEIVE_EIS_HU_Comf_Rq_AR2 = 0;
	@sysvar::CH_Nodes::CH__PDURECEIPT_SIM_EIS_HU_Comf_Rq_AR2 = 0;
	@sysvar::CH_Nodes::CH__PDURECEIPT_RECEIVE_EIS_HU_State_AR = 0;
	@sysvar::CH_Nodes::CH__PDURECEIPT_SIM_EIS_HU_State_AR = 0;
	@sysvar::CH_Nodes::CH__PDURECEIPT_RECEIVE_EIS_HVAC_Disp_Stat1_AR = 0;
	@sysvar::CH_Nodes::CH__PDURECEIPT_SIM_EIS_HVAC_Disp_Stat1_AR = 0;
	@sysvar::CH_Nodes::CH__PDURECEIPT_RECEIVE_EIS_HVAC_OBD_DTC_AR = 0;
	@sysvar::CH_Nodes::CH__PDURECEIPT_SIM_EIS_HVAC_OBD_DTC_AR = 0;
	@sysvar::CH_Nodes::CH__PDURECEIPT_RECEIVE_EIS_HVAC_Rs2_AR = 0;
	@sysvar::CH_Nodes::CH__PDURECEIPT_SIM_EIS_HVAC_Rs2_AR = 0;
	@sysvar::CH_Nodes::CH__PDURECEIPT_RECEIVE_EIS_HVAC_Rs3_AR2 = 0;
	@sysvar::CH_Nodes::CH__PDURECEIPT_SIM_EIS_HVAC_Rs3_AR2 = 0;
	@sysvar::CH_Nodes::CH__PDURECEIPT_RECEIVE_EIS_HVAC_Rs_AR2 = 0;
	@sysvar::CH_Nodes::CH__PDURECEIPT_SIM_EIS_HVAC_Rs_AR2 = 0;
	@sysvar::CH_Nodes::CH__PDURECEIPT_RECEIVE_EIS_HVAC_State1_AR = 0;
	@sysvar::CH_Nodes::CH__PDURECEIPT_SIM_EIS_HVAC_State1_AR = 0;
	@sysvar::CH_Nodes::CH__PDURECEIPT_RECEIVE_EIS_IC_BasicInfo_AR2 = 0;
	@sysvar::CH_Nodes::CH__PDURECEIPT_SIM_EIS_IC_BasicInfo_AR2 = 0;
	@sysvar::CH_Nodes::CH__PDURECEIPT_RECEIVE_EIS_IC_DriveAssistSys_AR2 = 0;
	@sysvar::CH_Nodes::CH__PDURECEIPT_SIM_EIS_IC_DriveAssistSys_AR2 = 0;
	@sysvar::CH_Nodes::CH__PDURECEIPT_RECEIVE_EIS_IC_Settings_AR2 = 0;
	@sysvar::CH_Nodes::CH__PDURECEIPT_SIM_EIS_IC_Settings_AR2 = 0;
	@sysvar::CH_Nodes::CH__PDURECEIPT_RECEIVE_EIS_ICH_Stat_AR = 0;
	@sysvar::CH_Nodes::CH__PDURECEIPT_SIM_EIS_ICH_Stat_AR = 0;
	@sysvar::CH_Nodes::CH__PDURECEIPT_RECEIVE_EIS_Ign_Veh_Stat_AR2 = 0;
	@sysvar::CH_Nodes::CH__PDURECEIPT_SIM_EIS_Ign_Veh_Stat_AR2 = 0;
	@sysvar::CH_Nodes::CH__PDURECEIPT_RECEIVE_EIS_IHC_Lgt_Stat_HLI_2_AR2 = 0;
	@sysvar::CH_Nodes::CH__PDURECEIPT_SIM_EIS_IHC_Lgt_Stat_HLI_2_AR2 = 0;
	@sysvar::CH_Nodes::CH__PDURECEIPT_RECEIVE_EIS_IHC_Lgt_Stat_HLI_AR2 = 0;
	@sysvar::CH_Nodes::CH__PDURECEIPT_SIM_EIS_IHC_Lgt_Stat_HLI_AR2 = 0;
	@sysvar::CH_Nodes::CH__PDURECEIPT_RECEIVE_EIS_KG_State_AR2 = 0;
	@sysvar::CH_Nodes::CH__PDURECEIPT_SIM_EIS_KG_State_AR2 = 0;
	@sysvar::CH_Nodes::CH__PDURECEIPT_RECEIVE_EIS_LDC_Disp_Stat_IC_AR2 = 0;
	@sysvar::CH_Nodes::CH__PDURECEIPT_SIM_EIS_LDC_Disp_Stat_IC_AR2 = 0;
	@sysvar::CH_Nodes::CH__PDURECEIPT_RECEIVE_EIS_LgtSens_State_AR = 0;
	@sysvar::CH_Nodes::CH__PDURECEIPT_SIM_EIS_LgtSens_State_AR = 0;
	@sysvar::CH_Nodes::CH__PDURECEIPT_RECEIVE_EIS_Mirr_Adj_Lt_Rq_AR = 0;
	@sysvar::CH_Nodes::CH__PDURECEIPT_SIM_EIS_Mirr_Adj_Lt_Rq_AR = 0;
	@sysvar::CH_Nodes::CH__PDURECEIPT_RECEIVE_EIS_Mirr_Adj_Rt_Rq_AR = 0;
	@sysvar::CH_Nodes::CH__PDURECEIPT_SIM_EIS_Mirr_Adj_Rt_Rq_AR = 0;
	@sysvar::CH_Nodes::CH__PDURECEIPT_RECEIVE_EIS_NAVI_Pos1_AR = 0;
	@sysvar::CH_Nodes::CH__PDURECEIPT_SIM_EIS_NAVI_Pos1_AR = 0;
	@sysvar::CH_Nodes::CH__PDURECEIPT_RECEIVE_EIS_NAVI_Pos2_AR = 0;
	@sysvar::CH_Nodes::CH__PDURECEIPT_SIM_EIS_NAVI_Pos2_AR = 0;
	@sysvar::CH_Nodes::CH__PDURECEIPT_RECEIVE_EIS_NAVI_Pos3_AR = 0;
	@sysvar::CH_Nodes::CH__PDURECEIPT_SIM_EIS_NAVI_Pos3_AR = 0;
	@sysvar::CH_Nodes::CH__PDURECEIPT_RECEIVE_EIS_NAVI_Pos4_AR = 0;
	@sysvar::CH_Nodes::CH__PDURECEIPT_SIM_EIS_NAVI_Pos4_AR = 0;
	@sysvar::CH_Nodes::CH__PDURECEIPT_RECEIVE_EIS_NAVI_Pos5_AR = 0;
	@sysvar::CH_Nodes::CH__PDURECEIPT_SIM_EIS_NAVI_Pos5_AR = 0;
	@sysvar::CH_Nodes::CH__PDURECEIPT_RECEIVE_EIS_NVP_Stat1_AR2 = 0;
	@sysvar::CH_Nodes::CH__PDURECEIPT_SIM_EIS_NVP_Stat1_AR2 = 0;
	@sysvar::CH_Nodes::CH__PDURECEIPT_RECEIVE_EIS_OHCM_Stat_AR2 = 0;
	@sysvar::CH_Nodes::CH__PDURECEIPT_SIM_EIS_OHCM_Stat_AR2 = 0;
	@sysvar::CH_Nodes::CH__PDURECEIPT_RECEIVE_EIS_ORC_Disp_Stat_AR2 = 0;
	@sysvar::CH_Nodes::CH__PDURECEIPT_SIM_EIS_ORC_Disp_Stat_AR2 = 0;
	@sysvar::CH_Nodes::CH__PDURECEIPT_RECEIVE_EIS_ORC_Impact_AR2 = 0;
	@sysvar::CH_Nodes::CH__PDURECEIPT_SIM_EIS_ORC_Impact_AR2 = 0;
	@sysvar::CH_Nodes::CH__PDURECEIPT_RECEIVE_EIS_Park_Disp_Rs_AR2 = 0;
	@sysvar::CH_Nodes::CH__PDURECEIPT_SIM_EIS_Park_Disp_Rs_AR2 = 0;
	@sysvar::CH_Nodes::CH__PDURECEIPT_RECEIVE_EIS_PHB_IHC_Plus_Tunnel_3_4_AR2 = 0;
	@sysvar::CH_Nodes::CH__PDURECEIPT_SIM_EIS_PHB_IHC_Plus_Tunnel_3_4_AR2 = 0;
	@sysvar::CH_Nodes::CH__PDURECEIPT_RECEIVE_EIS_PHB_IHC_Plus_Tunnel_AR2 = 0;
	@sysvar::CH_Nodes::CH__PDURECEIPT_SIM_EIS_PHB_IHC_Plus_Tunnel_AR2 = 0;
	@sysvar::CH_Nodes::CH__PDURECEIPT_RECEIVE_EIS_PN14_Disp_Rq_AR = 0;
	@sysvar::CH_Nodes::CH__PDURECEIPT_SIM_EIS_PN14_Disp_Rq_AR = 0;
	@sysvar::CH_Nodes::CH__PDURECEIPT_RECEIVE_EIS_PN14_Rs1_AR2 = 0;
	@sysvar::CH_Nodes::CH__PDURECEIPT_SIM_EIS_PN14_Rs1_AR2 = 0;
	@sysvar::CH_Nodes::CH__PDURECEIPT_RECEIVE_EIS_PN14_Rs2_AR = 0;
	@sysvar::CH_Nodes::CH__PDURECEIPT_SIM_EIS_PN14_Rs2_AR = 0;
	@sysvar::CH_Nodes::CH__PDURECEIPT_RECEIVE_EIS_PN14_Stat2_AR2 = 0;
	@sysvar::CH_Nodes::CH__PDURECEIPT_SIM_EIS_PN14_Stat2_AR2 = 0;
	@sysvar::CH_Nodes::CH__PDURECEIPT_RECEIVE_EIS_PN14_Stat_AR = 0;
	@sysvar::CH_Nodes::CH__PDURECEIPT_SIM_EIS_PN14_Stat_AR = 0;
	@sysvar::CH_Nodes::CH__PDURECEIPT_RECEIVE_EIS_PN48_Bat_Stat2_AR2 = 0;
	@sysvar::CH_Nodes::CH__PDURECEIPT_SIM_EIS_PN48_Bat_Stat2_AR2 = 0;
	@sysvar::CH_Nodes::CH__PDURECEIPT_RECEIVE_EIS_PN48_Bat_Stat_AR = 0;
	@sysvar::CH_Nodes::CH__PDURECEIPT_SIM_EIS_PN48_Bat_Stat_AR = 0;
	@sysvar::CH_Nodes::CH__PDURECEIPT_RECEIVE_EIS_PN48_BatLim_Stat_AR = 0;
	@sysvar::CH_Nodes::CH__PDURECEIPT_SIM_EIS_PN48_BatLim_Stat_AR = 0;
	@sysvar::CH_Nodes::CH__PDURECEIPT_RECEIVE_EIS_PN48_DCDC48_LISB48_Stat_AR = 0;
	@sysvar::CH_Nodes::CH__PDURECEIPT_SIM_EIS_PN48_DCDC48_LISB48_Stat_AR = 0;
	@sysvar::CH_Nodes::CH__PDURECEIPT_RECEIVE_EIS_PN48_Stat_AR = 0;
	@sysvar::CH_Nodes::CH__PDURECEIPT_SIM_EIS_PN48_Stat_AR = 0;
	@sysvar::CH_Nodes::CH__PDURECEIPT_RECEIVE_EIS_PNHV_WeekDepTmTbl_Rq_HU_AR2 = 0;
	@sysvar::CH_Nodes::CH__PDURECEIPT_SIM_EIS_PNHV_WeekDepTmTbl_Rq_HU_AR2 = 0;
	@sysvar::CH_Nodes::CH__PDURECEIPT_RECEIVE_EIS_PreCond_On_Rq_AR = 0;
	@sysvar::CH_Nodes::CH__PDURECEIPT_SIM_EIS_PreCond_On_Rq_AR = 0;
	@sysvar::CH_Nodes::CH__PDURECEIPT_RECEIVE_EIS_PreCond_Rq_HU_AR2 = 0;
	@sysvar::CH_Nodes::CH__PDURECEIPT_SIM_EIS_PreCond_Rq_HU_AR2 = 0;
	@sysvar::CH_Nodes::CH__PDURECEIPT_RECEIVE_EIS_PreCond_Stat_AR = 0;
	@sysvar::CH_Nodes::CH__PDURECEIPT_SIM_EIS_PreCond_Stat_AR = 0;
	@sysvar::CH_Nodes::CH__PDURECEIPT_RECEIVE_EIS_PT_ObjIntrst_Gw_AR2 = 0;
	@sysvar::CH_Nodes::CH__PDURECEIPT_SIM_EIS_PT_ObjIntrst_Gw_AR2 = 0;
	@sysvar::CH_Nodes::CH__PDURECEIPT_RECEIVE_EIS_RemPark_Auth_Rs_AR2 = 0;
	@sysvar::CH_Nodes::CH__PDURECEIPT_SIM_EIS_RemPark_Auth_Rs_AR2 = 0;
	@sysvar::CH_Nodes::CH__PDURECEIPT_RECEIVE_EIS_RemPark_Stat_EIS_AR2 = 0;
	@sysvar::CH_Nodes::CH__PDURECEIPT_SIM_EIS_RemPark_Stat_EIS_AR2 = 0;
	@sysvar::CH_Nodes::CH__PDURECEIPT_RECEIVE_EIS_RTC_Date_Time_AR2 = 0;
	@sysvar::CH_Nodes::CH__PDURECEIPT_SIM_EIS_RTC_Date_Time_AR2 = 0;
	@sysvar::CH_Nodes::CH__PDURECEIPT_RECEIVE_EIS_RTC_Stat1_AR2 = 0;
	@sysvar::CH_Nodes::CH__PDURECEIPT_SIM_EIS_RTC_Stat1_AR2 = 0;
	@sysvar::CH_Nodes::CH__PDURECEIPT_RECEIVE_EIS_SADR_Trgr_FCW_AR2 = 0;
	@sysvar::CH_Nodes::CH__PDURECEIPT_SIM_EIS_SADR_Trgr_FCW_AR2 = 0;
	@sysvar::CH_Nodes::CH__PDURECEIPT_RECEIVE_EIS_SeatAdj_FL_Rq_AR = 0;
	@sysvar::CH_Nodes::CH__PDURECEIPT_SIM_EIS_SeatAdj_FL_Rq_AR = 0;
	@sysvar::CH_Nodes::CH__PDURECEIPT_RECEIVE_EIS_SeatAdj_FR_Rq_AR = 0;
	@sysvar::CH_Nodes::CH__PDURECEIPT_SIM_EIS_SeatAdj_FR_Rq_AR = 0;
	@sysvar::CH_Nodes::CH__PDURECEIPT_RECEIVE_EIS_SPCR_Stat_BC_F_AR2 = 0;
	@sysvar::CH_Nodes::CH__PDURECEIPT_SIM_EIS_SPCR_Stat_BC_F_AR2 = 0;
	@sysvar::CH_Nodes::CH__PDURECEIPT_RECEIVE_EIS_SPL_Obj1_Obj2_NV_AR2 = 0;
	@sysvar::CH_Nodes::CH__PDURECEIPT_SIM_EIS_SPL_Obj1_Obj2_NV_AR2 = 0;
	@sysvar::CH_Nodes::CH__PDURECEIPT_RECEIVE_EIS_SPV_Actn_Rq_AR2 = 0;
	@sysvar::CH_Nodes::CH__PDURECEIPT_SIM_EIS_SPV_Actn_Rq_AR2 = 0;
	@sysvar::CH_Nodes::CH__PDURECEIPT_RECEIVE_EIS_SPV_Alm_Rq_AR = 0;
	@sysvar::CH_Nodes::CH__PDURECEIPT_SIM_EIS_SPV_Alm_Rq_AR = 0;
	@sysvar::CH_Nodes::CH__PDURECEIPT_RECEIVE_EIS_SPV_Stat_AR2 = 0;
	@sysvar::CH_Nodes::CH__PDURECEIPT_SIM_EIS_SPV_Stat_AR2 = 0;
	@sysvar::CH_Nodes::CH__PDURECEIPT_RECEIVE_EIS_SVS_Rq_HU_AR2 = 0;
	@sysvar::CH_Nodes::CH__PDURECEIPT_SIM_EIS_SVS_Rq_HU_AR2 = 0;
	@sysvar::CH_Nodes::CH__PDURECEIPT_RECEIVE_EIS_TBCSC_DAC_EPS_AR2 = 0;
	@sysvar::CH_Nodes::CH__PDURECEIPT_SIM_EIS_TBCSC_DAC_EPS_AR2 = 0;
	@sysvar::CH_Nodes::CH__PDURECEIPT_RECEIVE_EIS_TBCSC_DAC_ESP_AR2 = 0;
	@sysvar::CH_Nodes::CH__PDURECEIPT_SIM_EIS_TBCSC_DAC_ESP_AR2 = 0;
	@sysvar::CH_Nodes::CH__PDURECEIPT_RECEIVE_EIS_TBCSC_Hi_Rq1_AR2 = 0;
	@sysvar::CH_Nodes::CH__PDURECEIPT_SIM_EIS_TBCSC_Hi_Rq1_AR2 = 0;
	@sysvar::CH_Nodes::CH__PDURECEIPT_RECEIVE_EIS_TBCSC_Hi_Rq2_AR2 = 0;
	@sysvar::CH_Nodes::CH__PDURECEIPT_SIM_EIS_TBCSC_Hi_Rq2_AR2 = 0;
	@sysvar::CH_Nodes::CH__PDURECEIPT_RECEIVE_EIS_TBCSC_Lo_Rq1_AR2 = 0;
	@sysvar::CH_Nodes::CH__PDURECEIPT_SIM_EIS_TBCSC_Lo_Rq1_AR2 = 0;
	@sysvar::CH_Nodes::CH__PDURECEIPT_RECEIVE_EIS_TBCSC_Lo_Rq2_AR2 = 0;
	@sysvar::CH_Nodes::CH__PDURECEIPT_SIM_EIS_TBCSC_Lo_Rq2_AR2 = 0;
	@sysvar::CH_Nodes::CH__PDURECEIPT_RECEIVE_EIS_TC_Distance_AR = 0;
	@sysvar::CH_Nodes::CH__PDURECEIPT_SIM_EIS_TC_Distance_AR = 0;
	@sysvar::CH_Nodes::CH__PDURECEIPT_RECEIVE_EIS_TGW_DateTm_Stat_AR = 0;
	@sysvar::CH_Nodes::CH__PDURECEIPT_SIM_EIS_TGW_DateTm_Stat_AR = 0;
	@sysvar::CH_Nodes::CH__PDURECEIPT_RECEIVE_EIS_Tire_State_AR2 = 0;
	@sysvar::CH_Nodes::CH__PDURECEIPT_SIM_EIS_Tire_State_AR2 = 0;
	@sysvar::CH_Nodes::CH__PDURECEIPT_RECEIVE_EIS_TrafficInfo_AR = 0;
	@sysvar::CH_Nodes::CH__PDURECEIPT_SIM_EIS_TrafficInfo_AR = 0;
	@sysvar::CH_Nodes::CH__PDURECEIPT_RECEIVE_EIS_Trailer_Stat_AR2 = 0;
	@sysvar::CH_Nodes::CH__PDURECEIPT_SIM_EIS_Trailer_Stat_AR2 = 0;
	@sysvar::CH_Nodes::CH__PDURECEIPT_RECEIVE_EIS_TSA_Disp_Rq1_AR2 = 0;
	@sysvar::CH_Nodes::CH__PDURECEIPT_SIM_EIS_TSA_Disp_Rq1_AR2 = 0;
	@sysvar::CH_Nodes::CH__PDURECEIPT_RECEIVE_EIS_TSA_Disp_Rq2_AR = 0;
	@sysvar::CH_Nodes::CH__PDURECEIPT_SIM_EIS_TSA_Disp_Rq2_AR = 0;
	@sysvar::CH_Nodes::CH__PDURECEIPT_RECEIVE_EIS_TSA_Disp_Rq3_AR = 0;
	@sysvar::CH_Nodes::CH__PDURECEIPT_SIM_EIS_TSA_Disp_Rq3_AR = 0;
	@sysvar::CH_Nodes::CH__PDURECEIPT_RECEIVE_EIS_VehAccel_X_Rq_Gw_AR2 = 0;
	@sysvar::CH_Nodes::CH__PDURECEIPT_SIM_EIS_VehAccel_X_Rq_Gw_AR2 = 0;
	@sysvar::CH_Nodes::CH__PDURECEIPT_RECEIVE_EIS_VIN_AR = 0;
	@sysvar::CH_Nodes::CH__PDURECEIPT_SIM_EIS_VIN_AR = 0;
	@sysvar::CH_Nodes::CH__PDURECEIPT_RECEIVE_EIS_Wiper_Stat_AR = 0;
	@sysvar::CH_Nodes::CH__PDURECEIPT_SIM_EIS_Wiper_Stat_AR = 0;
	@sysvar::CH_Nodes::CH__PDURECEIPT_RECEIVE_EIS_WUDOP_EIS_FR = 0;
	@sysvar::CH_Nodes::CH__PDURECEIPT_SIM_EIS_WUDOP_EIS_FR = 0;
	@sysvar::CH_Nodes::CH__PDURECEIPT_RECEIVE_EIS_YMAS_Rq_MPC_AR2 = 0;
	@sysvar::CH_Nodes::CH__PDURECEIPT_SIM_EIS_YMAS_Rq_MPC_AR2 = 0;
	@sysvar::CH_Nodes::CH__PDURECEIPT_RECEIVE_EPS_DTQ_Rs_AR2 = 0;
	@sysvar::CH_Nodes::CH__PDURECEIPT_SIM_EPS_DTQ_Rs_AR2 = 0;
	@sysvar::CH_Nodes::CH__PDURECEIPT_RECEIVE_EPS_EPS_Stat_Disp_Rq_AR2 = 0;
	@sysvar::CH_Nodes::CH__PDURECEIPT_SIM_EPS_EPS_Stat_Disp_Rq_AR2 = 0;
	@sysvar::CH_Nodes::CH__PDURECEIPT_RECEIVE_EPS_PARK_St_Rs_AR2 = 0;
	@sysvar::CH_Nodes::CH__PDURECEIPT_SIM_EPS_PARK_St_Rs_AR2 = 0;
	@sysvar::CH_Nodes::CH__PDURECEIPT_RECEIVE_EPS_ROE_EPS = 0;
	@sysvar::CH_Nodes::CH__PDURECEIPT_SIM_EPS_ROE_EPS = 0;
	@sysvar::CH_Nodes::CH__PDURECEIPT_RECEIVE_EPS_STA_Rs1_AR2 = 0;
	@sysvar::CH_Nodes::CH__PDURECEIPT_SIM_EPS_STA_Rs1_AR2 = 0;
	@sysvar::CH_Nodes::CH__PDURECEIPT_RECEIVE_EPS_TBCSC_EPS_DAC_AR2 = 0;
	@sysvar::CH_Nodes::CH__PDURECEIPT_SIM_EPS_TBCSC_EPS_DAC_AR2 = 0;
	@sysvar::CH_Nodes::CH__PDURECEIPT_RECEIVE_EPS_TBCSC_Rs_EPS_AR2 = 0;
	@sysvar::CH_Nodes::CH__PDURECEIPT_SIM_EPS_TBCSC_Rs_EPS_AR2 = 0;
	@sysvar::CH_Nodes::CH__PDURECEIPT_RECEIVE_EPS_WUDOP_EPS_FR = 0;
	@sysvar::CH_Nodes::CH__PDURECEIPT_SIM_EPS_WUDOP_EPS_FR = 0;
	@sysvar::CH_Nodes::CH__PDURECEIPT_RECEIVE_ESP_AWD_TCASE_Rq_ESP_AR2 = 0;
	@sysvar::CH_Nodes::CH__PDURECEIPT_SIM_ESP_AWD_TCASE_Rq_ESP_AR2 = 0;
	@sysvar::CH_Nodes::CH__PDURECEIPT_RECEIVE_ESP_BrkSys_Stat_AR2 = 0;
	@sysvar::CH_Nodes::CH__PDURECEIPT_SIM_ESP_BrkSys_Stat_AR2 = 0;
	@sysvar::CH_Nodes::CH__PDURECEIPT_RECEIVE_ESP_DPC_Disp_Rq_AR2 = 0;
	@sysvar::CH_Nodes::CH__PDURECEIPT_SIM_ESP_DPC_Disp_Rq_AR2 = 0;
	@sysvar::CH_Nodes::CH__PDURECEIPT_RECEIVE_ESP_DPC_IndMd_Stat_AR2 = 0;
	@sysvar::CH_Nodes::CH__PDURECEIPT_SIM_ESP_DPC_IndMd_Stat_AR2 = 0;
	@sysvar::CH_Nodes::CH__PDURECEIPT_RECEIVE_ESP_DPC_IndMd_Style2_AR2 = 0;
	@sysvar::CH_Nodes::CH__PDURECEIPT_SIM_ESP_DPC_IndMd_Style2_AR2 = 0;
	@sysvar::CH_Nodes::CH__PDURECEIPT_RECEIVE_ESP_DPC_IndMd_Style_AR2 = 0;
	@sysvar::CH_Nodes::CH__PDURECEIPT_SIM_ESP_DPC_IndMd_Style_AR2 = 0;
	@sysvar::CH_Nodes::CH__PDURECEIPT_RECEIVE_ESP_DPC_Master_Rq_AR2 = 0;
	@sysvar::CH_Nodes::CH__PDURECEIPT_SIM_ESP_DPC_Master_Rq_AR2 = 0;
	@sysvar::CH_Nodes::CH__PDURECEIPT_RECEIVE_ESP_Eng_Susp_Rq_AS_AR2 = 0;
	@sysvar::CH_Nodes::CH__PDURECEIPT_SIM_ESP_Eng_Susp_Rq_AS_AR2 = 0;
	@sysvar::CH_Nodes::CH__PDURECEIPT_RECEIVE_ESP_EPKB_Disp_IndLmp_Rq_2_AR2 = 0;
	@sysvar::CH_Nodes::CH__PDURECEIPT_SIM_ESP_EPKB_Disp_IndLmp_Rq_2_AR2 = 0;
	@sysvar::CH_Nodes::CH__PDURECEIPT_RECEIVE_ESP_EPKB_Stat_Gw_AR2 = 0;
	@sysvar::CH_Nodes::CH__PDURECEIPT_SIM_ESP_EPKB_Stat_Gw_AR2 = 0;
	@sysvar::CH_Nodes::CH__PDURECEIPT_RECEIVE_ESP_ESP_Disp_Rq2_AR2 = 0;
	@sysvar::CH_Nodes::CH__PDURECEIPT_SIM_ESP_ESP_Disp_Rq2_AR2 = 0;
	@sysvar::CH_Nodes::CH__PDURECEIPT_RECEIVE_ESP_ESP_Disp_Rq3_AR = 0;
	@sysvar::CH_Nodes::CH__PDURECEIPT_SIM_ESP_ESP_Disp_Rq3_AR = 0;
	@sysvar::CH_Nodes::CH__PDURECEIPT_RECEIVE_ESP_ESP_Disp_Rq_AMG_AR2 = 0;
	@sysvar::CH_Nodes::CH__PDURECEIPT_SIM_ESP_ESP_Disp_Rq_AMG_AR2 = 0;
	@sysvar::CH_Nodes::CH__PDURECEIPT_RECEIVE_ESP_ESP_Disp_Rq_AR2 = 0;
	@sysvar::CH_Nodes::CH__PDURECEIPT_SIM_ESP_ESP_Disp_Rq_AR2 = 0;
	@sysvar::CH_Nodes::CH__PDURECEIPT_RECEIVE_ESP_ESP_OBD_Stat_AR = 0;
	@sysvar::CH_Nodes::CH__PDURECEIPT_SIM_ESP_ESP_OBD_Stat_AR = 0;
	@sysvar::CH_Nodes::CH__PDURECEIPT_RECEIVE_ESP_ESP_Stat1_AR2 = 0;
	@sysvar::CH_Nodes::CH__PDURECEIPT_SIM_ESP_ESP_Stat1_AR2 = 0;
	@sysvar::CH_Nodes::CH__PDURECEIPT_RECEIVE_ESP_LDC_Disp_Rq_ESP_AR = 0;
	@sysvar::CH_Nodes::CH__PDURECEIPT_SIM_ESP_LDC_Disp_Rq_ESP_AR = 0;
	@sysvar::CH_Nodes::CH__PDURECEIPT_RECEIVE_ESP_PARK_Brk_Rs_AR2 = 0;
	@sysvar::CH_Nodes::CH__PDURECEIPT_SIM_ESP_PARK_Brk_Rs_AR2 = 0;
	@sysvar::CH_Nodes::CH__PDURECEIPT_RECEIVE_ESP_PARK_Drv_Rq_ESP_AR2 = 0;
	@sysvar::CH_Nodes::CH__PDURECEIPT_SIM_ESP_PARK_Drv_Rq_ESP_AR2 = 0;
	@sysvar::CH_Nodes::CH__PDURECEIPT_RECEIVE_ESP_PresfCtrl_Rq_ESP_AR2 = 0;
	@sysvar::CH_Nodes::CH__PDURECEIPT_SIM_ESP_PresfCtrl_Rq_ESP_AR2 = 0;
	@sysvar::CH_Nodes::CH__PDURECEIPT_RECEIVE_ESP_PT_Rq_ESP_AR2 = 0;
	@sysvar::CH_Nodes::CH__PDURECEIPT_SIM_ESP_PT_Rq_ESP_AR2 = 0;
	@sysvar::CH_Nodes::CH__PDURECEIPT_RECEIVE_ESP_ROE_ESP = 0;
	@sysvar::CH_Nodes::CH__PDURECEIPT_SIM_ESP_ROE_ESP = 0;
	@sysvar::CH_Nodes::CH__PDURECEIPT_RECEIVE_ESP_SADR_Trgr_ESP_AR2 = 0;
	@sysvar::CH_Nodes::CH__PDURECEIPT_SIM_ESP_SADR_Trgr_ESP_AR2 = 0;
	@sysvar::CH_Nodes::CH__PDURECEIPT_RECEIVE_ESP_St_Rq_STA_AR2 = 0;
	@sysvar::CH_Nodes::CH__PDURECEIPT_SIM_ESP_St_Rq_STA_AR2 = 0;
	@sysvar::CH_Nodes::CH__PDURECEIPT_RECEIVE_ESP_TBCSC_ESP_DAC_AR2 = 0;
	@sysvar::CH_Nodes::CH__PDURECEIPT_SIM_ESP_TBCSC_ESP_DAC_AR2 = 0;
	@sysvar::CH_Nodes::CH__PDURECEIPT_RECEIVE_ESP_TBCSC_Rs1_ESP_AR2 = 0;
	@sysvar::CH_Nodes::CH__PDURECEIPT_SIM_ESP_TBCSC_Rs1_ESP_AR2 = 0;
	@sysvar::CH_Nodes::CH__PDURECEIPT_RECEIVE_ESP_TBCSC_Rs2_ESP_AR2 = 0;
	@sysvar::CH_Nodes::CH__PDURECEIPT_SIM_ESP_TBCSC_Rs2_ESP_AR2 = 0;
	@sysvar::CH_Nodes::CH__PDURECEIPT_RECEIVE_ESP_VehAccel_X_Rs1_AR2 = 0;
	@sysvar::CH_Nodes::CH__PDURECEIPT_SIM_ESP_VehAccel_X_Rs1_AR2 = 0;
	@sysvar::CH_Nodes::CH__PDURECEIPT_RECEIVE_ESP_VehAccel_X_Rs2_AR2 = 0;
	@sysvar::CH_Nodes::CH__PDURECEIPT_SIM_ESP_VehAccel_X_Rs2_AR2 = 0;
	@sysvar::CH_Nodes::CH__PDURECEIPT_RECEIVE_ESP_VehDyn_Stat1_AR2 = 0;
	@sysvar::CH_Nodes::CH__PDURECEIPT_SIM_ESP_VehDyn_Stat1_AR2 = 0;
	@sysvar::CH_Nodes::CH__PDURECEIPT_RECEIVE_ESP_VehDyn_Stat2_AR2 = 0;
	@sysvar::CH_Nodes::CH__PDURECEIPT_SIM_ESP_VehDyn_Stat2_AR2 = 0;
	@sysvar::CH_Nodes::CH__PDURECEIPT_RECEIVE_ESP_VehSpd_X_AR2 = 0;
	@sysvar::CH_Nodes::CH__PDURECEIPT_SIM_ESP_VehSpd_X_AR2 = 0;
	@sysvar::CH_Nodes::CH__PDURECEIPT_RECEIVE_ESP_Whl_Lt_Stat_AR2 = 0;
	@sysvar::CH_Nodes::CH__PDURECEIPT_SIM_ESP_Whl_Lt_Stat_AR2 = 0;
	@sysvar::CH_Nodes::CH__PDURECEIPT_RECEIVE_ESP_Whl_Rt_Stat_AR2 = 0;
	@sysvar::CH_Nodes::CH__PDURECEIPT_SIM_ESP_Whl_Rt_Stat_AR2 = 0;
	@sysvar::CH_Nodes::CH__PDURECEIPT_RECEIVE_ESP_WhlPlsCnt_TPM_AR2 = 0;
	@sysvar::CH_Nodes::CH__PDURECEIPT_SIM_ESP_WhlPlsCnt_TPM_AR2 = 0;
	@sysvar::CH_Nodes::CH__PDURECEIPT_RECEIVE_ESP_WUDOP_ESP_FR = 0;
	@sysvar::CH_Nodes::CH__PDURECEIPT_SIM_ESP_WUDOP_ESP_FR = 0;
	@sysvar::CH_Nodes::CH__PDURECEIPT_RECEIVE_ESP_YMAS_Rs_AR2 = 0;
	@sysvar::CH_Nodes::CH__PDURECEIPT_SIM_ESP_YMAS_Rs_AR2 = 0;
	@sysvar::CH_Nodes::CH__PDURECEIPT_RECEIVE_FCW_CMS_PI_State_AR2 = 0;
	@sysvar::CH_Nodes::CH__PDURECEIPT_SIM_FCW_CMS_PI_State_AR2 = 0;
	@sysvar::CH_Nodes::CH__PDURECEIPT_RECEIVE_FCW_FCW_Disp_Rq_Gw_AR = 0;
	@sysvar::CH_Nodes::CH__PDURECEIPT_SIM_FCW_FCW_Disp_Rq_Gw_AR = 0;
	@sysvar::CH_Nodes::CH__PDURECEIPT_RECEIVE_FCW_PT_ObjIntrst_AR2 = 0;
	@sysvar::CH_Nodes::CH__PDURECEIPT_SIM_FCW_PT_ObjIntrst_AR2 = 0;
	@sysvar::CH_Nodes::CH__PDURECEIPT_RECEIVE_FCW_RDU_Disp_Rq_AR = 0;
	@sysvar::CH_Nodes::CH__PDURECEIPT_SIM_FCW_RDU_Disp_Rq_AR = 0;
	@sysvar::CH_Nodes::CH__PDURECEIPT_RECEIVE_FCW_ROE_RDU = 0;
	@sysvar::CH_Nodes::CH__PDURECEIPT_SIM_FCW_ROE_RDU = 0;
	@sysvar::CH_Nodes::CH__PDURECEIPT_RECEIVE_FCW_SADR_Trgr_RDU_AR2 = 0;
	@sysvar::CH_Nodes::CH__PDURECEIPT_SIM_FCW_SADR_Trgr_RDU_AR2 = 0;
	@sysvar::CH_Nodes::CH__PDURECEIPT_RECEIVE_FCW_VehAccel_X_Rq_AR2 = 0;
	@sysvar::CH_Nodes::CH__PDURECEIPT_SIM_FCW_VehAccel_X_Rq_AR2 = 0;
	@sysvar::CH_Nodes::CH__PDURECEIPT_RECEIVE_LRR_DTR_Obj_A_FR2 = 0;
	@sysvar::CH_Nodes::CH__PDURECEIPT_SIM_LRR_DTR_Obj_A_FR2 = 0;
	@sysvar::CH_Nodes::CH__PDURECEIPT_RECEIVE_LRR_DTR_Obj_B_FR2 = 0;
	@sysvar::CH_Nodes::CH__PDURECEIPT_SIM_LRR_DTR_Obj_B_FR2 = 0;
	@sysvar::CH_Nodes::CH__PDURECEIPT_RECEIVE_LRR_DTR_Obj_C_FR2 = 0;
	@sysvar::CH_Nodes::CH__PDURECEIPT_SIM_LRR_DTR_Obj_C_FR2 = 0;
	@sysvar::CH_Nodes::CH__PDURECEIPT_RECEIVE_LRR_DTR_Obj_D_FR2 = 0;
	@sysvar::CH_Nodes::CH__PDURECEIPT_SIM_LRR_DTR_Obj_D_FR2 = 0;
	@sysvar::CH_Nodes::CH__PDURECEIPT_RECEIVE_LRR_DTR_Obj_E_FR2 = 0;
	@sysvar::CH_Nodes::CH__PDURECEIPT_SIM_LRR_DTR_Obj_E_FR2 = 0;
	@sysvar::CH_Nodes::CH__PDURECEIPT_RECEIVE_LRR_DTR_Obj_F_FR2 = 0;
	@sysvar::CH_Nodes::CH__PDURECEIPT_SIM_LRR_DTR_Obj_F_FR2 = 0;
	@sysvar::CH_Nodes::CH__PDURECEIPT_RECEIVE_LRR_DTR_Obj_G_FR2 = 0;
	@sysvar::CH_Nodes::CH__PDURECEIPT_SIM_LRR_DTR_Obj_G_FR2 = 0;
	@sysvar::CH_Nodes::CH__PDURECEIPT_RECEIVE_LRR_DTR_ObjStat_FR2 = 0;
	@sysvar::CH_Nodes::CH__PDURECEIPT_SIM_LRR_DTR_ObjStat_FR2 = 0;
	@sysvar::CH_Nodes::CH__PDURECEIPT_RECEIVE_LRR_DTR_Polyg_Lt_FR2 = 0;
	@sysvar::CH_Nodes::CH__PDURECEIPT_SIM_LRR_DTR_Polyg_Lt_FR2 = 0;
	@sysvar::CH_Nodes::CH__PDURECEIPT_RECEIVE_LRR_DTR_Polyg_Rt_FR2 = 0;
	@sysvar::CH_Nodes::CH__PDURECEIPT_SIM_LRR_DTR_Polyg_Rt_FR2 = 0;
	@sysvar::CH_Nodes::CH__PDURECEIPT_RECEIVE_LRR_DTR_Stat_FR2 = 0;
	@sysvar::CH_Nodes::CH__PDURECEIPT_SIM_LRR_DTR_Stat_FR2 = 0;
	@sysvar::CH_Nodes::CH__PDURECEIPT_RECEIVE_LRR_ROE_LRR = 0;
	@sysvar::CH_Nodes::CH__PDURECEIPT_SIM_LRR_ROE_LRR = 0;
	@sysvar::CH_Nodes::CH__PDURECEIPT_RECEIVE_MPC_Cam_Stat_AR2 = 0;
	@sysvar::CH_Nodes::CH__PDURECEIPT_SIM_MPC_Cam_Stat_AR2 = 0;
	@sysvar::CH_Nodes::CH__PDURECEIPT_RECEIVE_MPC_CamLane_Disp_Warn_Rq_Gw_AR2 = 0;
	@sysvar::CH_Nodes::CH__PDURECEIPT_SIM_MPC_CamLane_Disp_Warn_Rq_Gw_AR2 = 0;
	@sysvar::CH_Nodes::CH__PDURECEIPT_RECEIVE_MPC_CamLane_FastAttr1_FR2 = 0;
	@sysvar::CH_Nodes::CH__PDURECEIPT_SIM_MPC_CamLane_FastAttr1_FR2 = 0;
	@sysvar::CH_Nodes::CH__PDURECEIPT_RECEIVE_MPC_CamLane_FastAttr2_FR2 = 0;
	@sysvar::CH_Nodes::CH__PDURECEIPT_SIM_MPC_CamLane_FastAttr2_FR2 = 0;
	@sysvar::CH_Nodes::CH__PDURECEIPT_RECEIVE_MPC_CamLane_LaneAttr1_Gw_AR2 = 0;
	@sysvar::CH_Nodes::CH__PDURECEIPT_SIM_MPC_CamLane_LaneAttr1_Gw_AR2 = 0;
	@sysvar::CH_Nodes::CH__PDURECEIPT_RECEIVE_MPC_CamLane_LaneAttr2_Gw_AR2 = 0;
	@sysvar::CH_Nodes::CH__PDURECEIPT_SIM_MPC_CamLane_LaneAttr2_Gw_AR2 = 0;
	@sysvar::CH_Nodes::CH__PDURECEIPT_RECEIVE_MPC_CamLane_LaneAttr3_Gw_AR2 = 0;
	@sysvar::CH_Nodes::CH__PDURECEIPT_SIM_MPC_CamLane_LaneAttr3_Gw_AR2 = 0;
	@sysvar::CH_Nodes::CH__PDURECEIPT_RECEIVE_MPC_CamLane_LaneAttr4_FR2 = 0;
	@sysvar::CH_Nodes::CH__PDURECEIPT_SIM_MPC_CamLane_LaneAttr4_FR2 = 0;
	@sysvar::CH_Nodes::CH__PDURECEIPT_RECEIVE_MPC_CamLane_LaneAttr5_FR2 = 0;
	@sysvar::CH_Nodes::CH__PDURECEIPT_SIM_MPC_CamLane_LaneAttr5_FR2 = 0;
	@sysvar::CH_Nodes::CH__PDURECEIPT_RECEIVE_MPC_CamLane_LaneAttr6_Gw_AR2 = 0;
	@sysvar::CH_Nodes::CH__PDURECEIPT_SIM_MPC_CamLane_LaneAttr6_Gw_AR2 = 0;
	@sysvar::CH_Nodes::CH__PDURECEIPT_RECEIVE_MPC_CamLane_LaneAttr7_Gw_AR2 = 0;
	@sysvar::CH_Nodes::CH__PDURECEIPT_SIM_MPC_CamLane_LaneAttr7_Gw_AR2 = 0;
	@sysvar::CH_Nodes::CH__PDURECEIPT_RECEIVE_MPC_CamObj_A_Mtn_FR2 = 0;
	@sysvar::CH_Nodes::CH__PDURECEIPT_SIM_MPC_CamObj_A_Mtn_FR2 = 0;
	@sysvar::CH_Nodes::CH__PDURECEIPT_RECEIVE_MPC_CamObj_A_Posn_FR2 = 0;
	@sysvar::CH_Nodes::CH__PDURECEIPT_SIM_MPC_CamObj_A_Posn_FR2 = 0;
	@sysvar::CH_Nodes::CH__PDURECEIPT_RECEIVE_MPC_CamObj_B_Mtn_FR2 = 0;
	@sysvar::CH_Nodes::CH__PDURECEIPT_SIM_MPC_CamObj_B_Mtn_FR2 = 0;
	@sysvar::CH_Nodes::CH__PDURECEIPT_RECEIVE_MPC_CamObj_B_Posn_FR2 = 0;
	@sysvar::CH_Nodes::CH__PDURECEIPT_SIM_MPC_CamObj_B_Posn_FR2 = 0;
	@sysvar::CH_Nodes::CH__PDURECEIPT_RECEIVE_MPC_CamObj_C_Mtn_FR2 = 0;
	@sysvar::CH_Nodes::CH__PDURECEIPT_SIM_MPC_CamObj_C_Mtn_FR2 = 0;
	@sysvar::CH_Nodes::CH__PDURECEIPT_RECEIVE_MPC_CamObj_C_Posn_FR2 = 0;
	@sysvar::CH_Nodes::CH__PDURECEIPT_SIM_MPC_CamObj_C_Posn_FR2 = 0;
	@sysvar::CH_Nodes::CH__PDURECEIPT_RECEIVE_MPC_IHC_Lgt_Stat_MPC_Gw_AR2 = 0;
	@sysvar::CH_Nodes::CH__PDURECEIPT_SIM_MPC_IHC_Lgt_Stat_MPC_Gw_AR2 = 0;
	@sysvar::CH_Nodes::CH__PDURECEIPT_RECEIVE_MPC_IHC_Plus_HL_Stat_AR2 = 0;
	@sysvar::CH_Nodes::CH__PDURECEIPT_SIM_MPC_IHC_Plus_HL_Stat_AR2 = 0;
	@sysvar::CH_Nodes::CH__PDURECEIPT_RECEIVE_MPC_IHC_Plus_Tunnel_3_4_AR2 = 0;
	@sysvar::CH_Nodes::CH__PDURECEIPT_SIM_MPC_IHC_Plus_Tunnel_3_4_AR2 = 0;
	@sysvar::CH_Nodes::CH__PDURECEIPT_RECEIVE_MPC_IHC_Plus_Tunnel_AR2 = 0;
	@sysvar::CH_Nodes::CH__PDURECEIPT_SIM_MPC_IHC_Plus_Tunnel_AR2 = 0;
	@sysvar::CH_Nodes::CH__PDURECEIPT_RECEIVE_MPC_Preview_Header1_FR2 = 0;
	@sysvar::CH_Nodes::CH__PDURECEIPT_SIM_MPC_Preview_Header1_FR2 = 0;
	@sysvar::CH_Nodes::CH__PDURECEIPT_RECEIVE_MPC_Preview_Header2_FR2 = 0;
	@sysvar::CH_Nodes::CH__PDURECEIPT_SIM_MPC_Preview_Header2_FR2 = 0;
	@sysvar::CH_Nodes::CH__PDURECEIPT_RECEIVE_MPC_Preview_ProfData1_FR2 = 0;
	@sysvar::CH_Nodes::CH__PDURECEIPT_SIM_MPC_Preview_ProfData1_FR2 = 0;
	@sysvar::CH_Nodes::CH__PDURECEIPT_RECEIVE_MPC_Preview_ProfData2_FR2 = 0;
	@sysvar::CH_Nodes::CH__PDURECEIPT_SIM_MPC_Preview_ProfData2_FR2 = 0;
	@sysvar::CH_Nodes::CH__PDURECEIPT_RECEIVE_MPC_ROE_SMPC = 0;
	@sysvar::CH_Nodes::CH__PDURECEIPT_SIM_MPC_ROE_SMPC = 0;
	@sysvar::CH_Nodes::CH__PDURECEIPT_RECEIVE_MPC_SPL_Obj1_Obj2_MPC_AR2 = 0;
	@sysvar::CH_Nodes::CH__PDURECEIPT_SIM_MPC_SPL_Obj1_Obj2_MPC_AR2 = 0;
	@sysvar::CH_Nodes::CH__PDURECEIPT_RECEIVE_MPC_TSA_Disp_Rq1_Gw_AR2 = 0;
	@sysvar::CH_Nodes::CH__PDURECEIPT_SIM_MPC_TSA_Disp_Rq1_Gw_AR2 = 0;
	@sysvar::CH_Nodes::CH__PDURECEIPT_RECEIVE_MPC_TSA_Disp_Rq2_Gw_AR = 0;
	@sysvar::CH_Nodes::CH__PDURECEIPT_SIM_MPC_TSA_Disp_Rq2_Gw_AR = 0;
	@sysvar::CH_Nodes::CH__PDURECEIPT_RECEIVE_MPC_TSA_Disp_Rq3_Gw_AR = 0;
	@sysvar::CH_Nodes::CH__PDURECEIPT_SIM_MPC_TSA_Disp_Rq3_Gw_AR = 0;
	@sysvar::CH_Nodes::CH__PDURECEIPT_RECEIVE_MPC_YMAS_Rq_MPC_Gw_AR2 = 0;
	@sysvar::CH_Nodes::CH__PDURECEIPT_SIM_MPC_YMAS_Rq_MPC_Gw_AR2 = 0;
	@sysvar::CH_Nodes::CH__PDURECEIPT_RECEIVE_PARK_Brk_Rq_PARK_AR2 = 0;
	@sysvar::CH_Nodes::CH__PDURECEIPT_SIM_PARK_Brk_Rq_PARK_AR2 = 0;
	@sysvar::CH_Nodes::CH__PDURECEIPT_RECEIVE_PARK_ECU_INFO_RVC_AR = 0;
	@sysvar::CH_Nodes::CH__PDURECEIPT_SIM_PARK_ECU_INFO_RVC_AR = 0;
	@sysvar::CH_Nodes::CH__PDURECEIPT_RECEIVE_PARK_Park_Disp_Rq_AR2 = 0;
	@sysvar::CH_Nodes::CH__PDURECEIPT_SIM_PARK_Park_Disp_Rq_AR2 = 0;
	@sysvar::CH_Nodes::CH__PDURECEIPT_RECEIVE_PARK_Park_Set_Stat_AR2 = 0;
	@sysvar::CH_Nodes::CH__PDURECEIPT_SIM_PARK_Park_Set_Stat_AR2 = 0;
	@sysvar::CH_Nodes::CH__PDURECEIPT_RECEIVE_PARK_Park_Stat_AR2 = 0;
	@sysvar::CH_Nodes::CH__PDURECEIPT_SIM_PARK_Park_Stat_AR2 = 0;
	@sysvar::CH_Nodes::CH__PDURECEIPT_RECEIVE_PARK_ParkSensObj_Stat1_FR2 = 0;
	@sysvar::CH_Nodes::CH__PDURECEIPT_SIM_PARK_ParkSensObj_Stat1_FR2 = 0;
	@sysvar::CH_Nodes::CH__PDURECEIPT_RECEIVE_PARK_ParkSensObj_Stat2_FR2 = 0;
	@sysvar::CH_Nodes::CH__PDURECEIPT_SIM_PARK_ParkSensObj_Stat2_FR2 = 0;
	@sysvar::CH_Nodes::CH__PDURECEIPT_RECEIVE_PARK_ParkSpaceMeas_Stat_AR = 0;
	@sysvar::CH_Nodes::CH__PDURECEIPT_SIM_PARK_ParkSpaceMeas_Stat_AR = 0;
	@sysvar::CH_Nodes::CH__PDURECEIPT_RECEIVE_PARK_ParkWarn_AR2 = 0;
	@sysvar::CH_Nodes::CH__PDURECEIPT_SIM_PARK_ParkWarn_AR2 = 0;
	@sysvar::CH_Nodes::CH__PDURECEIPT_RECEIVE_PARK_RemPark_Rq_AR2 = 0;
	@sysvar::CH_Nodes::CH__PDURECEIPT_SIM_PARK_RemPark_Rq_AR2 = 0;
	@sysvar::CH_Nodes::CH__PDURECEIPT_RECEIVE_PARK_ROE_PARK = 0;
	@sysvar::CH_Nodes::CH__PDURECEIPT_SIM_PARK_ROE_PARK = 0;
	@sysvar::CH_Nodes::CH__PDURECEIPT_RECEIVE_PARK_RVC_SVS_Park_Stat_AR2 = 0;
	@sysvar::CH_Nodes::CH__PDURECEIPT_SIM_PARK_RVC_SVS_Park_Stat_AR2 = 0;
	@sysvar::CH_Nodes::CH__PDURECEIPT_RECEIVE_PARK_SADR_Trgr_PARK_AR2 = 0;
	@sysvar::CH_Nodes::CH__PDURECEIPT_SIM_PARK_SADR_Trgr_PARK_AR2 = 0;
	@sysvar::CH_Nodes::CH__PDURECEIPT_RECEIVE_PARK_St_Rq_PARK_AR2 = 0;
	@sysvar::CH_Nodes::CH__PDURECEIPT_SIM_PARK_St_Rq_PARK_AR2 = 0;
	@sysvar::CH_Nodes::CH__PDURECEIPT_RECEIVE_RDU_BrkSys_Rq_YMAS_AR2 = 0;
	@sysvar::CH_Nodes::CH__PDURECEIPT_SIM_RDU_BrkSys_Rq_YMAS_AR2 = 0;
	@sysvar::CH_Nodes::CH__PDURECEIPT_RECEIVE_RDU_BSM_Disp_Warn_Rq_Gw_AR2 = 0;
	@sysvar::CH_Nodes::CH__PDURECEIPT_SIM_RDU_BSM_Disp_Warn_Rq_Gw_AR2 = 0;
	@sysvar::CH_Nodes::CH__PDURECEIPT_RECEIVE_RDU_CMS_PI_Sd_Stat_MMR_F1_AR2 = 0;
	@sysvar::CH_Nodes::CH__PDURECEIPT_SIM_RDU_CMS_PI_Sd_Stat_MMR_F1_AR2 = 0;
	@sysvar::CH_Nodes::CH__PDURECEIPT_RECEIVE_RDU_CMS_PI_Sd_Stat_MMR_F4_AR2 = 0;
	@sysvar::CH_Nodes::CH__PDURECEIPT_SIM_RDU_CMS_PI_Sd_Stat_MMR_F4_AR2 = 0;
	@sysvar::CH_Nodes::CH__PDURECEIPT_RECEIVE_RDU_CMS_PI_State_AR2 = 0;
	@sysvar::CH_Nodes::CH__PDURECEIPT_SIM_RDU_CMS_PI_State_AR2 = 0;
	@sysvar::CH_Nodes::CH__PDURECEIPT_RECEIVE_RDU_DTQ_Disp_Warn_Rq_AR2 = 0;
	@sysvar::CH_Nodes::CH__PDURECEIPT_SIM_RDU_DTQ_Disp_Warn_Rq_AR2 = 0;
	@sysvar::CH_Nodes::CH__PDURECEIPT_RECEIVE_RDU_DTQ_Rq1_AR2 = 0;
	@sysvar::CH_Nodes::CH__PDURECEIPT_SIM_RDU_DTQ_Rq1_AR2 = 0;
	@sysvar::CH_Nodes::CH__PDURECEIPT_RECEIVE_RDU_DTQ_Rq2_AR2 = 0;
	@sysvar::CH_Nodes::CH__PDURECEIPT_SIM_RDU_DTQ_Rq2_AR2 = 0;
	@sysvar::CH_Nodes::CH__PDURECEIPT_RECEIVE_RDU_LDC_Disp_Rq_RDU_AR2 = 0;
	@sysvar::CH_Nodes::CH__PDURECEIPT_SIM_RDU_LDC_Disp_Rq_RDU_AR2 = 0;
	@sysvar::CH_Nodes::CH__PDURECEIPT_RECEIVE_RDU_LDP_Warn_Rq_AR2 = 0;
	@sysvar::CH_Nodes::CH__PDURECEIPT_SIM_RDU_LDP_Warn_Rq_AR2 = 0;
	@sysvar::CH_Nodes::CH__PDURECEIPT_RECEIVE_RDU_PT_ObjIntrst_AR2 = 0;
	@sysvar::CH_Nodes::CH__PDURECEIPT_SIM_RDU_PT_ObjIntrst_AR2 = 0;
	@sysvar::CH_Nodes::CH__PDURECEIPT_RECEIVE_RDU_RDU_Disp_Rq_AR = 0;
	@sysvar::CH_Nodes::CH__PDURECEIPT_SIM_RDU_RDU_Disp_Rq_AR = 0;
	@sysvar::CH_Nodes::CH__PDURECEIPT_RECEIVE_RDU_RDU_GlobalAttr_AR2 = 0;
	@sysvar::CH_Nodes::CH__PDURECEIPT_SIM_RDU_RDU_GlobalAttr_AR2 = 0;
	@sysvar::CH_Nodes::CH__PDURECEIPT_RECEIVE_RDU_RDU_Stat1_AR = 0;
	@sysvar::CH_Nodes::CH__PDURECEIPT_SIM_RDU_RDU_Stat1_AR = 0;
	@sysvar::CH_Nodes::CH__PDURECEIPT_RECEIVE_RDU_ROE_MMR_F1 = 0;
	@sysvar::CH_Nodes::CH__PDURECEIPT_SIM_RDU_ROE_MMR_F1 = 0;
	@sysvar::CH_Nodes::CH__PDURECEIPT_RECEIVE_RDU_ROE_MMR_F4 = 0;
	@sysvar::CH_Nodes::CH__PDURECEIPT_SIM_RDU_ROE_MMR_F4 = 0;
	@sysvar::CH_Nodes::CH__PDURECEIPT_RECEIVE_RDU_ROE_MMR_RM = 0;
	@sysvar::CH_Nodes::CH__PDURECEIPT_SIM_RDU_ROE_MMR_RM = 0;
	@sysvar::CH_Nodes::CH__PDURECEIPT_RECEIVE_RDU_ROE_MMR_RS = 0;
	@sysvar::CH_Nodes::CH__PDURECEIPT_SIM_RDU_ROE_MMR_RS = 0;
	@sysvar::CH_Nodes::CH__PDURECEIPT_RECEIVE_RDU_ROE_RDU = 0;
	@sysvar::CH_Nodes::CH__PDURECEIPT_SIM_RDU_ROE_RDU = 0;
	@sysvar::CH_Nodes::CH__PDURECEIPT_RECEIVE_RDU_SADR_Trgr_RDU_AR2 = 0;
	@sysvar::CH_Nodes::CH__PDURECEIPT_SIM_RDU_SADR_Trgr_RDU_AR2 = 0;
	@sysvar::CH_Nodes::CH__PDURECEIPT_RECEIVE_RDU_SCS_Stat1_RDU_AR2 = 0;
	@sysvar::CH_Nodes::CH__PDURECEIPT_SIM_RDU_SCS_Stat1_RDU_AR2 = 0;
	@sysvar::CH_Nodes::CH__PDURECEIPT_RECEIVE_RDU_SCS_Stat2_RDU_AR2 = 0;
	@sysvar::CH_Nodes::CH__PDURECEIPT_SIM_RDU_SCS_Stat2_RDU_AR2 = 0;
	@sysvar::CH_Nodes::CH__PDURECEIPT_RECEIVE_RDU_Veh_Stat_RDU_FR2 = 0;
	@sysvar::CH_Nodes::CH__PDURECEIPT_SIM_RDU_Veh_Stat_RDU_FR2 = 0;
	@sysvar::CH_Nodes::CH__PDURECEIPT_RECEIVE_RDU_VehAccel_X_Rq_AR2 = 0;
	@sysvar::CH_Nodes::CH__PDURECEIPT_SIM_RDU_VehAccel_X_Rq_AR2 = 0;
	@sysvar::CH_Nodes::CH__PDURECEIPT_RECEIVE_SCCM_LDC_Rq_StWhl_AR2 = 0;
	@sysvar::CH_Nodes::CH__PDURECEIPT_SIM_SCCM_LDC_Rq_StWhl_AR2 = 0;
	@sysvar::CH_Nodes::CH__PDURECEIPT_RECEIVE_SCCM_LDC_SBW_Rq_SCCM_AR2 = 0;
	@sysvar::CH_Nodes::CH__PDURECEIPT_SIM_SCCM_LDC_SBW_Rq_SCCM_AR2 = 0;
	@sysvar::CH_Nodes::CH__PDURECEIPT_RECEIVE_SCCM_ROE_SCCM = 0;
	@sysvar::CH_Nodes::CH__PDURECEIPT_SIM_SCCM_ROE_SCCM = 0;
	@sysvar::CH_Nodes::CH__PDURECEIPT_RECEIVE_SCCM_ROE_SWSP = 0;
	@sysvar::CH_Nodes::CH__PDURECEIPT_SIM_SCCM_ROE_SWSP = 0;
	@sysvar::CH_Nodes::CH__PDURECEIPT_RECEIVE_SCCM_SCCM_Sw_Stat_AR2 = 0;
	@sysvar::CH_Nodes::CH__PDURECEIPT_SIM_SCCM_SCCM_Sw_Stat_AR2 = 0;
	@sysvar::CH_Nodes::CH__PDURECEIPT_RECEIVE_SCCM_StWhl_Angl_Stat_AR2 = 0;
	@sysvar::CH_Nodes::CH__PDURECEIPT_SIM_SCCM_StWhl_Angl_Stat_AR2 = 0;
	@sysvar::CH_Nodes::CH__PDURECEIPT_RECEIVE_SCCM_StWhl_OFN_Stat_AR2 = 0;
	@sysvar::CH_Nodes::CH__PDURECEIPT_SIM_SCCM_StWhl_OFN_Stat_AR2 = 0;
	@sysvar::CH_Nodes::CH__PDURECEIPT_RECEIVE_SCCM_StWhl_Sw_Stat_AR2 = 0;
	@sysvar::CH_Nodes::CH__PDURECEIPT_SIM_SCCM_StWhl_Sw_Stat_AR2 = 0;
	@sysvar::CH_Nodes::CH__PDURECEIPT_RECEIVE_SCCM_WUDOP_SCCM_FR = 0;
	@sysvar::CH_Nodes::CH__PDURECEIPT_SIM_SCCM_WUDOP_SCCM_FR = 0;
	@sysvar::CH_Nodes::CH__PDURECEIPT_RECEIVE_SDTR_CMS_PI_State_AR2 = 0;
	@sysvar::CH_Nodes::CH__PDURECEIPT_SIM_SDTR_CMS_PI_State_AR2 = 0;
	@sysvar::CH_Nodes::CH__PDURECEIPT_RECEIVE_SDTR_LDC_Disp_Rq_RDU_AR2 = 0;
	@sysvar::CH_Nodes::CH__PDURECEIPT_SIM_SDTR_LDC_Disp_Rq_RDU_AR2 = 0;
	@sysvar::CH_Nodes::CH__PDURECEIPT_RECEIVE_SDTR_PT_ObjIntrst_AR2 = 0;
	@sysvar::CH_Nodes::CH__PDURECEIPT_SIM_SDTR_PT_ObjIntrst_AR2 = 0;
	@sysvar::CH_Nodes::CH__PDURECEIPT_RECEIVE_SDTR_RDU_Disp_Rq_AR = 0;
	@sysvar::CH_Nodes::CH__PDURECEIPT_SIM_SDTR_RDU_Disp_Rq_AR = 0;
	@sysvar::CH_Nodes::CH__PDURECEIPT_RECEIVE_SDTR_RDU_Stat1_AR = 0;
	@sysvar::CH_Nodes::CH__PDURECEIPT_SIM_SDTR_RDU_Stat1_AR = 0;
	@sysvar::CH_Nodes::CH__PDURECEIPT_RECEIVE_SDTR_ROE_RDU = 0;
	@sysvar::CH_Nodes::CH__PDURECEIPT_SIM_SDTR_ROE_RDU = 0;
	@sysvar::CH_Nodes::CH__PDURECEIPT_RECEIVE_SDTR_SADR_Trgr_RDU_AR2 = 0;
	@sysvar::CH_Nodes::CH__PDURECEIPT_SIM_SDTR_SADR_Trgr_RDU_AR2 = 0;
	@sysvar::CH_Nodes::CH__PDURECEIPT_RECEIVE_SDTR_VehAccel_X_Rq_AR2 = 0;
	@sysvar::CH_Nodes::CH__PDURECEIPT_SIM_SDTR_VehAccel_X_Rq_AR2 = 0;
	@sysvar::CH_Nodes::CH__PDURECEIPT_RECEIVE_SPC_Eng_Rq_ABC_AR2 = 0;
	@sysvar::CH_Nodes::CH__PDURECEIPT_SIM_SPC_Eng_Rq_ABC_AR2 = 0;
	@sysvar::CH_Nodes::CH__PDURECEIPT_RECEIVE_SPC_OffRoad_Disp_Rq_AR = 0;
	@sysvar::CH_Nodes::CH__PDURECEIPT_SIM_SPC_OffRoad_Disp_Rq_AR = 0;
	@sysvar::CH_Nodes::CH__PDURECEIPT_RECEIVE_SPC_Preview_Data_SPC_AR = 0;
	@sysvar::CH_Nodes::CH__PDURECEIPT_SIM_SPC_Preview_Data_SPC_AR = 0;
	@sysvar::CH_Nodes::CH__PDURECEIPT_RECEIVE_SPC_ROE_MPU_FL = 0;
	@sysvar::CH_Nodes::CH__PDURECEIPT_SIM_SPC_ROE_MPU_FL = 0;
	@sysvar::CH_Nodes::CH__PDURECEIPT_RECEIVE_SPC_ROE_MPU_FR = 0;
	@sysvar::CH_Nodes::CH__PDURECEIPT_SIM_SPC_ROE_MPU_FR = 0;
	@sysvar::CH_Nodes::CH__PDURECEIPT_RECEIVE_SPC_ROE_MPU_RL = 0;
	@sysvar::CH_Nodes::CH__PDURECEIPT_SIM_SPC_ROE_MPU_RL = 0;
	@sysvar::CH_Nodes::CH__PDURECEIPT_RECEIVE_SPC_ROE_MPU_RR = 0;
	@sysvar::CH_Nodes::CH__PDURECEIPT_SIM_SPC_ROE_MPU_RR = 0;
	@sysvar::CH_Nodes::CH__PDURECEIPT_RECEIVE_SPC_ROE_SPC = 0;
	@sysvar::CH_Nodes::CH__PDURECEIPT_SIM_SPC_ROE_SPC = 0;
	@sysvar::CH_Nodes::CH__PDURECEIPT_RECEIVE_SPC_SPC_Disp_Rq_AR = 0;
	@sysvar::CH_Nodes::CH__PDURECEIPT_SIM_SPC_SPC_Disp_Rq_AR = 0;
	@sysvar::CH_Nodes::CH__PDURECEIPT_RECEIVE_SPC_SPC_SwLED_Msg_Rq_AR2 = 0;
	@sysvar::CH_Nodes::CH__PDURECEIPT_SIM_SPC_SPC_SwLED_Msg_Rq_AR2 = 0;
	@sysvar::CH_Nodes::CH__PDURECEIPT_RECEIVE_SPC_SpringVlv_Rq_AR = 0;
	@sysvar::CH_Nodes::CH__PDURECEIPT_SIM_SPC_SpringVlv_Rq_AR = 0;
	@sysvar::CH_Nodes::CH__PDURECEIPT_RECEIVE_SPC_VehCarv_Stat_AR = 0;
	@sysvar::CH_Nodes::CH__PDURECEIPT_SIM_SPC_VehCarv_Stat_AR = 0;
	@sysvar::CH_Nodes::CH__PDURECEIPT_RECEIVE_SPC_VehLvl_Stat_AR2 = 0;
	@sysvar::CH_Nodes::CH__PDURECEIPT_SIM_SPC_VehLvl_Stat_AR2 = 0;
	@sysvar::CH_Nodes::CH__PDURECEIPT_RECEIVE_SPC_VX_ROE_SPC_VX = 0;
	@sysvar::CH_Nodes::CH__PDURECEIPT_SIM_SPC_VX_ROE_SPC_VX = 0;
	@sysvar::CH_Nodes::CH__PDURECEIPT_RECEIVE_SPC_VX_SPC_VX_Stat1_AR = 0;
	@sysvar::CH_Nodes::CH__PDURECEIPT_SIM_SPC_VX_SPC_VX_Stat1_AR = 0;
	@sysvar::CH_Nodes::CH__PDURECEIPT_RECEIVE_SPC_VX_SpringVlv_Stat_AR = 0;
	@sysvar::CH_Nodes::CH__PDURECEIPT_SIM_SPC_VX_SpringVlv_Stat_AR = 0;
}
/*@@end*/

/*@@frPDU:MsgChannel1.CHASSIS::SpringVlv_Stat_AR:*/
on frPDU MsgChannel1.CHASSIS::AWD_TCASE_Disp_Rq_AR2
{
	if (TimeToElapse(Timer_AWD_TCASEAWD_TCASE_Disp_Rq_AR2_ReceiptPDU) >= 1000/2)
	{
		//Timer nicht zu 50% abgelaufen (d.h. aktiv und Botschaft nicht mit halber Zykluszeit empfangen)
		//außer bei spontan
		@sysvar::CH_Nodes::CH__PDURECEIPT_RECEIVE_AWD_TCASE_AWD_TCASE_Disp_Rq_AR2 = 4;
	}
	else
	{
		//Timer zu 50% abgelaufen (d.h. Botschaft mit mindestens halber Zykluszeit empfangen)
		@sysvar::CH_Nodes::CH__PDURECEIPT_RECEIVE_AWD_TCASE_AWD_TCASE_Disp_Rq_AR2 = 3;
	}
	//Timer auf Zykluszeit setzen
	setTimer(Timer_AWD_TCASEAWD_TCASE_Disp_Rq_AR2_ReceiptPDU, 1000);

	output(this);
}
/*@@end*/
/*@@frPDU:MsgChannel1.CHASSIS::SpringVlv_Stat_AR:*/
on frPDU MsgChannel1.CHASSIS::AWD_TCASE_Stat1_AR2
{
	if (TimeToElapse(Timer_AWD_TCASEAWD_TCASE_Stat1_AR2_ReceiptPDU) >= 20/2)
	{
		//Timer nicht zu 50% abgelaufen (d.h. aktiv und Botschaft nicht mit halber Zykluszeit empfangen)
		//außer bei spontan
		@sysvar::CH_Nodes::CH__PDURECEIPT_RECEIVE_AWD_TCASE_AWD_TCASE_Stat1_AR2 = 4;
	}
	else
	{
		//Timer zu 50% abgelaufen (d.h. Botschaft mit mindestens halber Zykluszeit empfangen)
		@sysvar::CH_Nodes::CH__PDURECEIPT_RECEIVE_AWD_TCASE_AWD_TCASE_Stat1_AR2 = 3;
	}
	//Timer auf Zykluszeit setzen
	setTimer(Timer_AWD_TCASEAWD_TCASE_Stat1_AR2_ReceiptPDU, 20);

	output(this);
}
/*@@end*/
/*@@frPDU:MsgChannel1.CHASSIS::SpringVlv_Stat_AR:*/
on frPDU MsgChannel1.CHASSIS::AWD_TCASE_Stat2_AR2
{
	if (TimeToElapse(Timer_AWD_TCASEAWD_TCASE_Stat2_AR2_ReceiptPDU) >= 20/2)
	{
		//Timer nicht zu 50% abgelaufen (d.h. aktiv und Botschaft nicht mit halber Zykluszeit empfangen)
		//außer bei spontan
		@sysvar::CH_Nodes::CH__PDURECEIPT_RECEIVE_AWD_TCASE_AWD_TCASE_Stat2_AR2 = 4;
	}
	else
	{
		//Timer zu 50% abgelaufen (d.h. Botschaft mit mindestens halber Zykluszeit empfangen)
		@sysvar::CH_Nodes::CH__PDURECEIPT_RECEIVE_AWD_TCASE_AWD_TCASE_Stat2_AR2 = 3;
	}
	//Timer auf Zykluszeit setzen
	setTimer(Timer_AWD_TCASEAWD_TCASE_Stat2_AR2_ReceiptPDU, 20);

	output(this);
}
/*@@end*/
/*@@frPDU:MsgChannel1.CHASSIS::SpringVlv_Stat_AR:*/
on frPDU MsgChannel1.CHASSIS::ROE_AWD_TCASE
{
	if (TimeToElapse(Timer_AWD_TCASEROE_AWD_TCASE_ReceiptPDU) >= 5/2)
	{
		//Timer nicht zu 50% abgelaufen (d.h. aktiv und Botschaft nicht mit halber Zykluszeit empfangen)
		//außer bei spontan
	}
	else
	{
		//Timer zu 50% abgelaufen (d.h. Botschaft mit mindestens halber Zykluszeit empfangen)
		@sysvar::CH_Nodes::CH__PDURECEIPT_RECEIVE_AWD_TCASE_ROE_AWD_TCASE = 3;
	}
	//Timer auf Zykluszeit setzen
	setTimer(Timer_AWD_TCASEROE_AWD_TCASE_ReceiptPDU, 5);

	output(this);
}
/*@@end*/
/*@@frPDU:MsgChannel1.CHASSIS::SpringVlv_Stat_AR:*/
on frPDU MsgChannel1.CHASSIS::Adblue_Disp_Rq_AR
{
	if (TimeToElapse(Timer_CPCAdblue_Disp_Rq_AR_ReceiptPDU) >= 5000/2)
	{
		//Timer nicht zu 50% abgelaufen (d.h. aktiv und Botschaft nicht mit halber Zykluszeit empfangen)
		//außer bei spontan
		@sysvar::CH_Nodes::CH__PDURECEIPT_RECEIVE_CPC_Adblue_Disp_Rq_AR = 4;
	}
	else
	{
		//Timer zu 50% abgelaufen (d.h. Botschaft mit mindestens halber Zykluszeit empfangen)
		@sysvar::CH_Nodes::CH__PDURECEIPT_RECEIVE_CPC_Adblue_Disp_Rq_AR = 3;
	}
	//Timer auf Zykluszeit setzen
	setTimer(Timer_CPCAdblue_Disp_Rq_AR_ReceiptPDU, 5000);

	output(this);
}
/*@@end*/
/*@@frPDU:MsgChannel1.CHASSIS::SpringVlv_Stat_AR:*/
on frPDU MsgChannel1.CHASSIS::Adblue_Disp_Warn_Rq_AR
{
	if (TimeToElapse(Timer_CPCAdblue_Disp_Warn_Rq_AR_ReceiptPDU) >= 1000/2)
	{
		//Timer nicht zu 50% abgelaufen (d.h. aktiv und Botschaft nicht mit halber Zykluszeit empfangen)
		//außer bei spontan
		@sysvar::CH_Nodes::CH__PDURECEIPT_RECEIVE_CPC_Adblue_Disp_Warn_Rq_AR = 4;
	}
	else
	{
		//Timer zu 50% abgelaufen (d.h. Botschaft mit mindestens halber Zykluszeit empfangen)
		@sysvar::CH_Nodes::CH__PDURECEIPT_RECEIVE_CPC_Adblue_Disp_Warn_Rq_AR = 3;
	}
	//Timer auf Zykluszeit setzen
	setTimer(Timer_CPCAdblue_Disp_Warn_Rq_AR_ReceiptPDU, 1000);

	output(this);
}
/*@@end*/
/*@@frPDU:MsgChannel1.CHASSIS::SpringVlv_Stat_AR:*/
on frPDU MsgChannel1.CHASSIS::Assyst_Stat2_AR
{
	if (TimeToElapse(Timer_CPCAssyst_Stat2_AR_ReceiptPDU) >= 1000/2)
	{
		//Timer nicht zu 50% abgelaufen (d.h. aktiv und Botschaft nicht mit halber Zykluszeit empfangen)
		//außer bei spontan
		@sysvar::CH_Nodes::CH__PDURECEIPT_RECEIVE_CPC_Assyst_Stat2_AR = 4;
	}
	else
	{
		//Timer zu 50% abgelaufen (d.h. Botschaft mit mindestens halber Zykluszeit empfangen)
		@sysvar::CH_Nodes::CH__PDURECEIPT_RECEIVE_CPC_Assyst_Stat2_AR = 3;
	}
	//Timer auf Zykluszeit setzen
	setTimer(Timer_CPCAssyst_Stat2_AR_ReceiptPDU, 1000);

	output(this);
}
/*@@end*/
/*@@frPDU:MsgChannel1.CHASSIS::SpringVlv_Stat_AR:*/
on frPDU MsgChannel1.CHASSIS::Assyst_Stat3_AR2
{
	if (TimeToElapse(Timer_CPCAssyst_Stat3_AR2_ReceiptPDU) >= 1000/2)
	{
		//Timer nicht zu 50% abgelaufen (d.h. aktiv und Botschaft nicht mit halber Zykluszeit empfangen)
		//außer bei spontan
		@sysvar::CH_Nodes::CH__PDURECEIPT_RECEIVE_CPC_Assyst_Stat3_AR2 = 4;
	}
	else
	{
		//Timer zu 50% abgelaufen (d.h. Botschaft mit mindestens halber Zykluszeit empfangen)
		@sysvar::CH_Nodes::CH__PDURECEIPT_RECEIVE_CPC_Assyst_Stat3_AR2 = 3;
	}
	//Timer auf Zykluszeit setzen
	setTimer(Timer_CPCAssyst_Stat3_AR2_ReceiptPDU, 1000);

	output(this);
}
/*@@end*/
/*@@frPDU:MsgChannel1.CHASSIS::SpringVlv_Stat_AR:*/
on frPDU MsgChannel1.CHASSIS::Assyst_Stat_AR
{
	if (TimeToElapse(Timer_CPCAssyst_Stat_AR_ReceiptPDU) >= 1000/2)
	{
		//Timer nicht zu 50% abgelaufen (d.h. aktiv und Botschaft nicht mit halber Zykluszeit empfangen)
		//außer bei spontan
		@sysvar::CH_Nodes::CH__PDURECEIPT_RECEIVE_CPC_Assyst_Stat_AR = 4;
	}
	else
	{
		//Timer zu 50% abgelaufen (d.h. Botschaft mit mindestens halber Zykluszeit empfangen)
		@sysvar::CH_Nodes::CH__PDURECEIPT_RECEIVE_CPC_Assyst_Stat_AR = 3;
	}
	//Timer auf Zykluszeit setzen
	setTimer(Timer_CPCAssyst_Stat_AR_ReceiptPDU, 1000);

	output(this);
}
/*@@end*/
/*@@frPDU:MsgChannel1.CHASSIS::SpringVlv_Stat_AR:*/
on frPDU MsgChannel1.CHASSIS::CNG_Disp_Rq_AR2
{
	if (TimeToElapse(Timer_CPCCNG_Disp_Rq_AR2_ReceiptPDU) >= 1000/2)
	{
		//Timer nicht zu 50% abgelaufen (d.h. aktiv und Botschaft nicht mit halber Zykluszeit empfangen)
		//außer bei spontan
		@sysvar::CH_Nodes::CH__PDURECEIPT_RECEIVE_CPC_CNG_Disp_Rq_AR2 = 4;
	}
	else
	{
		//Timer zu 50% abgelaufen (d.h. Botschaft mit mindestens halber Zykluszeit empfangen)
		@sysvar::CH_Nodes::CH__PDURECEIPT_RECEIVE_CPC_CNG_Disp_Rq_AR2 = 3;
	}
	//Timer auf Zykluszeit setzen
	setTimer(Timer_CPCCNG_Disp_Rq_AR2_ReceiptPDU, 1000);

	output(this);
}
/*@@end*/
/*@@frPDU:MsgChannel1.CHASSIS::SpringVlv_Stat_AR:*/
on frPDU MsgChannel1.CHASSIS::CPC_CHASSIS_R1_AR2
{
	if (TimeToElapse(Timer_CPCCPC_CHASSIS_R1_AR2_ReceiptPDU) >= 200/2)
	{
		//Timer nicht zu 50% abgelaufen (d.h. aktiv und Botschaft nicht mit halber Zykluszeit empfangen)
		//außer bei spontan
		@sysvar::CH_Nodes::CH__PDURECEIPT_RECEIVE_CPC_CPC_CHASSIS_R1_AR2 = 4;
	}
	else
	{
		//Timer zu 50% abgelaufen (d.h. Botschaft mit mindestens halber Zykluszeit empfangen)
		@sysvar::CH_Nodes::CH__PDURECEIPT_RECEIVE_CPC_CPC_CHASSIS_R1_AR2 = 3;
	}
	//Timer auf Zykluszeit setzen
	setTimer(Timer_CPCCPC_CHASSIS_R1_AR2_ReceiptPDU, 200);

	output(this);
}
/*@@end*/
/*@@frPDU:MsgChannel1.CHASSIS::SpringVlv_Stat_AR:*/
on frPDU MsgChannel1.CHASSIS::CPC_CHASSIS_R2_AR2
{
	if (TimeToElapse(Timer_CPCCPC_CHASSIS_R2_AR2_ReceiptPDU) >= 40/2)
	{
		//Timer nicht zu 50% abgelaufen (d.h. aktiv und Botschaft nicht mit halber Zykluszeit empfangen)
		//außer bei spontan
		@sysvar::CH_Nodes::CH__PDURECEIPT_RECEIVE_CPC_CPC_CHASSIS_R2_AR2 = 4;
	}
	else
	{
		//Timer zu 50% abgelaufen (d.h. Botschaft mit mindestens halber Zykluszeit empfangen)
		@sysvar::CH_Nodes::CH__PDURECEIPT_RECEIVE_CPC_CPC_CHASSIS_R2_AR2 = 3;
	}
	//Timer auf Zykluszeit setzen
	setTimer(Timer_CPCCPC_CHASSIS_R2_AR2_ReceiptPDU, 40);

	output(this);
}
/*@@end*/
/*@@frPDU:MsgChannel1.CHASSIS::SpringVlv_Stat_AR:*/
on frPDU MsgChannel1.CHASSIS::DCDC1_Rs1_AR2
{
	if (TimeToElapse(Timer_CPCDCDC1_Rs1_AR2_ReceiptPDU) >= 20/2)
	{
		//Timer nicht zu 50% abgelaufen (d.h. aktiv und Botschaft nicht mit halber Zykluszeit empfangen)
		//außer bei spontan
		@sysvar::CH_Nodes::CH__PDURECEIPT_RECEIVE_CPC_DCDC1_Rs1_AR2 = 4;
	}
	else
	{
		//Timer zu 50% abgelaufen (d.h. Botschaft mit mindestens halber Zykluszeit empfangen)
		@sysvar::CH_Nodes::CH__PDURECEIPT_RECEIVE_CPC_DCDC1_Rs1_AR2 = 3;
	}
	//Timer auf Zykluszeit setzen
	setTimer(Timer_CPCDCDC1_Rs1_AR2_ReceiptPDU, 20);

	output(this);
}
/*@@end*/
/*@@frPDU:MsgChannel1.CHASSIS::SpringVlv_Stat_AR:*/
on frPDU MsgChannel1.CHASSIS::DPC_PT_Rs_AR
{
	if (TimeToElapse(Timer_CPCDPC_PT_Rs_AR_ReceiptPDU) >= 100/2)
	{
		//Timer nicht zu 50% abgelaufen (d.h. aktiv und Botschaft nicht mit halber Zykluszeit empfangen)
		//außer bei spontan
		@sysvar::CH_Nodes::CH__PDURECEIPT_RECEIVE_CPC_DPC_PT_Rs_AR = 4;
	}
	else
	{
		//Timer zu 50% abgelaufen (d.h. Botschaft mit mindestens halber Zykluszeit empfangen)
		@sysvar::CH_Nodes::CH__PDURECEIPT_RECEIVE_CPC_DPC_PT_Rs_AR = 3;
	}
	//Timer auf Zykluszeit setzen
	setTimer(Timer_CPCDPC_PT_Rs_AR_ReceiptPDU, 100);

	output(this);
}
/*@@end*/
/*@@frPDU:MsgChannel1.CHASSIS::SpringVlv_Stat_AR:*/
on frPDU MsgChannel1.CHASSIS::ECM_DAC4_AR
{
	if (TimeToElapse(Timer_CPCECM_DAC4_AR_ReceiptPDU) >= 5/2)
	{
		//Timer nicht zu 50% abgelaufen (d.h. aktiv und Botschaft nicht mit halber Zykluszeit empfangen)
		//außer bei spontan
	}
	else
	{
		//Timer zu 50% abgelaufen (d.h. Botschaft mit mindestens halber Zykluszeit empfangen)
		@sysvar::CH_Nodes::CH__PDURECEIPT_RECEIVE_CPC_ECM_DAC4_AR = 3;
	}
	//Timer auf Zykluszeit setzen
	setTimer(Timer_CPCECM_DAC4_AR_ReceiptPDU, 5);

	output(this);
}
/*@@end*/
/*@@frPDU:MsgChannel1.CHASSIS::SpringVlv_Stat_AR:*/
on frPDU MsgChannel1.CHASSIS::ECO_Homepage_Data
{
	if (TimeToElapse(Timer_CPCECO_Homepage_Data_ReceiptPDU) >= 1000/2)
	{
		//Timer nicht zu 50% abgelaufen (d.h. aktiv und Botschaft nicht mit halber Zykluszeit empfangen)
		//außer bei spontan
		@sysvar::CH_Nodes::CH__PDURECEIPT_RECEIVE_CPC_ECO_Homepage_Data = 4;
	}
	else
	{
		//Timer zu 50% abgelaufen (d.h. Botschaft mit mindestens halber Zykluszeit empfangen)
		@sysvar::CH_Nodes::CH__PDURECEIPT_RECEIVE_CPC_ECO_Homepage_Data = 3;
	}
	//Timer auf Zykluszeit setzen
	setTimer(Timer_CPCECO_Homepage_Data_ReceiptPDU, 1000);

	output(this);
}
/*@@end*/
/*@@frPDU:MsgChannel1.CHASSIS::SpringVlv_Stat_AR:*/
on frPDU MsgChannel1.CHASSIS::ECO_Score_Disp_Rq_AR
{
	if (TimeToElapse(Timer_CPCECO_Score_Disp_Rq_AR_ReceiptPDU) >= 200/2)
	{
		//Timer nicht zu 50% abgelaufen (d.h. aktiv und Botschaft nicht mit halber Zykluszeit empfangen)
		//außer bei spontan
		@sysvar::CH_Nodes::CH__PDURECEIPT_RECEIVE_CPC_ECO_Score_Disp_Rq_AR = 4;
	}
	else
	{
		//Timer zu 50% abgelaufen (d.h. Botschaft mit mindestens halber Zykluszeit empfangen)
		@sysvar::CH_Nodes::CH__PDURECEIPT_RECEIVE_CPC_ECO_Score_Disp_Rq_AR = 3;
	}
	//Timer auf Zykluszeit setzen
	setTimer(Timer_CPCECO_Score_Disp_Rq_AR_ReceiptPDU, 200);

	output(this);
}
/*@@end*/
/*@@frPDU:MsgChannel1.CHASSIS::SpringVlv_Stat_AR:*/
on frPDU MsgChannel1.CHASSIS::EM01_Stat1_AR2
{
	if (TimeToElapse(Timer_CPCEM01_Stat1_AR2_ReceiptPDU) >= 10/2)
	{
		//Timer nicht zu 50% abgelaufen (d.h. aktiv und Botschaft nicht mit halber Zykluszeit empfangen)
		//außer bei spontan
		@sysvar::CH_Nodes::CH__PDURECEIPT_RECEIVE_CPC_EM01_Stat1_AR2 = 4;
	}
	else
	{
		//Timer zu 50% abgelaufen (d.h. Botschaft mit mindestens halber Zykluszeit empfangen)
		@sysvar::CH_Nodes::CH__PDURECEIPT_RECEIVE_CPC_EM01_Stat1_AR2 = 3;
	}
	//Timer auf Zykluszeit setzen
	setTimer(Timer_CPCEM01_Stat1_AR2_ReceiptPDU, 10);

	output(this);
}
/*@@end*/
/*@@frPDU:MsgChannel1.CHASSIS::SpringVlv_Stat_AR:*/
on frPDU MsgChannel1.CHASSIS::EM01_Stat2_AR2
{
	if (TimeToElapse(Timer_CPCEM01_Stat2_AR2_ReceiptPDU) >= 20/2)
	{
		//Timer nicht zu 50% abgelaufen (d.h. aktiv und Botschaft nicht mit halber Zykluszeit empfangen)
		//außer bei spontan
		@sysvar::CH_Nodes::CH__PDURECEIPT_RECEIVE_CPC_EM01_Stat2_AR2 = 4;
	}
	else
	{
		//Timer zu 50% abgelaufen (d.h. Botschaft mit mindestens halber Zykluszeit empfangen)
		@sysvar::CH_Nodes::CH__PDURECEIPT_RECEIVE_CPC_EM01_Stat2_AR2 = 3;
	}
	//Timer auf Zykluszeit setzen
	setTimer(Timer_CPCEM01_Stat2_AR2_ReceiptPDU, 20);

	output(this);
}
/*@@end*/
/*@@frPDU:MsgChannel1.CHASSIS::SpringVlv_Stat_AR:*/
on frPDU MsgChannel1.CHASSIS::EM01_Trq_Rs_AR2
{
	if (TimeToElapse(Timer_CPCEM01_Trq_Rs_AR2_ReceiptPDU) >= 10/2)
	{
		//Timer nicht zu 50% abgelaufen (d.h. aktiv und Botschaft nicht mit halber Zykluszeit empfangen)
		//außer bei spontan
		@sysvar::CH_Nodes::CH__PDURECEIPT_RECEIVE_CPC_EM01_Trq_Rs_AR2 = 4;
	}
	else
	{
		//Timer zu 50% abgelaufen (d.h. Botschaft mit mindestens halber Zykluszeit empfangen)
		@sysvar::CH_Nodes::CH__PDURECEIPT_RECEIVE_CPC_EM01_Trq_Rs_AR2 = 3;
	}
	//Timer auf Zykluszeit setzen
	setTimer(Timer_CPCEM01_Trq_Rs_AR2_ReceiptPDU, 10);

	output(this);
}
/*@@end*/
/*@@frPDU:MsgChannel1.CHASSIS::SpringVlv_Stat_AR:*/
on frPDU MsgChannel1.CHASSIS::EM_DAC4_AR
{
	if (TimeToElapse(Timer_CPCEM_DAC4_AR_ReceiptPDU) >= 5/2)
	{
		//Timer nicht zu 50% abgelaufen (d.h. aktiv und Botschaft nicht mit halber Zykluszeit empfangen)
		//außer bei spontan
	}
	else
	{
		//Timer zu 50% abgelaufen (d.h. Botschaft mit mindestens halber Zykluszeit empfangen)
		@sysvar::CH_Nodes::CH__PDURECEIPT_RECEIVE_CPC_EM_DAC4_AR = 3;
	}
	//Timer auf Zykluszeit setzen
	setTimer(Timer_CPCEM_DAC4_AR_ReceiptPDU, 5);

	output(this);
}
/*@@end*/
/*@@frPDU:MsgChannel1.CHASSIS::SpringVlv_Stat_AR:*/
on frPDU MsgChannel1.CHASSIS::EMM_Data1_AR2
{
	if (TimeToElapse(Timer_CPCEMM_Data1_AR2_ReceiptPDU) >= 200/2)
	{
		//Timer nicht zu 50% abgelaufen (d.h. aktiv und Botschaft nicht mit halber Zykluszeit empfangen)
		//außer bei spontan
		@sysvar::CH_Nodes::CH__PDURECEIPT_RECEIVE_CPC_EMM_Data1_AR2 = 4;
	}
	else
	{
		//Timer zu 50% abgelaufen (d.h. Botschaft mit mindestens halber Zykluszeit empfangen)
		@sysvar::CH_Nodes::CH__PDURECEIPT_RECEIVE_CPC_EMM_Data1_AR2 = 3;
	}
	//Timer auf Zykluszeit setzen
	setTimer(Timer_CPCEMM_Data1_AR2_ReceiptPDU, 200);

	output(this);
}
/*@@end*/
/*@@frPDU:MsgChannel1.CHASSIS::SpringVlv_Stat_AR:*/
on frPDU MsgChannel1.CHASSIS::EnergyMngmnt_PreCond_Stat_AR2
{
	if (TimeToElapse(Timer_CPCEnergyMngmnt_PreCond_Stat_AR2_ReceiptPDU) >= 1000/2)
	{
		//Timer nicht zu 50% abgelaufen (d.h. aktiv und Botschaft nicht mit halber Zykluszeit empfangen)
		//außer bei spontan
		@sysvar::CH_Nodes::CH__PDURECEIPT_RECEIVE_CPC_EnergyMngmnt_PreCond_Stat_AR2 = 4;
	}
	else
	{
		//Timer zu 50% abgelaufen (d.h. Botschaft mit mindestens halber Zykluszeit empfangen)
		@sysvar::CH_Nodes::CH__PDURECEIPT_RECEIVE_CPC_EnergyMngmnt_PreCond_Stat_AR2 = 3;
	}
	//Timer auf Zykluszeit setzen
	setTimer(Timer_CPCEnergyMngmnt_PreCond_Stat_AR2_ReceiptPDU, 1000);

	output(this);
}
/*@@end*/
/*@@frPDU:MsgChannel1.CHASSIS::SpringVlv_Stat_AR:*/
on frPDU MsgChannel1.CHASSIS::Eng_Rs_1_AR2
{
	if (TimeToElapse(Timer_CPCEng_Rs_1_AR2_ReceiptPDU) >= 10/2)
	{
		//Timer nicht zu 50% abgelaufen (d.h. aktiv und Botschaft nicht mit halber Zykluszeit empfangen)
		//außer bei spontan
		@sysvar::CH_Nodes::CH__PDURECEIPT_RECEIVE_CPC_Eng_Rs_1_AR2 = 4;
	}
	else
	{
		//Timer zu 50% abgelaufen (d.h. Botschaft mit mindestens halber Zykluszeit empfangen)
		@sysvar::CH_Nodes::CH__PDURECEIPT_RECEIVE_CPC_Eng_Rs_1_AR2 = 3;
	}
	//Timer auf Zykluszeit setzen
	setTimer(Timer_CPCEng_Rs_1_AR2_ReceiptPDU, 10);

	output(this);
}
/*@@end*/
/*@@frPDU:MsgChannel1.CHASSIS::SpringVlv_Stat_AR:*/
on frPDU MsgChannel1.CHASSIS::Eng_Rs_2_AR2
{
	if (TimeToElapse(Timer_CPCEng_Rs_2_AR2_ReceiptPDU) >= 20/2)
	{
		//Timer nicht zu 50% abgelaufen (d.h. aktiv und Botschaft nicht mit halber Zykluszeit empfangen)
		//außer bei spontan
		@sysvar::CH_Nodes::CH__PDURECEIPT_RECEIVE_CPC_Eng_Rs_2_AR2 = 4;
	}
	else
	{
		//Timer zu 50% abgelaufen (d.h. Botschaft mit mindestens halber Zykluszeit empfangen)
		@sysvar::CH_Nodes::CH__PDURECEIPT_RECEIVE_CPC_Eng_Rs_2_AR2 = 3;
	}
	//Timer auf Zykluszeit setzen
	setTimer(Timer_CPCEng_Rs_2_AR2_ReceiptPDU, 20);

	output(this);
}
/*@@end*/
/*@@frPDU:MsgChannel1.CHASSIS::SpringVlv_Stat_AR:*/
on frPDU MsgChannel1.CHASSIS::Eng_Rs_3_AR2
{
	if (TimeToElapse(Timer_CPCEng_Rs_3_AR2_ReceiptPDU) >= 20/2)
	{
		//Timer nicht zu 50% abgelaufen (d.h. aktiv und Botschaft nicht mit halber Zykluszeit empfangen)
		//außer bei spontan
		@sysvar::CH_Nodes::CH__PDURECEIPT_RECEIVE_CPC_Eng_Rs_3_AR2 = 4;
	}
	else
	{
		//Timer zu 50% abgelaufen (d.h. Botschaft mit mindestens halber Zykluszeit empfangen)
		@sysvar::CH_Nodes::CH__PDURECEIPT_RECEIVE_CPC_Eng_Rs_3_AR2 = 3;
	}
	//Timer auf Zykluszeit setzen
	setTimer(Timer_CPCEng_Rs_3_AR2_ReceiptPDU, 20);

	output(this);
}
/*@@end*/
/*@@frPDU:MsgChannel1.CHASSIS::SpringVlv_Stat_AR:*/
on frPDU MsgChannel1.CHASSIS::Eng_Rs_EM_AR2
{
	if (TimeToElapse(Timer_CPCEng_Rs_EM_AR2_ReceiptPDU) >= 20/2)
	{
		//Timer nicht zu 50% abgelaufen (d.h. aktiv und Botschaft nicht mit halber Zykluszeit empfangen)
		//außer bei spontan
		@sysvar::CH_Nodes::CH__PDURECEIPT_RECEIVE_CPC_Eng_Rs_EM_AR2 = 4;
	}
	else
	{
		//Timer zu 50% abgelaufen (d.h. Botschaft mit mindestens halber Zykluszeit empfangen)
		@sysvar::CH_Nodes::CH__PDURECEIPT_RECEIVE_CPC_Eng_Rs_EM_AR2 = 3;
	}
	//Timer auf Zykluszeit setzen
	setTimer(Timer_CPCEng_Rs_EM_AR2_ReceiptPDU, 20);

	output(this);
}
/*@@end*/
/*@@frPDU:MsgChannel1.CHASSIS::SpringVlv_Stat_AR:*/
on frPDU MsgChannel1.CHASSIS::Eng_Rs_EngCtrl_AR2
{
	if (TimeToElapse(Timer_CPCEng_Rs_EngCtrl_AR2_ReceiptPDU) >= 10/2)
	{
		//Timer nicht zu 50% abgelaufen (d.h. aktiv und Botschaft nicht mit halber Zykluszeit empfangen)
		//außer bei spontan
		@sysvar::CH_Nodes::CH__PDURECEIPT_RECEIVE_CPC_Eng_Rs_EngCtrl_AR2 = 4;
	}
	else
	{
		//Timer zu 50% abgelaufen (d.h. Botschaft mit mindestens halber Zykluszeit empfangen)
		@sysvar::CH_Nodes::CH__PDURECEIPT_RECEIVE_CPC_Eng_Rs_EngCtrl_AR2 = 3;
	}
	//Timer auf Zykluszeit setzen
	setTimer(Timer_CPCEng_Rs_EngCtrl_AR2_ReceiptPDU, 10);

	output(this);
}
/*@@end*/
/*@@frPDU:MsgChannel1.CHASSIS::SpringVlv_Stat_AR:*/
on frPDU MsgChannel1.CHASSIS::EngCtrl_Disp_Rq_AR2
{
	if (TimeToElapse(Timer_CPCEngCtrl_Disp_Rq_AR2_ReceiptPDU) >= 100/2)
	{
		//Timer nicht zu 50% abgelaufen (d.h. aktiv und Botschaft nicht mit halber Zykluszeit empfangen)
		//außer bei spontan
		@sysvar::CH_Nodes::CH__PDURECEIPT_RECEIVE_CPC_EngCtrl_Disp_Rq_AR2 = 4;
	}
	else
	{
		//Timer zu 50% abgelaufen (d.h. Botschaft mit mindestens halber Zykluszeit empfangen)
		@sysvar::CH_Nodes::CH__PDURECEIPT_RECEIVE_CPC_EngCtrl_Disp_Rq_AR2 = 3;
	}
	//Timer auf Zykluszeit setzen
	setTimer(Timer_CPCEngCtrl_Disp_Rq_AR2_ReceiptPDU, 100);

	output(this);
}
/*@@end*/
/*@@frPDU:MsgChannel1.CHASSIS::SpringVlv_Stat_AR:*/
on frPDU MsgChannel1.CHASSIS::EngCtrl_OBD1_AR
{
	if (TimeToElapse(Timer_CPCEngCtrl_OBD1_AR_ReceiptPDU) >= 100/2)
	{
		//Timer nicht zu 50% abgelaufen (d.h. aktiv und Botschaft nicht mit halber Zykluszeit empfangen)
		//außer bei spontan
		@sysvar::CH_Nodes::CH__PDURECEIPT_RECEIVE_CPC_EngCtrl_OBD1_AR = 4;
	}
	else
	{
		//Timer zu 50% abgelaufen (d.h. Botschaft mit mindestens halber Zykluszeit empfangen)
		@sysvar::CH_Nodes::CH__PDURECEIPT_RECEIVE_CPC_EngCtrl_OBD1_AR = 3;
	}
	//Timer auf Zykluszeit setzen
	setTimer(Timer_CPCEngCtrl_OBD1_AR_ReceiptPDU, 100);

	output(this);
}
/*@@end*/
/*@@frPDU:MsgChannel1.CHASSIS::SpringVlv_Stat_AR:*/
on frPDU MsgChannel1.CHASSIS::EngCtrl_Stat_AR2
{
	if (TimeToElapse(Timer_CPCEngCtrl_Stat_AR2_ReceiptPDU) >= 100/2)
	{
		//Timer nicht zu 50% abgelaufen (d.h. aktiv und Botschaft nicht mit halber Zykluszeit empfangen)
		//außer bei spontan
		@sysvar::CH_Nodes::CH__PDURECEIPT_RECEIVE_CPC_EngCtrl_Stat_AR2 = 4;
	}
	else
	{
		//Timer zu 50% abgelaufen (d.h. Botschaft mit mindestens halber Zykluszeit empfangen)
		@sysvar::CH_Nodes::CH__PDURECEIPT_RECEIVE_CPC_EngCtrl_Stat_AR2 = 3;
	}
	//Timer auf Zykluszeit setzen
	setTimer(Timer_CPCEngCtrl_Stat_AR2_ReceiptPDU, 100);

	output(this);
}
/*@@end*/
/*@@frPDU:MsgChannel1.CHASSIS::SpringVlv_Stat_AR:*/
on frPDU MsgChannel1.CHASSIS::ESP_OBD_Data_AR
{
	if (TimeToElapse(Timer_CPCESP_OBD_Data_AR_ReceiptPDU) >= 100/2)
	{
		//Timer nicht zu 50% abgelaufen (d.h. aktiv und Botschaft nicht mit halber Zykluszeit empfangen)
		//außer bei spontan
		@sysvar::CH_Nodes::CH__PDURECEIPT_RECEIVE_CPC_ESP_OBD_Data_AR = 4;
	}
	else
	{
		//Timer zu 50% abgelaufen (d.h. Botschaft mit mindestens halber Zykluszeit empfangen)
		@sysvar::CH_Nodes::CH__PDURECEIPT_RECEIVE_CPC_ESP_OBD_Data_AR = 3;
	}
	//Timer auf Zykluszeit setzen
	setTimer(Timer_CPCESP_OBD_Data_AR_ReceiptPDU, 100);

	output(this);
}
/*@@end*/
/*@@frPDU:MsgChannel1.CHASSIS::SpringVlv_Stat_AR:*/
on frPDU MsgChannel1.CHASSIS::Fuel_Stat2_AR2
{
	if (TimeToElapse(Timer_CPCFuel_Stat2_AR2_ReceiptPDU) >= 500/2)
	{
		//Timer nicht zu 50% abgelaufen (d.h. aktiv und Botschaft nicht mit halber Zykluszeit empfangen)
		//außer bei spontan
		@sysvar::CH_Nodes::CH__PDURECEIPT_RECEIVE_CPC_Fuel_Stat2_AR2 = 4;
	}
	else
	{
		//Timer zu 50% abgelaufen (d.h. Botschaft mit mindestens halber Zykluszeit empfangen)
		@sysvar::CH_Nodes::CH__PDURECEIPT_RECEIVE_CPC_Fuel_Stat2_AR2 = 3;
	}
	//Timer auf Zykluszeit setzen
	setTimer(Timer_CPCFuel_Stat2_AR2_ReceiptPDU, 500);

	output(this);
}
/*@@end*/
/*@@frPDU:MsgChannel1.CHASSIS::SpringVlv_Stat_AR:*/
on frPDU MsgChannel1.CHASSIS::FuelLvl_Stat_AR2
{
	if (TimeToElapse(Timer_CPCFuelLvl_Stat_AR2_ReceiptPDU) >= 1000/2)
	{
		//Timer nicht zu 50% abgelaufen (d.h. aktiv und Botschaft nicht mit halber Zykluszeit empfangen)
		//außer bei spontan
		@sysvar::CH_Nodes::CH__PDURECEIPT_RECEIVE_CPC_FuelLvl_Stat_AR2 = 4;
	}
	else
	{
		//Timer zu 50% abgelaufen (d.h. Botschaft mit mindestens halber Zykluszeit empfangen)
		@sysvar::CH_Nodes::CH__PDURECEIPT_RECEIVE_CPC_FuelLvl_Stat_AR2 = 3;
	}
	//Timer auf Zykluszeit setzen
	setTimer(Timer_CPCFuelLvl_Stat_AR2_ReceiptPDU, 1000);

	output(this);
}
/*@@end*/
/*@@frPDU:MsgChannel1.CHASSIS::SpringVlv_Stat_AR:*/
on frPDU MsgChannel1.CHASSIS::HumanMachineIfc_AR2
{
	if (TimeToElapse(Timer_CPCHumanMachineIfc_AR2_ReceiptPDU) >= 100/2)
	{
		//Timer nicht zu 50% abgelaufen (d.h. aktiv und Botschaft nicht mit halber Zykluszeit empfangen)
		//außer bei spontan
		@sysvar::CH_Nodes::CH__PDURECEIPT_RECEIVE_CPC_HumanMachineIfc_AR2 = 4;
	}
	else
	{
		//Timer zu 50% abgelaufen (d.h. Botschaft mit mindestens halber Zykluszeit empfangen)
		@sysvar::CH_Nodes::CH__PDURECEIPT_RECEIVE_CPC_HumanMachineIfc_AR2 = 3;
	}
	//Timer auf Zykluszeit setzen
	setTimer(Timer_CPCHumanMachineIfc_AR2_ReceiptPDU, 100);

	output(this);
}
/*@@end*/
/*@@frPDU:MsgChannel1.CHASSIS::SpringVlv_Stat_AR:*/
on frPDU MsgChannel1.CHASSIS::HumanMachineIfc_Rq_AR
{
	if (TimeToElapse(Timer_CPCHumanMachineIfc_Rq_AR_ReceiptPDU) >= 20/2)
	{
		//Timer nicht zu 50% abgelaufen (d.h. aktiv und Botschaft nicht mit halber Zykluszeit empfangen)
		//außer bei spontan
		@sysvar::CH_Nodes::CH__PDURECEIPT_RECEIVE_CPC_HumanMachineIfc_Rq_AR = 4;
	}
	else
	{
		//Timer zu 50% abgelaufen (d.h. Botschaft mit mindestens halber Zykluszeit empfangen)
		@sysvar::CH_Nodes::CH__PDURECEIPT_RECEIVE_CPC_HumanMachineIfc_Rq_AR = 3;
	}
	//Timer auf Zykluszeit setzen
	setTimer(Timer_CPCHumanMachineIfc_Rq_AR_ReceiptPDU, 20);

	output(this);
}
/*@@end*/
/*@@frPDU:MsgChannel1.CHASSIS::SpringVlv_Stat_AR:*/
on frPDU MsgChannel1.CHASSIS::ISM_DAC4_AR
{
	if (TimeToElapse(Timer_CPCISM_DAC4_AR_ReceiptPDU) >= 5/2)
	{
		//Timer nicht zu 50% abgelaufen (d.h. aktiv und Botschaft nicht mit halber Zykluszeit empfangen)
		//außer bei spontan
	}
	else
	{
		//Timer zu 50% abgelaufen (d.h. Botschaft mit mindestens halber Zykluszeit empfangen)
		@sysvar::CH_Nodes::CH__PDURECEIPT_RECEIVE_CPC_ISM_DAC4_AR = 3;
	}
	//Timer auf Zykluszeit setzen
	setTimer(Timer_CPCISM_DAC4_AR_ReceiptPDU, 5);

	output(this);
}
/*@@end*/
/*@@frPDU:MsgChannel1.CHASSIS::SpringVlv_Stat_AR:*/
on frPDU MsgChannel1.CHASSIS::OBL_DC_Output_AR
{
	if (TimeToElapse(Timer_CPCOBL_DC_Output_AR_ReceiptPDU) >= 100/2)
	{
		//Timer nicht zu 50% abgelaufen (d.h. aktiv und Botschaft nicht mit halber Zykluszeit empfangen)
		//außer bei spontan
		@sysvar::CH_Nodes::CH__PDURECEIPT_RECEIVE_CPC_OBL_DC_Output_AR = 4;
	}
	else
	{
		//Timer zu 50% abgelaufen (d.h. Botschaft mit mindestens halber Zykluszeit empfangen)
		@sysvar::CH_Nodes::CH__PDURECEIPT_RECEIVE_CPC_OBL_DC_Output_AR = 3;
	}
	//Timer auf Zykluszeit setzen
	setTimer(Timer_CPCOBL_DC_Output_AR_ReceiptPDU, 100);

	output(this);
}
/*@@end*/
/*@@frPDU:MsgChannel1.CHASSIS::SpringVlv_Stat_AR:*/
on frPDU MsgChannel1.CHASSIS::PARK_Drv_Rs_TCM_AR2
{
	if (TimeToElapse(Timer_CPCPARK_Drv_Rs_TCM_AR2_ReceiptPDU) >= 120/2)
	{
		//Timer nicht zu 50% abgelaufen (d.h. aktiv und Botschaft nicht mit halber Zykluszeit empfangen)
		//außer bei spontan
		@sysvar::CH_Nodes::CH__PDURECEIPT_RECEIVE_CPC_PARK_Drv_Rs_TCM_AR2 = 4;
	}
	else
	{
		//Timer zu 50% abgelaufen (d.h. Botschaft mit mindestens halber Zykluszeit empfangen)
		@sysvar::CH_Nodes::CH__PDURECEIPT_RECEIVE_CPC_PARK_Drv_Rs_TCM_AR2 = 3;
	}
	//Timer auf Zykluszeit setzen
	setTimer(Timer_CPCPARK_Drv_Rs_TCM_AR2_ReceiptPDU, 120);

	output(this);
}
/*@@end*/
/*@@frPDU:MsgChannel1.CHASSIS::SpringVlv_Stat_AR:*/
on frPDU MsgChannel1.CHASSIS::PN14_Gen_Rs_AR
{
	if (TimeToElapse(Timer_CPCPN14_Gen_Rs_AR_ReceiptPDU) >= 500/2)
	{
		//Timer nicht zu 50% abgelaufen (d.h. aktiv und Botschaft nicht mit halber Zykluszeit empfangen)
		//außer bei spontan
		@sysvar::CH_Nodes::CH__PDURECEIPT_RECEIVE_CPC_PN14_Gen_Rs_AR = 4;
	}
	else
	{
		//Timer zu 50% abgelaufen (d.h. Botschaft mit mindestens halber Zykluszeit empfangen)
		@sysvar::CH_Nodes::CH__PDURECEIPT_RECEIVE_CPC_PN14_Gen_Rs_AR = 3;
	}
	//Timer auf Zykluszeit setzen
	setTimer(Timer_CPCPN14_Gen_Rs_AR_ReceiptPDU, 500);

	output(this);
}
/*@@end*/
/*@@frPDU:MsgChannel1.CHASSIS::SpringVlv_Stat_AR:*/
on frPDU MsgChannel1.CHASSIS::PNHV_BMS_Stat_AR2
{
	if (TimeToElapse(Timer_CPCPNHV_BMS_Stat_AR2_ReceiptPDU) >= 100/2)
	{
		//Timer nicht zu 50% abgelaufen (d.h. aktiv und Botschaft nicht mit halber Zykluszeit empfangen)
		//außer bei spontan
		@sysvar::CH_Nodes::CH__PDURECEIPT_RECEIVE_CPC_PNHV_BMS_Stat_AR2 = 4;
	}
	else
	{
		//Timer zu 50% abgelaufen (d.h. Botschaft mit mindestens halber Zykluszeit empfangen)
		@sysvar::CH_Nodes::CH__PDURECEIPT_RECEIVE_CPC_PNHV_BMS_Stat_AR2 = 3;
	}
	//Timer auf Zykluszeit setzen
	setTimer(Timer_CPCPNHV_BMS_Stat_AR2_ReceiptPDU, 100);

	output(this);
}
/*@@end*/
/*@@frPDU:MsgChannel1.CHASSIS::SpringVlv_Stat_AR:*/
on frPDU MsgChannel1.CHASSIS::PNHV_EnergyMngmnt_Disp_Rq_AR
{
	if (TimeToElapse(Timer_CPCPNHV_EnergyMngmnt_Disp_Rq_AR_ReceiptPDU) >= 1000/2)
	{
		//Timer nicht zu 50% abgelaufen (d.h. aktiv und Botschaft nicht mit halber Zykluszeit empfangen)
		//außer bei spontan
		@sysvar::CH_Nodes::CH__PDURECEIPT_RECEIVE_CPC_PNHV_EnergyMngmnt_Disp_Rq_AR = 4;
	}
	else
	{
		//Timer zu 50% abgelaufen (d.h. Botschaft mit mindestens halber Zykluszeit empfangen)
		@sysvar::CH_Nodes::CH__PDURECEIPT_RECEIVE_CPC_PNHV_EnergyMngmnt_Disp_Rq_AR = 3;
	}
	//Timer auf Zykluszeit setzen
	setTimer(Timer_CPCPNHV_EnergyMngmnt_Disp_Rq_AR_ReceiptPDU, 1000);

	output(this);
}
/*@@end*/
/*@@frPDU:MsgChannel1.CHASSIS::SpringVlv_Stat_AR:*/
on frPDU MsgChannel1.CHASSIS::PNHV_EnergyMngmnt_Stat2_AR2
{
	if (TimeToElapse(Timer_CPCPNHV_EnergyMngmnt_Stat2_AR2_ReceiptPDU) >= 100/2)
	{
		//Timer nicht zu 50% abgelaufen (d.h. aktiv und Botschaft nicht mit halber Zykluszeit empfangen)
		//außer bei spontan
		@sysvar::CH_Nodes::CH__PDURECEIPT_RECEIVE_CPC_PNHV_EnergyMngmnt_Stat2_AR2 = 4;
	}
	else
	{
		//Timer zu 50% abgelaufen (d.h. Botschaft mit mindestens halber Zykluszeit empfangen)
		@sysvar::CH_Nodes::CH__PDURECEIPT_RECEIVE_CPC_PNHV_EnergyMngmnt_Stat2_AR2 = 3;
	}
	//Timer auf Zykluszeit setzen
	setTimer(Timer_CPCPNHV_EnergyMngmnt_Stat2_AR2_ReceiptPDU, 100);

	output(this);
}
/*@@end*/
/*@@frPDU:MsgChannel1.CHASSIS::SpringVlv_Stat_AR:*/
on frPDU MsgChannel1.CHASSIS::PNHV_EnergyMngmnt_Stat3_AR2
{
	if (TimeToElapse(Timer_CPCPNHV_EnergyMngmnt_Stat3_AR2_ReceiptPDU) >= 100/2)
	{
		//Timer nicht zu 50% abgelaufen (d.h. aktiv und Botschaft nicht mit halber Zykluszeit empfangen)
		//außer bei spontan
		@sysvar::CH_Nodes::CH__PDURECEIPT_RECEIVE_CPC_PNHV_EnergyMngmnt_Stat3_AR2 = 4;
	}
	else
	{
		//Timer zu 50% abgelaufen (d.h. Botschaft mit mindestens halber Zykluszeit empfangen)
		@sysvar::CH_Nodes::CH__PDURECEIPT_RECEIVE_CPC_PNHV_EnergyMngmnt_Stat3_AR2 = 3;
	}
	//Timer auf Zykluszeit setzen
	setTimer(Timer_CPCPNHV_EnergyMngmnt_Stat3_AR2_ReceiptPDU, 100);

	output(this);
}
/*@@end*/
/*@@frPDU:MsgChannel1.CHASSIS::SpringVlv_Stat_AR:*/
on frPDU MsgChannel1.CHASSIS::PNHV_EnergyMngmntSet_Rs1_AR2
{
	if (TimeToElapse(Timer_CPCPNHV_EnergyMngmntSet_Rs1_AR2_ReceiptPDU) >= 1000/2)
	{
		//Timer nicht zu 50% abgelaufen (d.h. aktiv und Botschaft nicht mit halber Zykluszeit empfangen)
		//außer bei spontan
		@sysvar::CH_Nodes::CH__PDURECEIPT_RECEIVE_CPC_PNHV_EnergyMngmntSet_Rs1_AR2 = 4;
	}
	else
	{
		//Timer zu 50% abgelaufen (d.h. Botschaft mit mindestens halber Zykluszeit empfangen)
		@sysvar::CH_Nodes::CH__PDURECEIPT_RECEIVE_CPC_PNHV_EnergyMngmntSet_Rs1_AR2 = 3;
	}
	//Timer auf Zykluszeit setzen
	setTimer(Timer_CPCPNHV_EnergyMngmntSet_Rs1_AR2_ReceiptPDU, 1000);

	output(this);
}
/*@@end*/
/*@@frPDU:MsgChannel1.CHASSIS::SpringVlv_Stat_AR:*/
on frPDU MsgChannel1.CHASSIS::PNHV_EnergyMngmntSet_Rs2_AR
{
	if (TimeToElapse(Timer_CPCPNHV_EnergyMngmntSet_Rs2_AR_ReceiptPDU) >= 1000/2)
	{
		//Timer nicht zu 50% abgelaufen (d.h. aktiv und Botschaft nicht mit halber Zykluszeit empfangen)
		//außer bei spontan
		@sysvar::CH_Nodes::CH__PDURECEIPT_RECEIVE_CPC_PNHV_EnergyMngmntSet_Rs2_AR = 4;
	}
	else
	{
		//Timer zu 50% abgelaufen (d.h. Botschaft mit mindestens halber Zykluszeit empfangen)
		@sysvar::CH_Nodes::CH__PDURECEIPT_RECEIVE_CPC_PNHV_EnergyMngmntSet_Rs2_AR = 3;
	}
	//Timer auf Zykluszeit setzen
	setTimer(Timer_CPCPNHV_EnergyMngmntSet_Rs2_AR_ReceiptPDU, 1000);

	output(this);
}
/*@@end*/
/*@@frPDU:MsgChannel1.CHASSIS::SpringVlv_Stat_AR:*/
on frPDU MsgChannel1.CHASSIS::PNHV_Stat_AR2
{
	if (TimeToElapse(Timer_CPCPNHV_Stat_AR2_ReceiptPDU) >= 100/2)
	{
		//Timer nicht zu 50% abgelaufen (d.h. aktiv und Botschaft nicht mit halber Zykluszeit empfangen)
		//außer bei spontan
		@sysvar::CH_Nodes::CH__PDURECEIPT_RECEIVE_CPC_PNHV_Stat_AR2 = 4;
	}
	else
	{
		//Timer zu 50% abgelaufen (d.h. Botschaft mit mindestens halber Zykluszeit empfangen)
		@sysvar::CH_Nodes::CH__PDURECEIPT_RECEIVE_CPC_PNHV_Stat_AR2 = 3;
	}
	//Timer auf Zykluszeit setzen
	setTimer(Timer_CPCPNHV_Stat_AR2_ReceiptPDU, 100);

	output(this);
}
/*@@end*/
/*@@frPDU:MsgChannel1.CHASSIS::SpringVlv_Stat_AR:*/
on frPDU MsgChannel1.CHASSIS::PNHV_WeekDepTmTbl_Stat_AR2
{
	if (TimeToElapse(Timer_CPCPNHV_WeekDepTmTbl_Stat_AR2_ReceiptPDU) >= 5/2)
	{
		//Timer nicht zu 50% abgelaufen (d.h. aktiv und Botschaft nicht mit halber Zykluszeit empfangen)
		//außer bei spontan
		@sysvar::CH_Nodes::CH__PDURECEIPT_RECEIVE_CPC_PNHV_WeekDepTmTbl_Stat_AR2 = 4;
	}
	else
	{
		//Timer zu 50% abgelaufen (d.h. Botschaft mit mindestens halber Zykluszeit empfangen)
		@sysvar::CH_Nodes::CH__PDURECEIPT_RECEIVE_CPC_PNHV_WeekDepTmTbl_Stat_AR2 = 3;
	}
	//Timer auf Zykluszeit setzen
	setTimer(Timer_CPCPNHV_WeekDepTmTbl_Stat_AR2_ReceiptPDU, 5);
	if (TimeToElapse(Timer_CPCPNHV_WeekDepTmTbl_Stat_AR2_ReceiptPDU) >= 5/2)
	{
		//Timer nicht zu 50% abgelaufen (d.h. aktiv und Botschaft nicht mit halber Zykluszeit empfangen)
		//außer bei spontan
		@sysvar::CH_Nodes::CH__PDURECEIPT_RECEIVE_CPC_PNHV_WeekDepTmTbl_Stat_AR2 = 4;
	}
	else
	{
		//Timer zu 50% abgelaufen (d.h. Botschaft mit mindestens halber Zykluszeit empfangen)
		@sysvar::CH_Nodes::CH__PDURECEIPT_RECEIVE_CPC_PNHV_WeekDepTmTbl_Stat_AR2 = 3;
	}
	//Timer auf Zykluszeit setzen
	setTimer(Timer_CPCPNHV_WeekDepTmTbl_Stat_AR2_ReceiptPDU, 5);
	if (TimeToElapse(Timer_CPCPNHV_WeekDepTmTbl_Stat_AR2_ReceiptPDU) >= 5/2)
	{
		//Timer nicht zu 50% abgelaufen (d.h. aktiv und Botschaft nicht mit halber Zykluszeit empfangen)
		//außer bei spontan
		@sysvar::CH_Nodes::CH__PDURECEIPT_RECEIVE_CPC_PNHV_WeekDepTmTbl_Stat_AR2 = 4;
	}
	else
	{
		//Timer zu 50% abgelaufen (d.h. Botschaft mit mindestens halber Zykluszeit empfangen)
		@sysvar::CH_Nodes::CH__PDURECEIPT_RECEIVE_CPC_PNHV_WeekDepTmTbl_Stat_AR2 = 3;
	}
	//Timer auf Zykluszeit setzen
	setTimer(Timer_CPCPNHV_WeekDepTmTbl_Stat_AR2_ReceiptPDU, 5);
	if (TimeToElapse(Timer_CPCPNHV_WeekDepTmTbl_Stat_AR2_ReceiptPDU) >= 5/2)
	{
		//Timer nicht zu 50% abgelaufen (d.h. aktiv und Botschaft nicht mit halber Zykluszeit empfangen)
		//außer bei spontan
		@sysvar::CH_Nodes::CH__PDURECEIPT_RECEIVE_CPC_PNHV_WeekDepTmTbl_Stat_AR2 = 4;
	}
	else
	{
		//Timer zu 50% abgelaufen (d.h. Botschaft mit mindestens halber Zykluszeit empfangen)
		@sysvar::CH_Nodes::CH__PDURECEIPT_RECEIVE_CPC_PNHV_WeekDepTmTbl_Stat_AR2 = 3;
	}
	//Timer auf Zykluszeit setzen
	setTimer(Timer_CPCPNHV_WeekDepTmTbl_Stat_AR2_ReceiptPDU, 5);
	if (TimeToElapse(Timer_CPCPNHV_WeekDepTmTbl_Stat_AR2_ReceiptPDU) >= 5/2)
	{
		//Timer nicht zu 50% abgelaufen (d.h. aktiv und Botschaft nicht mit halber Zykluszeit empfangen)
		//außer bei spontan
		@sysvar::CH_Nodes::CH__PDURECEIPT_RECEIVE_CPC_PNHV_WeekDepTmTbl_Stat_AR2 = 4;
	}
	else
	{
		//Timer zu 50% abgelaufen (d.h. Botschaft mit mindestens halber Zykluszeit empfangen)
		@sysvar::CH_Nodes::CH__PDURECEIPT_RECEIVE_CPC_PNHV_WeekDepTmTbl_Stat_AR2 = 3;
	}
	//Timer auf Zykluszeit setzen
	setTimer(Timer_CPCPNHV_WeekDepTmTbl_Stat_AR2_ReceiptPDU, 5);
	if (TimeToElapse(Timer_CPCPNHV_WeekDepTmTbl_Stat_AR2_ReceiptPDU) >= 5/2)
	{
		//Timer nicht zu 50% abgelaufen (d.h. aktiv und Botschaft nicht mit halber Zykluszeit empfangen)
		//außer bei spontan
		@sysvar::CH_Nodes::CH__PDURECEIPT_RECEIVE_CPC_PNHV_WeekDepTmTbl_Stat_AR2 = 4;
	}
	else
	{
		//Timer zu 50% abgelaufen (d.h. Botschaft mit mindestens halber Zykluszeit empfangen)
		@sysvar::CH_Nodes::CH__PDURECEIPT_RECEIVE_CPC_PNHV_WeekDepTmTbl_Stat_AR2 = 3;
	}
	//Timer auf Zykluszeit setzen
	setTimer(Timer_CPCPNHV_WeekDepTmTbl_Stat_AR2_ReceiptPDU, 5);
	if (TimeToElapse(Timer_CPCPNHV_WeekDepTmTbl_Stat_AR2_ReceiptPDU) >= 5/2)
	{
		//Timer nicht zu 50% abgelaufen (d.h. aktiv und Botschaft nicht mit halber Zykluszeit empfangen)
		//außer bei spontan
		@sysvar::CH_Nodes::CH__PDURECEIPT_RECEIVE_CPC_PNHV_WeekDepTmTbl_Stat_AR2 = 4;
	}
	else
	{
		//Timer zu 50% abgelaufen (d.h. Botschaft mit mindestens halber Zykluszeit empfangen)
		@sysvar::CH_Nodes::CH__PDURECEIPT_RECEIVE_CPC_PNHV_WeekDepTmTbl_Stat_AR2 = 3;
	}
	//Timer auf Zykluszeit setzen
	setTimer(Timer_CPCPNHV_WeekDepTmTbl_Stat_AR2_ReceiptPDU, 5);
	if (TimeToElapse(Timer_CPCPNHV_WeekDepTmTbl_Stat_AR2_ReceiptPDU) >= 5/2)
	{
		//Timer nicht zu 50% abgelaufen (d.h. aktiv und Botschaft nicht mit halber Zykluszeit empfangen)
		//außer bei spontan
		@sysvar::CH_Nodes::CH__PDURECEIPT_RECEIVE_CPC_PNHV_WeekDepTmTbl_Stat_AR2 = 4;
	}
	else
	{
		//Timer zu 50% abgelaufen (d.h. Botschaft mit mindestens halber Zykluszeit empfangen)
		@sysvar::CH_Nodes::CH__PDURECEIPT_RECEIVE_CPC_PNHV_WeekDepTmTbl_Stat_AR2 = 3;
	}
	//Timer auf Zykluszeit setzen
	setTimer(Timer_CPCPNHV_WeekDepTmTbl_Stat_AR2_ReceiptPDU, 5);

	output(this);
}
/*@@end*/
/*@@frPDU:MsgChannel1.CHASSIS::SpringVlv_Stat_AR:*/
on frPDU MsgChannel1.CHASSIS::PT_DataContain_Rq_AR2
{
	if (TimeToElapse(Timer_CPCPT_DataContain_Rq_AR2_ReceiptPDU) >= 1000/2)
	{
		//Timer nicht zu 50% abgelaufen (d.h. aktiv und Botschaft nicht mit halber Zykluszeit empfangen)
		//außer bei spontan
		@sysvar::CH_Nodes::CH__PDURECEIPT_RECEIVE_CPC_PT_DataContain_Rq_AR2 = 4;
	}
	else
	{
		//Timer zu 50% abgelaufen (d.h. Botschaft mit mindestens halber Zykluszeit empfangen)
		@sysvar::CH_Nodes::CH__PDURECEIPT_RECEIVE_CPC_PT_DataContain_Rq_AR2 = 3;
	}
	//Timer auf Zykluszeit setzen
	setTimer(Timer_CPCPT_DataContain_Rq_AR2_ReceiptPDU, 1000);

	output(this);
}
/*@@end*/
/*@@frPDU:MsgChannel1.CHASSIS::SpringVlv_Stat_AR:*/
on frPDU MsgChannel1.CHASSIS::PT_Disp_Rq2_AR
{
	if (TimeToElapse(Timer_CPCPT_Disp_Rq2_AR_ReceiptPDU) >= 100/2)
	{
		//Timer nicht zu 50% abgelaufen (d.h. aktiv und Botschaft nicht mit halber Zykluszeit empfangen)
		//außer bei spontan
		@sysvar::CH_Nodes::CH__PDURECEIPT_RECEIVE_CPC_PT_Disp_Rq2_AR = 4;
	}
	else
	{
		//Timer zu 50% abgelaufen (d.h. Botschaft mit mindestens halber Zykluszeit empfangen)
		@sysvar::CH_Nodes::CH__PDURECEIPT_RECEIVE_CPC_PT_Disp_Rq2_AR = 3;
	}
	//Timer auf Zykluszeit setzen
	setTimer(Timer_CPCPT_Disp_Rq2_AR_ReceiptPDU, 100);

	output(this);
}
/*@@end*/
/*@@frPDU:MsgChannel1.CHASSIS::SpringVlv_Stat_AR:*/
on frPDU MsgChannel1.CHASSIS::PT_ThermM_AR2
{
	if (TimeToElapse(Timer_CPCPT_ThermM_AR2_ReceiptPDU) >= 500/2)
	{
		//Timer nicht zu 50% abgelaufen (d.h. aktiv und Botschaft nicht mit halber Zykluszeit empfangen)
		//außer bei spontan
		@sysvar::CH_Nodes::CH__PDURECEIPT_RECEIVE_CPC_PT_ThermM_AR2 = 4;
	}
	else
	{
		//Timer zu 50% abgelaufen (d.h. Botschaft mit mindestens halber Zykluszeit empfangen)
		@sysvar::CH_Nodes::CH__PDURECEIPT_RECEIVE_CPC_PT_ThermM_AR2 = 3;
	}
	//Timer auf Zykluszeit setzen
	setTimer(Timer_CPCPT_ThermM_AR2_ReceiptPDU, 500);

	output(this);
}
/*@@end*/
/*@@frPDU:MsgChannel1.CHASSIS::SpringVlv_Stat_AR:*/
on frPDU MsgChannel1.CHASSIS::PT_ThermM_Rq_AR2
{
	if (TimeToElapse(Timer_CPCPT_ThermM_Rq_AR2_ReceiptPDU) >= 500/2)
	{
		//Timer nicht zu 50% abgelaufen (d.h. aktiv und Botschaft nicht mit halber Zykluszeit empfangen)
		//außer bei spontan
		@sysvar::CH_Nodes::CH__PDURECEIPT_RECEIVE_CPC_PT_ThermM_Rq_AR2 = 4;
	}
	else
	{
		//Timer zu 50% abgelaufen (d.h. Botschaft mit mindestens halber Zykluszeit empfangen)
		@sysvar::CH_Nodes::CH__PDURECEIPT_RECEIVE_CPC_PT_ThermM_Rq_AR2 = 3;
	}
	//Timer auf Zykluszeit setzen
	setTimer(Timer_CPCPT_ThermM_Rq_AR2_ReceiptPDU, 500);

	output(this);
}
/*@@end*/
/*@@frPDU:MsgChannel1.CHASSIS::SpringVlv_Stat_AR:*/
on frPDU MsgChannel1.CHASSIS::PtHyb_Mngmnt_Rq1_AR
{
	if (TimeToElapse(Timer_CPCPtHyb_Mngmnt_Rq1_AR_ReceiptPDU) >= 5000/2)
	{
		//Timer nicht zu 50% abgelaufen (d.h. aktiv und Botschaft nicht mit halber Zykluszeit empfangen)
		//außer bei spontan
		@sysvar::CH_Nodes::CH__PDURECEIPT_RECEIVE_CPC_PtHyb_Mngmnt_Rq1_AR = 4;
	}
	else
	{
		//Timer zu 50% abgelaufen (d.h. Botschaft mit mindestens halber Zykluszeit empfangen)
		@sysvar::CH_Nodes::CH__PDURECEIPT_RECEIVE_CPC_PtHyb_Mngmnt_Rq1_AR = 3;
	}
	//Timer auf Zykluszeit setzen
	setTimer(Timer_CPCPtHyb_Mngmnt_Rq1_AR_ReceiptPDU, 5000);

	output(this);
}
/*@@end*/
/*@@frPDU:MsgChannel1.CHASSIS::SpringVlv_Stat_AR:*/
on frPDU MsgChannel1.CHASSIS::PtMngmnt_Disp_Rq_AR2
{
	if (TimeToElapse(Timer_CPCPtMngmnt_Disp_Rq_AR2_ReceiptPDU) >= 100/2)
	{
		//Timer nicht zu 50% abgelaufen (d.h. aktiv und Botschaft nicht mit halber Zykluszeit empfangen)
		//außer bei spontan
		@sysvar::CH_Nodes::CH__PDURECEIPT_RECEIVE_CPC_PtMngmnt_Disp_Rq_AR2 = 4;
	}
	else
	{
		//Timer zu 50% abgelaufen (d.h. Botschaft mit mindestens halber Zykluszeit empfangen)
		@sysvar::CH_Nodes::CH__PDURECEIPT_RECEIVE_CPC_PtMngmnt_Disp_Rq_AR2 = 3;
	}
	//Timer auf Zykluszeit setzen
	setTimer(Timer_CPCPtMngmnt_Disp_Rq_AR2_ReceiptPDU, 100);

	output(this);
}
/*@@end*/
/*@@frPDU:MsgChannel1.CHASSIS::SpringVlv_Stat_AR:*/
on frPDU MsgChannel1.CHASSIS::PtMngmnt_Rq_AR2
{
	if (TimeToElapse(Timer_CPCPtMngmnt_Rq_AR2_ReceiptPDU) >= 20/2)
	{
		//Timer nicht zu 50% abgelaufen (d.h. aktiv und Botschaft nicht mit halber Zykluszeit empfangen)
		//außer bei spontan
		@sysvar::CH_Nodes::CH__PDURECEIPT_RECEIVE_CPC_PtMngmnt_Rq_AR2 = 4;
	}
	else
	{
		//Timer zu 50% abgelaufen (d.h. Botschaft mit mindestens halber Zykluszeit empfangen)
		@sysvar::CH_Nodes::CH__PDURECEIPT_RECEIVE_CPC_PtMngmnt_Rq_AR2 = 3;
	}
	//Timer auf Zykluszeit setzen
	setTimer(Timer_CPCPtMngmnt_Rq_AR2_ReceiptPDU, 20);

	output(this);
}
/*@@end*/
/*@@frPDU:MsgChannel1.CHASSIS::SpringVlv_Stat_AR:*/
on frPDU MsgChannel1.CHASSIS::PtMngmnt_Stat2_AR2
{
	if (TimeToElapse(Timer_CPCPtMngmnt_Stat2_AR2_ReceiptPDU) >= 10/2)
	{
		//Timer nicht zu 50% abgelaufen (d.h. aktiv und Botschaft nicht mit halber Zykluszeit empfangen)
		//außer bei spontan
		@sysvar::CH_Nodes::CH__PDURECEIPT_RECEIVE_CPC_PtMngmnt_Stat2_AR2 = 4;
	}
	else
	{
		//Timer zu 50% abgelaufen (d.h. Botschaft mit mindestens halber Zykluszeit empfangen)
		@sysvar::CH_Nodes::CH__PDURECEIPT_RECEIVE_CPC_PtMngmnt_Stat2_AR2 = 3;
	}
	//Timer auf Zykluszeit setzen
	setTimer(Timer_CPCPtMngmnt_Stat2_AR2_ReceiptPDU, 10);

	output(this);
}
/*@@end*/
/*@@frPDU:MsgChannel1.CHASSIS::SpringVlv_Stat_AR:*/
on frPDU MsgChannel1.CHASSIS::PtMngmnt_Stat_AR2
{
	if (TimeToElapse(Timer_CPCPtMngmnt_Stat_AR2_ReceiptPDU) >= 100/2)
	{
		//Timer nicht zu 50% abgelaufen (d.h. aktiv und Botschaft nicht mit halber Zykluszeit empfangen)
		//außer bei spontan
		@sysvar::CH_Nodes::CH__PDURECEIPT_RECEIVE_CPC_PtMngmnt_Stat_AR2 = 4;
	}
	else
	{
		//Timer zu 50% abgelaufen (d.h. Botschaft mit mindestens halber Zykluszeit empfangen)
		@sysvar::CH_Nodes::CH__PDURECEIPT_RECEIVE_CPC_PtMngmnt_Stat_AR2 = 3;
	}
	//Timer auf Zykluszeit setzen
	setTimer(Timer_CPCPtMngmnt_Stat_AR2_ReceiptPDU, 100);

	output(this);
}
/*@@end*/
/*@@frPDU:MsgChannel1.CHASSIS::SpringVlv_Stat_AR:*/
on frPDU MsgChannel1.CHASSIS::SBW_DrvPosn_Disp_Rq_ISM_AR2
{
	if (TimeToElapse(Timer_CPCSBW_DrvPosn_Disp_Rq_ISM_AR2_ReceiptPDU) >= 200/2)
	{
		//Timer nicht zu 50% abgelaufen (d.h. aktiv und Botschaft nicht mit halber Zykluszeit empfangen)
		//außer bei spontan
		@sysvar::CH_Nodes::CH__PDURECEIPT_RECEIVE_CPC_SBW_DrvPosn_Disp_Rq_ISM_AR2 = 4;
	}
	else
	{
		//Timer zu 50% abgelaufen (d.h. Botschaft mit mindestens halber Zykluszeit empfangen)
		@sysvar::CH_Nodes::CH__PDURECEIPT_RECEIVE_CPC_SBW_DrvPosn_Disp_Rq_ISM_AR2 = 3;
	}
	//Timer auf Zykluszeit setzen
	setTimer(Timer_CPCSBW_DrvPosn_Disp_Rq_ISM_AR2_ReceiptPDU, 200);

	output(this);
}
/*@@end*/
/*@@frPDU:MsgChannel1.CHASSIS::SpringVlv_Stat_AR:*/
on frPDU MsgChannel1.CHASSIS::SBW_DrvPosn_Disp_Rq_TCM_AR2
{
	if (TimeToElapse(Timer_CPCSBW_DrvPosn_Disp_Rq_TCM_AR2_ReceiptPDU) >= 200/2)
	{
		//Timer nicht zu 50% abgelaufen (d.h. aktiv und Botschaft nicht mit halber Zykluszeit empfangen)
		//außer bei spontan
		@sysvar::CH_Nodes::CH__PDURECEIPT_RECEIVE_CPC_SBW_DrvPosn_Disp_Rq_TCM_AR2 = 4;
	}
	else
	{
		//Timer zu 50% abgelaufen (d.h. Botschaft mit mindestens halber Zykluszeit empfangen)
		@sysvar::CH_Nodes::CH__PDURECEIPT_RECEIVE_CPC_SBW_DrvPosn_Disp_Rq_TCM_AR2 = 3;
	}
	//Timer auf Zykluszeit setzen
	setTimer(Timer_CPCSBW_DrvPosn_Disp_Rq_TCM_AR2_ReceiptPDU, 200);

	output(this);
}
/*@@end*/
/*@@frPDU:MsgChannel1.CHASSIS::SpringVlv_Stat_AR:*/
on frPDU MsgChannel1.CHASSIS::SBW_Stat_AR2
{
	if (TimeToElapse(Timer_CPCSBW_Stat_AR2_ReceiptPDU) >= 100/2)
	{
		//Timer nicht zu 50% abgelaufen (d.h. aktiv und Botschaft nicht mit halber Zykluszeit empfangen)
		//außer bei spontan
		@sysvar::CH_Nodes::CH__PDURECEIPT_RECEIVE_CPC_SBW_Stat_AR2 = 4;
	}
	else
	{
		//Timer zu 50% abgelaufen (d.h. Botschaft mit mindestens halber Zykluszeit empfangen)
		@sysvar::CH_Nodes::CH__PDURECEIPT_RECEIVE_CPC_SBW_Stat_AR2 = 3;
	}
	//Timer auf Zykluszeit setzen
	setTimer(Timer_CPCSBW_Stat_AR2_ReceiptPDU, 100);

	output(this);
}
/*@@end*/
/*@@frPDU:MsgChannel1.CHASSIS::SpringVlv_Stat_AR:*/
on frPDU MsgChannel1.CHASSIS::SND_GEN_Stat_AR
{
	if (TimeToElapse(Timer_CPCSND_GEN_Stat_AR_ReceiptPDU) >= 600/2)
	{
		//Timer nicht zu 50% abgelaufen (d.h. aktiv und Botschaft nicht mit halber Zykluszeit empfangen)
		//außer bei spontan
		@sysvar::CH_Nodes::CH__PDURECEIPT_RECEIVE_CPC_SND_GEN_Stat_AR = 4;
	}
	else
	{
		//Timer zu 50% abgelaufen (d.h. Botschaft mit mindestens halber Zykluszeit empfangen)
		@sysvar::CH_Nodes::CH__PDURECEIPT_RECEIVE_CPC_SND_GEN_Stat_AR = 3;
	}
	//Timer auf Zykluszeit setzen
	setTimer(Timer_CPCSND_GEN_Stat_AR_ReceiptPDU, 600);

	output(this);
}
/*@@end*/
/*@@frPDU:MsgChannel1.CHASSIS::SpringVlv_Stat_AR:*/
on frPDU MsgChannel1.CHASSIS::TC_Disp_Rq_ECM_AR
{
	if (TimeToElapse(Timer_CPCTC_Disp_Rq_ECM_AR_ReceiptPDU) >= 40/2)
	{
		//Timer nicht zu 50% abgelaufen (d.h. aktiv und Botschaft nicht mit halber Zykluszeit empfangen)
		//außer bei spontan
		@sysvar::CH_Nodes::CH__PDURECEIPT_RECEIVE_CPC_TC_Disp_Rq_ECM_AR = 4;
	}
	else
	{
		//Timer zu 50% abgelaufen (d.h. Botschaft mit mindestens halber Zykluszeit empfangen)
		@sysvar::CH_Nodes::CH__PDURECEIPT_RECEIVE_CPC_TC_Disp_Rq_ECM_AR = 3;
	}
	//Timer auf Zykluszeit setzen
	setTimer(Timer_CPCTC_Disp_Rq_ECM_AR_ReceiptPDU, 40);
	if (TimeToElapse(Timer_CPCTC_Disp_Rq_ECM_AR_ReceiptPDU) >= 40/2)
	{
		//Timer nicht zu 50% abgelaufen (d.h. aktiv und Botschaft nicht mit halber Zykluszeit empfangen)
		//außer bei spontan
		@sysvar::CH_Nodes::CH__PDURECEIPT_RECEIVE_CPC_TC_Disp_Rq_ECM_AR = 4;
	}
	else
	{
		//Timer zu 50% abgelaufen (d.h. Botschaft mit mindestens halber Zykluszeit empfangen)
		@sysvar::CH_Nodes::CH__PDURECEIPT_RECEIVE_CPC_TC_Disp_Rq_ECM_AR = 3;
	}
	//Timer auf Zykluszeit setzen
	setTimer(Timer_CPCTC_Disp_Rq_ECM_AR_ReceiptPDU, 40);
	if (TimeToElapse(Timer_CPCTC_Disp_Rq_ECM_AR_ReceiptPDU) >= 40/2)
	{
		//Timer nicht zu 50% abgelaufen (d.h. aktiv und Botschaft nicht mit halber Zykluszeit empfangen)
		//außer bei spontan
		@sysvar::CH_Nodes::CH__PDURECEIPT_RECEIVE_CPC_TC_Disp_Rq_ECM_AR = 4;
	}
	else
	{
		//Timer zu 50% abgelaufen (d.h. Botschaft mit mindestens halber Zykluszeit empfangen)
		@sysvar::CH_Nodes::CH__PDURECEIPT_RECEIVE_CPC_TC_Disp_Rq_ECM_AR = 3;
	}
	//Timer auf Zykluszeit setzen
	setTimer(Timer_CPCTC_Disp_Rq_ECM_AR_ReceiptPDU, 40);
	if (TimeToElapse(Timer_CPCTC_Disp_Rq_ECM_AR_ReceiptPDU) >= 40/2)
	{
		//Timer nicht zu 50% abgelaufen (d.h. aktiv und Botschaft nicht mit halber Zykluszeit empfangen)
		//außer bei spontan
		@sysvar::CH_Nodes::CH__PDURECEIPT_RECEIVE_CPC_TC_Disp_Rq_ECM_AR = 4;
	}
	else
	{
		//Timer zu 50% abgelaufen (d.h. Botschaft mit mindestens halber Zykluszeit empfangen)
		@sysvar::CH_Nodes::CH__PDURECEIPT_RECEIVE_CPC_TC_Disp_Rq_ECM_AR = 3;
	}
	//Timer auf Zykluszeit setzen
	setTimer(Timer_CPCTC_Disp_Rq_ECM_AR_ReceiptPDU, 40);
	if (TimeToElapse(Timer_CPCTC_Disp_Rq_ECM_AR_ReceiptPDU) >= 40/2)
	{
		//Timer nicht zu 50% abgelaufen (d.h. aktiv und Botschaft nicht mit halber Zykluszeit empfangen)
		//außer bei spontan
		@sysvar::CH_Nodes::CH__PDURECEIPT_RECEIVE_CPC_TC_Disp_Rq_ECM_AR = 4;
	}
	else
	{
		//Timer zu 50% abgelaufen (d.h. Botschaft mit mindestens halber Zykluszeit empfangen)
		@sysvar::CH_Nodes::CH__PDURECEIPT_RECEIVE_CPC_TC_Disp_Rq_ECM_AR = 3;
	}
	//Timer auf Zykluszeit setzen
	setTimer(Timer_CPCTC_Disp_Rq_ECM_AR_ReceiptPDU, 40);

	output(this);
}
/*@@end*/
/*@@frPDU:MsgChannel1.CHASSIS::SpringVlv_Stat_AR:*/
on frPDU MsgChannel1.CHASSIS::TC_EBBC_Disp_Rq_ECM_AR
{
	if (TimeToElapse(Timer_CPCTC_EBBC_Disp_Rq_ECM_AR_ReceiptPDU) >= 100/2)
	{
		//Timer nicht zu 50% abgelaufen (d.h. aktiv und Botschaft nicht mit halber Zykluszeit empfangen)
		//außer bei spontan
		@sysvar::CH_Nodes::CH__PDURECEIPT_RECEIVE_CPC_TC_EBBC_Disp_Rq_ECM_AR = 4;
	}
	else
	{
		//Timer zu 50% abgelaufen (d.h. Botschaft mit mindestens halber Zykluszeit empfangen)
		@sysvar::CH_Nodes::CH__PDURECEIPT_RECEIVE_CPC_TC_EBBC_Disp_Rq_ECM_AR = 3;
	}
	//Timer auf Zykluszeit setzen
	setTimer(Timer_CPCTC_EBBC_Disp_Rq_ECM_AR_ReceiptPDU, 100);

	output(this);
}
/*@@end*/
/*@@frPDU:MsgChannel1.CHASSIS::SpringVlv_Stat_AR:*/
on frPDU MsgChannel1.CHASSIS::TC_EEBBC_Disp_Rq_AR
{
	if (TimeToElapse(Timer_CPCTC_EEBBC_Disp_Rq_AR_ReceiptPDU) >= 100/2)
	{
		//Timer nicht zu 50% abgelaufen (d.h. aktiv und Botschaft nicht mit halber Zykluszeit empfangen)
		//außer bei spontan
		@sysvar::CH_Nodes::CH__PDURECEIPT_RECEIVE_CPC_TC_EEBBC_Disp_Rq_AR = 4;
	}
	else
	{
		//Timer zu 50% abgelaufen (d.h. Botschaft mit mindestens halber Zykluszeit empfangen)
		@sysvar::CH_Nodes::CH__PDURECEIPT_RECEIVE_CPC_TC_EEBBC_Disp_Rq_AR = 3;
	}
	//Timer auf Zykluszeit setzen
	setTimer(Timer_CPCTC_EEBBC_Disp_Rq_AR_ReceiptPDU, 100);

	output(this);
}
/*@@end*/
/*@@frPDU:MsgChannel1.CHASSIS::SpringVlv_Stat_AR:*/
on frPDU MsgChannel1.CHASSIS::TCM_DAC4_AR
{
	if (TimeToElapse(Timer_CPCTCM_DAC4_AR_ReceiptPDU) >= 5/2)
	{
		//Timer nicht zu 50% abgelaufen (d.h. aktiv und Botschaft nicht mit halber Zykluszeit empfangen)
		//außer bei spontan
	}
	else
	{
		//Timer zu 50% abgelaufen (d.h. Botschaft mit mindestens halber Zykluszeit empfangen)
		@sysvar::CH_Nodes::CH__PDURECEIPT_RECEIVE_CPC_TCM_DAC4_AR = 3;
	}
	//Timer auf Zykluszeit setzen
	setTimer(Timer_CPCTCM_DAC4_AR_ReceiptPDU, 5);

	output(this);
}
/*@@end*/
/*@@frPDU:MsgChannel1.CHASSIS::SpringVlv_Stat_AR:*/
on frPDU MsgChannel1.CHASSIS::TCM_Data2_AR2
{
	if (TimeToElapse(Timer_CPCTCM_Data2_AR2_ReceiptPDU) >= 20/2)
	{
		//Timer nicht zu 50% abgelaufen (d.h. aktiv und Botschaft nicht mit halber Zykluszeit empfangen)
		//außer bei spontan
		@sysvar::CH_Nodes::CH__PDURECEIPT_RECEIVE_CPC_TCM_Data2_AR2 = 4;
	}
	else
	{
		//Timer zu 50% abgelaufen (d.h. Botschaft mit mindestens halber Zykluszeit empfangen)
		@sysvar::CH_Nodes::CH__PDURECEIPT_RECEIVE_CPC_TCM_Data2_AR2 = 3;
	}
	//Timer auf Zykluszeit setzen
	setTimer(Timer_CPCTCM_Data2_AR2_ReceiptPDU, 20);

	output(this);
}
/*@@end*/
/*@@frPDU:MsgChannel1.CHASSIS::SpringVlv_Stat_AR:*/
on frPDU MsgChannel1.CHASSIS::TCM_Data3_AR2
{
	if (TimeToElapse(Timer_CPCTCM_Data3_AR2_ReceiptPDU) >= 20/2)
	{
		//Timer nicht zu 50% abgelaufen (d.h. aktiv und Botschaft nicht mit halber Zykluszeit empfangen)
		//außer bei spontan
		@sysvar::CH_Nodes::CH__PDURECEIPT_RECEIVE_CPC_TCM_Data3_AR2 = 4;
	}
	else
	{
		//Timer zu 50% abgelaufen (d.h. Botschaft mit mindestens halber Zykluszeit empfangen)
		@sysvar::CH_Nodes::CH__PDURECEIPT_RECEIVE_CPC_TCM_Data3_AR2 = 3;
	}
	//Timer auf Zykluszeit setzen
	setTimer(Timer_CPCTCM_Data3_AR2_ReceiptPDU, 20);

	output(this);
}
/*@@end*/
/*@@frPDU:MsgChannel1.CHASSIS::SpringVlv_Stat_AR:*/
on frPDU MsgChannel1.CHASSIS::TCM_Disp_Rq_AMG_AR
{
	if (TimeToElapse(Timer_CPCTCM_Disp_Rq_AMG_AR_ReceiptPDU) >= 200/2)
	{
		//Timer nicht zu 50% abgelaufen (d.h. aktiv und Botschaft nicht mit halber Zykluszeit empfangen)
		//außer bei spontan
		@sysvar::CH_Nodes::CH__PDURECEIPT_RECEIVE_CPC_TCM_Disp_Rq_AMG_AR = 4;
	}
	else
	{
		//Timer zu 50% abgelaufen (d.h. Botschaft mit mindestens halber Zykluszeit empfangen)
		@sysvar::CH_Nodes::CH__PDURECEIPT_RECEIVE_CPC_TCM_Disp_Rq_AMG_AR = 3;
	}
	//Timer auf Zykluszeit setzen
	setTimer(Timer_CPCTCM_Disp_Rq_AMG_AR_ReceiptPDU, 200);

	output(this);
}
/*@@end*/
/*@@frPDU:MsgChannel1.CHASSIS::SpringVlv_Stat_AR:*/
on frPDU MsgChannel1.CHASSIS::TCM_State3_AR2
{
	if (TimeToElapse(Timer_CPCTCM_State3_AR2_ReceiptPDU) >= 100/2)
	{
		//Timer nicht zu 50% abgelaufen (d.h. aktiv und Botschaft nicht mit halber Zykluszeit empfangen)
		//außer bei spontan
		@sysvar::CH_Nodes::CH__PDURECEIPT_RECEIVE_CPC_TCM_State3_AR2 = 4;
	}
	else
	{
		//Timer zu 50% abgelaufen (d.h. Botschaft mit mindestens halber Zykluszeit empfangen)
		@sysvar::CH_Nodes::CH__PDURECEIPT_RECEIVE_CPC_TCM_State3_AR2 = 3;
	}
	//Timer auf Zykluszeit setzen
	setTimer(Timer_CPCTCM_State3_AR2_ReceiptPDU, 100);

	output(this);
}
/*@@end*/
/*@@frPDU:MsgChannel1.CHASSIS::SpringVlv_Stat_AR:*/
on frPDU MsgChannel1.CHASSIS::TCU_Disp_Rq_AR2
{
	if (TimeToElapse(Timer_CPCTCU_Disp_Rq_AR2_ReceiptPDU) >= 1000/2)
	{
		//Timer nicht zu 50% abgelaufen (d.h. aktiv und Botschaft nicht mit halber Zykluszeit empfangen)
		//außer bei spontan
		@sysvar::CH_Nodes::CH__PDURECEIPT_RECEIVE_CPC_TCU_Disp_Rq_AR2 = 4;
	}
	else
	{
		//Timer zu 50% abgelaufen (d.h. Botschaft mit mindestens halber Zykluszeit empfangen)
		@sysvar::CH_Nodes::CH__PDURECEIPT_RECEIVE_CPC_TCU_Disp_Rq_AR2 = 3;
	}
	//Timer auf Zykluszeit setzen
	setTimer(Timer_CPCTCU_Disp_Rq_AR2_ReceiptPDU, 1000);

	output(this);
}
/*@@end*/
/*@@frPDU:MsgChannel1.CHASSIS::SpringVlv_Stat_AR:*/
on frPDU MsgChannel1.CHASSIS::ThermMngmnt_1_AR2
{
	if (TimeToElapse(Timer_CPCThermMngmnt_1_AR2_ReceiptPDU) >= 1000/2)
	{
		//Timer nicht zu 50% abgelaufen (d.h. aktiv und Botschaft nicht mit halber Zykluszeit empfangen)
		//außer bei spontan
		@sysvar::CH_Nodes::CH__PDURECEIPT_RECEIVE_CPC_ThermMngmnt_1_AR2 = 4;
	}
	else
	{
		//Timer zu 50% abgelaufen (d.h. Botschaft mit mindestens halber Zykluszeit empfangen)
		@sysvar::CH_Nodes::CH__PDURECEIPT_RECEIVE_CPC_ThermMngmnt_1_AR2 = 3;
	}
	//Timer auf Zykluszeit setzen
	setTimer(Timer_CPCThermMngmnt_1_AR2_ReceiptPDU, 1000);

	output(this);
}
/*@@end*/
/*@@frPDU:MsgChannel1.CHASSIS::SpringVlv_Stat_AR:*/
on frPDU MsgChannel1.CHASSIS::ThermMngmnt_4_AR
{
	if (TimeToElapse(Timer_CPCThermMngmnt_4_AR_ReceiptPDU) >= 200/2)
	{
		//Timer nicht zu 50% abgelaufen (d.h. aktiv und Botschaft nicht mit halber Zykluszeit empfangen)
		//außer bei spontan
		@sysvar::CH_Nodes::CH__PDURECEIPT_RECEIVE_CPC_ThermMngmnt_4_AR = 4;
	}
	else
	{
		//Timer zu 50% abgelaufen (d.h. Botschaft mit mindestens halber Zykluszeit empfangen)
		@sysvar::CH_Nodes::CH__PDURECEIPT_RECEIVE_CPC_ThermMngmnt_4_AR = 3;
	}
	//Timer auf Zykluszeit setzen
	setTimer(Timer_CPCThermMngmnt_4_AR_ReceiptPDU, 200);

	output(this);
}
/*@@end*/
/*@@frPDU:MsgChannel1.CHASSIS::SpringVlv_Stat_AR:*/
on frPDU MsgChannel1.CHASSIS::ThermMngmnt_EV_1_AR2
{
	if (TimeToElapse(Timer_CPCThermMngmnt_EV_1_AR2_ReceiptPDU) >= 200/2)
	{
		//Timer nicht zu 50% abgelaufen (d.h. aktiv und Botschaft nicht mit halber Zykluszeit empfangen)
		//außer bei spontan
		@sysvar::CH_Nodes::CH__PDURECEIPT_RECEIVE_CPC_ThermMngmnt_EV_1_AR2 = 4;
	}
	else
	{
		//Timer zu 50% abgelaufen (d.h. Botschaft mit mindestens halber Zykluszeit empfangen)
		@sysvar::CH_Nodes::CH__PDURECEIPT_RECEIVE_CPC_ThermMngmnt_EV_1_AR2 = 3;
	}
	//Timer auf Zykluszeit setzen
	setTimer(Timer_CPCThermMngmnt_EV_1_AR2_ReceiptPDU, 200);

	output(this);
}
/*@@end*/
/*@@frPDU:MsgChannel1.CHASSIS::SpringVlv_Stat_AR:*/
on frPDU MsgChannel1.CHASSIS::VehPwrMngmnt_EMM_Stat2_AR2
{
	if (TimeToElapse(Timer_CPCVehPwrMngmnt_EMM_Stat2_AR2_ReceiptPDU) >= 1000/2)
	{
		//Timer nicht zu 50% abgelaufen (d.h. aktiv und Botschaft nicht mit halber Zykluszeit empfangen)
		//außer bei spontan
		@sysvar::CH_Nodes::CH__PDURECEIPT_RECEIVE_CPC_VehPwrMngmnt_EMM_Stat2_AR2 = 4;
	}
	else
	{
		//Timer zu 50% abgelaufen (d.h. Botschaft mit mindestens halber Zykluszeit empfangen)
		@sysvar::CH_Nodes::CH__PDURECEIPT_RECEIVE_CPC_VehPwrMngmnt_EMM_Stat2_AR2 = 3;
	}
	//Timer auf Zykluszeit setzen
	setTimer(Timer_CPCVehPwrMngmnt_EMM_Stat2_AR2_ReceiptPDU, 1000);

	output(this);
}
/*@@end*/
/*@@frPDU:MsgChannel1.CHASSIS::SpringVlv_Stat_AR:*/
on frPDU MsgChannel1.CHASSIS::VehPwrMngmnt_Rq_AR
{
	if (TimeToElapse(Timer_CPCVehPwrMngmnt_Rq_AR_ReceiptPDU) >= 1000/2)
	{
		//Timer nicht zu 50% abgelaufen (d.h. aktiv und Botschaft nicht mit halber Zykluszeit empfangen)
		//außer bei spontan
		@sysvar::CH_Nodes::CH__PDURECEIPT_RECEIVE_CPC_VehPwrMngmnt_Rq_AR = 4;
	}
	else
	{
		//Timer zu 50% abgelaufen (d.h. Botschaft mit mindestens halber Zykluszeit empfangen)
		@sysvar::CH_Nodes::CH__PDURECEIPT_RECEIVE_CPC_VehPwrMngmnt_Rq_AR = 3;
	}
	//Timer auf Zykluszeit setzen
	setTimer(Timer_CPCVehPwrMngmnt_Rq_AR_ReceiptPDU, 1000);

	output(this);
}
/*@@end*/
/*@@frPDU:MsgChannel1.CHASSIS::SpringVlv_Stat_AR:*/
on frPDU MsgChannel1.CHASSIS::WIA_EngTrq_AR
{
	if (TimeToElapse(Timer_CPCWIA_EngTrq_AR_ReceiptPDU) >= 500/2)
	{
		//Timer nicht zu 50% abgelaufen (d.h. aktiv und Botschaft nicht mit halber Zykluszeit empfangen)
		//außer bei spontan
		@sysvar::CH_Nodes::CH__PDURECEIPT_RECEIVE_CPC_WIA_EngTrq_AR = 4;
	}
	else
	{
		//Timer zu 50% abgelaufen (d.h. Botschaft mit mindestens halber Zykluszeit empfangen)
		@sysvar::CH_Nodes::CH__PDURECEIPT_RECEIVE_CPC_WIA_EngTrq_AR = 3;
	}
	//Timer auf Zykluszeit setzen
	setTimer(Timer_CPCWIA_EngTrq_AR_ReceiptPDU, 500);

	output(this);
}
/*@@end*/
/*@@frPDU:MsgChannel1.CHASSIS::SpringVlv_Stat_AR:*/
on frPDU MsgChannel1.CHASSIS::WPT_Stat2_AR2
{
	if (TimeToElapse(Timer_CPCWPT_Stat2_AR2_ReceiptPDU) >= 200/2)
	{
		//Timer nicht zu 50% abgelaufen (d.h. aktiv und Botschaft nicht mit halber Zykluszeit empfangen)
		//außer bei spontan
		@sysvar::CH_Nodes::CH__PDURECEIPT_RECEIVE_CPC_WPT_Stat2_AR2 = 4;
	}
	else
	{
		//Timer zu 50% abgelaufen (d.h. Botschaft mit mindestens halber Zykluszeit empfangen)
		@sysvar::CH_Nodes::CH__PDURECEIPT_RECEIVE_CPC_WPT_Stat2_AR2 = 3;
	}
	//Timer auf Zykluszeit setzen
	setTimer(Timer_CPCWPT_Stat2_AR2_ReceiptPDU, 200);

	output(this);
}
/*@@end*/
/*@@frPDU:MsgChannel1.CHASSIS::SpringVlv_Stat_AR:*/
on frPDU MsgChannel1.CHASSIS::DPC_Disp_Rq_AMG_AR2
{
	if (TimeToElapse(Timer_DRVUDPC_Disp_Rq_AMG_AR2_ReceiptPDU) >= 100/2)
	{
		//Timer nicht zu 50% abgelaufen (d.h. aktiv und Botschaft nicht mit halber Zykluszeit empfangen)
		//außer bei spontan
		@sysvar::CH_Nodes::CH__PDURECEIPT_RECEIVE_DRVU_DPC_Disp_Rq_AMG_AR2 = 4;
	}
	else
	{
		//Timer zu 50% abgelaufen (d.h. Botschaft mit mindestens halber Zykluszeit empfangen)
		@sysvar::CH_Nodes::CH__PDURECEIPT_RECEIVE_DRVU_DPC_Disp_Rq_AMG_AR2 = 3;
	}
	//Timer auf Zykluszeit setzen
	setTimer(Timer_DRVUDPC_Disp_Rq_AMG_AR2_ReceiptPDU, 100);

	output(this);
}
/*@@end*/
/*@@frPDU:MsgChannel1.CHASSIS::SpringVlv_Stat_AR:*/
on frPDU MsgChannel1.CHASSIS::DPC_IndMd_Stat_AMG_AR2
{
	if (TimeToElapse(Timer_DRVUDPC_IndMd_Stat_AMG_AR2_ReceiptPDU) >= 100/2)
	{
		//Timer nicht zu 50% abgelaufen (d.h. aktiv und Botschaft nicht mit halber Zykluszeit empfangen)
		//außer bei spontan
		@sysvar::CH_Nodes::CH__PDURECEIPT_RECEIVE_DRVU_DPC_IndMd_Stat_AMG_AR2 = 4;
	}
	else
	{
		//Timer zu 50% abgelaufen (d.h. Botschaft mit mindestens halber Zykluszeit empfangen)
		@sysvar::CH_Nodes::CH__PDURECEIPT_RECEIVE_DRVU_DPC_IndMd_Stat_AMG_AR2 = 3;
	}
	//Timer auf Zykluszeit setzen
	setTimer(Timer_DRVUDPC_IndMd_Stat_AMG_AR2_ReceiptPDU, 100);

	output(this);
}
/*@@end*/
/*@@frPDU:MsgChannel1.CHASSIS::SpringVlv_Stat_AR:*/
on frPDU MsgChannel1.CHASSIS::DPC_IndMd_Style2_AMG_AR2
{
	if (TimeToElapse(Timer_DRVUDPC_IndMd_Style2_AMG_AR2_ReceiptPDU) >= 1000/2)
	{
		//Timer nicht zu 50% abgelaufen (d.h. aktiv und Botschaft nicht mit halber Zykluszeit empfangen)
		//außer bei spontan
		@sysvar::CH_Nodes::CH__PDURECEIPT_RECEIVE_DRVU_DPC_IndMd_Style2_AMG_AR2 = 4;
	}
	else
	{
		//Timer zu 50% abgelaufen (d.h. Botschaft mit mindestens halber Zykluszeit empfangen)
		@sysvar::CH_Nodes::CH__PDURECEIPT_RECEIVE_DRVU_DPC_IndMd_Style2_AMG_AR2 = 3;
	}
	//Timer auf Zykluszeit setzen
	setTimer(Timer_DRVUDPC_IndMd_Style2_AMG_AR2_ReceiptPDU, 1000);

	output(this);
}
/*@@end*/
/*@@frPDU:MsgChannel1.CHASSIS::SpringVlv_Stat_AR:*/
on frPDU MsgChannel1.CHASSIS::DPC_IndMd_Style_AMG_AR2
{
	if (TimeToElapse(Timer_DRVUDPC_IndMd_Style_AMG_AR2_ReceiptPDU) >= 1000/2)
	{
		//Timer nicht zu 50% abgelaufen (d.h. aktiv und Botschaft nicht mit halber Zykluszeit empfangen)
		//außer bei spontan
		@sysvar::CH_Nodes::CH__PDURECEIPT_RECEIVE_DRVU_DPC_IndMd_Style_AMG_AR2 = 4;
	}
	else
	{
		//Timer zu 50% abgelaufen (d.h. Botschaft mit mindestens halber Zykluszeit empfangen)
		@sysvar::CH_Nodes::CH__PDURECEIPT_RECEIVE_DRVU_DPC_IndMd_Style_AMG_AR2 = 3;
	}
	//Timer auf Zykluszeit setzen
	setTimer(Timer_DRVUDPC_IndMd_Style_AMG_AR2_ReceiptPDU, 1000);

	output(this);
}
/*@@end*/
/*@@frPDU:MsgChannel1.CHASSIS::SpringVlv_Stat_AR:*/
on frPDU MsgChannel1.CHASSIS::DPC_Master_Rq_AMG_AR2
{
	if (TimeToElapse(Timer_DRVUDPC_Master_Rq_AMG_AR2_ReceiptPDU) >= 100/2)
	{
		//Timer nicht zu 50% abgelaufen (d.h. aktiv und Botschaft nicht mit halber Zykluszeit empfangen)
		//außer bei spontan
		@sysvar::CH_Nodes::CH__PDURECEIPT_RECEIVE_DRVU_DPC_Master_Rq_AMG_AR2 = 4;
	}
	else
	{
		//Timer zu 50% abgelaufen (d.h. Botschaft mit mindestens halber Zykluszeit empfangen)
		@sysvar::CH_Nodes::CH__PDURECEIPT_RECEIVE_DRVU_DPC_Master_Rq_AMG_AR2 = 3;
	}
	//Timer auf Zykluszeit setzen
	setTimer(Timer_DRVUDPC_Master_Rq_AMG_AR2_ReceiptPDU, 100);

	output(this);
}
/*@@end*/
/*@@frPDU:MsgChannel1.CHASSIS::SpringVlv_Stat_AR:*/
on frPDU MsgChannel1.CHASSIS::DRVU_Stat_AR
{
	if (TimeToElapse(Timer_DRVUDRVU_Stat_AR_ReceiptPDU) >= 100/2)
	{
		//Timer nicht zu 50% abgelaufen (d.h. aktiv und Botschaft nicht mit halber Zykluszeit empfangen)
		//außer bei spontan
		@sysvar::CH_Nodes::CH__PDURECEIPT_RECEIVE_DRVU_DRVU_Stat_AR = 4;
	}
	else
	{
		//Timer zu 50% abgelaufen (d.h. Botschaft mit mindestens halber Zykluszeit empfangen)
		@sysvar::CH_Nodes::CH__PDURECEIPT_RECEIVE_DRVU_DRVU_Stat_AR = 3;
	}
	//Timer auf Zykluszeit setzen
	setTimer(Timer_DRVUDRVU_Stat_AR_ReceiptPDU, 100);

	output(this);
}
/*@@end*/
/*@@frPDU:MsgChannel1.CHASSIS::SpringVlv_Stat_AR:*/
on frPDU MsgChannel1.CHASSIS::ESP_EDIFF_Rs_AR
{
	if (TimeToElapse(Timer_DRVUESP_EDIFF_Rs_AR_ReceiptPDU) >= 10/2)
	{
		//Timer nicht zu 50% abgelaufen (d.h. aktiv und Botschaft nicht mit halber Zykluszeit empfangen)
		//außer bei spontan
		@sysvar::CH_Nodes::CH__PDURECEIPT_RECEIVE_DRVU_ESP_EDIFF_Rs_AR = 4;
	}
	else
	{
		//Timer zu 50% abgelaufen (d.h. Botschaft mit mindestens halber Zykluszeit empfangen)
		@sysvar::CH_Nodes::CH__PDURECEIPT_RECEIVE_DRVU_ESP_EDIFF_Rs_AR = 3;
	}
	//Timer auf Zykluszeit setzen
	setTimer(Timer_DRVUESP_EDIFF_Rs_AR_ReceiptPDU, 10);

	output(this);
}
/*@@end*/
/*@@frPDU:MsgChannel1.CHASSIS::SpringVlv_Stat_AR:*/
on frPDU MsgChannel1.CHASSIS::ActvComf_Rq_AR2
{
	if (TimeToElapse(Timer_EISActvComf_Rq_AR2_ReceiptPDU) >= 1000/2)
	{
		//Timer nicht zu 50% abgelaufen (d.h. aktiv und Botschaft nicht mit halber Zykluszeit empfangen)
		//außer bei spontan
		@sysvar::CH_Nodes::CH__PDURECEIPT_RECEIVE_EIS_ActvComf_Rq_AR2 = 4;
	}
	else
	{
		//Timer zu 50% abgelaufen (d.h. Botschaft mit mindestens halber Zykluszeit empfangen)
		@sysvar::CH_Nodes::CH__PDURECEIPT_RECEIVE_EIS_ActvComf_Rq_AR2 = 3;
	}
	//Timer auf Zykluszeit setzen
	setTimer(Timer_EISActvComf_Rq_AR2_ReceiptPDU, 1000);

	output(this);
}
/*@@end*/
/*@@frPDU:MsgChannel1.CHASSIS::SpringVlv_Stat_AR:*/
on frPDU MsgChannel1.CHASSIS::ADAS_CURRENT_ATTRIBUTES_AR
{
	if (TimeToElapse(Timer_EISADAS_CURRENT_ATTRIBUTES_AR_ReceiptPDU) >= 1000/2)
	{
		//Timer nicht zu 50% abgelaufen (d.h. aktiv und Botschaft nicht mit halber Zykluszeit empfangen)
		//außer bei spontan
		@sysvar::CH_Nodes::CH__PDURECEIPT_RECEIVE_EIS_ADAS_CURRENT_ATTRIBUTES_AR = 4;
	}
	else
	{
		//Timer zu 50% abgelaufen (d.h. Botschaft mit mindestens halber Zykluszeit empfangen)
		@sysvar::CH_Nodes::CH__PDURECEIPT_RECEIVE_EIS_ADAS_CURRENT_ATTRIBUTES_AR = 3;
	}
	//Timer auf Zykluszeit setzen
	setTimer(Timer_EISADAS_CURRENT_ATTRIBUTES_AR_ReceiptPDU, 1000);

	output(this);
}
/*@@end*/
/*@@frPDU:MsgChannel1.CHASSIS::SpringVlv_Stat_AR:*/
on frPDU MsgChannel1.CHASSIS::ADAS_POSITION_AR
{
	if (TimeToElapse(Timer_EISADAS_POSITION_AR_ReceiptPDU) >= 500/2)
	{
		//Timer nicht zu 50% abgelaufen (d.h. aktiv und Botschaft nicht mit halber Zykluszeit empfangen)
		//außer bei spontan
		@sysvar::CH_Nodes::CH__PDURECEIPT_RECEIVE_EIS_ADAS_POSITION_AR = 4;
	}
	else
	{
		//Timer zu 50% abgelaufen (d.h. Botschaft mit mindestens halber Zykluszeit empfangen)
		@sysvar::CH_Nodes::CH__PDURECEIPT_RECEIVE_EIS_ADAS_POSITION_AR = 3;
	}
	//Timer auf Zykluszeit setzen
	setTimer(Timer_EISADAS_POSITION_AR_ReceiptPDU, 500);

	output(this);
}
/*@@end*/
/*@@frPDU:MsgChannel1.CHASSIS::SpringVlv_Stat_AR:*/
on frPDU MsgChannel1.CHASSIS::ADAS_PREDICTION_AR
{
	if (TimeToElapse(Timer_EISADAS_PREDICTION_AR_ReceiptPDU) >= 100/2)
	{
		//Timer nicht zu 50% abgelaufen (d.h. aktiv und Botschaft nicht mit halber Zykluszeit empfangen)
		//außer bei spontan
		@sysvar::CH_Nodes::CH__PDURECEIPT_RECEIVE_EIS_ADAS_PREDICTION_AR = 4;
	}
	else
	{
		//Timer zu 50% abgelaufen (d.h. Botschaft mit mindestens halber Zykluszeit empfangen)
		@sysvar::CH_Nodes::CH__PDURECEIPT_RECEIVE_EIS_ADAS_PREDICTION_AR = 3;
	}
	//Timer auf Zykluszeit setzen
	setTimer(Timer_EISADAS_PREDICTION_AR_ReceiptPDU, 100);
	if (TimeToElapse(Timer_EISADAS_PREDICTION_AR_ReceiptPDU) >= 100/2)
	{
		//Timer nicht zu 50% abgelaufen (d.h. aktiv und Botschaft nicht mit halber Zykluszeit empfangen)
		//außer bei spontan
		@sysvar::CH_Nodes::CH__PDURECEIPT_RECEIVE_EIS_ADAS_PREDICTION_AR = 4;
	}
	else
	{
		//Timer zu 50% abgelaufen (d.h. Botschaft mit mindestens halber Zykluszeit empfangen)
		@sysvar::CH_Nodes::CH__PDURECEIPT_RECEIVE_EIS_ADAS_PREDICTION_AR = 3;
	}
	//Timer auf Zykluszeit setzen
	setTimer(Timer_EISADAS_PREDICTION_AR_ReceiptPDU, 100);
	if (TimeToElapse(Timer_EISADAS_PREDICTION_AR_ReceiptPDU) >= 100/2)
	{
		//Timer nicht zu 50% abgelaufen (d.h. aktiv und Botschaft nicht mit halber Zykluszeit empfangen)
		//außer bei spontan
		@sysvar::CH_Nodes::CH__PDURECEIPT_RECEIVE_EIS_ADAS_PREDICTION_AR = 4;
	}
	else
	{
		//Timer zu 50% abgelaufen (d.h. Botschaft mit mindestens halber Zykluszeit empfangen)
		@sysvar::CH_Nodes::CH__PDURECEIPT_RECEIVE_EIS_ADAS_PREDICTION_AR = 3;
	}
	//Timer auf Zykluszeit setzen
	setTimer(Timer_EISADAS_PREDICTION_AR_ReceiptPDU, 100);
	if (TimeToElapse(Timer_EISADAS_PREDICTION_AR_ReceiptPDU) >= 100/2)
	{
		//Timer nicht zu 50% abgelaufen (d.h. aktiv und Botschaft nicht mit halber Zykluszeit empfangen)
		//außer bei spontan
		@sysvar::CH_Nodes::CH__PDURECEIPT_RECEIVE_EIS_ADAS_PREDICTION_AR = 4;
	}
	else
	{
		//Timer zu 50% abgelaufen (d.h. Botschaft mit mindestens halber Zykluszeit empfangen)
		@sysvar::CH_Nodes::CH__PDURECEIPT_RECEIVE_EIS_ADAS_PREDICTION_AR = 3;
	}
	//Timer auf Zykluszeit setzen
	setTimer(Timer_EISADAS_PREDICTION_AR_ReceiptPDU, 100);

	output(this);
}
/*@@end*/
/*@@frPDU:MsgChannel1.CHASSIS::SpringVlv_Stat_AR:*/
on frPDU MsgChannel1.CHASSIS::ADAS_PROFILE_LONG_AR
{
	if (TimeToElapse(Timer_EISADAS_PROFILE_LONG_AR_ReceiptPDU) >= 500/2)
	{
		//Timer nicht zu 50% abgelaufen (d.h. aktiv und Botschaft nicht mit halber Zykluszeit empfangen)
		//außer bei spontan
		@sysvar::CH_Nodes::CH__PDURECEIPT_RECEIVE_EIS_ADAS_PROFILE_LONG_AR = 4;
	}
	else
	{
		//Timer zu 50% abgelaufen (d.h. Botschaft mit mindestens halber Zykluszeit empfangen)
		@sysvar::CH_Nodes::CH__PDURECEIPT_RECEIVE_EIS_ADAS_PROFILE_LONG_AR = 3;
	}
	//Timer auf Zykluszeit setzen
	setTimer(Timer_EISADAS_PROFILE_LONG_AR_ReceiptPDU, 500);
	if (TimeToElapse(Timer_EISADAS_PROFILE_LONG_AR_ReceiptPDU) >= 500/2)
	{
		//Timer nicht zu 50% abgelaufen (d.h. aktiv und Botschaft nicht mit halber Zykluszeit empfangen)
		//außer bei spontan
		@sysvar::CH_Nodes::CH__PDURECEIPT_RECEIVE_EIS_ADAS_PROFILE_LONG_AR = 4;
	}
	else
	{
		//Timer zu 50% abgelaufen (d.h. Botschaft mit mindestens halber Zykluszeit empfangen)
		@sysvar::CH_Nodes::CH__PDURECEIPT_RECEIVE_EIS_ADAS_PROFILE_LONG_AR = 3;
	}
	//Timer auf Zykluszeit setzen
	setTimer(Timer_EISADAS_PROFILE_LONG_AR_ReceiptPDU, 500);
	if (TimeToElapse(Timer_EISADAS_PROFILE_LONG_AR_ReceiptPDU) >= 500/2)
	{
		//Timer nicht zu 50% abgelaufen (d.h. aktiv und Botschaft nicht mit halber Zykluszeit empfangen)
		//außer bei spontan
		@sysvar::CH_Nodes::CH__PDURECEIPT_RECEIVE_EIS_ADAS_PROFILE_LONG_AR = 4;
	}
	else
	{
		//Timer zu 50% abgelaufen (d.h. Botschaft mit mindestens halber Zykluszeit empfangen)
		@sysvar::CH_Nodes::CH__PDURECEIPT_RECEIVE_EIS_ADAS_PROFILE_LONG_AR = 3;
	}
	//Timer auf Zykluszeit setzen
	setTimer(Timer_EISADAS_PROFILE_LONG_AR_ReceiptPDU, 500);
	if (TimeToElapse(Timer_EISADAS_PROFILE_LONG_AR_ReceiptPDU) >= 500/2)
	{
		//Timer nicht zu 50% abgelaufen (d.h. aktiv und Botschaft nicht mit halber Zykluszeit empfangen)
		//außer bei spontan
		@sysvar::CH_Nodes::CH__PDURECEIPT_RECEIVE_EIS_ADAS_PROFILE_LONG_AR = 4;
	}
	else
	{
		//Timer zu 50% abgelaufen (d.h. Botschaft mit mindestens halber Zykluszeit empfangen)
		@sysvar::CH_Nodes::CH__PDURECEIPT_RECEIVE_EIS_ADAS_PROFILE_LONG_AR = 3;
	}
	//Timer auf Zykluszeit setzen
	setTimer(Timer_EISADAS_PROFILE_LONG_AR_ReceiptPDU, 500);
	if (TimeToElapse(Timer_EISADAS_PROFILE_LONG_AR_ReceiptPDU) >= 500/2)
	{
		//Timer nicht zu 50% abgelaufen (d.h. aktiv und Botschaft nicht mit halber Zykluszeit empfangen)
		//außer bei spontan
		@sysvar::CH_Nodes::CH__PDURECEIPT_RECEIVE_EIS_ADAS_PROFILE_LONG_AR = 4;
	}
	else
	{
		//Timer zu 50% abgelaufen (d.h. Botschaft mit mindestens halber Zykluszeit empfangen)
		@sysvar::CH_Nodes::CH__PDURECEIPT_RECEIVE_EIS_ADAS_PROFILE_LONG_AR = 3;
	}
	//Timer auf Zykluszeit setzen
	setTimer(Timer_EISADAS_PROFILE_LONG_AR_ReceiptPDU, 500);
	if (TimeToElapse(Timer_EISADAS_PROFILE_LONG_AR_ReceiptPDU) >= 500/2)
	{
		//Timer nicht zu 50% abgelaufen (d.h. aktiv und Botschaft nicht mit halber Zykluszeit empfangen)
		//außer bei spontan
		@sysvar::CH_Nodes::CH__PDURECEIPT_RECEIVE_EIS_ADAS_PROFILE_LONG_AR = 4;
	}
	else
	{
		//Timer zu 50% abgelaufen (d.h. Botschaft mit mindestens halber Zykluszeit empfangen)
		@sysvar::CH_Nodes::CH__PDURECEIPT_RECEIVE_EIS_ADAS_PROFILE_LONG_AR = 3;
	}
	//Timer auf Zykluszeit setzen
	setTimer(Timer_EISADAS_PROFILE_LONG_AR_ReceiptPDU, 500);

	output(this);
}
/*@@end*/
/*@@frPDU:MsgChannel1.CHASSIS::SpringVlv_Stat_AR:*/
on frPDU MsgChannel1.CHASSIS::ADAS_PROFILE_SHORT_AR
{
	if (TimeToElapse(Timer_EISADAS_PROFILE_SHORT_AR_ReceiptPDU) >= 100/2)
	{
		//Timer nicht zu 50% abgelaufen (d.h. aktiv und Botschaft nicht mit halber Zykluszeit empfangen)
		//außer bei spontan
		@sysvar::CH_Nodes::CH__PDURECEIPT_RECEIVE_EIS_ADAS_PROFILE_SHORT_AR = 4;
	}
	else
	{
		//Timer zu 50% abgelaufen (d.h. Botschaft mit mindestens halber Zykluszeit empfangen)
		@sysvar::CH_Nodes::CH__PDURECEIPT_RECEIVE_EIS_ADAS_PROFILE_SHORT_AR = 3;
	}
	//Timer auf Zykluszeit setzen
	setTimer(Timer_EISADAS_PROFILE_SHORT_AR_ReceiptPDU, 100);
	if (TimeToElapse(Timer_EISADAS_PROFILE_SHORT_AR_ReceiptPDU) >= 100/2)
	{
		//Timer nicht zu 50% abgelaufen (d.h. aktiv und Botschaft nicht mit halber Zykluszeit empfangen)
		//außer bei spontan
		@sysvar::CH_Nodes::CH__PDURECEIPT_RECEIVE_EIS_ADAS_PROFILE_SHORT_AR = 4;
	}
	else
	{
		//Timer zu 50% abgelaufen (d.h. Botschaft mit mindestens halber Zykluszeit empfangen)
		@sysvar::CH_Nodes::CH__PDURECEIPT_RECEIVE_EIS_ADAS_PROFILE_SHORT_AR = 3;
	}
	//Timer auf Zykluszeit setzen
	setTimer(Timer_EISADAS_PROFILE_SHORT_AR_ReceiptPDU, 100);
	if (TimeToElapse(Timer_EISADAS_PROFILE_SHORT_AR_ReceiptPDU) >= 100/2)
	{
		//Timer nicht zu 50% abgelaufen (d.h. aktiv und Botschaft nicht mit halber Zykluszeit empfangen)
		//außer bei spontan
		@sysvar::CH_Nodes::CH__PDURECEIPT_RECEIVE_EIS_ADAS_PROFILE_SHORT_AR = 4;
	}
	else
	{
		//Timer zu 50% abgelaufen (d.h. Botschaft mit mindestens halber Zykluszeit empfangen)
		@sysvar::CH_Nodes::CH__PDURECEIPT_RECEIVE_EIS_ADAS_PROFILE_SHORT_AR = 3;
	}
	//Timer auf Zykluszeit setzen
	setTimer(Timer_EISADAS_PROFILE_SHORT_AR_ReceiptPDU, 100);
	if (TimeToElapse(Timer_EISADAS_PROFILE_SHORT_AR_ReceiptPDU) >= 100/2)
	{
		//Timer nicht zu 50% abgelaufen (d.h. aktiv und Botschaft nicht mit halber Zykluszeit empfangen)
		//außer bei spontan
		@sysvar::CH_Nodes::CH__PDURECEIPT_RECEIVE_EIS_ADAS_PROFILE_SHORT_AR = 4;
	}
	else
	{
		//Timer zu 50% abgelaufen (d.h. Botschaft mit mindestens halber Zykluszeit empfangen)
		@sysvar::CH_Nodes::CH__PDURECEIPT_RECEIVE_EIS_ADAS_PROFILE_SHORT_AR = 3;
	}
	//Timer auf Zykluszeit setzen
	setTimer(Timer_EISADAS_PROFILE_SHORT_AR_ReceiptPDU, 100);
	if (TimeToElapse(Timer_EISADAS_PROFILE_SHORT_AR_ReceiptPDU) >= 100/2)
	{
		//Timer nicht zu 50% abgelaufen (d.h. aktiv und Botschaft nicht mit halber Zykluszeit empfangen)
		//außer bei spontan
		@sysvar::CH_Nodes::CH__PDURECEIPT_RECEIVE_EIS_ADAS_PROFILE_SHORT_AR = 4;
	}
	else
	{
		//Timer zu 50% abgelaufen (d.h. Botschaft mit mindestens halber Zykluszeit empfangen)
		@sysvar::CH_Nodes::CH__PDURECEIPT_RECEIVE_EIS_ADAS_PROFILE_SHORT_AR = 3;
	}
	//Timer auf Zykluszeit setzen
	setTimer(Timer_EISADAS_PROFILE_SHORT_AR_ReceiptPDU, 100);
	if (TimeToElapse(Timer_EISADAS_PROFILE_SHORT_AR_ReceiptPDU) >= 100/2)
	{
		//Timer nicht zu 50% abgelaufen (d.h. aktiv und Botschaft nicht mit halber Zykluszeit empfangen)
		//außer bei spontan
		@sysvar::CH_Nodes::CH__PDURECEIPT_RECEIVE_EIS_ADAS_PROFILE_SHORT_AR = 4;
	}
	else
	{
		//Timer zu 50% abgelaufen (d.h. Botschaft mit mindestens halber Zykluszeit empfangen)
		@sysvar::CH_Nodes::CH__PDURECEIPT_RECEIVE_EIS_ADAS_PROFILE_SHORT_AR = 3;
	}
	//Timer auf Zykluszeit setzen
	setTimer(Timer_EISADAS_PROFILE_SHORT_AR_ReceiptPDU, 100);
	if (TimeToElapse(Timer_EISADAS_PROFILE_SHORT_AR_ReceiptPDU) >= 100/2)
	{
		//Timer nicht zu 50% abgelaufen (d.h. aktiv und Botschaft nicht mit halber Zykluszeit empfangen)
		//außer bei spontan
		@sysvar::CH_Nodes::CH__PDURECEIPT_RECEIVE_EIS_ADAS_PROFILE_SHORT_AR = 4;
	}
	else
	{
		//Timer zu 50% abgelaufen (d.h. Botschaft mit mindestens halber Zykluszeit empfangen)
		@sysvar::CH_Nodes::CH__PDURECEIPT_RECEIVE_EIS_ADAS_PROFILE_SHORT_AR = 3;
	}
	//Timer auf Zykluszeit setzen
	setTimer(Timer_EISADAS_PROFILE_SHORT_AR_ReceiptPDU, 100);
	if (TimeToElapse(Timer_EISADAS_PROFILE_SHORT_AR_ReceiptPDU) >= 100/2)
	{
		//Timer nicht zu 50% abgelaufen (d.h. aktiv und Botschaft nicht mit halber Zykluszeit empfangen)
		//außer bei spontan
		@sysvar::CH_Nodes::CH__PDURECEIPT_RECEIVE_EIS_ADAS_PROFILE_SHORT_AR = 4;
	}
	else
	{
		//Timer zu 50% abgelaufen (d.h. Botschaft mit mindestens halber Zykluszeit empfangen)
		@sysvar::CH_Nodes::CH__PDURECEIPT_RECEIVE_EIS_ADAS_PROFILE_SHORT_AR = 3;
	}
	//Timer auf Zykluszeit setzen
	setTimer(Timer_EISADAS_PROFILE_SHORT_AR_ReceiptPDU, 100);
	if (TimeToElapse(Timer_EISADAS_PROFILE_SHORT_AR_ReceiptPDU) >= 100/2)
	{
		//Timer nicht zu 50% abgelaufen (d.h. aktiv und Botschaft nicht mit halber Zykluszeit empfangen)
		//außer bei spontan
		@sysvar::CH_Nodes::CH__PDURECEIPT_RECEIVE_EIS_ADAS_PROFILE_SHORT_AR = 4;
	}
	else
	{
		//Timer zu 50% abgelaufen (d.h. Botschaft mit mindestens halber Zykluszeit empfangen)
		@sysvar::CH_Nodes::CH__PDURECEIPT_RECEIVE_EIS_ADAS_PROFILE_SHORT_AR = 3;
	}
	//Timer auf Zykluszeit setzen
	setTimer(Timer_EISADAS_PROFILE_SHORT_AR_ReceiptPDU, 100);
	if (TimeToElapse(Timer_EISADAS_PROFILE_SHORT_AR_ReceiptPDU) >= 100/2)
	{
		//Timer nicht zu 50% abgelaufen (d.h. aktiv und Botschaft nicht mit halber Zykluszeit empfangen)
		//außer bei spontan
		@sysvar::CH_Nodes::CH__PDURECEIPT_RECEIVE_EIS_ADAS_PROFILE_SHORT_AR = 4;
	}
	else
	{
		//Timer zu 50% abgelaufen (d.h. Botschaft mit mindestens halber Zykluszeit empfangen)
		@sysvar::CH_Nodes::CH__PDURECEIPT_RECEIVE_EIS_ADAS_PROFILE_SHORT_AR = 3;
	}
	//Timer auf Zykluszeit setzen
	setTimer(Timer_EISADAS_PROFILE_SHORT_AR_ReceiptPDU, 100);

	output(this);
}
/*@@end*/
/*@@frPDU:MsgChannel1.CHASSIS::SpringVlv_Stat_AR:*/
on frPDU MsgChannel1.CHASSIS::ADASLR_POSITION_AR
{
	if (TimeToElapse(Timer_EISADASLR_POSITION_AR_ReceiptPDU) >= 5000/2)
	{
		//Timer nicht zu 50% abgelaufen (d.h. aktiv und Botschaft nicht mit halber Zykluszeit empfangen)
		//außer bei spontan
		@sysvar::CH_Nodes::CH__PDURECEIPT_RECEIVE_EIS_ADASLR_POSITION_AR = 4;
	}
	else
	{
		//Timer zu 50% abgelaufen (d.h. Botschaft mit mindestens halber Zykluszeit empfangen)
		@sysvar::CH_Nodes::CH__PDURECEIPT_RECEIVE_EIS_ADASLR_POSITION_AR = 3;
	}
	//Timer auf Zykluszeit setzen
	setTimer(Timer_EISADASLR_POSITION_AR_ReceiptPDU, 5000);

	output(this);
}
/*@@end*/
/*@@frPDU:MsgChannel1.CHASSIS::SpringVlv_Stat_AR:*/
on frPDU MsgChannel1.CHASSIS::ADASLR_PROFILE_LONG_AR
{
	if (TimeToElapse(Timer_EISADASLR_PROFILE_LONG_AR_ReceiptPDU) >= 1000/2)
	{
		//Timer nicht zu 50% abgelaufen (d.h. aktiv und Botschaft nicht mit halber Zykluszeit empfangen)
		//außer bei spontan
		@sysvar::CH_Nodes::CH__PDURECEIPT_RECEIVE_EIS_ADASLR_PROFILE_LONG_AR = 4;
	}
	else
	{
		//Timer zu 50% abgelaufen (d.h. Botschaft mit mindestens halber Zykluszeit empfangen)
		@sysvar::CH_Nodes::CH__PDURECEIPT_RECEIVE_EIS_ADASLR_PROFILE_LONG_AR = 3;
	}
	//Timer auf Zykluszeit setzen
	setTimer(Timer_EISADASLR_PROFILE_LONG_AR_ReceiptPDU, 1000);
	if (TimeToElapse(Timer_EISADASLR_PROFILE_LONG_AR_ReceiptPDU) >= 1000/2)
	{
		//Timer nicht zu 50% abgelaufen (d.h. aktiv und Botschaft nicht mit halber Zykluszeit empfangen)
		//außer bei spontan
		@sysvar::CH_Nodes::CH__PDURECEIPT_RECEIVE_EIS_ADASLR_PROFILE_LONG_AR = 4;
	}
	else
	{
		//Timer zu 50% abgelaufen (d.h. Botschaft mit mindestens halber Zykluszeit empfangen)
		@sysvar::CH_Nodes::CH__PDURECEIPT_RECEIVE_EIS_ADASLR_PROFILE_LONG_AR = 3;
	}
	//Timer auf Zykluszeit setzen
	setTimer(Timer_EISADASLR_PROFILE_LONG_AR_ReceiptPDU, 1000);
	if (TimeToElapse(Timer_EISADASLR_PROFILE_LONG_AR_ReceiptPDU) >= 1000/2)
	{
		//Timer nicht zu 50% abgelaufen (d.h. aktiv und Botschaft nicht mit halber Zykluszeit empfangen)
		//außer bei spontan
		@sysvar::CH_Nodes::CH__PDURECEIPT_RECEIVE_EIS_ADASLR_PROFILE_LONG_AR = 4;
	}
	else
	{
		//Timer zu 50% abgelaufen (d.h. Botschaft mit mindestens halber Zykluszeit empfangen)
		@sysvar::CH_Nodes::CH__PDURECEIPT_RECEIVE_EIS_ADASLR_PROFILE_LONG_AR = 3;
	}
	//Timer auf Zykluszeit setzen
	setTimer(Timer_EISADASLR_PROFILE_LONG_AR_ReceiptPDU, 1000);
	if (TimeToElapse(Timer_EISADASLR_PROFILE_LONG_AR_ReceiptPDU) >= 1000/2)
	{
		//Timer nicht zu 50% abgelaufen (d.h. aktiv und Botschaft nicht mit halber Zykluszeit empfangen)
		//außer bei spontan
		@sysvar::CH_Nodes::CH__PDURECEIPT_RECEIVE_EIS_ADASLR_PROFILE_LONG_AR = 4;
	}
	else
	{
		//Timer zu 50% abgelaufen (d.h. Botschaft mit mindestens halber Zykluszeit empfangen)
		@sysvar::CH_Nodes::CH__PDURECEIPT_RECEIVE_EIS_ADASLR_PROFILE_LONG_AR = 3;
	}
	//Timer auf Zykluszeit setzen
	setTimer(Timer_EISADASLR_PROFILE_LONG_AR_ReceiptPDU, 1000);
	if (TimeToElapse(Timer_EISADASLR_PROFILE_LONG_AR_ReceiptPDU) >= 1000/2)
	{
		//Timer nicht zu 50% abgelaufen (d.h. aktiv und Botschaft nicht mit halber Zykluszeit empfangen)
		//außer bei spontan
		@sysvar::CH_Nodes::CH__PDURECEIPT_RECEIVE_EIS_ADASLR_PROFILE_LONG_AR = 4;
	}
	else
	{
		//Timer zu 50% abgelaufen (d.h. Botschaft mit mindestens halber Zykluszeit empfangen)
		@sysvar::CH_Nodes::CH__PDURECEIPT_RECEIVE_EIS_ADASLR_PROFILE_LONG_AR = 3;
	}
	//Timer auf Zykluszeit setzen
	setTimer(Timer_EISADASLR_PROFILE_LONG_AR_ReceiptPDU, 1000);
	if (TimeToElapse(Timer_EISADASLR_PROFILE_LONG_AR_ReceiptPDU) >= 1000/2)
	{
		//Timer nicht zu 50% abgelaufen (d.h. aktiv und Botschaft nicht mit halber Zykluszeit empfangen)
		//außer bei spontan
		@sysvar::CH_Nodes::CH__PDURECEIPT_RECEIVE_EIS_ADASLR_PROFILE_LONG_AR = 4;
	}
	else
	{
		//Timer zu 50% abgelaufen (d.h. Botschaft mit mindestens halber Zykluszeit empfangen)
		@sysvar::CH_Nodes::CH__PDURECEIPT_RECEIVE_EIS_ADASLR_PROFILE_LONG_AR = 3;
	}
	//Timer auf Zykluszeit setzen
	setTimer(Timer_EISADASLR_PROFILE_LONG_AR_ReceiptPDU, 1000);

	output(this);
}
/*@@end*/
/*@@frPDU:MsgChannel1.CHASSIS::SpringVlv_Stat_AR:*/
on frPDU MsgChannel1.CHASSIS::Assyst_Rq_AR2
{
	if (TimeToElapse(Timer_EISAssyst_Rq_AR2_ReceiptPDU) >= 1000/2)
	{
		//Timer nicht zu 50% abgelaufen (d.h. aktiv und Botschaft nicht mit halber Zykluszeit empfangen)
		//außer bei spontan
		@sysvar::CH_Nodes::CH__PDURECEIPT_RECEIVE_EIS_Assyst_Rq_AR2 = 4;
	}
	else
	{
		//Timer zu 50% abgelaufen (d.h. Botschaft mit mindestens halber Zykluszeit empfangen)
		@sysvar::CH_Nodes::CH__PDURECEIPT_RECEIVE_EIS_Assyst_Rq_AR2 = 3;
	}
	//Timer auf Zykluszeit setzen
	setTimer(Timer_EISAssyst_Rq_AR2_ReceiptPDU, 1000);

	output(this);
}
/*@@end*/
/*@@frPDU:MsgChannel1.CHASSIS::SpringVlv_Stat_AR:*/
on frPDU MsgChannel1.CHASSIS::BC_F_Disp_Rq_AR
{
	if (TimeToElapse(Timer_EISBC_F_Disp_Rq_AR_ReceiptPDU) >= 1000/2)
	{
		//Timer nicht zu 50% abgelaufen (d.h. aktiv und Botschaft nicht mit halber Zykluszeit empfangen)
		//außer bei spontan
		@sysvar::CH_Nodes::CH__PDURECEIPT_RECEIVE_EIS_BC_F_Disp_Rq_AR = 4;
	}
	else
	{
		//Timer zu 50% abgelaufen (d.h. Botschaft mit mindestens halber Zykluszeit empfangen)
		@sysvar::CH_Nodes::CH__PDURECEIPT_RECEIVE_EIS_BC_F_Disp_Rq_AR = 3;
	}
	//Timer auf Zykluszeit setzen
	setTimer(Timer_EISBC_F_Disp_Rq_AR_ReceiptPDU, 1000);

	output(this);
}
/*@@end*/
/*@@frPDU:MsgChannel1.CHASSIS::SpringVlv_Stat_AR:*/
on frPDU MsgChannel1.CHASSIS::BC_F_Stat1_AR
{
	if (TimeToElapse(Timer_EISBC_F_Stat1_AR_ReceiptPDU) >= 100/2)
	{
		//Timer nicht zu 50% abgelaufen (d.h. aktiv und Botschaft nicht mit halber Zykluszeit empfangen)
		//außer bei spontan
		@sysvar::CH_Nodes::CH__PDURECEIPT_RECEIVE_EIS_BC_F_Stat1_AR = 4;
	}
	else
	{
		//Timer zu 50% abgelaufen (d.h. Botschaft mit mindestens halber Zykluszeit empfangen)
		@sysvar::CH_Nodes::CH__PDURECEIPT_RECEIVE_EIS_BC_F_Stat1_AR = 3;
	}
	//Timer auf Zykluszeit setzen
	setTimer(Timer_EISBC_F_Stat1_AR_ReceiptPDU, 100);

	output(this);
}
/*@@end*/
/*@@frPDU:MsgChannel1.CHASSIS::SpringVlv_Stat_AR:*/
on frPDU MsgChannel1.CHASSIS::BC_F_Stat2_AR2
{
	if (TimeToElapse(Timer_EISBC_F_Stat2_AR2_ReceiptPDU) >= 500/2)
	{
		//Timer nicht zu 50% abgelaufen (d.h. aktiv und Botschaft nicht mit halber Zykluszeit empfangen)
		//außer bei spontan
		@sysvar::CH_Nodes::CH__PDURECEIPT_RECEIVE_EIS_BC_F_Stat2_AR2 = 4;
	}
	else
	{
		//Timer zu 50% abgelaufen (d.h. Botschaft mit mindestens halber Zykluszeit empfangen)
		@sysvar::CH_Nodes::CH__PDURECEIPT_RECEIVE_EIS_BC_F_Stat2_AR2 = 3;
	}
	//Timer auf Zykluszeit setzen
	setTimer(Timer_EISBC_F_Stat2_AR2_ReceiptPDU, 500);

	output(this);
}
/*@@end*/
/*@@frPDU:MsgChannel1.CHASSIS::SpringVlv_Stat_AR:*/
on frPDU MsgChannel1.CHASSIS::BC_R_Stat1_AR
{
	if (TimeToElapse(Timer_EISBC_R_Stat1_AR_ReceiptPDU) >= 200/2)
	{
		//Timer nicht zu 50% abgelaufen (d.h. aktiv und Botschaft nicht mit halber Zykluszeit empfangen)
		//außer bei spontan
		@sysvar::CH_Nodes::CH__PDURECEIPT_RECEIVE_EIS_BC_R_Stat1_AR = 4;
	}
	else
	{
		//Timer zu 50% abgelaufen (d.h. Botschaft mit mindestens halber Zykluszeit empfangen)
		@sysvar::CH_Nodes::CH__PDURECEIPT_RECEIVE_EIS_BC_R_Stat1_AR = 3;
	}
	//Timer auf Zykluszeit setzen
	setTimer(Timer_EISBC_R_Stat1_AR_ReceiptPDU, 200);

	output(this);
}
/*@@end*/
/*@@frPDU:MsgChannel1.CHASSIS::SpringVlv_Stat_AR:*/
on frPDU MsgChannel1.CHASSIS::BLSM_Disp_Stat_AR
{
	if (TimeToElapse(Timer_EISBLSM_Disp_Stat_AR_ReceiptPDU) >= 5/2)
	{
		//Timer nicht zu 50% abgelaufen (d.h. aktiv und Botschaft nicht mit halber Zykluszeit empfangen)
		//außer bei spontan
		@sysvar::CH_Nodes::CH__PDURECEIPT_RECEIVE_EIS_BLSM_Disp_Stat_AR = 4;
	}
	else
	{
		//Timer zu 50% abgelaufen (d.h. Botschaft mit mindestens halber Zykluszeit empfangen)
		@sysvar::CH_Nodes::CH__PDURECEIPT_RECEIVE_EIS_BLSM_Disp_Stat_AR = 3;
	}
	//Timer auf Zykluszeit setzen
	setTimer(Timer_EISBLSM_Disp_Stat_AR_ReceiptPDU, 5);

	output(this);
}
/*@@end*/
/*@@frPDU:MsgChannel1.CHASSIS::SpringVlv_Stat_AR:*/
on frPDU MsgChannel1.CHASSIS::BODY_CHASSIS_R1_AR
{
	if (TimeToElapse(Timer_EISBODY_CHASSIS_R1_AR_ReceiptPDU) >= 500/2)
	{
		//Timer nicht zu 50% abgelaufen (d.h. aktiv und Botschaft nicht mit halber Zykluszeit empfangen)
		//außer bei spontan
		@sysvar::CH_Nodes::CH__PDURECEIPT_RECEIVE_EIS_BODY_CHASSIS_R1_AR = 4;
	}
	else
	{
		//Timer zu 50% abgelaufen (d.h. Botschaft mit mindestens halber Zykluszeit empfangen)
		@sysvar::CH_Nodes::CH__PDURECEIPT_RECEIVE_EIS_BODY_CHASSIS_R1_AR = 3;
	}
	//Timer auf Zykluszeit setzen
	setTimer(Timer_EISBODY_CHASSIS_R1_AR_ReceiptPDU, 500);

	output(this);
}
/*@@end*/
/*@@frPDU:MsgChannel1.CHASSIS::SpringVlv_Stat_AR:*/
on frPDU MsgChannel1.CHASSIS::BSM_Disp_Warn_Rq_AR2
{
	if (TimeToElapse(Timer_EISBSM_Disp_Warn_Rq_AR2_ReceiptPDU) >= 200/2)
	{
		//Timer nicht zu 50% abgelaufen (d.h. aktiv und Botschaft nicht mit halber Zykluszeit empfangen)
		//außer bei spontan
		@sysvar::CH_Nodes::CH__PDURECEIPT_RECEIVE_EIS_BSM_Disp_Warn_Rq_AR2 = 4;
	}
	else
	{
		//Timer zu 50% abgelaufen (d.h. Botschaft mit mindestens halber Zykluszeit empfangen)
		@sysvar::CH_Nodes::CH__PDURECEIPT_RECEIVE_EIS_BSM_Disp_Warn_Rq_AR2 = 3;
	}
	//Timer auf Zykluszeit setzen
	setTimer(Timer_EISBSM_Disp_Warn_Rq_AR2_ReceiptPDU, 200);

	output(this);
}
/*@@end*/
/*@@frPDU:MsgChannel1.CHASSIS::SpringVlv_Stat_AR:*/
on frPDU MsgChannel1.CHASSIS::CamLane_Disp_Warn_Rq_AR2
{
	if (TimeToElapse(Timer_EISCamLane_Disp_Warn_Rq_AR2_ReceiptPDU) >= 160/2)
	{
		//Timer nicht zu 50% abgelaufen (d.h. aktiv und Botschaft nicht mit halber Zykluszeit empfangen)
		//außer bei spontan
		@sysvar::CH_Nodes::CH__PDURECEIPT_RECEIVE_EIS_CamLane_Disp_Warn_Rq_AR2 = 4;
	}
	else
	{
		//Timer zu 50% abgelaufen (d.h. Botschaft mit mindestens halber Zykluszeit empfangen)
		@sysvar::CH_Nodes::CH__PDURECEIPT_RECEIVE_EIS_CamLane_Disp_Warn_Rq_AR2 = 3;
	}
	//Timer auf Zykluszeit setzen
	setTimer(Timer_EISCamLane_Disp_Warn_Rq_AR2_ReceiptPDU, 160);

	output(this);
}
/*@@end*/
/*@@frPDU:MsgChannel1.CHASSIS::SpringVlv_Stat_AR:*/
on frPDU MsgChannel1.CHASSIS::CamLane_LaneAttr1_AR2
{
	if (TimeToElapse(Timer_EISCamLane_LaneAttr1_AR2_ReceiptPDU) >= 40/2)
	{
		//Timer nicht zu 50% abgelaufen (d.h. aktiv und Botschaft nicht mit halber Zykluszeit empfangen)
		//außer bei spontan
		@sysvar::CH_Nodes::CH__PDURECEIPT_RECEIVE_EIS_CamLane_LaneAttr1_AR2 = 4;
	}
	else
	{
		//Timer zu 50% abgelaufen (d.h. Botschaft mit mindestens halber Zykluszeit empfangen)
		@sysvar::CH_Nodes::CH__PDURECEIPT_RECEIVE_EIS_CamLane_LaneAttr1_AR2 = 3;
	}
	//Timer auf Zykluszeit setzen
	setTimer(Timer_EISCamLane_LaneAttr1_AR2_ReceiptPDU, 40);

	output(this);
}
/*@@end*/
/*@@frPDU:MsgChannel1.CHASSIS::SpringVlv_Stat_AR:*/
on frPDU MsgChannel1.CHASSIS::CamLane_LaneAttr2_AR2
{
	if (TimeToElapse(Timer_EISCamLane_LaneAttr2_AR2_ReceiptPDU) >= 40/2)
	{
		//Timer nicht zu 50% abgelaufen (d.h. aktiv und Botschaft nicht mit halber Zykluszeit empfangen)
		//außer bei spontan
		@sysvar::CH_Nodes::CH__PDURECEIPT_RECEIVE_EIS_CamLane_LaneAttr2_AR2 = 4;
	}
	else
	{
		//Timer zu 50% abgelaufen (d.h. Botschaft mit mindestens halber Zykluszeit empfangen)
		@sysvar::CH_Nodes::CH__PDURECEIPT_RECEIVE_EIS_CamLane_LaneAttr2_AR2 = 3;
	}
	//Timer auf Zykluszeit setzen
	setTimer(Timer_EISCamLane_LaneAttr2_AR2_ReceiptPDU, 40);

	output(this);
}
/*@@end*/
/*@@frPDU:MsgChannel1.CHASSIS::SpringVlv_Stat_AR:*/
on frPDU MsgChannel1.CHASSIS::CamLane_LaneAttr3_AR2
{
	if (TimeToElapse(Timer_EISCamLane_LaneAttr3_AR2_ReceiptPDU) >= 40/2)
	{
		//Timer nicht zu 50% abgelaufen (d.h. aktiv und Botschaft nicht mit halber Zykluszeit empfangen)
		//außer bei spontan
		@sysvar::CH_Nodes::CH__PDURECEIPT_RECEIVE_EIS_CamLane_LaneAttr3_AR2 = 4;
	}
	else
	{
		//Timer zu 50% abgelaufen (d.h. Botschaft mit mindestens halber Zykluszeit empfangen)
		@sysvar::CH_Nodes::CH__PDURECEIPT_RECEIVE_EIS_CamLane_LaneAttr3_AR2 = 3;
	}
	//Timer auf Zykluszeit setzen
	setTimer(Timer_EISCamLane_LaneAttr3_AR2_ReceiptPDU, 40);

	output(this);
}
/*@@end*/
/*@@frPDU:MsgChannel1.CHASSIS::SpringVlv_Stat_AR:*/
on frPDU MsgChannel1.CHASSIS::CamLane_LaneAttr6_AR2
{
	if (TimeToElapse(Timer_EISCamLane_LaneAttr6_AR2_ReceiptPDU) >= 40/2)
	{
		//Timer nicht zu 50% abgelaufen (d.h. aktiv und Botschaft nicht mit halber Zykluszeit empfangen)
		//außer bei spontan
		@sysvar::CH_Nodes::CH__PDURECEIPT_RECEIVE_EIS_CamLane_LaneAttr6_AR2 = 4;
	}
	else
	{
		//Timer zu 50% abgelaufen (d.h. Botschaft mit mindestens halber Zykluszeit empfangen)
		@sysvar::CH_Nodes::CH__PDURECEIPT_RECEIVE_EIS_CamLane_LaneAttr6_AR2 = 3;
	}
	//Timer auf Zykluszeit setzen
	setTimer(Timer_EISCamLane_LaneAttr6_AR2_ReceiptPDU, 40);

	output(this);
}
/*@@end*/
/*@@frPDU:MsgChannel1.CHASSIS::SpringVlv_Stat_AR:*/
on frPDU MsgChannel1.CHASSIS::CamLane_LaneAttr7_AR2
{
	if (TimeToElapse(Timer_EISCamLane_LaneAttr7_AR2_ReceiptPDU) >= 40/2)
	{
		//Timer nicht zu 50% abgelaufen (d.h. aktiv und Botschaft nicht mit halber Zykluszeit empfangen)
		//außer bei spontan
		@sysvar::CH_Nodes::CH__PDURECEIPT_RECEIVE_EIS_CamLane_LaneAttr7_AR2 = 4;
	}
	else
	{
		//Timer zu 50% abgelaufen (d.h. Botschaft mit mindestens halber Zykluszeit empfangen)
		@sysvar::CH_Nodes::CH__PDURECEIPT_RECEIVE_EIS_CamLane_LaneAttr7_AR2 = 3;
	}
	//Timer auf Zykluszeit setzen
	setTimer(Timer_EISCamLane_LaneAttr7_AR2_ReceiptPDU, 40);

	output(this);
}
/*@@end*/
/*@@frPDU:MsgChannel1.CHASSIS::SpringVlv_Stat_AR:*/
on frPDU MsgChannel1.CHASSIS::CLkS_Rq_AR
{
	if (TimeToElapse(Timer_EISCLkS_Rq_AR_ReceiptPDU) >= 50/2)
	{
		//Timer nicht zu 50% abgelaufen (d.h. aktiv und Botschaft nicht mit halber Zykluszeit empfangen)
		//außer bei spontan
		@sysvar::CH_Nodes::CH__PDURECEIPT_RECEIVE_EIS_CLkS_Rq_AR = 4;
	}
	else
	{
		//Timer zu 50% abgelaufen (d.h. Botschaft mit mindestens halber Zykluszeit empfangen)
		@sysvar::CH_Nodes::CH__PDURECEIPT_RECEIVE_EIS_CLkS_Rq_AR = 3;
	}
	//Timer auf Zykluszeit setzen
	setTimer(Timer_EISCLkS_Rq_AR_ReceiptPDU, 50);

	output(this);
}
/*@@end*/
/*@@frPDU:MsgChannel1.CHASSIS::SpringVlv_Stat_AR:*/
on frPDU MsgChannel1.CHASSIS::CLkS_State_AR
{
	if (TimeToElapse(Timer_EISCLkS_State_AR_ReceiptPDU) >= 100/2)
	{
		//Timer nicht zu 50% abgelaufen (d.h. aktiv und Botschaft nicht mit halber Zykluszeit empfangen)
		//außer bei spontan
		@sysvar::CH_Nodes::CH__PDURECEIPT_RECEIVE_EIS_CLkS_State_AR = 4;
	}
	else
	{
		//Timer zu 50% abgelaufen (d.h. Botschaft mit mindestens halber Zykluszeit empfangen)
		@sysvar::CH_Nodes::CH__PDURECEIPT_RECEIVE_EIS_CLkS_State_AR = 3;
	}
	//Timer auf Zykluszeit setzen
	setTimer(Timer_EISCLkS_State_AR_ReceiptPDU, 100);

	output(this);
}
/*@@end*/
/*@@frPDU:MsgChannel1.CHASSIS::SpringVlv_Stat_AR:*/
on frPDU MsgChannel1.CHASSIS::ClockSync_Stat_FR2
{
	if (TimeToElapse(Timer_EISClockSync_Stat_FR2_ReceiptPDU) >= 5/2)
	{
		//Timer nicht zu 50% abgelaufen (d.h. aktiv und Botschaft nicht mit halber Zykluszeit empfangen)
		//außer bei spontan
	}
	else
	{
		//Timer zu 50% abgelaufen (d.h. Botschaft mit mindestens halber Zykluszeit empfangen)
		@sysvar::CH_Nodes::CH__PDURECEIPT_RECEIVE_EIS_ClockSync_Stat_FR2 = 3;
	}
	//Timer auf Zykluszeit setzen
	setTimer(Timer_EISClockSync_Stat_FR2_ReceiptPDU, 5);

	output(this);
}
/*@@end*/
/*@@frPDU:MsgChannel1.CHASSIS::SpringVlv_Stat_AR:*/
on frPDU MsgChannel1.CHASSIS::CMS_PI_State_Gw_AR2
{
	if (TimeToElapse(Timer_EISCMS_PI_State_Gw_AR2_ReceiptPDU) >= 20/2)
	{
		//Timer nicht zu 50% abgelaufen (d.h. aktiv und Botschaft nicht mit halber Zykluszeit empfangen)
		//außer bei spontan
		@sysvar::CH_Nodes::CH__PDURECEIPT_RECEIVE_EIS_CMS_PI_State_Gw_AR2 = 4;
	}
	else
	{
		//Timer zu 50% abgelaufen (d.h. Botschaft mit mindestens halber Zykluszeit empfangen)
		@sysvar::CH_Nodes::CH__PDURECEIPT_RECEIVE_EIS_CMS_PI_State_Gw_AR2 = 3;
	}
	//Timer auf Zykluszeit setzen
	setTimer(Timer_EISCMS_PI_State_Gw_AR2_ReceiptPDU, 20);

	output(this);
}
/*@@end*/
/*@@frPDU:MsgChannel1.CHASSIS::SpringVlv_Stat_AR:*/
on frPDU MsgChannel1.CHASSIS::Config_HU4_AR2
{
	if (TimeToElapse(Timer_EISConfig_HU4_AR2_ReceiptPDU) >= 1000/2)
	{
		//Timer nicht zu 50% abgelaufen (d.h. aktiv und Botschaft nicht mit halber Zykluszeit empfangen)
		//außer bei spontan
		@sysvar::CH_Nodes::CH__PDURECEIPT_RECEIVE_EIS_Config_HU4_AR2 = 4;
	}
	else
	{
		//Timer zu 50% abgelaufen (d.h. Botschaft mit mindestens halber Zykluszeit empfangen)
		@sysvar::CH_Nodes::CH__PDURECEIPT_RECEIVE_EIS_Config_HU4_AR2 = 3;
	}
	//Timer auf Zykluszeit setzen
	setTimer(Timer_EISConfig_HU4_AR2_ReceiptPDU, 1000);

	output(this);
}
/*@@end*/
/*@@frPDU:MsgChannel1.CHASSIS::SpringVlv_Stat_AR:*/
on frPDU MsgChannel1.CHASSIS::Config_HU5_AR2
{
	if (TimeToElapse(Timer_EISConfig_HU5_AR2_ReceiptPDU) >= 1000/2)
	{
		//Timer nicht zu 50% abgelaufen (d.h. aktiv und Botschaft nicht mit halber Zykluszeit empfangen)
		//außer bei spontan
		@sysvar::CH_Nodes::CH__PDURECEIPT_RECEIVE_EIS_Config_HU5_AR2 = 4;
	}
	else
	{
		//Timer zu 50% abgelaufen (d.h. Botschaft mit mindestens halber Zykluszeit empfangen)
		@sysvar::CH_Nodes::CH__PDURECEIPT_RECEIVE_EIS_Config_HU5_AR2 = 3;
	}
	//Timer auf Zykluszeit setzen
	setTimer(Timer_EISConfig_HU5_AR2_ReceiptPDU, 1000);

	output(this);
}
/*@@end*/
/*@@frPDU:MsgChannel1.CHASSIS::SpringVlv_Stat_AR:*/
on frPDU MsgChannel1.CHASSIS::CRCM_Stat_AR
{
	if (TimeToElapse(Timer_EISCRCM_Stat_AR_ReceiptPDU) >= 200/2)
	{
		//Timer nicht zu 50% abgelaufen (d.h. aktiv und Botschaft nicht mit halber Zykluszeit empfangen)
		//außer bei spontan
		@sysvar::CH_Nodes::CH__PDURECEIPT_RECEIVE_EIS_CRCM_Stat_AR = 4;
	}
	else
	{
		//Timer zu 50% abgelaufen (d.h. Botschaft mit mindestens halber Zykluszeit empfangen)
		@sysvar::CH_Nodes::CH__PDURECEIPT_RECEIVE_EIS_CRCM_Stat_AR = 3;
	}
	//Timer auf Zykluszeit setzen
	setTimer(Timer_EISCRCM_Stat_AR_ReceiptPDU, 200);

	output(this);
}
/*@@end*/
/*@@frPDU:MsgChannel1.CHASSIS::SpringVlv_Stat_AR:*/
on frPDU MsgChannel1.CHASSIS::CTRL_C_Stat1_AR
{
	if (TimeToElapse(Timer_EISCTRL_C_Stat1_AR_ReceiptPDU) >= 100/2)
	{
		//Timer nicht zu 50% abgelaufen (d.h. aktiv und Botschaft nicht mit halber Zykluszeit empfangen)
		//außer bei spontan
		@sysvar::CH_Nodes::CH__PDURECEIPT_RECEIVE_EIS_CTRL_C_Stat1_AR = 4;
	}
	else
	{
		//Timer zu 50% abgelaufen (d.h. Botschaft mit mindestens halber Zykluszeit empfangen)
		@sysvar::CH_Nodes::CH__PDURECEIPT_RECEIVE_EIS_CTRL_C_Stat1_AR = 3;
	}
	//Timer auf Zykluszeit setzen
	setTimer(Timer_EISCTRL_C_Stat1_AR_ReceiptPDU, 100);

	output(this);
}
/*@@end*/
/*@@frPDU:MsgChannel1.CHASSIS::SpringVlv_Stat_AR:*/
on frPDU MsgChannel1.CHASSIS::DAC4_ECM_AR
{
	if (TimeToElapse(Timer_EISDAC4_ECM_AR_ReceiptPDU) >= 5/2)
	{
		//Timer nicht zu 50% abgelaufen (d.h. aktiv und Botschaft nicht mit halber Zykluszeit empfangen)
		//außer bei spontan
	}
	else
	{
		//Timer zu 50% abgelaufen (d.h. Botschaft mit mindestens halber Zykluszeit empfangen)
		@sysvar::CH_Nodes::CH__PDURECEIPT_RECEIVE_EIS_DAC4_ECM_AR = 3;
	}
	//Timer auf Zykluszeit setzen
	setTimer(Timer_EISDAC4_ECM_AR_ReceiptPDU, 5);

	output(this);
}
/*@@end*/
/*@@frPDU:MsgChannel1.CHASSIS::SpringVlv_Stat_AR:*/
on frPDU MsgChannel1.CHASSIS::DAC4_EM2_AR
{
	if (TimeToElapse(Timer_EISDAC4_EM2_AR_ReceiptPDU) >= 5/2)
	{
		//Timer nicht zu 50% abgelaufen (d.h. aktiv und Botschaft nicht mit halber Zykluszeit empfangen)
		//außer bei spontan
	}
	else
	{
		//Timer zu 50% abgelaufen (d.h. Botschaft mit mindestens halber Zykluszeit empfangen)
		@sysvar::CH_Nodes::CH__PDURECEIPT_RECEIVE_EIS_DAC4_EM2_AR = 3;
	}
	//Timer auf Zykluszeit setzen
	setTimer(Timer_EISDAC4_EM2_AR_ReceiptPDU, 5);

	output(this);
}
/*@@end*/
/*@@frPDU:MsgChannel1.CHASSIS::SpringVlv_Stat_AR:*/
on frPDU MsgChannel1.CHASSIS::DAC4_ISM_AR
{
	if (TimeToElapse(Timer_EISDAC4_ISM_AR_ReceiptPDU) >= 5/2)
	{
		//Timer nicht zu 50% abgelaufen (d.h. aktiv und Botschaft nicht mit halber Zykluszeit empfangen)
		//außer bei spontan
	}
	else
	{
		//Timer zu 50% abgelaufen (d.h. Botschaft mit mindestens halber Zykluszeit empfangen)
		@sysvar::CH_Nodes::CH__PDURECEIPT_RECEIVE_EIS_DAC4_ISM_AR = 3;
	}
	//Timer auf Zykluszeit setzen
	setTimer(Timer_EISDAC4_ISM_AR_ReceiptPDU, 5);

	output(this);
}
/*@@end*/
/*@@frPDU:MsgChannel1.CHASSIS::SpringVlv_Stat_AR:*/
on frPDU MsgChannel1.CHASSIS::DAC4_TCM_AR
{
	if (TimeToElapse(Timer_EISDAC4_TCM_AR_ReceiptPDU) >= 5/2)
	{
		//Timer nicht zu 50% abgelaufen (d.h. aktiv und Botschaft nicht mit halber Zykluszeit empfangen)
		//außer bei spontan
	}
	else
	{
		//Timer zu 50% abgelaufen (d.h. Botschaft mit mindestens halber Zykluszeit empfangen)
		@sysvar::CH_Nodes::CH__PDURECEIPT_RECEIVE_EIS_DAC4_TCM_AR = 3;
	}
	//Timer auf Zykluszeit setzen
	setTimer(Timer_EISDAC4_TCM_AR_ReceiptPDU, 5);

	output(this);
}
/*@@end*/
/*@@frPDU:MsgChannel1.CHASSIS::SpringVlv_Stat_AR:*/
on frPDU MsgChannel1.CHASSIS::Dimming_Stat_AR2
{
	if (TimeToElapse(Timer_EISDimming_Stat_AR2_ReceiptPDU) >= 200/2)
	{
		//Timer nicht zu 50% abgelaufen (d.h. aktiv und Botschaft nicht mit halber Zykluszeit empfangen)
		//außer bei spontan
		@sysvar::CH_Nodes::CH__PDURECEIPT_RECEIVE_EIS_Dimming_Stat_AR2 = 4;
	}
	else
	{
		//Timer zu 50% abgelaufen (d.h. Botschaft mit mindestens halber Zykluszeit empfangen)
		@sysvar::CH_Nodes::CH__PDURECEIPT_RECEIVE_EIS_Dimming_Stat_AR2 = 3;
	}
	//Timer auf Zykluszeit setzen
	setTimer(Timer_EISDimming_Stat_AR2_ReceiptPDU, 200);

	output(this);
}
/*@@end*/
/*@@frPDU:MsgChannel1.CHASSIS::SpringVlv_Stat_AR:*/
on frPDU MsgChannel1.CHASSIS::Door_FL_Stat_AR2
{
	if (TimeToElapse(Timer_EISDoor_FL_Stat_AR2_ReceiptPDU) >= 500/2)
	{
		//Timer nicht zu 50% abgelaufen (d.h. aktiv und Botschaft nicht mit halber Zykluszeit empfangen)
		//außer bei spontan
		@sysvar::CH_Nodes::CH__PDURECEIPT_RECEIVE_EIS_Door_FL_Stat_AR2 = 4;
	}
	else
	{
		//Timer zu 50% abgelaufen (d.h. Botschaft mit mindestens halber Zykluszeit empfangen)
		@sysvar::CH_Nodes::CH__PDURECEIPT_RECEIVE_EIS_Door_FL_Stat_AR2 = 3;
	}
	//Timer auf Zykluszeit setzen
	setTimer(Timer_EISDoor_FL_Stat_AR2_ReceiptPDU, 500);

	output(this);
}
/*@@end*/
/*@@frPDU:MsgChannel1.CHASSIS::SpringVlv_Stat_AR:*/
on frPDU MsgChannel1.CHASSIS::Door_FR_Stat_AR2
{
	if (TimeToElapse(Timer_EISDoor_FR_Stat_AR2_ReceiptPDU) >= 500/2)
	{
		//Timer nicht zu 50% abgelaufen (d.h. aktiv und Botschaft nicht mit halber Zykluszeit empfangen)
		//außer bei spontan
		@sysvar::CH_Nodes::CH__PDURECEIPT_RECEIVE_EIS_Door_FR_Stat_AR2 = 4;
	}
	else
	{
		//Timer zu 50% abgelaufen (d.h. Botschaft mit mindestens halber Zykluszeit empfangen)
		@sysvar::CH_Nodes::CH__PDURECEIPT_RECEIVE_EIS_Door_FR_Stat_AR2 = 3;
	}
	//Timer auf Zykluszeit setzen
	setTimer(Timer_EISDoor_FR_Stat_AR2_ReceiptPDU, 500);

	output(this);
}
/*@@end*/
/*@@frPDU:MsgChannel1.CHASSIS::SpringVlv_Stat_AR:*/
on frPDU MsgChannel1.CHASSIS::Door_RL_Stat_AR2
{
	if (TimeToElapse(Timer_EISDoor_RL_Stat_AR2_ReceiptPDU) >= 500/2)
	{
		//Timer nicht zu 50% abgelaufen (d.h. aktiv und Botschaft nicht mit halber Zykluszeit empfangen)
		//außer bei spontan
		@sysvar::CH_Nodes::CH__PDURECEIPT_RECEIVE_EIS_Door_RL_Stat_AR2 = 4;
	}
	else
	{
		//Timer zu 50% abgelaufen (d.h. Botschaft mit mindestens halber Zykluszeit empfangen)
		@sysvar::CH_Nodes::CH__PDURECEIPT_RECEIVE_EIS_Door_RL_Stat_AR2 = 3;
	}
	//Timer auf Zykluszeit setzen
	setTimer(Timer_EISDoor_RL_Stat_AR2_ReceiptPDU, 500);

	output(this);
}
/*@@end*/
/*@@frPDU:MsgChannel1.CHASSIS::SpringVlv_Stat_AR:*/
on frPDU MsgChannel1.CHASSIS::Door_RR_Stat_AR2
{
	if (TimeToElapse(Timer_EISDoor_RR_Stat_AR2_ReceiptPDU) >= 500/2)
	{
		//Timer nicht zu 50% abgelaufen (d.h. aktiv und Botschaft nicht mit halber Zykluszeit empfangen)
		//außer bei spontan
		@sysvar::CH_Nodes::CH__PDURECEIPT_RECEIVE_EIS_Door_RR_Stat_AR2 = 4;
	}
	else
	{
		//Timer zu 50% abgelaufen (d.h. Botschaft mit mindestens halber Zykluszeit empfangen)
		@sysvar::CH_Nodes::CH__PDURECEIPT_RECEIVE_EIS_Door_RR_Stat_AR2 = 3;
	}
	//Timer auf Zykluszeit setzen
	setTimer(Timer_EISDoor_RR_Stat_AR2_ReceiptPDU, 500);

	output(this);
}
/*@@end*/
/*@@frPDU:MsgChannel1.CHASSIS::SpringVlv_Stat_AR:*/
on frPDU MsgChannel1.CHASSIS::DPC_IndMd_Rq_AR
{
	if (TimeToElapse(Timer_EISDPC_IndMd_Rq_AR_ReceiptPDU) >= 100/2)
	{
		//Timer nicht zu 50% abgelaufen (d.h. aktiv und Botschaft nicht mit halber Zykluszeit empfangen)
		//außer bei spontan
		@sysvar::CH_Nodes::CH__PDURECEIPT_RECEIVE_EIS_DPC_IndMd_Rq_AR = 4;
	}
	else
	{
		//Timer zu 50% abgelaufen (d.h. Botschaft mit mindestens halber Zykluszeit empfangen)
		@sysvar::CH_Nodes::CH__PDURECEIPT_RECEIVE_EIS_DPC_IndMd_Rq_AR = 3;
	}
	//Timer auf Zykluszeit setzen
	setTimer(Timer_EISDPC_IndMd_Rq_AR_ReceiptPDU, 100);

	output(this);
}
/*@@end*/
/*@@frPDU:MsgChannel1.CHASSIS::SpringVlv_Stat_AR:*/
on frPDU MsgChannel1.CHASSIS::EAC_Stat_AR
{
	if (TimeToElapse(Timer_EISEAC_Stat_AR_ReceiptPDU) >= 100/2)
	{
		//Timer nicht zu 50% abgelaufen (d.h. aktiv und Botschaft nicht mit halber Zykluszeit empfangen)
		//außer bei spontan
		@sysvar::CH_Nodes::CH__PDURECEIPT_RECEIVE_EIS_EAC_Stat_AR = 4;
	}
	else
	{
		//Timer zu 50% abgelaufen (d.h. Botschaft mit mindestens halber Zykluszeit empfangen)
		@sysvar::CH_Nodes::CH__PDURECEIPT_RECEIVE_EIS_EAC_Stat_AR = 3;
	}
	//Timer auf Zykluszeit setzen
	setTimer(Timer_EISEAC_Stat_AR_ReceiptPDU, 100);

	output(this);
}
/*@@end*/
/*@@frPDU:MsgChannel1.CHASSIS::SpringVlv_Stat_AR:*/
on frPDU MsgChannel1.CHASSIS::EL_Stat_AR2
{
	if (TimeToElapse(Timer_EISEL_Stat_AR2_ReceiptPDU) >= 200/2)
	{
		//Timer nicht zu 50% abgelaufen (d.h. aktiv und Botschaft nicht mit halber Zykluszeit empfangen)
		//außer bei spontan
		@sysvar::CH_Nodes::CH__PDURECEIPT_RECEIVE_EIS_EL_Stat_AR2 = 4;
	}
	else
	{
		//Timer zu 50% abgelaufen (d.h. Botschaft mit mindestens halber Zykluszeit empfangen)
		@sysvar::CH_Nodes::CH__PDURECEIPT_RECEIVE_EIS_EL_Stat_AR2 = 3;
	}
	//Timer auf Zykluszeit setzen
	setTimer(Timer_EISEL_Stat_AR2_ReceiptPDU, 200);

	output(this);
}
/*@@end*/
/*@@frPDU:MsgChannel1.CHASSIS::SpringVlv_Stat_AR:*/
on frPDU MsgChannel1.CHASSIS::EL_TurnInd_Rq_AR2
{
	if (TimeToElapse(Timer_EISEL_TurnInd_Rq_AR2_ReceiptPDU) >= 5/2)
	{
		//Timer nicht zu 50% abgelaufen (d.h. aktiv und Botschaft nicht mit halber Zykluszeit empfangen)
		//außer bei spontan
	}
	else
	{
		//Timer zu 50% abgelaufen (d.h. Botschaft mit mindestens halber Zykluszeit empfangen)
		@sysvar::CH_Nodes::CH__PDURECEIPT_RECEIVE_EIS_EL_TurnInd_Rq_AR2 = 3;
	}
	//Timer auf Zykluszeit setzen
	setTimer(Timer_EISEL_TurnInd_Rq_AR2_ReceiptPDU, 5);

	output(this);
}
/*@@end*/
/*@@frPDU:MsgChannel1.CHASSIS::SpringVlv_Stat_AR:*/
on frPDU MsgChannel1.CHASSIS::EPKB_Stat_AR2
{
	if (TimeToElapse(Timer_EISEPKB_Stat_AR2_ReceiptPDU) >= 100/2)
	{
		//Timer nicht zu 50% abgelaufen (d.h. aktiv und Botschaft nicht mit halber Zykluszeit empfangen)
		//außer bei spontan
		@sysvar::CH_Nodes::CH__PDURECEIPT_RECEIVE_EIS_EPKB_Stat_AR2 = 4;
	}
	else
	{
		//Timer zu 50% abgelaufen (d.h. Botschaft mit mindestens halber Zykluszeit empfangen)
		@sysvar::CH_Nodes::CH__PDURECEIPT_RECEIVE_EIS_EPKB_Stat_AR2 = 3;
	}
	//Timer auf Zykluszeit setzen
	setTimer(Timer_EISEPKB_Stat_AR2_ReceiptPDU, 100);

	output(this);
}
/*@@end*/
/*@@frPDU:MsgChannel1.CHASSIS::SpringVlv_Stat_AR:*/
on frPDU MsgChannel1.CHASSIS::EVC_CfgBit_01_32_AR2
{
	if (TimeToElapse(Timer_EISEVC_CfgBit_01_32_AR2_ReceiptPDU) >= 1000/2)
	{
		//Timer nicht zu 50% abgelaufen (d.h. aktiv und Botschaft nicht mit halber Zykluszeit empfangen)
		//außer bei spontan
		@sysvar::CH_Nodes::CH__PDURECEIPT_RECEIVE_EIS_EVC_CfgBit_01_32_AR2 = 4;
	}
	else
	{
		//Timer zu 50% abgelaufen (d.h. Botschaft mit mindestens halber Zykluszeit empfangen)
		@sysvar::CH_Nodes::CH__PDURECEIPT_RECEIVE_EIS_EVC_CfgBit_01_32_AR2 = 3;
	}
	//Timer auf Zykluszeit setzen
	setTimer(Timer_EISEVC_CfgBit_01_32_AR2_ReceiptPDU, 1000);

	output(this);
}
/*@@end*/
/*@@frPDU:MsgChannel1.CHASSIS::SpringVlv_Stat_AR:*/
on frPDU MsgChannel1.CHASSIS::EVC_CfgBit_33_64_AR2
{
	if (TimeToElapse(Timer_EISEVC_CfgBit_33_64_AR2_ReceiptPDU) >= 1000/2)
	{
		//Timer nicht zu 50% abgelaufen (d.h. aktiv und Botschaft nicht mit halber Zykluszeit empfangen)
		//außer bei spontan
		@sysvar::CH_Nodes::CH__PDURECEIPT_RECEIVE_EIS_EVC_CfgBit_33_64_AR2 = 4;
	}
	else
	{
		//Timer zu 50% abgelaufen (d.h. Botschaft mit mindestens halber Zykluszeit empfangen)
		@sysvar::CH_Nodes::CH__PDURECEIPT_RECEIVE_EIS_EVC_CfgBit_33_64_AR2 = 3;
	}
	//Timer auf Zykluszeit setzen
	setTimer(Timer_EISEVC_CfgBit_33_64_AR2_ReceiptPDU, 1000);

	output(this);
}
/*@@end*/
/*@@frPDU:MsgChannel1.CHASSIS::SpringVlv_Stat_AR:*/
on frPDU MsgChannel1.CHASSIS::EVC_CfgBit_65_96_AR2
{
	if (TimeToElapse(Timer_EISEVC_CfgBit_65_96_AR2_ReceiptPDU) >= 1000/2)
	{
		//Timer nicht zu 50% abgelaufen (d.h. aktiv und Botschaft nicht mit halber Zykluszeit empfangen)
		//außer bei spontan
		@sysvar::CH_Nodes::CH__PDURECEIPT_RECEIVE_EIS_EVC_CfgBit_65_96_AR2 = 4;
	}
	else
	{
		//Timer zu 50% abgelaufen (d.h. Botschaft mit mindestens halber Zykluszeit empfangen)
		@sysvar::CH_Nodes::CH__PDURECEIPT_RECEIVE_EIS_EVC_CfgBit_65_96_AR2 = 3;
	}
	//Timer auf Zykluszeit setzen
	setTimer(Timer_EISEVC_CfgBit_65_96_AR2_ReceiptPDU, 1000);

	output(this);
}
/*@@end*/
/*@@frPDU:MsgChannel1.CHASSIS::SpringVlv_Stat_AR:*/
on frPDU MsgChannel1.CHASSIS::EVC_CfgBit_97_C8_AR2
{
	if (TimeToElapse(Timer_EISEVC_CfgBit_97_C8_AR2_ReceiptPDU) >= 1000/2)
	{
		//Timer nicht zu 50% abgelaufen (d.h. aktiv und Botschaft nicht mit halber Zykluszeit empfangen)
		//außer bei spontan
		@sysvar::CH_Nodes::CH__PDURECEIPT_RECEIVE_EIS_EVC_CfgBit_97_C8_AR2 = 4;
	}
	else
	{
		//Timer zu 50% abgelaufen (d.h. Botschaft mit mindestens halber Zykluszeit empfangen)
		@sysvar::CH_Nodes::CH__PDURECEIPT_RECEIVE_EIS_EVC_CfgBit_97_C8_AR2 = 3;
	}
	//Timer auf Zykluszeit setzen
	setTimer(Timer_EISEVC_CfgBit_97_C8_AR2_ReceiptPDU, 1000);

	output(this);
}
/*@@end*/
/*@@frPDU:MsgChannel1.CHASSIS::SpringVlv_Stat_AR:*/
on frPDU MsgChannel1.CHASSIS::EVC_CfgList_01_0C_AR2
{
	if (TimeToElapse(Timer_EISEVC_CfgList_01_0C_AR2_ReceiptPDU) >= 1000/2)
	{
		//Timer nicht zu 50% abgelaufen (d.h. aktiv und Botschaft nicht mit halber Zykluszeit empfangen)
		//außer bei spontan
		@sysvar::CH_Nodes::CH__PDURECEIPT_RECEIVE_EIS_EVC_CfgList_01_0C_AR2 = 4;
	}
	else
	{
		//Timer zu 50% abgelaufen (d.h. Botschaft mit mindestens halber Zykluszeit empfangen)
		@sysvar::CH_Nodes::CH__PDURECEIPT_RECEIVE_EIS_EVC_CfgList_01_0C_AR2 = 3;
	}
	//Timer auf Zykluszeit setzen
	setTimer(Timer_EISEVC_CfgList_01_0C_AR2_ReceiptPDU, 1000);

	output(this);
}
/*@@end*/
/*@@frPDU:MsgChannel1.CHASSIS::SpringVlv_Stat_AR:*/
on frPDU MsgChannel1.CHASSIS::FCW_Disp_Rq_AR
{
	if (TimeToElapse(Timer_EISFCW_Disp_Rq_AR_ReceiptPDU) >= 200/2)
	{
		//Timer nicht zu 50% abgelaufen (d.h. aktiv und Botschaft nicht mit halber Zykluszeit empfangen)
		//außer bei spontan
		@sysvar::CH_Nodes::CH__PDURECEIPT_RECEIVE_EIS_FCW_Disp_Rq_AR = 4;
	}
	else
	{
		//Timer zu 50% abgelaufen (d.h. Botschaft mit mindestens halber Zykluszeit empfangen)
		@sysvar::CH_Nodes::CH__PDURECEIPT_RECEIVE_EIS_FCW_Disp_Rq_AR = 3;
	}
	//Timer auf Zykluszeit setzen
	setTimer(Timer_EISFCW_Disp_Rq_AR_ReceiptPDU, 200);

	output(this);
}
/*@@end*/
/*@@frPDU:MsgChannel1.CHASSIS::SpringVlv_Stat_AR:*/
on frPDU MsgChannel1.CHASSIS::HMI_CHASSIS_R1_AR2
{
	if (TimeToElapse(Timer_EISHMI_CHASSIS_R1_AR2_ReceiptPDU) >= 100/2)
	{
		//Timer nicht zu 50% abgelaufen (d.h. aktiv und Botschaft nicht mit halber Zykluszeit empfangen)
		//außer bei spontan
		@sysvar::CH_Nodes::CH__PDURECEIPT_RECEIVE_EIS_HMI_CHASSIS_R1_AR2 = 4;
	}
	else
	{
		//Timer zu 50% abgelaufen (d.h. Botschaft mit mindestens halber Zykluszeit empfangen)
		@sysvar::CH_Nodes::CH__PDURECEIPT_RECEIVE_EIS_HMI_CHASSIS_R1_AR2 = 3;
	}
	//Timer auf Zykluszeit setzen
	setTimer(Timer_EISHMI_CHASSIS_R1_AR2_ReceiptPDU, 100);

	output(this);
}
/*@@end*/
/*@@frPDU:MsgChannel1.CHASSIS::SpringVlv_Stat_AR:*/
on frPDU MsgChannel1.CHASSIS::HU_Comf_Rq_AR2
{
	if (TimeToElapse(Timer_EISHU_Comf_Rq_AR2_ReceiptPDU) >= 1000/2)
	{
		//Timer nicht zu 50% abgelaufen (d.h. aktiv und Botschaft nicht mit halber Zykluszeit empfangen)
		//außer bei spontan
		@sysvar::CH_Nodes::CH__PDURECEIPT_RECEIVE_EIS_HU_Comf_Rq_AR2 = 4;
	}
	else
	{
		//Timer zu 50% abgelaufen (d.h. Botschaft mit mindestens halber Zykluszeit empfangen)
		@sysvar::CH_Nodes::CH__PDURECEIPT_RECEIVE_EIS_HU_Comf_Rq_AR2 = 3;
	}
	//Timer auf Zykluszeit setzen
	setTimer(Timer_EISHU_Comf_Rq_AR2_ReceiptPDU, 1000);

	output(this);
}
/*@@end*/
/*@@frPDU:MsgChannel1.CHASSIS::SpringVlv_Stat_AR:*/
on frPDU MsgChannel1.CHASSIS::HU_State_AR
{
	if (TimeToElapse(Timer_EISHU_State_AR_ReceiptPDU) >= 200/2)
	{
		//Timer nicht zu 50% abgelaufen (d.h. aktiv und Botschaft nicht mit halber Zykluszeit empfangen)
		//außer bei spontan
		@sysvar::CH_Nodes::CH__PDURECEIPT_RECEIVE_EIS_HU_State_AR = 4;
	}
	else
	{
		//Timer zu 50% abgelaufen (d.h. Botschaft mit mindestens halber Zykluszeit empfangen)
		@sysvar::CH_Nodes::CH__PDURECEIPT_RECEIVE_EIS_HU_State_AR = 3;
	}
	//Timer auf Zykluszeit setzen
	setTimer(Timer_EISHU_State_AR_ReceiptPDU, 200);

	output(this);
}
/*@@end*/
/*@@frPDU:MsgChannel1.CHASSIS::SpringVlv_Stat_AR:*/
on frPDU MsgChannel1.CHASSIS::HVAC_Disp_Stat1_AR
{
	if (TimeToElapse(Timer_EISHVAC_Disp_Stat1_AR_ReceiptPDU) >= 1000/2)
	{
		//Timer nicht zu 50% abgelaufen (d.h. aktiv und Botschaft nicht mit halber Zykluszeit empfangen)
		//außer bei spontan
		@sysvar::CH_Nodes::CH__PDURECEIPT_RECEIVE_EIS_HVAC_Disp_Stat1_AR = 4;
	}
	else
	{
		//Timer zu 50% abgelaufen (d.h. Botschaft mit mindestens halber Zykluszeit empfangen)
		@sysvar::CH_Nodes::CH__PDURECEIPT_RECEIVE_EIS_HVAC_Disp_Stat1_AR = 3;
	}
	//Timer auf Zykluszeit setzen
	setTimer(Timer_EISHVAC_Disp_Stat1_AR_ReceiptPDU, 1000);

	output(this);
}
/*@@end*/
/*@@frPDU:MsgChannel1.CHASSIS::SpringVlv_Stat_AR:*/
on frPDU MsgChannel1.CHASSIS::HVAC_OBD_DTC_AR
{
	if (TimeToElapse(Timer_EISHVAC_OBD_DTC_AR_ReceiptPDU) >= 100/2)
	{
		//Timer nicht zu 50% abgelaufen (d.h. aktiv und Botschaft nicht mit halber Zykluszeit empfangen)
		//außer bei spontan
		@sysvar::CH_Nodes::CH__PDURECEIPT_RECEIVE_EIS_HVAC_OBD_DTC_AR = 4;
	}
	else
	{
		//Timer zu 50% abgelaufen (d.h. Botschaft mit mindestens halber Zykluszeit empfangen)
		@sysvar::CH_Nodes::CH__PDURECEIPT_RECEIVE_EIS_HVAC_OBD_DTC_AR = 3;
	}
	//Timer auf Zykluszeit setzen
	setTimer(Timer_EISHVAC_OBD_DTC_AR_ReceiptPDU, 100);

	output(this);
}
/*@@end*/
/*@@frPDU:MsgChannel1.CHASSIS::SpringVlv_Stat_AR:*/
on frPDU MsgChannel1.CHASSIS::HVAC_Rs2_AR
{
	if (TimeToElapse(Timer_EISHVAC_Rs2_AR_ReceiptPDU) >= 100/2)
	{
		//Timer nicht zu 50% abgelaufen (d.h. aktiv und Botschaft nicht mit halber Zykluszeit empfangen)
		//außer bei spontan
		@sysvar::CH_Nodes::CH__PDURECEIPT_RECEIVE_EIS_HVAC_Rs2_AR = 4;
	}
	else
	{
		//Timer zu 50% abgelaufen (d.h. Botschaft mit mindestens halber Zykluszeit empfangen)
		@sysvar::CH_Nodes::CH__PDURECEIPT_RECEIVE_EIS_HVAC_Rs2_AR = 3;
	}
	//Timer auf Zykluszeit setzen
	setTimer(Timer_EISHVAC_Rs2_AR_ReceiptPDU, 100);

	output(this);
}
/*@@end*/
/*@@frPDU:MsgChannel1.CHASSIS::SpringVlv_Stat_AR:*/
on frPDU MsgChannel1.CHASSIS::HVAC_Rs3_AR2
{
	if (TimeToElapse(Timer_EISHVAC_Rs3_AR2_ReceiptPDU) >= 1000/2)
	{
		//Timer nicht zu 50% abgelaufen (d.h. aktiv und Botschaft nicht mit halber Zykluszeit empfangen)
		//außer bei spontan
		@sysvar::CH_Nodes::CH__PDURECEIPT_RECEIVE_EIS_HVAC_Rs3_AR2 = 4;
	}
	else
	{
		//Timer zu 50% abgelaufen (d.h. Botschaft mit mindestens halber Zykluszeit empfangen)
		@sysvar::CH_Nodes::CH__PDURECEIPT_RECEIVE_EIS_HVAC_Rs3_AR2 = 3;
	}
	//Timer auf Zykluszeit setzen
	setTimer(Timer_EISHVAC_Rs3_AR2_ReceiptPDU, 1000);

	output(this);
}
/*@@end*/
/*@@frPDU:MsgChannel1.CHASSIS::SpringVlv_Stat_AR:*/
on frPDU MsgChannel1.CHASSIS::HVAC_Rs_AR2
{
	if (TimeToElapse(Timer_EISHVAC_Rs_AR2_ReceiptPDU) >= 100/2)
	{
		//Timer nicht zu 50% abgelaufen (d.h. aktiv und Botschaft nicht mit halber Zykluszeit empfangen)
		//außer bei spontan
		@sysvar::CH_Nodes::CH__PDURECEIPT_RECEIVE_EIS_HVAC_Rs_AR2 = 4;
	}
	else
	{
		//Timer zu 50% abgelaufen (d.h. Botschaft mit mindestens halber Zykluszeit empfangen)
		@sysvar::CH_Nodes::CH__PDURECEIPT_RECEIVE_EIS_HVAC_Rs_AR2 = 3;
	}
	//Timer auf Zykluszeit setzen
	setTimer(Timer_EISHVAC_Rs_AR2_ReceiptPDU, 100);

	output(this);
}
/*@@end*/
/*@@frPDU:MsgChannel1.CHASSIS::SpringVlv_Stat_AR:*/
on frPDU MsgChannel1.CHASSIS::HVAC_State1_AR
{
	if (TimeToElapse(Timer_EISHVAC_State1_AR_ReceiptPDU) >= 500/2)
	{
		//Timer nicht zu 50% abgelaufen (d.h. aktiv und Botschaft nicht mit halber Zykluszeit empfangen)
		//außer bei spontan
		@sysvar::CH_Nodes::CH__PDURECEIPT_RECEIVE_EIS_HVAC_State1_AR = 4;
	}
	else
	{
		//Timer zu 50% abgelaufen (d.h. Botschaft mit mindestens halber Zykluszeit empfangen)
		@sysvar::CH_Nodes::CH__PDURECEIPT_RECEIVE_EIS_HVAC_State1_AR = 3;
	}
	//Timer auf Zykluszeit setzen
	setTimer(Timer_EISHVAC_State1_AR_ReceiptPDU, 500);

	output(this);
}
/*@@end*/
/*@@frPDU:MsgChannel1.CHASSIS::SpringVlv_Stat_AR:*/
on frPDU MsgChannel1.CHASSIS::IC_BasicInfo_AR2
{
	if (TimeToElapse(Timer_EISIC_BasicInfo_AR2_ReceiptPDU) >= 1000/2)
	{
		//Timer nicht zu 50% abgelaufen (d.h. aktiv und Botschaft nicht mit halber Zykluszeit empfangen)
		//außer bei spontan
		@sysvar::CH_Nodes::CH__PDURECEIPT_RECEIVE_EIS_IC_BasicInfo_AR2 = 4;
	}
	else
	{
		//Timer zu 50% abgelaufen (d.h. Botschaft mit mindestens halber Zykluszeit empfangen)
		@sysvar::CH_Nodes::CH__PDURECEIPT_RECEIVE_EIS_IC_BasicInfo_AR2 = 3;
	}
	//Timer auf Zykluszeit setzen
	setTimer(Timer_EISIC_BasicInfo_AR2_ReceiptPDU, 1000);

	output(this);
}
/*@@end*/
/*@@frPDU:MsgChannel1.CHASSIS::SpringVlv_Stat_AR:*/
on frPDU MsgChannel1.CHASSIS::IC_DriveAssistSys_AR2
{
	if (TimeToElapse(Timer_EISIC_DriveAssistSys_AR2_ReceiptPDU) >= 100/2)
	{
		//Timer nicht zu 50% abgelaufen (d.h. aktiv und Botschaft nicht mit halber Zykluszeit empfangen)
		//außer bei spontan
		@sysvar::CH_Nodes::CH__PDURECEIPT_RECEIVE_EIS_IC_DriveAssistSys_AR2 = 4;
	}
	else
	{
		//Timer zu 50% abgelaufen (d.h. Botschaft mit mindestens halber Zykluszeit empfangen)
		@sysvar::CH_Nodes::CH__PDURECEIPT_RECEIVE_EIS_IC_DriveAssistSys_AR2 = 3;
	}
	//Timer auf Zykluszeit setzen
	setTimer(Timer_EISIC_DriveAssistSys_AR2_ReceiptPDU, 100);

	output(this);
}
/*@@end*/
/*@@frPDU:MsgChannel1.CHASSIS::SpringVlv_Stat_AR:*/
on frPDU MsgChannel1.CHASSIS::IC_Settings_AR2
{
	if (TimeToElapse(Timer_EISIC_Settings_AR2_ReceiptPDU) >= 1000/2)
	{
		//Timer nicht zu 50% abgelaufen (d.h. aktiv und Botschaft nicht mit halber Zykluszeit empfangen)
		//außer bei spontan
		@sysvar::CH_Nodes::CH__PDURECEIPT_RECEIVE_EIS_IC_Settings_AR2 = 4;
	}
	else
	{
		//Timer zu 50% abgelaufen (d.h. Botschaft mit mindestens halber Zykluszeit empfangen)
		@sysvar::CH_Nodes::CH__PDURECEIPT_RECEIVE_EIS_IC_Settings_AR2 = 3;
	}
	//Timer auf Zykluszeit setzen
	setTimer(Timer_EISIC_Settings_AR2_ReceiptPDU, 1000);

	output(this);
}
/*@@end*/
/*@@frPDU:MsgChannel1.CHASSIS::SpringVlv_Stat_AR:*/
on frPDU MsgChannel1.CHASSIS::ICH_Stat_AR
{
	if (TimeToElapse(Timer_EISICH_Stat_AR_ReceiptPDU) >= 500/2)
	{
		//Timer nicht zu 50% abgelaufen (d.h. aktiv und Botschaft nicht mit halber Zykluszeit empfangen)
		//außer bei spontan
		@sysvar::CH_Nodes::CH__PDURECEIPT_RECEIVE_EIS_ICH_Stat_AR = 4;
	}
	else
	{
		//Timer zu 50% abgelaufen (d.h. Botschaft mit mindestens halber Zykluszeit empfangen)
		@sysvar::CH_Nodes::CH__PDURECEIPT_RECEIVE_EIS_ICH_Stat_AR = 3;
	}
	//Timer auf Zykluszeit setzen
	setTimer(Timer_EISICH_Stat_AR_ReceiptPDU, 500);

	output(this);
}
/*@@end*/
/*@@frPDU:MsgChannel1.CHASSIS::SpringVlv_Stat_AR:*/
on frPDU MsgChannel1.CHASSIS::Ign_Veh_Stat_AR2
{
	if (TimeToElapse(Timer_EISIgn_Veh_Stat_AR2_ReceiptPDU) >= 100/2)
	{
		//Timer nicht zu 50% abgelaufen (d.h. aktiv und Botschaft nicht mit halber Zykluszeit empfangen)
		//außer bei spontan
		@sysvar::CH_Nodes::CH__PDURECEIPT_RECEIVE_EIS_Ign_Veh_Stat_AR2 = 4;
	}
	else
	{
		//Timer zu 50% abgelaufen (d.h. Botschaft mit mindestens halber Zykluszeit empfangen)
		@sysvar::CH_Nodes::CH__PDURECEIPT_RECEIVE_EIS_Ign_Veh_Stat_AR2 = 3;
	}
	//Timer auf Zykluszeit setzen
	setTimer(Timer_EISIgn_Veh_Stat_AR2_ReceiptPDU, 100);

	output(this);
}
/*@@end*/
/*@@frPDU:MsgChannel1.CHASSIS::SpringVlv_Stat_AR:*/
on frPDU MsgChannel1.CHASSIS::IHC_Lgt_Stat_HLI_2_AR2
{
	if (TimeToElapse(Timer_EISIHC_Lgt_Stat_HLI_2_AR2_ReceiptPDU) >= 80/2)
	{
		//Timer nicht zu 50% abgelaufen (d.h. aktiv und Botschaft nicht mit halber Zykluszeit empfangen)
		//außer bei spontan
		@sysvar::CH_Nodes::CH__PDURECEIPT_RECEIVE_EIS_IHC_Lgt_Stat_HLI_2_AR2 = 4;
	}
	else
	{
		//Timer zu 50% abgelaufen (d.h. Botschaft mit mindestens halber Zykluszeit empfangen)
		@sysvar::CH_Nodes::CH__PDURECEIPT_RECEIVE_EIS_IHC_Lgt_Stat_HLI_2_AR2 = 3;
	}
	//Timer auf Zykluszeit setzen
	setTimer(Timer_EISIHC_Lgt_Stat_HLI_2_AR2_ReceiptPDU, 80);

	output(this);
}
/*@@end*/
/*@@frPDU:MsgChannel1.CHASSIS::SpringVlv_Stat_AR:*/
on frPDU MsgChannel1.CHASSIS::IHC_Lgt_Stat_HLI_AR2
{
	if (TimeToElapse(Timer_EISIHC_Lgt_Stat_HLI_AR2_ReceiptPDU) >= 80/2)
	{
		//Timer nicht zu 50% abgelaufen (d.h. aktiv und Botschaft nicht mit halber Zykluszeit empfangen)
		//außer bei spontan
		@sysvar::CH_Nodes::CH__PDURECEIPT_RECEIVE_EIS_IHC_Lgt_Stat_HLI_AR2 = 4;
	}
	else
	{
		//Timer zu 50% abgelaufen (d.h. Botschaft mit mindestens halber Zykluszeit empfangen)
		@sysvar::CH_Nodes::CH__PDURECEIPT_RECEIVE_EIS_IHC_Lgt_Stat_HLI_AR2 = 3;
	}
	//Timer auf Zykluszeit setzen
	setTimer(Timer_EISIHC_Lgt_Stat_HLI_AR2_ReceiptPDU, 80);

	output(this);
}
/*@@end*/
/*@@frPDU:MsgChannel1.CHASSIS::SpringVlv_Stat_AR:*/
on frPDU MsgChannel1.CHASSIS::KG_State_AR2
{
	if (TimeToElapse(Timer_EISKG_State_AR2_ReceiptPDU) >= 200/2)
	{
		//Timer nicht zu 50% abgelaufen (d.h. aktiv und Botschaft nicht mit halber Zykluszeit empfangen)
		//außer bei spontan
		@sysvar::CH_Nodes::CH__PDURECEIPT_RECEIVE_EIS_KG_State_AR2 = 4;
	}
	else
	{
		//Timer zu 50% abgelaufen (d.h. Botschaft mit mindestens halber Zykluszeit empfangen)
		@sysvar::CH_Nodes::CH__PDURECEIPT_RECEIVE_EIS_KG_State_AR2 = 3;
	}
	//Timer auf Zykluszeit setzen
	setTimer(Timer_EISKG_State_AR2_ReceiptPDU, 200);

	output(this);
}
/*@@end*/
/*@@frPDU:MsgChannel1.CHASSIS::SpringVlv_Stat_AR:*/
on frPDU MsgChannel1.CHASSIS::LDC_Disp_Stat_IC_AR2
{
	if (TimeToElapse(Timer_EISLDC_Disp_Stat_IC_AR2_ReceiptPDU) >= 200/2)
	{
		//Timer nicht zu 50% abgelaufen (d.h. aktiv und Botschaft nicht mit halber Zykluszeit empfangen)
		//außer bei spontan
		@sysvar::CH_Nodes::CH__PDURECEIPT_RECEIVE_EIS_LDC_Disp_Stat_IC_AR2 = 4;
	}
	else
	{
		//Timer zu 50% abgelaufen (d.h. Botschaft mit mindestens halber Zykluszeit empfangen)
		@sysvar::CH_Nodes::CH__PDURECEIPT_RECEIVE_EIS_LDC_Disp_Stat_IC_AR2 = 3;
	}
	//Timer auf Zykluszeit setzen
	setTimer(Timer_EISLDC_Disp_Stat_IC_AR2_ReceiptPDU, 200);

	output(this);
}
/*@@end*/
/*@@frPDU:MsgChannel1.CHASSIS::SpringVlv_Stat_AR:*/
on frPDU MsgChannel1.CHASSIS::LgtSens_State_AR
{
	if (TimeToElapse(Timer_EISLgtSens_State_AR_ReceiptPDU) >= 1000/2)
	{
		//Timer nicht zu 50% abgelaufen (d.h. aktiv und Botschaft nicht mit halber Zykluszeit empfangen)
		//außer bei spontan
		@sysvar::CH_Nodes::CH__PDURECEIPT_RECEIVE_EIS_LgtSens_State_AR = 4;
	}
	else
	{
		//Timer zu 50% abgelaufen (d.h. Botschaft mit mindestens halber Zykluszeit empfangen)
		@sysvar::CH_Nodes::CH__PDURECEIPT_RECEIVE_EIS_LgtSens_State_AR = 3;
	}
	//Timer auf Zykluszeit setzen
	setTimer(Timer_EISLgtSens_State_AR_ReceiptPDU, 1000);

	output(this);
}
/*@@end*/
/*@@frPDU:MsgChannel1.CHASSIS::SpringVlv_Stat_AR:*/
on frPDU MsgChannel1.CHASSIS::Mirr_Adj_Lt_Rq_AR
{
	if (TimeToElapse(Timer_EISMirr_Adj_Lt_Rq_AR_ReceiptPDU) >= 5/2)
	{
		//Timer nicht zu 50% abgelaufen (d.h. aktiv und Botschaft nicht mit halber Zykluszeit empfangen)
		//außer bei spontan
		@sysvar::CH_Nodes::CH__PDURECEIPT_RECEIVE_EIS_Mirr_Adj_Lt_Rq_AR = 4;
	}
	else
	{
		//Timer zu 50% abgelaufen (d.h. Botschaft mit mindestens halber Zykluszeit empfangen)
		@sysvar::CH_Nodes::CH__PDURECEIPT_RECEIVE_EIS_Mirr_Adj_Lt_Rq_AR = 3;
	}
	//Timer auf Zykluszeit setzen
	setTimer(Timer_EISMirr_Adj_Lt_Rq_AR_ReceiptPDU, 5);

	output(this);
}
/*@@end*/
/*@@frPDU:MsgChannel1.CHASSIS::SpringVlv_Stat_AR:*/
on frPDU MsgChannel1.CHASSIS::Mirr_Adj_Rt_Rq_AR
{
	if (TimeToElapse(Timer_EISMirr_Adj_Rt_Rq_AR_ReceiptPDU) >= 5/2)
	{
		//Timer nicht zu 50% abgelaufen (d.h. aktiv und Botschaft nicht mit halber Zykluszeit empfangen)
		//außer bei spontan
		@sysvar::CH_Nodes::CH__PDURECEIPT_RECEIVE_EIS_Mirr_Adj_Rt_Rq_AR = 4;
	}
	else
	{
		//Timer zu 50% abgelaufen (d.h. Botschaft mit mindestens halber Zykluszeit empfangen)
		@sysvar::CH_Nodes::CH__PDURECEIPT_RECEIVE_EIS_Mirr_Adj_Rt_Rq_AR = 3;
	}
	//Timer auf Zykluszeit setzen
	setTimer(Timer_EISMirr_Adj_Rt_Rq_AR_ReceiptPDU, 5);

	output(this);
}
/*@@end*/
/*@@frPDU:MsgChannel1.CHASSIS::SpringVlv_Stat_AR:*/
on frPDU MsgChannel1.CHASSIS::NAVI_Pos1_AR
{
	if (TimeToElapse(Timer_EISNAVI_Pos1_AR_ReceiptPDU) >= 1000/2)
	{
		//Timer nicht zu 50% abgelaufen (d.h. aktiv und Botschaft nicht mit halber Zykluszeit empfangen)
		//außer bei spontan
		@sysvar::CH_Nodes::CH__PDURECEIPT_RECEIVE_EIS_NAVI_Pos1_AR = 4;
	}
	else
	{
		//Timer zu 50% abgelaufen (d.h. Botschaft mit mindestens halber Zykluszeit empfangen)
		@sysvar::CH_Nodes::CH__PDURECEIPT_RECEIVE_EIS_NAVI_Pos1_AR = 3;
	}
	//Timer auf Zykluszeit setzen
	setTimer(Timer_EISNAVI_Pos1_AR_ReceiptPDU, 1000);

	output(this);
}
/*@@end*/
/*@@frPDU:MsgChannel1.CHASSIS::SpringVlv_Stat_AR:*/
on frPDU MsgChannel1.CHASSIS::NAVI_Pos2_AR
{
	if (TimeToElapse(Timer_EISNAVI_Pos2_AR_ReceiptPDU) >= 1000/2)
	{
		//Timer nicht zu 50% abgelaufen (d.h. aktiv und Botschaft nicht mit halber Zykluszeit empfangen)
		//außer bei spontan
		@sysvar::CH_Nodes::CH__PDURECEIPT_RECEIVE_EIS_NAVI_Pos2_AR = 4;
	}
	else
	{
		//Timer zu 50% abgelaufen (d.h. Botschaft mit mindestens halber Zykluszeit empfangen)
		@sysvar::CH_Nodes::CH__PDURECEIPT_RECEIVE_EIS_NAVI_Pos2_AR = 3;
	}
	//Timer auf Zykluszeit setzen
	setTimer(Timer_EISNAVI_Pos2_AR_ReceiptPDU, 1000);

	output(this);
}
/*@@end*/
/*@@frPDU:MsgChannel1.CHASSIS::SpringVlv_Stat_AR:*/
on frPDU MsgChannel1.CHASSIS::NAVI_Pos3_AR
{
	if (TimeToElapse(Timer_EISNAVI_Pos3_AR_ReceiptPDU) >= 1000/2)
	{
		//Timer nicht zu 50% abgelaufen (d.h. aktiv und Botschaft nicht mit halber Zykluszeit empfangen)
		//außer bei spontan
		@sysvar::CH_Nodes::CH__PDURECEIPT_RECEIVE_EIS_NAVI_Pos3_AR = 4;
	}
	else
	{
		//Timer zu 50% abgelaufen (d.h. Botschaft mit mindestens halber Zykluszeit empfangen)
		@sysvar::CH_Nodes::CH__PDURECEIPT_RECEIVE_EIS_NAVI_Pos3_AR = 3;
	}
	//Timer auf Zykluszeit setzen
	setTimer(Timer_EISNAVI_Pos3_AR_ReceiptPDU, 1000);

	output(this);
}
/*@@end*/
/*@@frPDU:MsgChannel1.CHASSIS::SpringVlv_Stat_AR:*/
on frPDU MsgChannel1.CHASSIS::NAVI_Pos4_AR
{
	if (TimeToElapse(Timer_EISNAVI_Pos4_AR_ReceiptPDU) >= 1000/2)
	{
		//Timer nicht zu 50% abgelaufen (d.h. aktiv und Botschaft nicht mit halber Zykluszeit empfangen)
		//außer bei spontan
		@sysvar::CH_Nodes::CH__PDURECEIPT_RECEIVE_EIS_NAVI_Pos4_AR = 4;
	}
	else
	{
		//Timer zu 50% abgelaufen (d.h. Botschaft mit mindestens halber Zykluszeit empfangen)
		@sysvar::CH_Nodes::CH__PDURECEIPT_RECEIVE_EIS_NAVI_Pos4_AR = 3;
	}
	//Timer auf Zykluszeit setzen
	setTimer(Timer_EISNAVI_Pos4_AR_ReceiptPDU, 1000);

	output(this);
}
/*@@end*/
/*@@frPDU:MsgChannel1.CHASSIS::SpringVlv_Stat_AR:*/
on frPDU MsgChannel1.CHASSIS::NAVI_Pos5_AR
{
	if (TimeToElapse(Timer_EISNAVI_Pos5_AR_ReceiptPDU) >= 1000/2)
	{
		//Timer nicht zu 50% abgelaufen (d.h. aktiv und Botschaft nicht mit halber Zykluszeit empfangen)
		//außer bei spontan
		@sysvar::CH_Nodes::CH__PDURECEIPT_RECEIVE_EIS_NAVI_Pos5_AR = 4;
	}
	else
	{
		//Timer zu 50% abgelaufen (d.h. Botschaft mit mindestens halber Zykluszeit empfangen)
		@sysvar::CH_Nodes::CH__PDURECEIPT_RECEIVE_EIS_NAVI_Pos5_AR = 3;
	}
	//Timer auf Zykluszeit setzen
	setTimer(Timer_EISNAVI_Pos5_AR_ReceiptPDU, 1000);

	output(this);
}
/*@@end*/
/*@@frPDU:MsgChannel1.CHASSIS::SpringVlv_Stat_AR:*/
on frPDU MsgChannel1.CHASSIS::NVP_Stat1_AR2
{
	if (TimeToElapse(Timer_EISNVP_Stat1_AR2_ReceiptPDU) >= 80/2)
	{
		//Timer nicht zu 50% abgelaufen (d.h. aktiv und Botschaft nicht mit halber Zykluszeit empfangen)
		//außer bei spontan
		@sysvar::CH_Nodes::CH__PDURECEIPT_RECEIVE_EIS_NVP_Stat1_AR2 = 4;
	}
	else
	{
		//Timer zu 50% abgelaufen (d.h. Botschaft mit mindestens halber Zykluszeit empfangen)
		@sysvar::CH_Nodes::CH__PDURECEIPT_RECEIVE_EIS_NVP_Stat1_AR2 = 3;
	}
	//Timer auf Zykluszeit setzen
	setTimer(Timer_EISNVP_Stat1_AR2_ReceiptPDU, 80);

	output(this);
}
/*@@end*/
/*@@frPDU:MsgChannel1.CHASSIS::SpringVlv_Stat_AR:*/
on frPDU MsgChannel1.CHASSIS::OHCM_Stat_AR2
{
	if (TimeToElapse(Timer_EISOHCM_Stat_AR2_ReceiptPDU) >= 100/2)
	{
		//Timer nicht zu 50% abgelaufen (d.h. aktiv und Botschaft nicht mit halber Zykluszeit empfangen)
		//außer bei spontan
		@sysvar::CH_Nodes::CH__PDURECEIPT_RECEIVE_EIS_OHCM_Stat_AR2 = 4;
	}
	else
	{
		//Timer zu 50% abgelaufen (d.h. Botschaft mit mindestens halber Zykluszeit empfangen)
		@sysvar::CH_Nodes::CH__PDURECEIPT_RECEIVE_EIS_OHCM_Stat_AR2 = 3;
	}
	//Timer auf Zykluszeit setzen
	setTimer(Timer_EISOHCM_Stat_AR2_ReceiptPDU, 100);

	output(this);
}
/*@@end*/
/*@@frPDU:MsgChannel1.CHASSIS::SpringVlv_Stat_AR:*/
on frPDU MsgChannel1.CHASSIS::ORC_Disp_Stat_AR2
{
	if (TimeToElapse(Timer_EISORC_Disp_Stat_AR2_ReceiptPDU) >= 100/2)
	{
		//Timer nicht zu 50% abgelaufen (d.h. aktiv und Botschaft nicht mit halber Zykluszeit empfangen)
		//außer bei spontan
		@sysvar::CH_Nodes::CH__PDURECEIPT_RECEIVE_EIS_ORC_Disp_Stat_AR2 = 4;
	}
	else
	{
		//Timer zu 50% abgelaufen (d.h. Botschaft mit mindestens halber Zykluszeit empfangen)
		@sysvar::CH_Nodes::CH__PDURECEIPT_RECEIVE_EIS_ORC_Disp_Stat_AR2 = 3;
	}
	//Timer auf Zykluszeit setzen
	setTimer(Timer_EISORC_Disp_Stat_AR2_ReceiptPDU, 100);

	output(this);
}
/*@@end*/
/*@@frPDU:MsgChannel1.CHASSIS::SpringVlv_Stat_AR:*/
on frPDU MsgChannel1.CHASSIS::ORC_Impact_AR2
{
	if (TimeToElapse(Timer_EISORC_Impact_AR2_ReceiptPDU) >= 20/2)
	{
		//Timer nicht zu 50% abgelaufen (d.h. aktiv und Botschaft nicht mit halber Zykluszeit empfangen)
		//außer bei spontan
		@sysvar::CH_Nodes::CH__PDURECEIPT_RECEIVE_EIS_ORC_Impact_AR2 = 4;
	}
	else
	{
		//Timer zu 50% abgelaufen (d.h. Botschaft mit mindestens halber Zykluszeit empfangen)
		@sysvar::CH_Nodes::CH__PDURECEIPT_RECEIVE_EIS_ORC_Impact_AR2 = 3;
	}
	//Timer auf Zykluszeit setzen
	setTimer(Timer_EISORC_Impact_AR2_ReceiptPDU, 20);

	output(this);
}
/*@@end*/
/*@@frPDU:MsgChannel1.CHASSIS::SpringVlv_Stat_AR:*/
on frPDU MsgChannel1.CHASSIS::Park_Disp_Rs_AR2
{
	if (TimeToElapse(Timer_EISPark_Disp_Rs_AR2_ReceiptPDU) >= 200/2)
	{
		//Timer nicht zu 50% abgelaufen (d.h. aktiv und Botschaft nicht mit halber Zykluszeit empfangen)
		//außer bei spontan
		@sysvar::CH_Nodes::CH__PDURECEIPT_RECEIVE_EIS_Park_Disp_Rs_AR2 = 4;
	}
	else
	{
		//Timer zu 50% abgelaufen (d.h. Botschaft mit mindestens halber Zykluszeit empfangen)
		@sysvar::CH_Nodes::CH__PDURECEIPT_RECEIVE_EIS_Park_Disp_Rs_AR2 = 3;
	}
	//Timer auf Zykluszeit setzen
	setTimer(Timer_EISPark_Disp_Rs_AR2_ReceiptPDU, 200);

	output(this);
}
/*@@end*/
/*@@frPDU:MsgChannel1.CHASSIS::SpringVlv_Stat_AR:*/
on frPDU MsgChannel1.CHASSIS::PHB_IHC_Plus_Tunnel_3_4_AR2
{
	if (TimeToElapse(Timer_EISPHB_IHC_Plus_Tunnel_3_4_AR2_ReceiptPDU) >= 40/2)
	{
		//Timer nicht zu 50% abgelaufen (d.h. aktiv und Botschaft nicht mit halber Zykluszeit empfangen)
		//außer bei spontan
		@sysvar::CH_Nodes::CH__PDURECEIPT_RECEIVE_EIS_PHB_IHC_Plus_Tunnel_3_4_AR2 = 4;
	}
	else
	{
		//Timer zu 50% abgelaufen (d.h. Botschaft mit mindestens halber Zykluszeit empfangen)
		@sysvar::CH_Nodes::CH__PDURECEIPT_RECEIVE_EIS_PHB_IHC_Plus_Tunnel_3_4_AR2 = 3;
	}
	//Timer auf Zykluszeit setzen
	setTimer(Timer_EISPHB_IHC_Plus_Tunnel_3_4_AR2_ReceiptPDU, 40);

	output(this);
}
/*@@end*/
/*@@frPDU:MsgChannel1.CHASSIS::SpringVlv_Stat_AR:*/
on frPDU MsgChannel1.CHASSIS::PHB_IHC_Plus_Tunnel_AR2
{
	if (TimeToElapse(Timer_EISPHB_IHC_Plus_Tunnel_AR2_ReceiptPDU) >= 40/2)
	{
		//Timer nicht zu 50% abgelaufen (d.h. aktiv und Botschaft nicht mit halber Zykluszeit empfangen)
		//außer bei spontan
		@sysvar::CH_Nodes::CH__PDURECEIPT_RECEIVE_EIS_PHB_IHC_Plus_Tunnel_AR2 = 4;
	}
	else
	{
		//Timer zu 50% abgelaufen (d.h. Botschaft mit mindestens halber Zykluszeit empfangen)
		@sysvar::CH_Nodes::CH__PDURECEIPT_RECEIVE_EIS_PHB_IHC_Plus_Tunnel_AR2 = 3;
	}
	//Timer auf Zykluszeit setzen
	setTimer(Timer_EISPHB_IHC_Plus_Tunnel_AR2_ReceiptPDU, 40);

	output(this);
}
/*@@end*/
/*@@frPDU:MsgChannel1.CHASSIS::SpringVlv_Stat_AR:*/
on frPDU MsgChannel1.CHASSIS::PN14_Disp_Rq_AR
{
	if (TimeToElapse(Timer_EISPN14_Disp_Rq_AR_ReceiptPDU) >= 1000/2)
	{
		//Timer nicht zu 50% abgelaufen (d.h. aktiv und Botschaft nicht mit halber Zykluszeit empfangen)
		//außer bei spontan
		@sysvar::CH_Nodes::CH__PDURECEIPT_RECEIVE_EIS_PN14_Disp_Rq_AR = 4;
	}
	else
	{
		//Timer zu 50% abgelaufen (d.h. Botschaft mit mindestens halber Zykluszeit empfangen)
		@sysvar::CH_Nodes::CH__PDURECEIPT_RECEIVE_EIS_PN14_Disp_Rq_AR = 3;
	}
	//Timer auf Zykluszeit setzen
	setTimer(Timer_EISPN14_Disp_Rq_AR_ReceiptPDU, 1000);

	output(this);
}
/*@@end*/
/*@@frPDU:MsgChannel1.CHASSIS::SpringVlv_Stat_AR:*/
on frPDU MsgChannel1.CHASSIS::PN14_Rs1_AR2
{
	if (TimeToElapse(Timer_EISPN14_Rs1_AR2_ReceiptPDU) >= 200/2)
	{
		//Timer nicht zu 50% abgelaufen (d.h. aktiv und Botschaft nicht mit halber Zykluszeit empfangen)
		//außer bei spontan
		@sysvar::CH_Nodes::CH__PDURECEIPT_RECEIVE_EIS_PN14_Rs1_AR2 = 4;
	}
	else
	{
		//Timer zu 50% abgelaufen (d.h. Botschaft mit mindestens halber Zykluszeit empfangen)
		@sysvar::CH_Nodes::CH__PDURECEIPT_RECEIVE_EIS_PN14_Rs1_AR2 = 3;
	}
	//Timer auf Zykluszeit setzen
	setTimer(Timer_EISPN14_Rs1_AR2_ReceiptPDU, 200);

	output(this);
}
/*@@end*/
/*@@frPDU:MsgChannel1.CHASSIS::SpringVlv_Stat_AR:*/
on frPDU MsgChannel1.CHASSIS::PN14_Rs2_AR
{
	if (TimeToElapse(Timer_EISPN14_Rs2_AR_ReceiptPDU) >= 200/2)
	{
		//Timer nicht zu 50% abgelaufen (d.h. aktiv und Botschaft nicht mit halber Zykluszeit empfangen)
		//außer bei spontan
		@sysvar::CH_Nodes::CH__PDURECEIPT_RECEIVE_EIS_PN14_Rs2_AR = 4;
	}
	else
	{
		//Timer zu 50% abgelaufen (d.h. Botschaft mit mindestens halber Zykluszeit empfangen)
		@sysvar::CH_Nodes::CH__PDURECEIPT_RECEIVE_EIS_PN14_Rs2_AR = 3;
	}
	//Timer auf Zykluszeit setzen
	setTimer(Timer_EISPN14_Rs2_AR_ReceiptPDU, 200);

	output(this);
}
/*@@end*/
/*@@frPDU:MsgChannel1.CHASSIS::SpringVlv_Stat_AR:*/
on frPDU MsgChannel1.CHASSIS::PN14_Stat2_AR2
{
	if (TimeToElapse(Timer_EISPN14_Stat2_AR2_ReceiptPDU) >= 200/2)
	{
		//Timer nicht zu 50% abgelaufen (d.h. aktiv und Botschaft nicht mit halber Zykluszeit empfangen)
		//außer bei spontan
		@sysvar::CH_Nodes::CH__PDURECEIPT_RECEIVE_EIS_PN14_Stat2_AR2 = 4;
	}
	else
	{
		//Timer zu 50% abgelaufen (d.h. Botschaft mit mindestens halber Zykluszeit empfangen)
		@sysvar::CH_Nodes::CH__PDURECEIPT_RECEIVE_EIS_PN14_Stat2_AR2 = 3;
	}
	//Timer auf Zykluszeit setzen
	setTimer(Timer_EISPN14_Stat2_AR2_ReceiptPDU, 200);

	output(this);
}
/*@@end*/
/*@@frPDU:MsgChannel1.CHASSIS::SpringVlv_Stat_AR:*/
on frPDU MsgChannel1.CHASSIS::PN14_Stat_AR
{
	if (TimeToElapse(Timer_EISPN14_Stat_AR_ReceiptPDU) >= 100/2)
	{
		//Timer nicht zu 50% abgelaufen (d.h. aktiv und Botschaft nicht mit halber Zykluszeit empfangen)
		//außer bei spontan
		@sysvar::CH_Nodes::CH__PDURECEIPT_RECEIVE_EIS_PN14_Stat_AR = 4;
	}
	else
	{
		//Timer zu 50% abgelaufen (d.h. Botschaft mit mindestens halber Zykluszeit empfangen)
		@sysvar::CH_Nodes::CH__PDURECEIPT_RECEIVE_EIS_PN14_Stat_AR = 3;
	}
	//Timer auf Zykluszeit setzen
	setTimer(Timer_EISPN14_Stat_AR_ReceiptPDU, 100);

	output(this);
}
/*@@end*/
/*@@frPDU:MsgChannel1.CHASSIS::SpringVlv_Stat_AR:*/
on frPDU MsgChannel1.CHASSIS::PN48_Bat_Stat2_AR2
{
	if (TimeToElapse(Timer_EISPN48_Bat_Stat2_AR2_ReceiptPDU) >= 200/2)
	{
		//Timer nicht zu 50% abgelaufen (d.h. aktiv und Botschaft nicht mit halber Zykluszeit empfangen)
		//außer bei spontan
		@sysvar::CH_Nodes::CH__PDURECEIPT_RECEIVE_EIS_PN48_Bat_Stat2_AR2 = 4;
	}
	else
	{
		//Timer zu 50% abgelaufen (d.h. Botschaft mit mindestens halber Zykluszeit empfangen)
		@sysvar::CH_Nodes::CH__PDURECEIPT_RECEIVE_EIS_PN48_Bat_Stat2_AR2 = 3;
	}
	//Timer auf Zykluszeit setzen
	setTimer(Timer_EISPN48_Bat_Stat2_AR2_ReceiptPDU, 200);

	output(this);
}
/*@@end*/
/*@@frPDU:MsgChannel1.CHASSIS::SpringVlv_Stat_AR:*/
on frPDU MsgChannel1.CHASSIS::PN48_Bat_Stat_AR
{
	if (TimeToElapse(Timer_EISPN48_Bat_Stat_AR_ReceiptPDU) >= 40/2)
	{
		//Timer nicht zu 50% abgelaufen (d.h. aktiv und Botschaft nicht mit halber Zykluszeit empfangen)
		//außer bei spontan
		@sysvar::CH_Nodes::CH__PDURECEIPT_RECEIVE_EIS_PN48_Bat_Stat_AR = 4;
	}
	else
	{
		//Timer zu 50% abgelaufen (d.h. Botschaft mit mindestens halber Zykluszeit empfangen)
		@sysvar::CH_Nodes::CH__PDURECEIPT_RECEIVE_EIS_PN48_Bat_Stat_AR = 3;
	}
	//Timer auf Zykluszeit setzen
	setTimer(Timer_EISPN48_Bat_Stat_AR_ReceiptPDU, 40);

	output(this);
}
/*@@end*/
/*@@frPDU:MsgChannel1.CHASSIS::SpringVlv_Stat_AR:*/
on frPDU MsgChannel1.CHASSIS::PN48_BatLim_Stat_AR
{
	if (TimeToElapse(Timer_EISPN48_BatLim_Stat_AR_ReceiptPDU) >= 100/2)
	{
		//Timer nicht zu 50% abgelaufen (d.h. aktiv und Botschaft nicht mit halber Zykluszeit empfangen)
		//außer bei spontan
		@sysvar::CH_Nodes::CH__PDURECEIPT_RECEIVE_EIS_PN48_BatLim_Stat_AR = 4;
	}
	else
	{
		//Timer zu 50% abgelaufen (d.h. Botschaft mit mindestens halber Zykluszeit empfangen)
		@sysvar::CH_Nodes::CH__PDURECEIPT_RECEIVE_EIS_PN48_BatLim_Stat_AR = 3;
	}
	//Timer auf Zykluszeit setzen
	setTimer(Timer_EISPN48_BatLim_Stat_AR_ReceiptPDU, 100);

	output(this);
}
/*@@end*/
/*@@frPDU:MsgChannel1.CHASSIS::SpringVlv_Stat_AR:*/
on frPDU MsgChannel1.CHASSIS::PN48_DCDC48_LISB48_Stat_AR
{
	if (TimeToElapse(Timer_EISPN48_DCDC48_LISB48_Stat_AR_ReceiptPDU) >= 200/2)
	{
		//Timer nicht zu 50% abgelaufen (d.h. aktiv und Botschaft nicht mit halber Zykluszeit empfangen)
		//außer bei spontan
		@sysvar::CH_Nodes::CH__PDURECEIPT_RECEIVE_EIS_PN48_DCDC48_LISB48_Stat_AR = 4;
	}
	else
	{
		//Timer zu 50% abgelaufen (d.h. Botschaft mit mindestens halber Zykluszeit empfangen)
		@sysvar::CH_Nodes::CH__PDURECEIPT_RECEIVE_EIS_PN48_DCDC48_LISB48_Stat_AR = 3;
	}
	//Timer auf Zykluszeit setzen
	setTimer(Timer_EISPN48_DCDC48_LISB48_Stat_AR_ReceiptPDU, 200);

	output(this);
}
/*@@end*/
/*@@frPDU:MsgChannel1.CHASSIS::SpringVlv_Stat_AR:*/
on frPDU MsgChannel1.CHASSIS::PN48_Stat_AR
{
	if (TimeToElapse(Timer_EISPN48_Stat_AR_ReceiptPDU) >= 1000/2)
	{
		//Timer nicht zu 50% abgelaufen (d.h. aktiv und Botschaft nicht mit halber Zykluszeit empfangen)
		//außer bei spontan
		@sysvar::CH_Nodes::CH__PDURECEIPT_RECEIVE_EIS_PN48_Stat_AR = 4;
	}
	else
	{
		//Timer zu 50% abgelaufen (d.h. Botschaft mit mindestens halber Zykluszeit empfangen)
		@sysvar::CH_Nodes::CH__PDURECEIPT_RECEIVE_EIS_PN48_Stat_AR = 3;
	}
	//Timer auf Zykluszeit setzen
	setTimer(Timer_EISPN48_Stat_AR_ReceiptPDU, 1000);

	output(this);
}
/*@@end*/
/*@@frPDU:MsgChannel1.CHASSIS::SpringVlv_Stat_AR:*/
on frPDU MsgChannel1.CHASSIS::PNHV_WeekDepTmTbl_Rq_HU_AR2
{
	if (TimeToElapse(Timer_EISPNHV_WeekDepTmTbl_Rq_HU_AR2_ReceiptPDU) >= 1000/2)
	{
		//Timer nicht zu 50% abgelaufen (d.h. aktiv und Botschaft nicht mit halber Zykluszeit empfangen)
		//außer bei spontan
		@sysvar::CH_Nodes::CH__PDURECEIPT_RECEIVE_EIS_PNHV_WeekDepTmTbl_Rq_HU_AR2 = 4;
	}
	else
	{
		//Timer zu 50% abgelaufen (d.h. Botschaft mit mindestens halber Zykluszeit empfangen)
		@sysvar::CH_Nodes::CH__PDURECEIPT_RECEIVE_EIS_PNHV_WeekDepTmTbl_Rq_HU_AR2 = 3;
	}
	//Timer auf Zykluszeit setzen
	setTimer(Timer_EISPNHV_WeekDepTmTbl_Rq_HU_AR2_ReceiptPDU, 1000);

	output(this);
}
/*@@end*/
/*@@frPDU:MsgChannel1.CHASSIS::SpringVlv_Stat_AR:*/
on frPDU MsgChannel1.CHASSIS::PreCond_On_Rq_AR
{
	if (TimeToElapse(Timer_EISPreCond_On_Rq_AR_ReceiptPDU) >= 1000/2)
	{
		//Timer nicht zu 50% abgelaufen (d.h. aktiv und Botschaft nicht mit halber Zykluszeit empfangen)
		//außer bei spontan
		@sysvar::CH_Nodes::CH__PDURECEIPT_RECEIVE_EIS_PreCond_On_Rq_AR = 4;
	}
	else
	{
		//Timer zu 50% abgelaufen (d.h. Botschaft mit mindestens halber Zykluszeit empfangen)
		@sysvar::CH_Nodes::CH__PDURECEIPT_RECEIVE_EIS_PreCond_On_Rq_AR = 3;
	}
	//Timer auf Zykluszeit setzen
	setTimer(Timer_EISPreCond_On_Rq_AR_ReceiptPDU, 1000);

	output(this);
}
/*@@end*/
/*@@frPDU:MsgChannel1.CHASSIS::SpringVlv_Stat_AR:*/
on frPDU MsgChannel1.CHASSIS::PreCond_Rq_HU_AR2
{
	if (TimeToElapse(Timer_EISPreCond_Rq_HU_AR2_ReceiptPDU) >= 1000/2)
	{
		//Timer nicht zu 50% abgelaufen (d.h. aktiv und Botschaft nicht mit halber Zykluszeit empfangen)
		//außer bei spontan
		@sysvar::CH_Nodes::CH__PDURECEIPT_RECEIVE_EIS_PreCond_Rq_HU_AR2 = 4;
	}
	else
	{
		//Timer zu 50% abgelaufen (d.h. Botschaft mit mindestens halber Zykluszeit empfangen)
		@sysvar::CH_Nodes::CH__PDURECEIPT_RECEIVE_EIS_PreCond_Rq_HU_AR2 = 3;
	}
	//Timer auf Zykluszeit setzen
	setTimer(Timer_EISPreCond_Rq_HU_AR2_ReceiptPDU, 1000);

	output(this);
}
/*@@end*/
/*@@frPDU:MsgChannel1.CHASSIS::SpringVlv_Stat_AR:*/
on frPDU MsgChannel1.CHASSIS::PreCond_Stat_AR
{
	if (TimeToElapse(Timer_EISPreCond_Stat_AR_ReceiptPDU) >= 1000/2)
	{
		//Timer nicht zu 50% abgelaufen (d.h. aktiv und Botschaft nicht mit halber Zykluszeit empfangen)
		//außer bei spontan
		@sysvar::CH_Nodes::CH__PDURECEIPT_RECEIVE_EIS_PreCond_Stat_AR = 4;
	}
	else
	{
		//Timer zu 50% abgelaufen (d.h. Botschaft mit mindestens halber Zykluszeit empfangen)
		@sysvar::CH_Nodes::CH__PDURECEIPT_RECEIVE_EIS_PreCond_Stat_AR = 3;
	}
	//Timer auf Zykluszeit setzen
	setTimer(Timer_EISPreCond_Stat_AR_ReceiptPDU, 1000);

	output(this);
}
/*@@end*/
/*@@frPDU:MsgChannel1.CHASSIS::SpringVlv_Stat_AR:*/
on frPDU MsgChannel1.CHASSIS::PT_ObjIntrst_Gw_AR2
{
	if (TimeToElapse(Timer_EISPT_ObjIntrst_Gw_AR2_ReceiptPDU) >= 40/2)
	{
		//Timer nicht zu 50% abgelaufen (d.h. aktiv und Botschaft nicht mit halber Zykluszeit empfangen)
		//außer bei spontan
		@sysvar::CH_Nodes::CH__PDURECEIPT_RECEIVE_EIS_PT_ObjIntrst_Gw_AR2 = 4;
	}
	else
	{
		//Timer zu 50% abgelaufen (d.h. Botschaft mit mindestens halber Zykluszeit empfangen)
		@sysvar::CH_Nodes::CH__PDURECEIPT_RECEIVE_EIS_PT_ObjIntrst_Gw_AR2 = 3;
	}
	//Timer auf Zykluszeit setzen
	setTimer(Timer_EISPT_ObjIntrst_Gw_AR2_ReceiptPDU, 40);

	output(this);
}
/*@@end*/
/*@@frPDU:MsgChannel1.CHASSIS::SpringVlv_Stat_AR:*/
on frPDU MsgChannel1.CHASSIS::RemPark_Auth_Rs_AR2
{
	if (TimeToElapse(Timer_EISRemPark_Auth_Rs_AR2_ReceiptPDU) >= 1000/2)
	{
		//Timer nicht zu 50% abgelaufen (d.h. aktiv und Botschaft nicht mit halber Zykluszeit empfangen)
		//außer bei spontan
		@sysvar::CH_Nodes::CH__PDURECEIPT_RECEIVE_EIS_RemPark_Auth_Rs_AR2 = 4;
	}
	else
	{
		//Timer zu 50% abgelaufen (d.h. Botschaft mit mindestens halber Zykluszeit empfangen)
		@sysvar::CH_Nodes::CH__PDURECEIPT_RECEIVE_EIS_RemPark_Auth_Rs_AR2 = 3;
	}
	//Timer auf Zykluszeit setzen
	setTimer(Timer_EISRemPark_Auth_Rs_AR2_ReceiptPDU, 1000);

	output(this);
}
/*@@end*/
/*@@frPDU:MsgChannel1.CHASSIS::SpringVlv_Stat_AR:*/
on frPDU MsgChannel1.CHASSIS::RemPark_Stat_EIS_AR2
{
	if (TimeToElapse(Timer_EISRemPark_Stat_EIS_AR2_ReceiptPDU) >= 200/2)
	{
		//Timer nicht zu 50% abgelaufen (d.h. aktiv und Botschaft nicht mit halber Zykluszeit empfangen)
		//außer bei spontan
		@sysvar::CH_Nodes::CH__PDURECEIPT_RECEIVE_EIS_RemPark_Stat_EIS_AR2 = 4;
	}
	else
	{
		//Timer zu 50% abgelaufen (d.h. Botschaft mit mindestens halber Zykluszeit empfangen)
		@sysvar::CH_Nodes::CH__PDURECEIPT_RECEIVE_EIS_RemPark_Stat_EIS_AR2 = 3;
	}
	//Timer auf Zykluszeit setzen
	setTimer(Timer_EISRemPark_Stat_EIS_AR2_ReceiptPDU, 200);

	output(this);
}
/*@@end*/
/*@@frPDU:MsgChannel1.CHASSIS::SpringVlv_Stat_AR:*/
on frPDU MsgChannel1.CHASSIS::RTC_Date_Time_AR2
{
	if (TimeToElapse(Timer_EISRTC_Date_Time_AR2_ReceiptPDU) >= 1000/2)
	{
		//Timer nicht zu 50% abgelaufen (d.h. aktiv und Botschaft nicht mit halber Zykluszeit empfangen)
		//außer bei spontan
		@sysvar::CH_Nodes::CH__PDURECEIPT_RECEIVE_EIS_RTC_Date_Time_AR2 = 4;
	}
	else
	{
		//Timer zu 50% abgelaufen (d.h. Botschaft mit mindestens halber Zykluszeit empfangen)
		@sysvar::CH_Nodes::CH__PDURECEIPT_RECEIVE_EIS_RTC_Date_Time_AR2 = 3;
	}
	//Timer auf Zykluszeit setzen
	setTimer(Timer_EISRTC_Date_Time_AR2_ReceiptPDU, 1000);

	output(this);
}
/*@@end*/
/*@@frPDU:MsgChannel1.CHASSIS::SpringVlv_Stat_AR:*/
on frPDU MsgChannel1.CHASSIS::RTC_Stat1_AR2
{
	if (TimeToElapse(Timer_EISRTC_Stat1_AR2_ReceiptPDU) >= 1000/2)
	{
		//Timer nicht zu 50% abgelaufen (d.h. aktiv und Botschaft nicht mit halber Zykluszeit empfangen)
		//außer bei spontan
		@sysvar::CH_Nodes::CH__PDURECEIPT_RECEIVE_EIS_RTC_Stat1_AR2 = 4;
	}
	else
	{
		//Timer zu 50% abgelaufen (d.h. Botschaft mit mindestens halber Zykluszeit empfangen)
		@sysvar::CH_Nodes::CH__PDURECEIPT_RECEIVE_EIS_RTC_Stat1_AR2 = 3;
	}
	//Timer auf Zykluszeit setzen
	setTimer(Timer_EISRTC_Stat1_AR2_ReceiptPDU, 1000);

	output(this);
}
/*@@end*/
/*@@frPDU:MsgChannel1.CHASSIS::SpringVlv_Stat_AR:*/
on frPDU MsgChannel1.CHASSIS::SADR_Trgr_FCW_AR2
{
	if (TimeToElapse(Timer_EISSADR_Trgr_FCW_AR2_ReceiptPDU) >= 5/2)
	{
		//Timer nicht zu 50% abgelaufen (d.h. aktiv und Botschaft nicht mit halber Zykluszeit empfangen)
		//außer bei spontan
		@sysvar::CH_Nodes::CH__PDURECEIPT_RECEIVE_EIS_SADR_Trgr_FCW_AR2 = 4;
	}
	else
	{
		//Timer zu 50% abgelaufen (d.h. Botschaft mit mindestens halber Zykluszeit empfangen)
		@sysvar::CH_Nodes::CH__PDURECEIPT_RECEIVE_EIS_SADR_Trgr_FCW_AR2 = 3;
	}
	//Timer auf Zykluszeit setzen
	setTimer(Timer_EISSADR_Trgr_FCW_AR2_ReceiptPDU, 5);

	output(this);
}
/*@@end*/
/*@@frPDU:MsgChannel1.CHASSIS::SpringVlv_Stat_AR:*/
on frPDU MsgChannel1.CHASSIS::SeatAdj_FL_Rq_AR
{
	if (TimeToElapse(Timer_EISSeatAdj_FL_Rq_AR_ReceiptPDU) >= 5/2)
	{
		//Timer nicht zu 50% abgelaufen (d.h. aktiv und Botschaft nicht mit halber Zykluszeit empfangen)
		//außer bei spontan
		@sysvar::CH_Nodes::CH__PDURECEIPT_RECEIVE_EIS_SeatAdj_FL_Rq_AR = 4;
	}
	else
	{
		//Timer zu 50% abgelaufen (d.h. Botschaft mit mindestens halber Zykluszeit empfangen)
		@sysvar::CH_Nodes::CH__PDURECEIPT_RECEIVE_EIS_SeatAdj_FL_Rq_AR = 3;
	}
	//Timer auf Zykluszeit setzen
	setTimer(Timer_EISSeatAdj_FL_Rq_AR_ReceiptPDU, 5);

	output(this);
}
/*@@end*/
/*@@frPDU:MsgChannel1.CHASSIS::SpringVlv_Stat_AR:*/
on frPDU MsgChannel1.CHASSIS::SeatAdj_FR_Rq_AR
{
	if (TimeToElapse(Timer_EISSeatAdj_FR_Rq_AR_ReceiptPDU) >= 5/2)
	{
		//Timer nicht zu 50% abgelaufen (d.h. aktiv und Botschaft nicht mit halber Zykluszeit empfangen)
		//außer bei spontan
		@sysvar::CH_Nodes::CH__PDURECEIPT_RECEIVE_EIS_SeatAdj_FR_Rq_AR = 4;
	}
	else
	{
		//Timer zu 50% abgelaufen (d.h. Botschaft mit mindestens halber Zykluszeit empfangen)
		@sysvar::CH_Nodes::CH__PDURECEIPT_RECEIVE_EIS_SeatAdj_FR_Rq_AR = 3;
	}
	//Timer auf Zykluszeit setzen
	setTimer(Timer_EISSeatAdj_FR_Rq_AR_ReceiptPDU, 5);

	output(this);
}
/*@@end*/
/*@@frPDU:MsgChannel1.CHASSIS::SpringVlv_Stat_AR:*/
on frPDU MsgChannel1.CHASSIS::SPCR_Stat_BC_F_AR2
{
	if (TimeToElapse(Timer_EISSPCR_Stat_BC_F_AR2_ReceiptPDU) >= 100/2)
	{
		//Timer nicht zu 50% abgelaufen (d.h. aktiv und Botschaft nicht mit halber Zykluszeit empfangen)
		//außer bei spontan
		@sysvar::CH_Nodes::CH__PDURECEIPT_RECEIVE_EIS_SPCR_Stat_BC_F_AR2 = 4;
	}
	else
	{
		//Timer zu 50% abgelaufen (d.h. Botschaft mit mindestens halber Zykluszeit empfangen)
		@sysvar::CH_Nodes::CH__PDURECEIPT_RECEIVE_EIS_SPCR_Stat_BC_F_AR2 = 3;
	}
	//Timer auf Zykluszeit setzen
	setTimer(Timer_EISSPCR_Stat_BC_F_AR2_ReceiptPDU, 100);

	output(this);
}
/*@@end*/
/*@@frPDU:MsgChannel1.CHASSIS::SpringVlv_Stat_AR:*/
on frPDU MsgChannel1.CHASSIS::SPL_Obj1_Obj2_NV_AR2
{
	if (TimeToElapse(Timer_EISSPL_Obj1_Obj2_NV_AR2_ReceiptPDU) >= 80/2)
	{
		//Timer nicht zu 50% abgelaufen (d.h. aktiv und Botschaft nicht mit halber Zykluszeit empfangen)
		//außer bei spontan
		@sysvar::CH_Nodes::CH__PDURECEIPT_RECEIVE_EIS_SPL_Obj1_Obj2_NV_AR2 = 4;
	}
	else
	{
		//Timer zu 50% abgelaufen (d.h. Botschaft mit mindestens halber Zykluszeit empfangen)
		@sysvar::CH_Nodes::CH__PDURECEIPT_RECEIVE_EIS_SPL_Obj1_Obj2_NV_AR2 = 3;
	}
	//Timer auf Zykluszeit setzen
	setTimer(Timer_EISSPL_Obj1_Obj2_NV_AR2_ReceiptPDU, 80);

	output(this);
}
/*@@end*/
/*@@frPDU:MsgChannel1.CHASSIS::SpringVlv_Stat_AR:*/
on frPDU MsgChannel1.CHASSIS::SPV_Actn_Rq_AR2
{
	if (TimeToElapse(Timer_EISSPV_Actn_Rq_AR2_ReceiptPDU) >= 100/2)
	{
		//Timer nicht zu 50% abgelaufen (d.h. aktiv und Botschaft nicht mit halber Zykluszeit empfangen)
		//außer bei spontan
		@sysvar::CH_Nodes::CH__PDURECEIPT_RECEIVE_EIS_SPV_Actn_Rq_AR2 = 4;
	}
	else
	{
		//Timer zu 50% abgelaufen (d.h. Botschaft mit mindestens halber Zykluszeit empfangen)
		@sysvar::CH_Nodes::CH__PDURECEIPT_RECEIVE_EIS_SPV_Actn_Rq_AR2 = 3;
	}
	//Timer auf Zykluszeit setzen
	setTimer(Timer_EISSPV_Actn_Rq_AR2_ReceiptPDU, 100);

	output(this);
}
/*@@end*/
/*@@frPDU:MsgChannel1.CHASSIS::SpringVlv_Stat_AR:*/
on frPDU MsgChannel1.CHASSIS::SPV_Alm_Rq_AR
{
	if (TimeToElapse(Timer_EISSPV_Alm_Rq_AR_ReceiptPDU) >= 100/2)
	{
		//Timer nicht zu 50% abgelaufen (d.h. aktiv und Botschaft nicht mit halber Zykluszeit empfangen)
		//außer bei spontan
		@sysvar::CH_Nodes::CH__PDURECEIPT_RECEIVE_EIS_SPV_Alm_Rq_AR = 4;
	}
	else
	{
		//Timer zu 50% abgelaufen (d.h. Botschaft mit mindestens halber Zykluszeit empfangen)
		@sysvar::CH_Nodes::CH__PDURECEIPT_RECEIVE_EIS_SPV_Alm_Rq_AR = 3;
	}
	//Timer auf Zykluszeit setzen
	setTimer(Timer_EISSPV_Alm_Rq_AR_ReceiptPDU, 100);

	output(this);
}
/*@@end*/
/*@@frPDU:MsgChannel1.CHASSIS::SpringVlv_Stat_AR:*/
on frPDU MsgChannel1.CHASSIS::SPV_Stat_AR2
{
	if (TimeToElapse(Timer_EISSPV_Stat_AR2_ReceiptPDU) >= 1000/2)
	{
		//Timer nicht zu 50% abgelaufen (d.h. aktiv und Botschaft nicht mit halber Zykluszeit empfangen)
		//außer bei spontan
		@sysvar::CH_Nodes::CH__PDURECEIPT_RECEIVE_EIS_SPV_Stat_AR2 = 4;
	}
	else
	{
		//Timer zu 50% abgelaufen (d.h. Botschaft mit mindestens halber Zykluszeit empfangen)
		@sysvar::CH_Nodes::CH__PDURECEIPT_RECEIVE_EIS_SPV_Stat_AR2 = 3;
	}
	//Timer auf Zykluszeit setzen
	setTimer(Timer_EISSPV_Stat_AR2_ReceiptPDU, 1000);

	output(this);
}
/*@@end*/
/*@@frPDU:MsgChannel1.CHASSIS::SpringVlv_Stat_AR:*/
on frPDU MsgChannel1.CHASSIS::SVS_Rq_HU_AR2
{
	if (TimeToElapse(Timer_EISSVS_Rq_HU_AR2_ReceiptPDU) >= 1000/2)
	{
		//Timer nicht zu 50% abgelaufen (d.h. aktiv und Botschaft nicht mit halber Zykluszeit empfangen)
		//außer bei spontan
		@sysvar::CH_Nodes::CH__PDURECEIPT_RECEIVE_EIS_SVS_Rq_HU_AR2 = 4;
	}
	else
	{
		//Timer zu 50% abgelaufen (d.h. Botschaft mit mindestens halber Zykluszeit empfangen)
		@sysvar::CH_Nodes::CH__PDURECEIPT_RECEIVE_EIS_SVS_Rq_HU_AR2 = 3;
	}
	//Timer auf Zykluszeit setzen
	setTimer(Timer_EISSVS_Rq_HU_AR2_ReceiptPDU, 1000);

	output(this);
}
/*@@end*/
/*@@frPDU:MsgChannel1.CHASSIS::SpringVlv_Stat_AR:*/
on frPDU MsgChannel1.CHASSIS::TBCSC_DAC_EPS_AR2
{
	if (TimeToElapse(Timer_EISTBCSC_DAC_EPS_AR2_ReceiptPDU) >= 5/2)
	{
		//Timer nicht zu 50% abgelaufen (d.h. aktiv und Botschaft nicht mit halber Zykluszeit empfangen)
		//außer bei spontan
	}
	else
	{
		//Timer zu 50% abgelaufen (d.h. Botschaft mit mindestens halber Zykluszeit empfangen)
		@sysvar::CH_Nodes::CH__PDURECEIPT_RECEIVE_EIS_TBCSC_DAC_EPS_AR2 = 3;
	}
	//Timer auf Zykluszeit setzen
	setTimer(Timer_EISTBCSC_DAC_EPS_AR2_ReceiptPDU, 5);

	output(this);
}
/*@@end*/
/*@@frPDU:MsgChannel1.CHASSIS::SpringVlv_Stat_AR:*/
on frPDU MsgChannel1.CHASSIS::TBCSC_DAC_ESP_AR2
{
	if (TimeToElapse(Timer_EISTBCSC_DAC_ESP_AR2_ReceiptPDU) >= 5/2)
	{
		//Timer nicht zu 50% abgelaufen (d.h. aktiv und Botschaft nicht mit halber Zykluszeit empfangen)
		//außer bei spontan
	}
	else
	{
		//Timer zu 50% abgelaufen (d.h. Botschaft mit mindestens halber Zykluszeit empfangen)
		@sysvar::CH_Nodes::CH__PDURECEIPT_RECEIVE_EIS_TBCSC_DAC_ESP_AR2 = 3;
	}
	//Timer auf Zykluszeit setzen
	setTimer(Timer_EISTBCSC_DAC_ESP_AR2_ReceiptPDU, 5);

	output(this);
}
/*@@end*/
/*@@frPDU:MsgChannel1.CHASSIS::SpringVlv_Stat_AR:*/
on frPDU MsgChannel1.CHASSIS::TBCSC_Hi_Rq1_AR2
{
	if (TimeToElapse(Timer_EISTBCSC_Hi_Rq1_AR2_ReceiptPDU) >= 5/2)
	{
		//Timer nicht zu 50% abgelaufen (d.h. aktiv und Botschaft nicht mit halber Zykluszeit empfangen)
		//außer bei spontan
	}
	else
	{
		//Timer zu 50% abgelaufen (d.h. Botschaft mit mindestens halber Zykluszeit empfangen)
		@sysvar::CH_Nodes::CH__PDURECEIPT_RECEIVE_EIS_TBCSC_Hi_Rq1_AR2 = 3;
	}
	//Timer auf Zykluszeit setzen
	setTimer(Timer_EISTBCSC_Hi_Rq1_AR2_ReceiptPDU, 5);

	output(this);
}
/*@@end*/
/*@@frPDU:MsgChannel1.CHASSIS::SpringVlv_Stat_AR:*/
on frPDU MsgChannel1.CHASSIS::TBCSC_Hi_Rq2_AR2
{
	if (TimeToElapse(Timer_EISTBCSC_Hi_Rq2_AR2_ReceiptPDU) >= 5/2)
	{
		//Timer nicht zu 50% abgelaufen (d.h. aktiv und Botschaft nicht mit halber Zykluszeit empfangen)
		//außer bei spontan
	}
	else
	{
		//Timer zu 50% abgelaufen (d.h. Botschaft mit mindestens halber Zykluszeit empfangen)
		@sysvar::CH_Nodes::CH__PDURECEIPT_RECEIVE_EIS_TBCSC_Hi_Rq2_AR2 = 3;
	}
	//Timer auf Zykluszeit setzen
	setTimer(Timer_EISTBCSC_Hi_Rq2_AR2_ReceiptPDU, 5);

	output(this);
}
/*@@end*/
/*@@frPDU:MsgChannel1.CHASSIS::SpringVlv_Stat_AR:*/
on frPDU MsgChannel1.CHASSIS::TBCSC_Lo_Rq1_AR2
{
	if (TimeToElapse(Timer_EISTBCSC_Lo_Rq1_AR2_ReceiptPDU) >= 5/2)
	{
		//Timer nicht zu 50% abgelaufen (d.h. aktiv und Botschaft nicht mit halber Zykluszeit empfangen)
		//außer bei spontan
	}
	else
	{
		//Timer zu 50% abgelaufen (d.h. Botschaft mit mindestens halber Zykluszeit empfangen)
		@sysvar::CH_Nodes::CH__PDURECEIPT_RECEIVE_EIS_TBCSC_Lo_Rq1_AR2 = 3;
	}
	//Timer auf Zykluszeit setzen
	setTimer(Timer_EISTBCSC_Lo_Rq1_AR2_ReceiptPDU, 5);

	output(this);
}
/*@@end*/
/*@@frPDU:MsgChannel1.CHASSIS::SpringVlv_Stat_AR:*/
on frPDU MsgChannel1.CHASSIS::TBCSC_Lo_Rq2_AR2
{
	if (TimeToElapse(Timer_EISTBCSC_Lo_Rq2_AR2_ReceiptPDU) >= 5/2)
	{
		//Timer nicht zu 50% abgelaufen (d.h. aktiv und Botschaft nicht mit halber Zykluszeit empfangen)
		//außer bei spontan
	}
	else
	{
		//Timer zu 50% abgelaufen (d.h. Botschaft mit mindestens halber Zykluszeit empfangen)
		@sysvar::CH_Nodes::CH__PDURECEIPT_RECEIVE_EIS_TBCSC_Lo_Rq2_AR2 = 3;
	}
	//Timer auf Zykluszeit setzen
	setTimer(Timer_EISTBCSC_Lo_Rq2_AR2_ReceiptPDU, 5);

	output(this);
}
/*@@end*/
/*@@frPDU:MsgChannel1.CHASSIS::SpringVlv_Stat_AR:*/
on frPDU MsgChannel1.CHASSIS::TC_Distance_AR
{
	if (TimeToElapse(Timer_EISTC_Distance_AR_ReceiptPDU) >= 100/2)
	{
		//Timer nicht zu 50% abgelaufen (d.h. aktiv und Botschaft nicht mit halber Zykluszeit empfangen)
		//außer bei spontan
		@sysvar::CH_Nodes::CH__PDURECEIPT_RECEIVE_EIS_TC_Distance_AR = 4;
	}
	else
	{
		//Timer zu 50% abgelaufen (d.h. Botschaft mit mindestens halber Zykluszeit empfangen)
		@sysvar::CH_Nodes::CH__PDURECEIPT_RECEIVE_EIS_TC_Distance_AR = 3;
	}
	//Timer auf Zykluszeit setzen
	setTimer(Timer_EISTC_Distance_AR_ReceiptPDU, 100);
	if (TimeToElapse(Timer_EISTC_Distance_AR_ReceiptPDU) >= 100/2)
	{
		//Timer nicht zu 50% abgelaufen (d.h. aktiv und Botschaft nicht mit halber Zykluszeit empfangen)
		//außer bei spontan
		@sysvar::CH_Nodes::CH__PDURECEIPT_RECEIVE_EIS_TC_Distance_AR = 4;
	}
	else
	{
		//Timer zu 50% abgelaufen (d.h. Botschaft mit mindestens halber Zykluszeit empfangen)
		@sysvar::CH_Nodes::CH__PDURECEIPT_RECEIVE_EIS_TC_Distance_AR = 3;
	}
	//Timer auf Zykluszeit setzen
	setTimer(Timer_EISTC_Distance_AR_ReceiptPDU, 100);
	if (TimeToElapse(Timer_EISTC_Distance_AR_ReceiptPDU) >= 100/2)
	{
		//Timer nicht zu 50% abgelaufen (d.h. aktiv und Botschaft nicht mit halber Zykluszeit empfangen)
		//außer bei spontan
		@sysvar::CH_Nodes::CH__PDURECEIPT_RECEIVE_EIS_TC_Distance_AR = 4;
	}
	else
	{
		//Timer zu 50% abgelaufen (d.h. Botschaft mit mindestens halber Zykluszeit empfangen)
		@sysvar::CH_Nodes::CH__PDURECEIPT_RECEIVE_EIS_TC_Distance_AR = 3;
	}
	//Timer auf Zykluszeit setzen
	setTimer(Timer_EISTC_Distance_AR_ReceiptPDU, 100);
	if (TimeToElapse(Timer_EISTC_Distance_AR_ReceiptPDU) >= 100/2)
	{
		//Timer nicht zu 50% abgelaufen (d.h. aktiv und Botschaft nicht mit halber Zykluszeit empfangen)
		//außer bei spontan
		@sysvar::CH_Nodes::CH__PDURECEIPT_RECEIVE_EIS_TC_Distance_AR = 4;
	}
	else
	{
		//Timer zu 50% abgelaufen (d.h. Botschaft mit mindestens halber Zykluszeit empfangen)
		@sysvar::CH_Nodes::CH__PDURECEIPT_RECEIVE_EIS_TC_Distance_AR = 3;
	}
	//Timer auf Zykluszeit setzen
	setTimer(Timer_EISTC_Distance_AR_ReceiptPDU, 100);

	output(this);
}
/*@@end*/
/*@@frPDU:MsgChannel1.CHASSIS::SpringVlv_Stat_AR:*/
on frPDU MsgChannel1.CHASSIS::TGW_DateTm_Stat_AR
{
	if (TimeToElapse(Timer_EISTGW_DateTm_Stat_AR_ReceiptPDU) >= 5000/2)
	{
		//Timer nicht zu 50% abgelaufen (d.h. aktiv und Botschaft nicht mit halber Zykluszeit empfangen)
		//außer bei spontan
		@sysvar::CH_Nodes::CH__PDURECEIPT_RECEIVE_EIS_TGW_DateTm_Stat_AR = 4;
	}
	else
	{
		//Timer zu 50% abgelaufen (d.h. Botschaft mit mindestens halber Zykluszeit empfangen)
		@sysvar::CH_Nodes::CH__PDURECEIPT_RECEIVE_EIS_TGW_DateTm_Stat_AR = 3;
	}
	//Timer auf Zykluszeit setzen
	setTimer(Timer_EISTGW_DateTm_Stat_AR_ReceiptPDU, 5000);

	output(this);
}
/*@@end*/
/*@@frPDU:MsgChannel1.CHASSIS::SpringVlv_Stat_AR:*/
on frPDU MsgChannel1.CHASSIS::Tire_State_AR2
{
	if (TimeToElapse(Timer_EISTire_State_AR2_ReceiptPDU) >= 1000/2)
	{
		//Timer nicht zu 50% abgelaufen (d.h. aktiv und Botschaft nicht mit halber Zykluszeit empfangen)
		//außer bei spontan
		@sysvar::CH_Nodes::CH__PDURECEIPT_RECEIVE_EIS_Tire_State_AR2 = 4;
	}
	else
	{
		//Timer zu 50% abgelaufen (d.h. Botschaft mit mindestens halber Zykluszeit empfangen)
		@sysvar::CH_Nodes::CH__PDURECEIPT_RECEIVE_EIS_Tire_State_AR2 = 3;
	}
	//Timer auf Zykluszeit setzen
	setTimer(Timer_EISTire_State_AR2_ReceiptPDU, 1000);

	output(this);
}
/*@@end*/
/*@@frPDU:MsgChannel1.CHASSIS::SpringVlv_Stat_AR:*/
on frPDU MsgChannel1.CHASSIS::TrafficInfo_AR
{
	if (TimeToElapse(Timer_EISTrafficInfo_AR_ReceiptPDU) >= 1000/2)
	{
		//Timer nicht zu 50% abgelaufen (d.h. aktiv und Botschaft nicht mit halber Zykluszeit empfangen)
		//außer bei spontan
		@sysvar::CH_Nodes::CH__PDURECEIPT_RECEIVE_EIS_TrafficInfo_AR = 4;
	}
	else
	{
		//Timer zu 50% abgelaufen (d.h. Botschaft mit mindestens halber Zykluszeit empfangen)
		@sysvar::CH_Nodes::CH__PDURECEIPT_RECEIVE_EIS_TrafficInfo_AR = 3;
	}
	//Timer auf Zykluszeit setzen
	setTimer(Timer_EISTrafficInfo_AR_ReceiptPDU, 1000);

	output(this);
}
/*@@end*/
/*@@frPDU:MsgChannel1.CHASSIS::SpringVlv_Stat_AR:*/
on frPDU MsgChannel1.CHASSIS::Trailer_Stat_AR2
{
	if (TimeToElapse(Timer_EISTrailer_Stat_AR2_ReceiptPDU) >= 500/2)
	{
		//Timer nicht zu 50% abgelaufen (d.h. aktiv und Botschaft nicht mit halber Zykluszeit empfangen)
		//außer bei spontan
		@sysvar::CH_Nodes::CH__PDURECEIPT_RECEIVE_EIS_Trailer_Stat_AR2 = 4;
	}
	else
	{
		//Timer zu 50% abgelaufen (d.h. Botschaft mit mindestens halber Zykluszeit empfangen)
		@sysvar::CH_Nodes::CH__PDURECEIPT_RECEIVE_EIS_Trailer_Stat_AR2 = 3;
	}
	//Timer auf Zykluszeit setzen
	setTimer(Timer_EISTrailer_Stat_AR2_ReceiptPDU, 500);

	output(this);
}
/*@@end*/
/*@@frPDU:MsgChannel1.CHASSIS::SpringVlv_Stat_AR:*/
on frPDU MsgChannel1.CHASSIS::TSA_Disp_Rq1_AR2
{
	if (TimeToElapse(Timer_EISTSA_Disp_Rq1_AR2_ReceiptPDU) >= 200/2)
	{
		//Timer nicht zu 50% abgelaufen (d.h. aktiv und Botschaft nicht mit halber Zykluszeit empfangen)
		//außer bei spontan
		@sysvar::CH_Nodes::CH__PDURECEIPT_RECEIVE_EIS_TSA_Disp_Rq1_AR2 = 4;
	}
	else
	{
		//Timer zu 50% abgelaufen (d.h. Botschaft mit mindestens halber Zykluszeit empfangen)
		@sysvar::CH_Nodes::CH__PDURECEIPT_RECEIVE_EIS_TSA_Disp_Rq1_AR2 = 3;
	}
	//Timer auf Zykluszeit setzen
	setTimer(Timer_EISTSA_Disp_Rq1_AR2_ReceiptPDU, 200);

	output(this);
}
/*@@end*/
/*@@frPDU:MsgChannel1.CHASSIS::SpringVlv_Stat_AR:*/
on frPDU MsgChannel1.CHASSIS::TSA_Disp_Rq2_AR
{
	if (TimeToElapse(Timer_EISTSA_Disp_Rq2_AR_ReceiptPDU) >= 200/2)
	{
		//Timer nicht zu 50% abgelaufen (d.h. aktiv und Botschaft nicht mit halber Zykluszeit empfangen)
		//außer bei spontan
		@sysvar::CH_Nodes::CH__PDURECEIPT_RECEIVE_EIS_TSA_Disp_Rq2_AR = 4;
	}
	else
	{
		//Timer zu 50% abgelaufen (d.h. Botschaft mit mindestens halber Zykluszeit empfangen)
		@sysvar::CH_Nodes::CH__PDURECEIPT_RECEIVE_EIS_TSA_Disp_Rq2_AR = 3;
	}
	//Timer auf Zykluszeit setzen
	setTimer(Timer_EISTSA_Disp_Rq2_AR_ReceiptPDU, 200);

	output(this);
}
/*@@end*/
/*@@frPDU:MsgChannel1.CHASSIS::SpringVlv_Stat_AR:*/
on frPDU MsgChannel1.CHASSIS::TSA_Disp_Rq3_AR
{
	if (TimeToElapse(Timer_EISTSA_Disp_Rq3_AR_ReceiptPDU) >= 200/2)
	{
		//Timer nicht zu 50% abgelaufen (d.h. aktiv und Botschaft nicht mit halber Zykluszeit empfangen)
		//außer bei spontan
		@sysvar::CH_Nodes::CH__PDURECEIPT_RECEIVE_EIS_TSA_Disp_Rq3_AR = 4;
	}
	else
	{
		//Timer zu 50% abgelaufen (d.h. Botschaft mit mindestens halber Zykluszeit empfangen)
		@sysvar::CH_Nodes::CH__PDURECEIPT_RECEIVE_EIS_TSA_Disp_Rq3_AR = 3;
	}
	//Timer auf Zykluszeit setzen
	setTimer(Timer_EISTSA_Disp_Rq3_AR_ReceiptPDU, 200);

	output(this);
}
/*@@end*/
/*@@frPDU:MsgChannel1.CHASSIS::SpringVlv_Stat_AR:*/
on frPDU MsgChannel1.CHASSIS::VehAccel_X_Rq_Gw_AR2
{
	if (TimeToElapse(Timer_EISVehAccel_X_Rq_Gw_AR2_ReceiptPDU) >= 20/2)
	{
		//Timer nicht zu 50% abgelaufen (d.h. aktiv und Botschaft nicht mit halber Zykluszeit empfangen)
		//außer bei spontan
		@sysvar::CH_Nodes::CH__PDURECEIPT_RECEIVE_EIS_VehAccel_X_Rq_Gw_AR2 = 4;
	}
	else
	{
		//Timer zu 50% abgelaufen (d.h. Botschaft mit mindestens halber Zykluszeit empfangen)
		@sysvar::CH_Nodes::CH__PDURECEIPT_RECEIVE_EIS_VehAccel_X_Rq_Gw_AR2 = 3;
	}
	//Timer auf Zykluszeit setzen
	setTimer(Timer_EISVehAccel_X_Rq_Gw_AR2_ReceiptPDU, 20);

	output(this);
}
/*@@end*/
/*@@frPDU:MsgChannel1.CHASSIS::SpringVlv_Stat_AR:*/
on frPDU MsgChannel1.CHASSIS::VIN_AR
{
		if (TimeToElapse(Timer_EISVIN_AR_ReceiptPDU) >= 1000/2)
		{
		//Timer nicht zu 50% abgelaufen (d.h. aktiv und Botschaft nicht mit halber Zykluszeit empfangen)
		//außer bei spontan
		@sysvar::CH_Nodes::CH__PDURECEIPT_RECEIVE_EIS_VIN_AR = 4;
	}
	else
	{
		//Timer zu 50% abgelaufen (d.h. Botschaft mit mindestens halber Zykluszeit empfangen)
		@sysvar::CH_Nodes::CH__PDURECEIPT_RECEIVE_EIS_VIN_AR = 3;
	}
	//Timer auf Zykluszeit setzen
	setTimer(Timer_EISVIN_AR_ReceiptPDU, 1000);

	output(this);
}
/*@@end*/
/*@@frPDU:MsgChannel1.CHASSIS::SpringVlv_Stat_AR:*/
on frPDU MsgChannel1.CHASSIS::Wiper_Stat_AR
{
	if (TimeToElapse(Timer_EISWiper_Stat_AR_ReceiptPDU) >= 1000/2)
	{
		//Timer nicht zu 50% abgelaufen (d.h. aktiv und Botschaft nicht mit halber Zykluszeit empfangen)
		//außer bei spontan
		@sysvar::CH_Nodes::CH__PDURECEIPT_RECEIVE_EIS_Wiper_Stat_AR = 4;
	}
	else
	{
		//Timer zu 50% abgelaufen (d.h. Botschaft mit mindestens halber Zykluszeit empfangen)
		@sysvar::CH_Nodes::CH__PDURECEIPT_RECEIVE_EIS_Wiper_Stat_AR = 3;
	}
	//Timer auf Zykluszeit setzen
	setTimer(Timer_EISWiper_Stat_AR_ReceiptPDU, 1000);

	output(this);
}
/*@@end*/
/*@@frPDU:MsgChannel1.CHASSIS::SpringVlv_Stat_AR:*/
on frPDU MsgChannel1.CHASSIS::WUDOP_EIS_FR
{
	if (TimeToElapse(Timer_EISWUDOP_EIS_FR_ReceiptPDU) >= 320/2)
	{
		//Timer nicht zu 50% abgelaufen (d.h. aktiv und Botschaft nicht mit halber Zykluszeit empfangen)
		//außer bei spontan
		@sysvar::CH_Nodes::CH__PDURECEIPT_RECEIVE_EIS_WUDOP_EIS_FR = 4;
	}
	else
	{
		//Timer zu 50% abgelaufen (d.h. Botschaft mit mindestens halber Zykluszeit empfangen)
		@sysvar::CH_Nodes::CH__PDURECEIPT_RECEIVE_EIS_WUDOP_EIS_FR = 3;
	}
	//Timer auf Zykluszeit setzen
	setTimer(Timer_EISWUDOP_EIS_FR_ReceiptPDU, 320);

	output(this);
}
/*@@end*/
/*@@frPDU:MsgChannel1.CHASSIS::SpringVlv_Stat_AR:*/
on frPDU MsgChannel1.CHASSIS::YMAS_Rq_MPC_AR2
{
	if (TimeToElapse(Timer_EISYMAS_Rq_MPC_AR2_ReceiptPDU) >= 20/2)
	{
		//Timer nicht zu 50% abgelaufen (d.h. aktiv und Botschaft nicht mit halber Zykluszeit empfangen)
		//außer bei spontan
		@sysvar::CH_Nodes::CH__PDURECEIPT_RECEIVE_EIS_YMAS_Rq_MPC_AR2 = 4;
	}
	else
	{
		//Timer zu 50% abgelaufen (d.h. Botschaft mit mindestens halber Zykluszeit empfangen)
		@sysvar::CH_Nodes::CH__PDURECEIPT_RECEIVE_EIS_YMAS_Rq_MPC_AR2 = 3;
	}
	//Timer auf Zykluszeit setzen
	setTimer(Timer_EISYMAS_Rq_MPC_AR2_ReceiptPDU, 20);

	output(this);
}
/*@@end*/
/*@@frPDU:MsgChannel1.CHASSIS::SpringVlv_Stat_AR:*/
on frPDU MsgChannel1.CHASSIS::DTQ_Rs_AR2
{
	if (TimeToElapse(Timer_EPSDTQ_Rs_AR2_ReceiptPDU) >= 20/2)
	{
		//Timer nicht zu 50% abgelaufen (d.h. aktiv und Botschaft nicht mit halber Zykluszeit empfangen)
		//außer bei spontan
		@sysvar::CH_Nodes::CH__PDURECEIPT_RECEIVE_EPS_DTQ_Rs_AR2 = 4;
	}
	else
	{
		//Timer zu 50% abgelaufen (d.h. Botschaft mit mindestens halber Zykluszeit empfangen)
		@sysvar::CH_Nodes::CH__PDURECEIPT_RECEIVE_EPS_DTQ_Rs_AR2 = 3;
	}
	//Timer auf Zykluszeit setzen
	setTimer(Timer_EPSDTQ_Rs_AR2_ReceiptPDU, 20);

	output(this);
}
/*@@end*/
/*@@frPDU:MsgChannel1.CHASSIS::SpringVlv_Stat_AR:*/
on frPDU MsgChannel1.CHASSIS::EPS_Stat_Disp_Rq_AR2
{
	if (TimeToElapse(Timer_EPSEPS_Stat_Disp_Rq_AR2_ReceiptPDU) >= 200/2)
	{
		//Timer nicht zu 50% abgelaufen (d.h. aktiv und Botschaft nicht mit halber Zykluszeit empfangen)
		//außer bei spontan
		@sysvar::CH_Nodes::CH__PDURECEIPT_RECEIVE_EPS_EPS_Stat_Disp_Rq_AR2 = 4;
	}
	else
	{
		//Timer zu 50% abgelaufen (d.h. Botschaft mit mindestens halber Zykluszeit empfangen)
		@sysvar::CH_Nodes::CH__PDURECEIPT_RECEIVE_EPS_EPS_Stat_Disp_Rq_AR2 = 3;
	}
	//Timer auf Zykluszeit setzen
	setTimer(Timer_EPSEPS_Stat_Disp_Rq_AR2_ReceiptPDU, 200);

	output(this);
}
/*@@end*/
/*@@frPDU:MsgChannel1.CHASSIS::SpringVlv_Stat_AR:*/
on frPDU MsgChannel1.CHASSIS::PARK_St_Rs_AR2
{
	if (TimeToElapse(Timer_EPSPARK_St_Rs_AR2_ReceiptPDU) >= 20/2)
	{
		//Timer nicht zu 50% abgelaufen (d.h. aktiv und Botschaft nicht mit halber Zykluszeit empfangen)
		//außer bei spontan
		@sysvar::CH_Nodes::CH__PDURECEIPT_RECEIVE_EPS_PARK_St_Rs_AR2 = 4;
	}
	else
	{
		//Timer zu 50% abgelaufen (d.h. Botschaft mit mindestens halber Zykluszeit empfangen)
		@sysvar::CH_Nodes::CH__PDURECEIPT_RECEIVE_EPS_PARK_St_Rs_AR2 = 3;
	}
	//Timer auf Zykluszeit setzen
	setTimer(Timer_EPSPARK_St_Rs_AR2_ReceiptPDU, 20);

	output(this);
}
/*@@end*/
/*@@frPDU:MsgChannel1.CHASSIS::SpringVlv_Stat_AR:*/
on frPDU MsgChannel1.CHASSIS::ROE_EPS
{
	if (TimeToElapse(Timer_EPSROE_EPS_ReceiptPDU) >= 5/2)
	{
		//Timer nicht zu 50% abgelaufen (d.h. aktiv und Botschaft nicht mit halber Zykluszeit empfangen)
		//außer bei spontan
	}
	else
	{
		//Timer zu 50% abgelaufen (d.h. Botschaft mit mindestens halber Zykluszeit empfangen)
		@sysvar::CH_Nodes::CH__PDURECEIPT_RECEIVE_EPS_ROE_EPS = 3;
	}
	//Timer auf Zykluszeit setzen
	setTimer(Timer_EPSROE_EPS_ReceiptPDU, 5);

	output(this);
}
/*@@end*/
/*@@frPDU:MsgChannel1.CHASSIS::SpringVlv_Stat_AR:*/
on frPDU MsgChannel1.CHASSIS::STA_Rs1_AR2
{
	if (TimeToElapse(Timer_EPSSTA_Rs1_AR2_ReceiptPDU) >= 20/2)
	{
		//Timer nicht zu 50% abgelaufen (d.h. aktiv und Botschaft nicht mit halber Zykluszeit empfangen)
		//außer bei spontan
		@sysvar::CH_Nodes::CH__PDURECEIPT_RECEIVE_EPS_STA_Rs1_AR2 = 4;
	}
	else
	{
		//Timer zu 50% abgelaufen (d.h. Botschaft mit mindestens halber Zykluszeit empfangen)
		@sysvar::CH_Nodes::CH__PDURECEIPT_RECEIVE_EPS_STA_Rs1_AR2 = 3;
	}
	//Timer auf Zykluszeit setzen
	setTimer(Timer_EPSSTA_Rs1_AR2_ReceiptPDU, 20);

	output(this);
}
/*@@end*/
/*@@frPDU:MsgChannel1.CHASSIS::SpringVlv_Stat_AR:*/
on frPDU MsgChannel1.CHASSIS::TBCSC_EPS_DAC_AR2
{
	if (TimeToElapse(Timer_EPSTBCSC_EPS_DAC_AR2_ReceiptPDU) >= 5/2)
	{
		//Timer nicht zu 50% abgelaufen (d.h. aktiv und Botschaft nicht mit halber Zykluszeit empfangen)
		//außer bei spontan
	}
	else
	{
		//Timer zu 50% abgelaufen (d.h. Botschaft mit mindestens halber Zykluszeit empfangen)
		@sysvar::CH_Nodes::CH__PDURECEIPT_RECEIVE_EPS_TBCSC_EPS_DAC_AR2 = 3;
	}
	//Timer auf Zykluszeit setzen
	setTimer(Timer_EPSTBCSC_EPS_DAC_AR2_ReceiptPDU, 5);

	output(this);
}
/*@@end*/
/*@@frPDU:MsgChannel1.CHASSIS::SpringVlv_Stat_AR:*/
on frPDU MsgChannel1.CHASSIS::TBCSC_Rs_EPS_AR2
{
	if (TimeToElapse(Timer_EPSTBCSC_Rs_EPS_AR2_ReceiptPDU) >= 5/2)
	{
		//Timer nicht zu 50% abgelaufen (d.h. aktiv und Botschaft nicht mit halber Zykluszeit empfangen)
		//außer bei spontan
	}
	else
	{
		//Timer zu 50% abgelaufen (d.h. Botschaft mit mindestens halber Zykluszeit empfangen)
		@sysvar::CH_Nodes::CH__PDURECEIPT_RECEIVE_EPS_TBCSC_Rs_EPS_AR2 = 3;
	}
	//Timer auf Zykluszeit setzen
	setTimer(Timer_EPSTBCSC_Rs_EPS_AR2_ReceiptPDU, 5);

	output(this);
}
/*@@end*/
/*@@frPDU:MsgChannel1.CHASSIS::SpringVlv_Stat_AR:*/
on frPDU MsgChannel1.CHASSIS::WUDOP_EPS_FR
{
	if (TimeToElapse(Timer_EPSWUDOP_EPS_FR_ReceiptPDU) >= 320/2)
	{
		//Timer nicht zu 50% abgelaufen (d.h. aktiv und Botschaft nicht mit halber Zykluszeit empfangen)
		//außer bei spontan
		@sysvar::CH_Nodes::CH__PDURECEIPT_RECEIVE_EPS_WUDOP_EPS_FR = 4;
	}
	else
	{
		//Timer zu 50% abgelaufen (d.h. Botschaft mit mindestens halber Zykluszeit empfangen)
		@sysvar::CH_Nodes::CH__PDURECEIPT_RECEIVE_EPS_WUDOP_EPS_FR = 3;
	}
	//Timer auf Zykluszeit setzen
	setTimer(Timer_EPSWUDOP_EPS_FR_ReceiptPDU, 320);

	output(this);
}
/*@@end*/
/*@@frPDU:MsgChannel1.CHASSIS::SpringVlv_Stat_AR:*/
on frPDU MsgChannel1.CHASSIS::AWD_TCASE_Rq_ESP_AR2
{
	if (TimeToElapse(Timer_ESPAWD_TCASE_Rq_ESP_AR2_ReceiptPDU) >= 20/2)
	{
		//Timer nicht zu 50% abgelaufen (d.h. aktiv und Botschaft nicht mit halber Zykluszeit empfangen)
		//außer bei spontan
		@sysvar::CH_Nodes::CH__PDURECEIPT_RECEIVE_ESP_AWD_TCASE_Rq_ESP_AR2 = 4;
	}
	else
	{
		//Timer zu 50% abgelaufen (d.h. Botschaft mit mindestens halber Zykluszeit empfangen)
		@sysvar::CH_Nodes::CH__PDURECEIPT_RECEIVE_ESP_AWD_TCASE_Rq_ESP_AR2 = 3;
	}
	//Timer auf Zykluszeit setzen
	setTimer(Timer_ESPAWD_TCASE_Rq_ESP_AR2_ReceiptPDU, 20);

	output(this);
}
/*@@end*/
/*@@frPDU:MsgChannel1.CHASSIS::SpringVlv_Stat_AR:*/
on frPDU MsgChannel1.CHASSIS::BrkSys_Stat_AR2
{
	if (TimeToElapse(Timer_ESPBrkSys_Stat_AR2_ReceiptPDU) >= 20/2)
	{
		//Timer nicht zu 50% abgelaufen (d.h. aktiv und Botschaft nicht mit halber Zykluszeit empfangen)
		//außer bei spontan
		@sysvar::CH_Nodes::CH__PDURECEIPT_RECEIVE_ESP_BrkSys_Stat_AR2 = 4;
	}
	else
	{
		//Timer zu 50% abgelaufen (d.h. Botschaft mit mindestens halber Zykluszeit empfangen)
		@sysvar::CH_Nodes::CH__PDURECEIPT_RECEIVE_ESP_BrkSys_Stat_AR2 = 3;
	}
	//Timer auf Zykluszeit setzen
	setTimer(Timer_ESPBrkSys_Stat_AR2_ReceiptPDU, 20);

	output(this);
}
/*@@end*/
/*@@frPDU:MsgChannel1.CHASSIS::SpringVlv_Stat_AR:*/
on frPDU MsgChannel1.CHASSIS::DPC_Disp_Rq_AR2
{
	if (TimeToElapse(Timer_ESPDPC_Disp_Rq_AR2_ReceiptPDU) >= 100/2)
	{
		//Timer nicht zu 50% abgelaufen (d.h. aktiv und Botschaft nicht mit halber Zykluszeit empfangen)
		//außer bei spontan
		@sysvar::CH_Nodes::CH__PDURECEIPT_RECEIVE_ESP_DPC_Disp_Rq_AR2 = 4;
	}
	else
	{
		//Timer zu 50% abgelaufen (d.h. Botschaft mit mindestens halber Zykluszeit empfangen)
		@sysvar::CH_Nodes::CH__PDURECEIPT_RECEIVE_ESP_DPC_Disp_Rq_AR2 = 3;
	}
	//Timer auf Zykluszeit setzen
	setTimer(Timer_ESPDPC_Disp_Rq_AR2_ReceiptPDU, 100);

	output(this);
}
/*@@end*/
/*@@frPDU:MsgChannel1.CHASSIS::SpringVlv_Stat_AR:*/
on frPDU MsgChannel1.CHASSIS::DPC_IndMd_Stat_AR2
{
	if (TimeToElapse(Timer_ESPDPC_IndMd_Stat_AR2_ReceiptPDU) >= 100/2)
	{
		//Timer nicht zu 50% abgelaufen (d.h. aktiv und Botschaft nicht mit halber Zykluszeit empfangen)
		//außer bei spontan
		@sysvar::CH_Nodes::CH__PDURECEIPT_RECEIVE_ESP_DPC_IndMd_Stat_AR2 = 4;
	}
	else
	{
		//Timer zu 50% abgelaufen (d.h. Botschaft mit mindestens halber Zykluszeit empfangen)
		@sysvar::CH_Nodes::CH__PDURECEIPT_RECEIVE_ESP_DPC_IndMd_Stat_AR2 = 3;
	}
	//Timer auf Zykluszeit setzen
	setTimer(Timer_ESPDPC_IndMd_Stat_AR2_ReceiptPDU, 100);

	output(this);
}
/*@@end*/
/*@@frPDU:MsgChannel1.CHASSIS::SpringVlv_Stat_AR:*/
on frPDU MsgChannel1.CHASSIS::DPC_IndMd_Style2_AR2
{
	if (TimeToElapse(Timer_ESPDPC_IndMd_Style2_AR2_ReceiptPDU) >= 1000/2)
	{
		//Timer nicht zu 50% abgelaufen (d.h. aktiv und Botschaft nicht mit halber Zykluszeit empfangen)
		//außer bei spontan
		@sysvar::CH_Nodes::CH__PDURECEIPT_RECEIVE_ESP_DPC_IndMd_Style2_AR2 = 4;
	}
	else
	{
		//Timer zu 50% abgelaufen (d.h. Botschaft mit mindestens halber Zykluszeit empfangen)
		@sysvar::CH_Nodes::CH__PDURECEIPT_RECEIVE_ESP_DPC_IndMd_Style2_AR2 = 3;
	}
	//Timer auf Zykluszeit setzen
	setTimer(Timer_ESPDPC_IndMd_Style2_AR2_ReceiptPDU, 1000);

	output(this);
}
/*@@end*/
/*@@frPDU:MsgChannel1.CHASSIS::SpringVlv_Stat_AR:*/
on frPDU MsgChannel1.CHASSIS::DPC_IndMd_Style_AR2
{
	if (TimeToElapse(Timer_ESPDPC_IndMd_Style_AR2_ReceiptPDU) >= 1000/2)
	{
		//Timer nicht zu 50% abgelaufen (d.h. aktiv und Botschaft nicht mit halber Zykluszeit empfangen)
		//außer bei spontan
		@sysvar::CH_Nodes::CH__PDURECEIPT_RECEIVE_ESP_DPC_IndMd_Style_AR2 = 4;
	}
	else
	{
		//Timer zu 50% abgelaufen (d.h. Botschaft mit mindestens halber Zykluszeit empfangen)
		@sysvar::CH_Nodes::CH__PDURECEIPT_RECEIVE_ESP_DPC_IndMd_Style_AR2 = 3;
	}
	//Timer auf Zykluszeit setzen
	setTimer(Timer_ESPDPC_IndMd_Style_AR2_ReceiptPDU, 1000);

	output(this);
}
/*@@end*/
/*@@frPDU:MsgChannel1.CHASSIS::SpringVlv_Stat_AR:*/
on frPDU MsgChannel1.CHASSIS::DPC_Master_Rq_AR2
{
	if (TimeToElapse(Timer_ESPDPC_Master_Rq_AR2_ReceiptPDU) >= 100/2)
	{
		//Timer nicht zu 50% abgelaufen (d.h. aktiv und Botschaft nicht mit halber Zykluszeit empfangen)
		//außer bei spontan
		@sysvar::CH_Nodes::CH__PDURECEIPT_RECEIVE_ESP_DPC_Master_Rq_AR2 = 4;
	}
	else
	{
		//Timer zu 50% abgelaufen (d.h. Botschaft mit mindestens halber Zykluszeit empfangen)
		@sysvar::CH_Nodes::CH__PDURECEIPT_RECEIVE_ESP_DPC_Master_Rq_AR2 = 3;
	}
	//Timer auf Zykluszeit setzen
	setTimer(Timer_ESPDPC_Master_Rq_AR2_ReceiptPDU, 100);

	output(this);
}
/*@@end*/
/*@@frPDU:MsgChannel1.CHASSIS::SpringVlv_Stat_AR:*/
on frPDU MsgChannel1.CHASSIS::Eng_Susp_Rq_AS_AR2
{
	if (TimeToElapse(Timer_ESPEng_Susp_Rq_AS_AR2_ReceiptPDU) >= 20/2)
	{
		//Timer nicht zu 50% abgelaufen (d.h. aktiv und Botschaft nicht mit halber Zykluszeit empfangen)
		//außer bei spontan
		@sysvar::CH_Nodes::CH__PDURECEIPT_RECEIVE_ESP_Eng_Susp_Rq_AS_AR2 = 4;
	}
	else
	{
		//Timer zu 50% abgelaufen (d.h. Botschaft mit mindestens halber Zykluszeit empfangen)
		@sysvar::CH_Nodes::CH__PDURECEIPT_RECEIVE_ESP_Eng_Susp_Rq_AS_AR2 = 3;
	}
	//Timer auf Zykluszeit setzen
	setTimer(Timer_ESPEng_Susp_Rq_AS_AR2_ReceiptPDU, 20);

	output(this);
}
/*@@end*/
/*@@frPDU:MsgChannel1.CHASSIS::SpringVlv_Stat_AR:*/
on frPDU MsgChannel1.CHASSIS::EPKB_Disp_IndLmp_Rq_2_AR2
{
	if (TimeToElapse(Timer_ESPEPKB_Disp_IndLmp_Rq_2_AR2_ReceiptPDU) >= 200/2)
	{
		//Timer nicht zu 50% abgelaufen (d.h. aktiv und Botschaft nicht mit halber Zykluszeit empfangen)
		//außer bei spontan
		@sysvar::CH_Nodes::CH__PDURECEIPT_RECEIVE_ESP_EPKB_Disp_IndLmp_Rq_2_AR2 = 4;
	}
	else
	{
		//Timer zu 50% abgelaufen (d.h. Botschaft mit mindestens halber Zykluszeit empfangen)
		@sysvar::CH_Nodes::CH__PDURECEIPT_RECEIVE_ESP_EPKB_Disp_IndLmp_Rq_2_AR2 = 3;
	}
	//Timer auf Zykluszeit setzen
	setTimer(Timer_ESPEPKB_Disp_IndLmp_Rq_2_AR2_ReceiptPDU, 200);

	output(this);
}
/*@@end*/
/*@@frPDU:MsgChannel1.CHASSIS::SpringVlv_Stat_AR:*/
on frPDU MsgChannel1.CHASSIS::EPKB_Stat_Gw_AR2
{
	if (TimeToElapse(Timer_ESPEPKB_Stat_Gw_AR2_ReceiptPDU) >= 100/2)
	{
		//Timer nicht zu 50% abgelaufen (d.h. aktiv und Botschaft nicht mit halber Zykluszeit empfangen)
		//außer bei spontan
		@sysvar::CH_Nodes::CH__PDURECEIPT_RECEIVE_ESP_EPKB_Stat_Gw_AR2 = 4;
	}
	else
	{
		//Timer zu 50% abgelaufen (d.h. Botschaft mit mindestens halber Zykluszeit empfangen)
		@sysvar::CH_Nodes::CH__PDURECEIPT_RECEIVE_ESP_EPKB_Stat_Gw_AR2 = 3;
	}
	//Timer auf Zykluszeit setzen
	setTimer(Timer_ESPEPKB_Stat_Gw_AR2_ReceiptPDU, 100);

	output(this);
}
/*@@end*/
/*@@frPDU:MsgChannel1.CHASSIS::SpringVlv_Stat_AR:*/
on frPDU MsgChannel1.CHASSIS::ESP_Disp_Rq2_AR2
{
	if (TimeToElapse(Timer_ESPESP_Disp_Rq2_AR2_ReceiptPDU) >= 100/2)
	{
		//Timer nicht zu 50% abgelaufen (d.h. aktiv und Botschaft nicht mit halber Zykluszeit empfangen)
		//außer bei spontan
		@sysvar::CH_Nodes::CH__PDURECEIPT_RECEIVE_ESP_ESP_Disp_Rq2_AR2 = 4;
	}
	else
	{
		//Timer zu 50% abgelaufen (d.h. Botschaft mit mindestens halber Zykluszeit empfangen)
		@sysvar::CH_Nodes::CH__PDURECEIPT_RECEIVE_ESP_ESP_Disp_Rq2_AR2 = 3;
	}
	//Timer auf Zykluszeit setzen
	setTimer(Timer_ESPESP_Disp_Rq2_AR2_ReceiptPDU, 100);

	output(this);
}
/*@@end*/
/*@@frPDU:MsgChannel1.CHASSIS::SpringVlv_Stat_AR:*/
on frPDU MsgChannel1.CHASSIS::ESP_Disp_Rq3_AR
{
	if (TimeToElapse(Timer_ESPESP_Disp_Rq3_AR_ReceiptPDU) >= 200/2)
	{
		//Timer nicht zu 50% abgelaufen (d.h. aktiv und Botschaft nicht mit halber Zykluszeit empfangen)
		//außer bei spontan
		@sysvar::CH_Nodes::CH__PDURECEIPT_RECEIVE_ESP_ESP_Disp_Rq3_AR = 4;
	}
	else
	{
		//Timer zu 50% abgelaufen (d.h. Botschaft mit mindestens halber Zykluszeit empfangen)
		@sysvar::CH_Nodes::CH__PDURECEIPT_RECEIVE_ESP_ESP_Disp_Rq3_AR = 3;
	}
	//Timer auf Zykluszeit setzen
	setTimer(Timer_ESPESP_Disp_Rq3_AR_ReceiptPDU, 200);

	output(this);
}
/*@@end*/
/*@@frPDU:MsgChannel1.CHASSIS::SpringVlv_Stat_AR:*/
on frPDU MsgChannel1.CHASSIS::ESP_Disp_Rq_AMG_AR2
{
	if (TimeToElapse(Timer_ESPESP_Disp_Rq_AMG_AR2_ReceiptPDU) >= 40/2)
	{
		//Timer nicht zu 50% abgelaufen (d.h. aktiv und Botschaft nicht mit halber Zykluszeit empfangen)
		//außer bei spontan
		@sysvar::CH_Nodes::CH__PDURECEIPT_RECEIVE_ESP_ESP_Disp_Rq_AMG_AR2 = 4;
	}
	else
	{
		//Timer zu 50% abgelaufen (d.h. Botschaft mit mindestens halber Zykluszeit empfangen)
		@sysvar::CH_Nodes::CH__PDURECEIPT_RECEIVE_ESP_ESP_Disp_Rq_AMG_AR2 = 3;
	}
	//Timer auf Zykluszeit setzen
	setTimer(Timer_ESPESP_Disp_Rq_AMG_AR2_ReceiptPDU, 40);

	output(this);
}
/*@@end*/
/*@@frPDU:MsgChannel1.CHASSIS::SpringVlv_Stat_AR:*/
on frPDU MsgChannel1.CHASSIS::ESP_Disp_Rq_AR2
{
	if (TimeToElapse(Timer_ESPESP_Disp_Rq_AR2_ReceiptPDU) >= 100/2)
	{
		//Timer nicht zu 50% abgelaufen (d.h. aktiv und Botschaft nicht mit halber Zykluszeit empfangen)
		//außer bei spontan
		@sysvar::CH_Nodes::CH__PDURECEIPT_RECEIVE_ESP_ESP_Disp_Rq_AR2 = 4;
	}
	else
	{
		//Timer zu 50% abgelaufen (d.h. Botschaft mit mindestens halber Zykluszeit empfangen)
		@sysvar::CH_Nodes::CH__PDURECEIPT_RECEIVE_ESP_ESP_Disp_Rq_AR2 = 3;
	}
	//Timer auf Zykluszeit setzen
	setTimer(Timer_ESPESP_Disp_Rq_AR2_ReceiptPDU, 100);

	output(this);
}
/*@@end*/
/*@@frPDU:MsgChannel1.CHASSIS::SpringVlv_Stat_AR:*/
on frPDU MsgChannel1.CHASSIS::ESP_OBD_Stat_AR
{
	if (TimeToElapse(Timer_ESPESP_OBD_Stat_AR_ReceiptPDU) >= 1000/2)
	{
		//Timer nicht zu 50% abgelaufen (d.h. aktiv und Botschaft nicht mit halber Zykluszeit empfangen)
		//außer bei spontan
		@sysvar::CH_Nodes::CH__PDURECEIPT_RECEIVE_ESP_ESP_OBD_Stat_AR = 4;
	}
	else
	{
		//Timer zu 50% abgelaufen (d.h. Botschaft mit mindestens halber Zykluszeit empfangen)
		@sysvar::CH_Nodes::CH__PDURECEIPT_RECEIVE_ESP_ESP_OBD_Stat_AR = 3;
	}
	//Timer auf Zykluszeit setzen
	setTimer(Timer_ESPESP_OBD_Stat_AR_ReceiptPDU, 1000);

	output(this);
}
/*@@end*/
/*@@frPDU:MsgChannel1.CHASSIS::SpringVlv_Stat_AR:*/
on frPDU MsgChannel1.CHASSIS::ESP_Stat1_AR2
{
	if (TimeToElapse(Timer_ESPESP_Stat1_AR2_ReceiptPDU) >= 100/2)
	{
		//Timer nicht zu 50% abgelaufen (d.h. aktiv und Botschaft nicht mit halber Zykluszeit empfangen)
		//außer bei spontan
		@sysvar::CH_Nodes::CH__PDURECEIPT_RECEIVE_ESP_ESP_Stat1_AR2 = 4;
	}
	else
	{
		//Timer zu 50% abgelaufen (d.h. Botschaft mit mindestens halber Zykluszeit empfangen)
		@sysvar::CH_Nodes::CH__PDURECEIPT_RECEIVE_ESP_ESP_Stat1_AR2 = 3;
	}
	//Timer auf Zykluszeit setzen
	setTimer(Timer_ESPESP_Stat1_AR2_ReceiptPDU, 100);

	output(this);
}
/*@@end*/
/*@@frPDU:MsgChannel1.CHASSIS::SpringVlv_Stat_AR:*/
on frPDU MsgChannel1.CHASSIS::LDC_Disp_Rq_ESP_AR
{
	if (TimeToElapse(Timer_ESPLDC_Disp_Rq_ESP_AR_ReceiptPDU) >= 200/2)
	{
		//Timer nicht zu 50% abgelaufen (d.h. aktiv und Botschaft nicht mit halber Zykluszeit empfangen)
		//außer bei spontan
		@sysvar::CH_Nodes::CH__PDURECEIPT_RECEIVE_ESP_LDC_Disp_Rq_ESP_AR = 4;
	}
	else
	{
		//Timer zu 50% abgelaufen (d.h. Botschaft mit mindestens halber Zykluszeit empfangen)
		@sysvar::CH_Nodes::CH__PDURECEIPT_RECEIVE_ESP_LDC_Disp_Rq_ESP_AR = 3;
	}
	//Timer auf Zykluszeit setzen
	setTimer(Timer_ESPLDC_Disp_Rq_ESP_AR_ReceiptPDU, 200);

	output(this);
}
/*@@end*/
/*@@frPDU:MsgChannel1.CHASSIS::SpringVlv_Stat_AR:*/
on frPDU MsgChannel1.CHASSIS::PARK_Brk_Rs_AR2
{
	if (TimeToElapse(Timer_ESPPARK_Brk_Rs_AR2_ReceiptPDU) >= 20/2)
	{
		//Timer nicht zu 50% abgelaufen (d.h. aktiv und Botschaft nicht mit halber Zykluszeit empfangen)
		//außer bei spontan
		@sysvar::CH_Nodes::CH__PDURECEIPT_RECEIVE_ESP_PARK_Brk_Rs_AR2 = 4;
	}
	else
	{
		//Timer zu 50% abgelaufen (d.h. Botschaft mit mindestens halber Zykluszeit empfangen)
		@sysvar::CH_Nodes::CH__PDURECEIPT_RECEIVE_ESP_PARK_Brk_Rs_AR2 = 3;
	}
	//Timer auf Zykluszeit setzen
	setTimer(Timer_ESPPARK_Brk_Rs_AR2_ReceiptPDU, 20);

	output(this);
}
/*@@end*/
/*@@frPDU:MsgChannel1.CHASSIS::SpringVlv_Stat_AR:*/
on frPDU MsgChannel1.CHASSIS::PARK_Drv_Rq_ESP_AR2
{
	if (TimeToElapse(Timer_ESPPARK_Drv_Rq_ESP_AR2_ReceiptPDU) >= 100/2)
	{
		//Timer nicht zu 50% abgelaufen (d.h. aktiv und Botschaft nicht mit halber Zykluszeit empfangen)
		//außer bei spontan
		@sysvar::CH_Nodes::CH__PDURECEIPT_RECEIVE_ESP_PARK_Drv_Rq_ESP_AR2 = 4;
	}
	else
	{
		//Timer zu 50% abgelaufen (d.h. Botschaft mit mindestens halber Zykluszeit empfangen)
		@sysvar::CH_Nodes::CH__PDURECEIPT_RECEIVE_ESP_PARK_Drv_Rq_ESP_AR2 = 3;
	}
	//Timer auf Zykluszeit setzen
	setTimer(Timer_ESPPARK_Drv_Rq_ESP_AR2_ReceiptPDU, 100);

	output(this);
}
/*@@end*/
/*@@frPDU:MsgChannel1.CHASSIS::SpringVlv_Stat_AR:*/
on frPDU MsgChannel1.CHASSIS::PresfCtrl_Rq_ESP_AR2
{
	if (TimeToElapse(Timer_ESPPresfCtrl_Rq_ESP_AR2_ReceiptPDU) >= 20/2)
	{
		//Timer nicht zu 50% abgelaufen (d.h. aktiv und Botschaft nicht mit halber Zykluszeit empfangen)
		//außer bei spontan
		@sysvar::CH_Nodes::CH__PDURECEIPT_RECEIVE_ESP_PresfCtrl_Rq_ESP_AR2 = 4;
	}
	else
	{
		//Timer zu 50% abgelaufen (d.h. Botschaft mit mindestens halber Zykluszeit empfangen)
		@sysvar::CH_Nodes::CH__PDURECEIPT_RECEIVE_ESP_PresfCtrl_Rq_ESP_AR2 = 3;
	}
	//Timer auf Zykluszeit setzen
	setTimer(Timer_ESPPresfCtrl_Rq_ESP_AR2_ReceiptPDU, 20);

	output(this);
}
/*@@end*/
/*@@frPDU:MsgChannel1.CHASSIS::SpringVlv_Stat_AR:*/
on frPDU MsgChannel1.CHASSIS::PT_Rq_ESP_AR2
{
	if (TimeToElapse(Timer_ESPPT_Rq_ESP_AR2_ReceiptPDU) >= 20/2)
	{
		//Timer nicht zu 50% abgelaufen (d.h. aktiv und Botschaft nicht mit halber Zykluszeit empfangen)
		//außer bei spontan
		@sysvar::CH_Nodes::CH__PDURECEIPT_RECEIVE_ESP_PT_Rq_ESP_AR2 = 4;
	}
	else
	{
		//Timer zu 50% abgelaufen (d.h. Botschaft mit mindestens halber Zykluszeit empfangen)
		@sysvar::CH_Nodes::CH__PDURECEIPT_RECEIVE_ESP_PT_Rq_ESP_AR2 = 3;
	}
	//Timer auf Zykluszeit setzen
	setTimer(Timer_ESPPT_Rq_ESP_AR2_ReceiptPDU, 20);

	output(this);
}
/*@@end*/
/*@@frPDU:MsgChannel1.CHASSIS::SpringVlv_Stat_AR:*/
on frPDU MsgChannel1.CHASSIS::ROE_ESP
{
	if (TimeToElapse(Timer_ESPROE_ESP_ReceiptPDU) >= 5/2)
	{
		//Timer nicht zu 50% abgelaufen (d.h. aktiv und Botschaft nicht mit halber Zykluszeit empfangen)
		//außer bei spontan
	}
	else
	{
		//Timer zu 50% abgelaufen (d.h. Botschaft mit mindestens halber Zykluszeit empfangen)
		@sysvar::CH_Nodes::CH__PDURECEIPT_RECEIVE_ESP_ROE_ESP = 3;
	}
	//Timer auf Zykluszeit setzen
	setTimer(Timer_ESPROE_ESP_ReceiptPDU, 5);

	output(this);
}
/*@@end*/
/*@@frPDU:MsgChannel1.CHASSIS::SpringVlv_Stat_AR:*/
on frPDU MsgChannel1.CHASSIS::SADR_Trgr_ESP_AR2
{
	if (TimeToElapse(Timer_ESPSADR_Trgr_ESP_AR2_ReceiptPDU) >= 5/2)
	{
		//Timer nicht zu 50% abgelaufen (d.h. aktiv und Botschaft nicht mit halber Zykluszeit empfangen)
		//außer bei spontan
		@sysvar::CH_Nodes::CH__PDURECEIPT_RECEIVE_ESP_SADR_Trgr_ESP_AR2 = 4;
	}
	else
	{
		//Timer zu 50% abgelaufen (d.h. Botschaft mit mindestens halber Zykluszeit empfangen)
		@sysvar::CH_Nodes::CH__PDURECEIPT_RECEIVE_ESP_SADR_Trgr_ESP_AR2 = 3;
	}
	//Timer auf Zykluszeit setzen
	setTimer(Timer_ESPSADR_Trgr_ESP_AR2_ReceiptPDU, 5);

	output(this);
}
/*@@end*/
/*@@frPDU:MsgChannel1.CHASSIS::SpringVlv_Stat_AR:*/
on frPDU MsgChannel1.CHASSIS::St_Rq_STA_AR2
{
	if (TimeToElapse(Timer_ESPSt_Rq_STA_AR2_ReceiptPDU) >= 20/2)
	{
		//Timer nicht zu 50% abgelaufen (d.h. aktiv und Botschaft nicht mit halber Zykluszeit empfangen)
		//außer bei spontan
		@sysvar::CH_Nodes::CH__PDURECEIPT_RECEIVE_ESP_St_Rq_STA_AR2 = 4;
	}
	else
	{
		//Timer zu 50% abgelaufen (d.h. Botschaft mit mindestens halber Zykluszeit empfangen)
		@sysvar::CH_Nodes::CH__PDURECEIPT_RECEIVE_ESP_St_Rq_STA_AR2 = 3;
	}
	//Timer auf Zykluszeit setzen
	setTimer(Timer_ESPSt_Rq_STA_AR2_ReceiptPDU, 20);

	output(this);
}
/*@@end*/
/*@@frPDU:MsgChannel1.CHASSIS::SpringVlv_Stat_AR:*/
on frPDU MsgChannel1.CHASSIS::TBCSC_ESP_DAC_AR2
{
	if (TimeToElapse(Timer_ESPTBCSC_ESP_DAC_AR2_ReceiptPDU) >= 5/2)
	{
		//Timer nicht zu 50% abgelaufen (d.h. aktiv und Botschaft nicht mit halber Zykluszeit empfangen)
		//außer bei spontan
	}
	else
	{
		//Timer zu 50% abgelaufen (d.h. Botschaft mit mindestens halber Zykluszeit empfangen)
		@sysvar::CH_Nodes::CH__PDURECEIPT_RECEIVE_ESP_TBCSC_ESP_DAC_AR2 = 3;
	}
	//Timer auf Zykluszeit setzen
	setTimer(Timer_ESPTBCSC_ESP_DAC_AR2_ReceiptPDU, 5);

	output(this);
}
/*@@end*/
/*@@frPDU:MsgChannel1.CHASSIS::SpringVlv_Stat_AR:*/
on frPDU MsgChannel1.CHASSIS::TBCSC_Rs1_ESP_AR2
{
	if (TimeToElapse(Timer_ESPTBCSC_Rs1_ESP_AR2_ReceiptPDU) >= 5/2)
	{
		//Timer nicht zu 50% abgelaufen (d.h. aktiv und Botschaft nicht mit halber Zykluszeit empfangen)
		//außer bei spontan
	}
	else
	{
		//Timer zu 50% abgelaufen (d.h. Botschaft mit mindestens halber Zykluszeit empfangen)
		@sysvar::CH_Nodes::CH__PDURECEIPT_RECEIVE_ESP_TBCSC_Rs1_ESP_AR2 = 3;
	}
	//Timer auf Zykluszeit setzen
	setTimer(Timer_ESPTBCSC_Rs1_ESP_AR2_ReceiptPDU, 5);

	output(this);
}
/*@@end*/
/*@@frPDU:MsgChannel1.CHASSIS::SpringVlv_Stat_AR:*/
on frPDU MsgChannel1.CHASSIS::TBCSC_Rs2_ESP_AR2
{
	if (TimeToElapse(Timer_ESPTBCSC_Rs2_ESP_AR2_ReceiptPDU) >= 5/2)
	{
		//Timer nicht zu 50% abgelaufen (d.h. aktiv und Botschaft nicht mit halber Zykluszeit empfangen)
		//außer bei spontan
	}
	else
	{
		//Timer zu 50% abgelaufen (d.h. Botschaft mit mindestens halber Zykluszeit empfangen)
		@sysvar::CH_Nodes::CH__PDURECEIPT_RECEIVE_ESP_TBCSC_Rs2_ESP_AR2 = 3;
	}
	//Timer auf Zykluszeit setzen
	setTimer(Timer_ESPTBCSC_Rs2_ESP_AR2_ReceiptPDU, 5);

	output(this);
}
/*@@end*/
/*@@frPDU:MsgChannel1.CHASSIS::SpringVlv_Stat_AR:*/
on frPDU MsgChannel1.CHASSIS::VehAccel_X_Rs1_AR2
{
	if (TimeToElapse(Timer_ESPVehAccel_X_Rs1_AR2_ReceiptPDU) >= 20/2)
	{
		//Timer nicht zu 50% abgelaufen (d.h. aktiv und Botschaft nicht mit halber Zykluszeit empfangen)
		//außer bei spontan
		@sysvar::CH_Nodes::CH__PDURECEIPT_RECEIVE_ESP_VehAccel_X_Rs1_AR2 = 4;
	}
	else
	{
		//Timer zu 50% abgelaufen (d.h. Botschaft mit mindestens halber Zykluszeit empfangen)
		@sysvar::CH_Nodes::CH__PDURECEIPT_RECEIVE_ESP_VehAccel_X_Rs1_AR2 = 3;
	}
	//Timer auf Zykluszeit setzen
	setTimer(Timer_ESPVehAccel_X_Rs1_AR2_ReceiptPDU, 20);

	output(this);
}
/*@@end*/
/*@@frPDU:MsgChannel1.CHASSIS::SpringVlv_Stat_AR:*/
on frPDU MsgChannel1.CHASSIS::VehAccel_X_Rs2_AR2
{
	if (TimeToElapse(Timer_ESPVehAccel_X_Rs2_AR2_ReceiptPDU) >= 20/2)
	{
		//Timer nicht zu 50% abgelaufen (d.h. aktiv und Botschaft nicht mit halber Zykluszeit empfangen)
		//außer bei spontan
		@sysvar::CH_Nodes::CH__PDURECEIPT_RECEIVE_ESP_VehAccel_X_Rs2_AR2 = 4;
	}
	else
	{
		//Timer zu 50% abgelaufen (d.h. Botschaft mit mindestens halber Zykluszeit empfangen)
		@sysvar::CH_Nodes::CH__PDURECEIPT_RECEIVE_ESP_VehAccel_X_Rs2_AR2 = 3;
	}
	//Timer auf Zykluszeit setzen
	setTimer(Timer_ESPVehAccel_X_Rs2_AR2_ReceiptPDU, 20);

	output(this);
}
/*@@end*/
/*@@frPDU:MsgChannel1.CHASSIS::SpringVlv_Stat_AR:*/
on frPDU MsgChannel1.CHASSIS::VehDyn_Stat1_AR2
{
	if (TimeToElapse(Timer_ESPVehDyn_Stat1_AR2_ReceiptPDU) >= 10/2)
	{
		//Timer nicht zu 50% abgelaufen (d.h. aktiv und Botschaft nicht mit halber Zykluszeit empfangen)
		//außer bei spontan
		@sysvar::CH_Nodes::CH__PDURECEIPT_RECEIVE_ESP_VehDyn_Stat1_AR2 = 4;
	}
	else
	{
		//Timer zu 50% abgelaufen (d.h. Botschaft mit mindestens halber Zykluszeit empfangen)
		@sysvar::CH_Nodes::CH__PDURECEIPT_RECEIVE_ESP_VehDyn_Stat1_AR2 = 3;
	}
	//Timer auf Zykluszeit setzen
	setTimer(Timer_ESPVehDyn_Stat1_AR2_ReceiptPDU, 10);

	output(this);
}
/*@@end*/
/*@@frPDU:MsgChannel1.CHASSIS::SpringVlv_Stat_AR:*/
on frPDU MsgChannel1.CHASSIS::VehDyn_Stat2_AR2
{
	if (TimeToElapse(Timer_ESPVehDyn_Stat2_AR2_ReceiptPDU) >= 10/2)
	{
		//Timer nicht zu 50% abgelaufen (d.h. aktiv und Botschaft nicht mit halber Zykluszeit empfangen)
		//außer bei spontan
		@sysvar::CH_Nodes::CH__PDURECEIPT_RECEIVE_ESP_VehDyn_Stat2_AR2 = 4;
	}
	else
	{
		//Timer zu 50% abgelaufen (d.h. Botschaft mit mindestens halber Zykluszeit empfangen)
		@sysvar::CH_Nodes::CH__PDURECEIPT_RECEIVE_ESP_VehDyn_Stat2_AR2 = 3;
	}
	//Timer auf Zykluszeit setzen
	setTimer(Timer_ESPVehDyn_Stat2_AR2_ReceiptPDU, 10);

	output(this);
}
/*@@end*/
/*@@frPDU:MsgChannel1.CHASSIS::SpringVlv_Stat_AR:*/
on frPDU MsgChannel1.CHASSIS::VehSpd_X_AR2
{
	if (TimeToElapse(Timer_ESPVehSpd_X_AR2_ReceiptPDU) >= 20/2)
	{
		//Timer nicht zu 50% abgelaufen (d.h. aktiv und Botschaft nicht mit halber Zykluszeit empfangen)
		//außer bei spontan
		@sysvar::CH_Nodes::CH__PDURECEIPT_RECEIVE_ESP_VehSpd_X_AR2 = 4;
	}
	else
	{
		//Timer zu 50% abgelaufen (d.h. Botschaft mit mindestens halber Zykluszeit empfangen)
		@sysvar::CH_Nodes::CH__PDURECEIPT_RECEIVE_ESP_VehSpd_X_AR2 = 3;
	}
	//Timer auf Zykluszeit setzen
	setTimer(Timer_ESPVehSpd_X_AR2_ReceiptPDU, 20);

	output(this);
}
/*@@end*/
/*@@frPDU:MsgChannel1.CHASSIS::SpringVlv_Stat_AR:*/
on frPDU MsgChannel1.CHASSIS::Whl_Lt_Stat_AR2
{
	if (TimeToElapse(Timer_ESPWhl_Lt_Stat_AR2_ReceiptPDU) >= 20/2)
	{
		//Timer nicht zu 50% abgelaufen (d.h. aktiv und Botschaft nicht mit halber Zykluszeit empfangen)
		//außer bei spontan
		@sysvar::CH_Nodes::CH__PDURECEIPT_RECEIVE_ESP_Whl_Lt_Stat_AR2 = 4;
	}
	else
	{
		//Timer zu 50% abgelaufen (d.h. Botschaft mit mindestens halber Zykluszeit empfangen)
		@sysvar::CH_Nodes::CH__PDURECEIPT_RECEIVE_ESP_Whl_Lt_Stat_AR2 = 3;
	}
	//Timer auf Zykluszeit setzen
	setTimer(Timer_ESPWhl_Lt_Stat_AR2_ReceiptPDU, 20);

	output(this);
}
/*@@end*/
/*@@frPDU:MsgChannel1.CHASSIS::SpringVlv_Stat_AR:*/
on frPDU MsgChannel1.CHASSIS::Whl_Rt_Stat_AR2
{
	if (TimeToElapse(Timer_ESPWhl_Rt_Stat_AR2_ReceiptPDU) >= 20/2)
	{
		//Timer nicht zu 50% abgelaufen (d.h. aktiv und Botschaft nicht mit halber Zykluszeit empfangen)
		//außer bei spontan
		@sysvar::CH_Nodes::CH__PDURECEIPT_RECEIVE_ESP_Whl_Rt_Stat_AR2 = 4;
	}
	else
	{
		//Timer zu 50% abgelaufen (d.h. Botschaft mit mindestens halber Zykluszeit empfangen)
		@sysvar::CH_Nodes::CH__PDURECEIPT_RECEIVE_ESP_Whl_Rt_Stat_AR2 = 3;
	}
	//Timer auf Zykluszeit setzen
	setTimer(Timer_ESPWhl_Rt_Stat_AR2_ReceiptPDU, 20);

	output(this);
}
/*@@end*/
/*@@frPDU:MsgChannel1.CHASSIS::SpringVlv_Stat_AR:*/
on frPDU MsgChannel1.CHASSIS::WhlPlsCnt_TPM_AR2
{
	if (TimeToElapse(Timer_ESPWhlPlsCnt_TPM_AR2_ReceiptPDU) >= 20/2)
	{
		//Timer nicht zu 50% abgelaufen (d.h. aktiv und Botschaft nicht mit halber Zykluszeit empfangen)
		//außer bei spontan
		@sysvar::CH_Nodes::CH__PDURECEIPT_RECEIVE_ESP_WhlPlsCnt_TPM_AR2 = 4;
	}
	else
	{
		//Timer zu 50% abgelaufen (d.h. Botschaft mit mindestens halber Zykluszeit empfangen)
		@sysvar::CH_Nodes::CH__PDURECEIPT_RECEIVE_ESP_WhlPlsCnt_TPM_AR2 = 3;
	}
	//Timer auf Zykluszeit setzen
	setTimer(Timer_ESPWhlPlsCnt_TPM_AR2_ReceiptPDU, 20);

	output(this);
}
/*@@end*/
/*@@frPDU:MsgChannel1.CHASSIS::SpringVlv_Stat_AR:*/
on frPDU MsgChannel1.CHASSIS::WUDOP_ESP_FR
{
	if (TimeToElapse(Timer_ESPWUDOP_ESP_FR_ReceiptPDU) >= 320/2)
	{
		//Timer nicht zu 50% abgelaufen (d.h. aktiv und Botschaft nicht mit halber Zykluszeit empfangen)
		//außer bei spontan
		@sysvar::CH_Nodes::CH__PDURECEIPT_RECEIVE_ESP_WUDOP_ESP_FR = 4;
	}
	else
	{
		//Timer zu 50% abgelaufen (d.h. Botschaft mit mindestens halber Zykluszeit empfangen)
		@sysvar::CH_Nodes::CH__PDURECEIPT_RECEIVE_ESP_WUDOP_ESP_FR = 3;
	}
	//Timer auf Zykluszeit setzen
	setTimer(Timer_ESPWUDOP_ESP_FR_ReceiptPDU, 320);

	output(this);
}
/*@@end*/
/*@@frPDU:MsgChannel1.CHASSIS::SpringVlv_Stat_AR:*/
on frPDU MsgChannel1.CHASSIS::YMAS_Rs_AR2
{
	if (TimeToElapse(Timer_ESPYMAS_Rs_AR2_ReceiptPDU) >= 20/2)
	{
		//Timer nicht zu 50% abgelaufen (d.h. aktiv und Botschaft nicht mit halber Zykluszeit empfangen)
		//außer bei spontan
		@sysvar::CH_Nodes::CH__PDURECEIPT_RECEIVE_ESP_YMAS_Rs_AR2 = 4;
	}
	else
	{
		//Timer zu 50% abgelaufen (d.h. Botschaft mit mindestens halber Zykluszeit empfangen)
		@sysvar::CH_Nodes::CH__PDURECEIPT_RECEIVE_ESP_YMAS_Rs_AR2 = 3;
	}
	//Timer auf Zykluszeit setzen
	setTimer(Timer_ESPYMAS_Rs_AR2_ReceiptPDU, 20);

	output(this);
}
/*@@end*/
/*@@frPDU:MsgChannel1.CHASSIS::SpringVlv_Stat_AR:*/
on frPDU MsgChannel1.CHASSIS::CMS_PI_State_AR2
{
	if (TimeToElapse(Timer_FCWCMS_PI_State_AR2_ReceiptPDU) >= 20/2)
	{
		//Timer nicht zu 50% abgelaufen (d.h. aktiv und Botschaft nicht mit halber Zykluszeit empfangen)
		//außer bei spontan
		@sysvar::CH_Nodes::CH__PDURECEIPT_RECEIVE_FCW_CMS_PI_State_AR2 = 4;
	}
	else
	{
		//Timer zu 50% abgelaufen (d.h. Botschaft mit mindestens halber Zykluszeit empfangen)
		@sysvar::CH_Nodes::CH__PDURECEIPT_RECEIVE_FCW_CMS_PI_State_AR2 = 3;
	}
	//Timer auf Zykluszeit setzen
	setTimer(Timer_FCWCMS_PI_State_AR2_ReceiptPDU, 20);
	if (TimeToElapse(Timer_RDUCMS_PI_State_AR2_ReceiptPDU) >= 20/2)
	{
		//Timer nicht zu 50% abgelaufen (d.h. aktiv und Botschaft nicht mit halber Zykluszeit empfangen)
		//außer bei spontan
		@sysvar::CH_Nodes::CH__PDURECEIPT_RECEIVE_RDU_CMS_PI_State_AR2 = 4;
	}
	else
	{
		//Timer zu 50% abgelaufen (d.h. Botschaft mit mindestens halber Zykluszeit empfangen)
		@sysvar::CH_Nodes::CH__PDURECEIPT_RECEIVE_RDU_CMS_PI_State_AR2 = 3;
	}
	//Timer auf Zykluszeit setzen
	setTimer(Timer_RDUCMS_PI_State_AR2_ReceiptPDU, 20);
	if (TimeToElapse(Timer_SDTRCMS_PI_State_AR2_ReceiptPDU) >= 20/2)
	{
		//Timer nicht zu 50% abgelaufen (d.h. aktiv und Botschaft nicht mit halber Zykluszeit empfangen)
		//außer bei spontan
		@sysvar::CH_Nodes::CH__PDURECEIPT_RECEIVE_SDTR_CMS_PI_State_AR2 = 4;
	}
	else
	{
		//Timer zu 50% abgelaufen (d.h. Botschaft mit mindestens halber Zykluszeit empfangen)
		@sysvar::CH_Nodes::CH__PDURECEIPT_RECEIVE_SDTR_CMS_PI_State_AR2 = 3;
	}
	//Timer auf Zykluszeit setzen
	setTimer(Timer_SDTRCMS_PI_State_AR2_ReceiptPDU, 20);

	output(this);
}
/*@@end*/
/*@@frPDU:MsgChannel1.CHASSIS::SpringVlv_Stat_AR:*/
on frPDU MsgChannel1.CHASSIS::FCW_Disp_Rq_Gw_AR
{
	if (TimeToElapse(Timer_FCWFCW_Disp_Rq_Gw_AR_ReceiptPDU) >= 200/2)
	{
		//Timer nicht zu 50% abgelaufen (d.h. aktiv und Botschaft nicht mit halber Zykluszeit empfangen)
		//außer bei spontan
		@sysvar::CH_Nodes::CH__PDURECEIPT_RECEIVE_FCW_FCW_Disp_Rq_Gw_AR = 4;
	}
	else
	{
		//Timer zu 50% abgelaufen (d.h. Botschaft mit mindestens halber Zykluszeit empfangen)
		@sysvar::CH_Nodes::CH__PDURECEIPT_RECEIVE_FCW_FCW_Disp_Rq_Gw_AR = 3;
	}
	//Timer auf Zykluszeit setzen
	setTimer(Timer_FCWFCW_Disp_Rq_Gw_AR_ReceiptPDU, 200);

	output(this);
}
/*@@end*/
/*@@frPDU:MsgChannel1.CHASSIS::SpringVlv_Stat_AR:*/
on frPDU MsgChannel1.CHASSIS::PT_ObjIntrst_AR2
{
	if (TimeToElapse(Timer_FCWPT_ObjIntrst_AR2_ReceiptPDU) >= 40/2)
	{
		//Timer nicht zu 50% abgelaufen (d.h. aktiv und Botschaft nicht mit halber Zykluszeit empfangen)
		//außer bei spontan
		@sysvar::CH_Nodes::CH__PDURECEIPT_RECEIVE_FCW_PT_ObjIntrst_AR2 = 4;
	}
	else
	{
		//Timer zu 50% abgelaufen (d.h. Botschaft mit mindestens halber Zykluszeit empfangen)
		@sysvar::CH_Nodes::CH__PDURECEIPT_RECEIVE_FCW_PT_ObjIntrst_AR2 = 3;
	}
	//Timer auf Zykluszeit setzen
	setTimer(Timer_FCWPT_ObjIntrst_AR2_ReceiptPDU, 40);
	if (TimeToElapse(Timer_RDUPT_ObjIntrst_AR2_ReceiptPDU) >= 40/2)
	{
		//Timer nicht zu 50% abgelaufen (d.h. aktiv und Botschaft nicht mit halber Zykluszeit empfangen)
		//außer bei spontan
		@sysvar::CH_Nodes::CH__PDURECEIPT_RECEIVE_RDU_PT_ObjIntrst_AR2 = 4;
	}
	else
	{
		//Timer zu 50% abgelaufen (d.h. Botschaft mit mindestens halber Zykluszeit empfangen)
		@sysvar::CH_Nodes::CH__PDURECEIPT_RECEIVE_RDU_PT_ObjIntrst_AR2 = 3;
	}
	//Timer auf Zykluszeit setzen
	setTimer(Timer_RDUPT_ObjIntrst_AR2_ReceiptPDU, 40);
	if (TimeToElapse(Timer_SDTRPT_ObjIntrst_AR2_ReceiptPDU) >= 40/2)
	{
		//Timer nicht zu 50% abgelaufen (d.h. aktiv und Botschaft nicht mit halber Zykluszeit empfangen)
		//außer bei spontan
		@sysvar::CH_Nodes::CH__PDURECEIPT_RECEIVE_SDTR_PT_ObjIntrst_AR2 = 4;
	}
	else
	{
		//Timer zu 50% abgelaufen (d.h. Botschaft mit mindestens halber Zykluszeit empfangen)
		@sysvar::CH_Nodes::CH__PDURECEIPT_RECEIVE_SDTR_PT_ObjIntrst_AR2 = 3;
	}
	//Timer auf Zykluszeit setzen
	setTimer(Timer_SDTRPT_ObjIntrst_AR2_ReceiptPDU, 40);

	output(this);
}
/*@@end*/
/*@@frPDU:MsgChannel1.CHASSIS::SpringVlv_Stat_AR:*/
on frPDU MsgChannel1.CHASSIS::RDU_Disp_Rq_AR
{
	if (TimeToElapse(Timer_FCWRDU_Disp_Rq_AR_ReceiptPDU) >= 500/2)
	{
		//Timer nicht zu 50% abgelaufen (d.h. aktiv und Botschaft nicht mit halber Zykluszeit empfangen)
		//außer bei spontan
		@sysvar::CH_Nodes::CH__PDURECEIPT_RECEIVE_FCW_RDU_Disp_Rq_AR = 4;
	}
	else
	{
		//Timer zu 50% abgelaufen (d.h. Botschaft mit mindestens halber Zykluszeit empfangen)
		@sysvar::CH_Nodes::CH__PDURECEIPT_RECEIVE_FCW_RDU_Disp_Rq_AR = 3;
	}
	//Timer auf Zykluszeit setzen
	setTimer(Timer_FCWRDU_Disp_Rq_AR_ReceiptPDU, 500);
	if (TimeToElapse(Timer_RDURDU_Disp_Rq_AR_ReceiptPDU) >= 500/2)
	{
		//Timer nicht zu 50% abgelaufen (d.h. aktiv und Botschaft nicht mit halber Zykluszeit empfangen)
		//außer bei spontan
		@sysvar::CH_Nodes::CH__PDURECEIPT_RECEIVE_RDU_RDU_Disp_Rq_AR = 4;
	}
	else
	{
		//Timer zu 50% abgelaufen (d.h. Botschaft mit mindestens halber Zykluszeit empfangen)
		@sysvar::CH_Nodes::CH__PDURECEIPT_RECEIVE_RDU_RDU_Disp_Rq_AR = 3;
	}
	//Timer auf Zykluszeit setzen
	setTimer(Timer_RDURDU_Disp_Rq_AR_ReceiptPDU, 500);
	if (TimeToElapse(Timer_SDTRRDU_Disp_Rq_AR_ReceiptPDU) >= 500/2)
	{
		//Timer nicht zu 50% abgelaufen (d.h. aktiv und Botschaft nicht mit halber Zykluszeit empfangen)
		//außer bei spontan
		@sysvar::CH_Nodes::CH__PDURECEIPT_RECEIVE_SDTR_RDU_Disp_Rq_AR = 4;
	}
	else
	{
		//Timer zu 50% abgelaufen (d.h. Botschaft mit mindestens halber Zykluszeit empfangen)
		@sysvar::CH_Nodes::CH__PDURECEIPT_RECEIVE_SDTR_RDU_Disp_Rq_AR = 3;
	}
	//Timer auf Zykluszeit setzen
	setTimer(Timer_SDTRRDU_Disp_Rq_AR_ReceiptPDU, 500);

	output(this);
}
/*@@end*/
/*@@frPDU:MsgChannel1.CHASSIS::SpringVlv_Stat_AR:*/
on frPDU MsgChannel1.CHASSIS::ROE_RDU
{
	if (TimeToElapse(Timer_FCWROE_RDU_ReceiptPDU) >= 5/2)
	{
		//Timer nicht zu 50% abgelaufen (d.h. aktiv und Botschaft nicht mit halber Zykluszeit empfangen)
		//außer bei spontan
	}
	else
	{
		//Timer zu 50% abgelaufen (d.h. Botschaft mit mindestens halber Zykluszeit empfangen)
		@sysvar::CH_Nodes::CH__PDURECEIPT_RECEIVE_FCW_ROE_RDU = 3;
	}
	//Timer auf Zykluszeit setzen
	setTimer(Timer_FCWROE_RDU_ReceiptPDU, 5);
	if (TimeToElapse(Timer_RDUROE_RDU_ReceiptPDU) >= 5/2)
	{
		//Timer nicht zu 50% abgelaufen (d.h. aktiv und Botschaft nicht mit halber Zykluszeit empfangen)
		//außer bei spontan
	}
	else
	{
		//Timer zu 50% abgelaufen (d.h. Botschaft mit mindestens halber Zykluszeit empfangen)
		@sysvar::CH_Nodes::CH__PDURECEIPT_RECEIVE_RDU_ROE_RDU = 3;
	}
	//Timer auf Zykluszeit setzen
	setTimer(Timer_RDUROE_RDU_ReceiptPDU, 5);
	if (TimeToElapse(Timer_SDTRROE_RDU_ReceiptPDU) >= 5/2)
	{
		//Timer nicht zu 50% abgelaufen (d.h. aktiv und Botschaft nicht mit halber Zykluszeit empfangen)
		//außer bei spontan
	}
	else
	{
		//Timer zu 50% abgelaufen (d.h. Botschaft mit mindestens halber Zykluszeit empfangen)
		@sysvar::CH_Nodes::CH__PDURECEIPT_RECEIVE_SDTR_ROE_RDU = 3;
	}
	//Timer auf Zykluszeit setzen
	setTimer(Timer_SDTRROE_RDU_ReceiptPDU, 5);

	output(this);
}
/*@@end*/
/*@@frPDU:MsgChannel1.CHASSIS::SpringVlv_Stat_AR:*/
on frPDU MsgChannel1.CHASSIS::SADR_Trgr_RDU_AR2
{
	if (TimeToElapse(Timer_FCWSADR_Trgr_RDU_AR2_ReceiptPDU) >= 5/2)
	{
		//Timer nicht zu 50% abgelaufen (d.h. aktiv und Botschaft nicht mit halber Zykluszeit empfangen)
		//außer bei spontan
		@sysvar::CH_Nodes::CH__PDURECEIPT_RECEIVE_FCW_SADR_Trgr_RDU_AR2 = 4;
	}
	else
	{
		//Timer zu 50% abgelaufen (d.h. Botschaft mit mindestens halber Zykluszeit empfangen)
		@sysvar::CH_Nodes::CH__PDURECEIPT_RECEIVE_FCW_SADR_Trgr_RDU_AR2 = 3;
	}
	//Timer auf Zykluszeit setzen
	setTimer(Timer_FCWSADR_Trgr_RDU_AR2_ReceiptPDU, 5);
	if (TimeToElapse(Timer_RDUSADR_Trgr_RDU_AR2_ReceiptPDU) >= 5/2)
	{
		//Timer nicht zu 50% abgelaufen (d.h. aktiv und Botschaft nicht mit halber Zykluszeit empfangen)
		//außer bei spontan
		@sysvar::CH_Nodes::CH__PDURECEIPT_RECEIVE_RDU_SADR_Trgr_RDU_AR2 = 4;
	}
	else
	{
		//Timer zu 50% abgelaufen (d.h. Botschaft mit mindestens halber Zykluszeit empfangen)
		@sysvar::CH_Nodes::CH__PDURECEIPT_RECEIVE_RDU_SADR_Trgr_RDU_AR2 = 3;
	}
	//Timer auf Zykluszeit setzen
	setTimer(Timer_RDUSADR_Trgr_RDU_AR2_ReceiptPDU, 5);
	if (TimeToElapse(Timer_SDTRSADR_Trgr_RDU_AR2_ReceiptPDU) >= 5/2)
	{
		//Timer nicht zu 50% abgelaufen (d.h. aktiv und Botschaft nicht mit halber Zykluszeit empfangen)
		//außer bei spontan
		@sysvar::CH_Nodes::CH__PDURECEIPT_RECEIVE_SDTR_SADR_Trgr_RDU_AR2 = 4;
	}
	else
	{
		//Timer zu 50% abgelaufen (d.h. Botschaft mit mindestens halber Zykluszeit empfangen)
		@sysvar::CH_Nodes::CH__PDURECEIPT_RECEIVE_SDTR_SADR_Trgr_RDU_AR2 = 3;
	}
	//Timer auf Zykluszeit setzen
	setTimer(Timer_SDTRSADR_Trgr_RDU_AR2_ReceiptPDU, 5);

	output(this);
}
/*@@end*/
/*@@frPDU:MsgChannel1.CHASSIS::SpringVlv_Stat_AR:*/
on frPDU MsgChannel1.CHASSIS::VehAccel_X_Rq_AR2
{
	if (TimeToElapse(Timer_FCWVehAccel_X_Rq_AR2_ReceiptPDU) >= 20/2)
	{
		//Timer nicht zu 50% abgelaufen (d.h. aktiv und Botschaft nicht mit halber Zykluszeit empfangen)
		//außer bei spontan
		@sysvar::CH_Nodes::CH__PDURECEIPT_RECEIVE_FCW_VehAccel_X_Rq_AR2 = 4;
	}
	else
	{
		//Timer zu 50% abgelaufen (d.h. Botschaft mit mindestens halber Zykluszeit empfangen)
		@sysvar::CH_Nodes::CH__PDURECEIPT_RECEIVE_FCW_VehAccel_X_Rq_AR2 = 3;
	}
	//Timer auf Zykluszeit setzen
	setTimer(Timer_FCWVehAccel_X_Rq_AR2_ReceiptPDU, 20);
	if (TimeToElapse(Timer_RDUVehAccel_X_Rq_AR2_ReceiptPDU) >= 20/2)
	{
		//Timer nicht zu 50% abgelaufen (d.h. aktiv und Botschaft nicht mit halber Zykluszeit empfangen)
		//außer bei spontan
		@sysvar::CH_Nodes::CH__PDURECEIPT_RECEIVE_RDU_VehAccel_X_Rq_AR2 = 4;
	}
	else
	{
		//Timer zu 50% abgelaufen (d.h. Botschaft mit mindestens halber Zykluszeit empfangen)
		@sysvar::CH_Nodes::CH__PDURECEIPT_RECEIVE_RDU_VehAccel_X_Rq_AR2 = 3;
	}
	//Timer auf Zykluszeit setzen
	setTimer(Timer_RDUVehAccel_X_Rq_AR2_ReceiptPDU, 20);
	if (TimeToElapse(Timer_SDTRVehAccel_X_Rq_AR2_ReceiptPDU) >= 20/2)
	{
		//Timer nicht zu 50% abgelaufen (d.h. aktiv und Botschaft nicht mit halber Zykluszeit empfangen)
		//außer bei spontan
		@sysvar::CH_Nodes::CH__PDURECEIPT_RECEIVE_SDTR_VehAccel_X_Rq_AR2 = 4;
	}
	else
	{
		//Timer zu 50% abgelaufen (d.h. Botschaft mit mindestens halber Zykluszeit empfangen)
		@sysvar::CH_Nodes::CH__PDURECEIPT_RECEIVE_SDTR_VehAccel_X_Rq_AR2 = 3;
	}
	//Timer auf Zykluszeit setzen
	setTimer(Timer_SDTRVehAccel_X_Rq_AR2_ReceiptPDU, 20);

	output(this);
}
/*@@end*/
/*@@frPDU:MsgChannel1.CHASSIS::SpringVlv_Stat_AR:*/
on frPDU MsgChannel1.CHASSIS::DTR_Obj_A_FR2
{
	if (TimeToElapse(Timer_LRRDTR_Obj_A_FR2_ReceiptPDU) >= 5/2)
	{
		//Timer nicht zu 50% abgelaufen (d.h. aktiv und Botschaft nicht mit halber Zykluszeit empfangen)
		//außer bei spontan
		@sysvar::CH_Nodes::CH__PDURECEIPT_RECEIVE_LRR_DTR_Obj_A_FR2 = 4;
	}
	else
	{
		//Timer zu 50% abgelaufen (d.h. Botschaft mit mindestens halber Zykluszeit empfangen)
		@sysvar::CH_Nodes::CH__PDURECEIPT_RECEIVE_LRR_DTR_Obj_A_FR2 = 3;
	}
	//Timer auf Zykluszeit setzen
	setTimer(Timer_LRRDTR_Obj_A_FR2_ReceiptPDU, 5);

	output(this);
}
/*@@end*/
/*@@frPDU:MsgChannel1.CHASSIS::SpringVlv_Stat_AR:*/
on frPDU MsgChannel1.CHASSIS::DTR_Obj_B_FR2
{
	if (TimeToElapse(Timer_LRRDTR_Obj_B_FR2_ReceiptPDU) >= 5/2)
	{
		//Timer nicht zu 50% abgelaufen (d.h. aktiv und Botschaft nicht mit halber Zykluszeit empfangen)
		//außer bei spontan
		@sysvar::CH_Nodes::CH__PDURECEIPT_RECEIVE_LRR_DTR_Obj_B_FR2 = 4;
	}
	else
	{
		//Timer zu 50% abgelaufen (d.h. Botschaft mit mindestens halber Zykluszeit empfangen)
		@sysvar::CH_Nodes::CH__PDURECEIPT_RECEIVE_LRR_DTR_Obj_B_FR2 = 3;
	}
	//Timer auf Zykluszeit setzen
	setTimer(Timer_LRRDTR_Obj_B_FR2_ReceiptPDU, 5);

	output(this);
}
/*@@end*/
/*@@frPDU:MsgChannel1.CHASSIS::SpringVlv_Stat_AR:*/
on frPDU MsgChannel1.CHASSIS::DTR_Obj_C_FR2
{
	if (TimeToElapse(Timer_LRRDTR_Obj_C_FR2_ReceiptPDU) >= 5/2)
	{
		//Timer nicht zu 50% abgelaufen (d.h. aktiv und Botschaft nicht mit halber Zykluszeit empfangen)
		//außer bei spontan
		@sysvar::CH_Nodes::CH__PDURECEIPT_RECEIVE_LRR_DTR_Obj_C_FR2 = 4;
	}
	else
	{
		//Timer zu 50% abgelaufen (d.h. Botschaft mit mindestens halber Zykluszeit empfangen)
		@sysvar::CH_Nodes::CH__PDURECEIPT_RECEIVE_LRR_DTR_Obj_C_FR2 = 3;
	}
	//Timer auf Zykluszeit setzen
	setTimer(Timer_LRRDTR_Obj_C_FR2_ReceiptPDU, 5);

	output(this);
}
/*@@end*/
/*@@frPDU:MsgChannel1.CHASSIS::SpringVlv_Stat_AR:*/
on frPDU MsgChannel1.CHASSIS::DTR_Obj_D_FR2
{
	if (TimeToElapse(Timer_LRRDTR_Obj_D_FR2_ReceiptPDU) >= 5/2)
	{
		//Timer nicht zu 50% abgelaufen (d.h. aktiv und Botschaft nicht mit halber Zykluszeit empfangen)
		//außer bei spontan
		@sysvar::CH_Nodes::CH__PDURECEIPT_RECEIVE_LRR_DTR_Obj_D_FR2 = 4;
	}
	else
	{
		//Timer zu 50% abgelaufen (d.h. Botschaft mit mindestens halber Zykluszeit empfangen)
		@sysvar::CH_Nodes::CH__PDURECEIPT_RECEIVE_LRR_DTR_Obj_D_FR2 = 3;
	}
	//Timer auf Zykluszeit setzen
	setTimer(Timer_LRRDTR_Obj_D_FR2_ReceiptPDU, 5);

	output(this);
}
/*@@end*/
/*@@frPDU:MsgChannel1.CHASSIS::SpringVlv_Stat_AR:*/
on frPDU MsgChannel1.CHASSIS::DTR_Obj_E_FR2
{
	if (TimeToElapse(Timer_LRRDTR_Obj_E_FR2_ReceiptPDU) >= 5/2)
	{
		//Timer nicht zu 50% abgelaufen (d.h. aktiv und Botschaft nicht mit halber Zykluszeit empfangen)
		//außer bei spontan
		@sysvar::CH_Nodes::CH__PDURECEIPT_RECEIVE_LRR_DTR_Obj_E_FR2 = 4;
	}
	else
	{
		//Timer zu 50% abgelaufen (d.h. Botschaft mit mindestens halber Zykluszeit empfangen)
		@sysvar::CH_Nodes::CH__PDURECEIPT_RECEIVE_LRR_DTR_Obj_E_FR2 = 3;
	}
	//Timer auf Zykluszeit setzen
	setTimer(Timer_LRRDTR_Obj_E_FR2_ReceiptPDU, 5);

	output(this);
}
/*@@end*/
/*@@frPDU:MsgChannel1.CHASSIS::SpringVlv_Stat_AR:*/
on frPDU MsgChannel1.CHASSIS::DTR_Obj_F_FR2
{
	if (TimeToElapse(Timer_LRRDTR_Obj_F_FR2_ReceiptPDU) >= 5/2)
	{
		//Timer nicht zu 50% abgelaufen (d.h. aktiv und Botschaft nicht mit halber Zykluszeit empfangen)
		//außer bei spontan
		@sysvar::CH_Nodes::CH__PDURECEIPT_RECEIVE_LRR_DTR_Obj_F_FR2 = 4;
	}
	else
	{
		//Timer zu 50% abgelaufen (d.h. Botschaft mit mindestens halber Zykluszeit empfangen)
		@sysvar::CH_Nodes::CH__PDURECEIPT_RECEIVE_LRR_DTR_Obj_F_FR2 = 3;
	}
	//Timer auf Zykluszeit setzen
	setTimer(Timer_LRRDTR_Obj_F_FR2_ReceiptPDU, 5);

	output(this);
}
/*@@end*/
/*@@frPDU:MsgChannel1.CHASSIS::SpringVlv_Stat_AR:*/
on frPDU MsgChannel1.CHASSIS::DTR_Obj_G_FR2
{
	if (TimeToElapse(Timer_LRRDTR_Obj_G_FR2_ReceiptPDU) >= 5/2)
	{
		//Timer nicht zu 50% abgelaufen (d.h. aktiv und Botschaft nicht mit halber Zykluszeit empfangen)
		//außer bei spontan
		@sysvar::CH_Nodes::CH__PDURECEIPT_RECEIVE_LRR_DTR_Obj_G_FR2 = 4;
	}
	else
	{
		//Timer zu 50% abgelaufen (d.h. Botschaft mit mindestens halber Zykluszeit empfangen)
		@sysvar::CH_Nodes::CH__PDURECEIPT_RECEIVE_LRR_DTR_Obj_G_FR2 = 3;
	}
	//Timer auf Zykluszeit setzen
	setTimer(Timer_LRRDTR_Obj_G_FR2_ReceiptPDU, 5);

	output(this);
}
/*@@end*/
/*@@frPDU:MsgChannel1.CHASSIS::SpringVlv_Stat_AR:*/
on frPDU MsgChannel1.CHASSIS::DTR_ObjStat_FR2
{
	if (TimeToElapse(Timer_LRRDTR_ObjStat_FR2_ReceiptPDU) >= 5/2)
	{
		//Timer nicht zu 50% abgelaufen (d.h. aktiv und Botschaft nicht mit halber Zykluszeit empfangen)
		//außer bei spontan
		@sysvar::CH_Nodes::CH__PDURECEIPT_RECEIVE_LRR_DTR_ObjStat_FR2 = 4;
	}
	else
	{
		//Timer zu 50% abgelaufen (d.h. Botschaft mit mindestens halber Zykluszeit empfangen)
		@sysvar::CH_Nodes::CH__PDURECEIPT_RECEIVE_LRR_DTR_ObjStat_FR2 = 3;
	}
	//Timer auf Zykluszeit setzen
	setTimer(Timer_LRRDTR_ObjStat_FR2_ReceiptPDU, 5);

	output(this);
}
/*@@end*/
/*@@frPDU:MsgChannel1.CHASSIS::SpringVlv_Stat_AR:*/
on frPDU MsgChannel1.CHASSIS::DTR_Polyg_Lt_FR2
{
	if (TimeToElapse(Timer_LRRDTR_Polyg_Lt_FR2_ReceiptPDU) >= 5/2)
	{
		//Timer nicht zu 50% abgelaufen (d.h. aktiv und Botschaft nicht mit halber Zykluszeit empfangen)
		//außer bei spontan
		@sysvar::CH_Nodes::CH__PDURECEIPT_RECEIVE_LRR_DTR_Polyg_Lt_FR2 = 4;
	}
	else
	{
		//Timer zu 50% abgelaufen (d.h. Botschaft mit mindestens halber Zykluszeit empfangen)
		@sysvar::CH_Nodes::CH__PDURECEIPT_RECEIVE_LRR_DTR_Polyg_Lt_FR2 = 3;
	}
	//Timer auf Zykluszeit setzen
	setTimer(Timer_LRRDTR_Polyg_Lt_FR2_ReceiptPDU, 5);

	output(this);
}
/*@@end*/
/*@@frPDU:MsgChannel1.CHASSIS::SpringVlv_Stat_AR:*/
on frPDU MsgChannel1.CHASSIS::DTR_Polyg_Rt_FR2
{
	if (TimeToElapse(Timer_LRRDTR_Polyg_Rt_FR2_ReceiptPDU) >= 5/2)
	{
		//Timer nicht zu 50% abgelaufen (d.h. aktiv und Botschaft nicht mit halber Zykluszeit empfangen)
		//außer bei spontan
		@sysvar::CH_Nodes::CH__PDURECEIPT_RECEIVE_LRR_DTR_Polyg_Rt_FR2 = 4;
	}
	else
	{
		//Timer zu 50% abgelaufen (d.h. Botschaft mit mindestens halber Zykluszeit empfangen)
		@sysvar::CH_Nodes::CH__PDURECEIPT_RECEIVE_LRR_DTR_Polyg_Rt_FR2 = 3;
	}
	//Timer auf Zykluszeit setzen
	setTimer(Timer_LRRDTR_Polyg_Rt_FR2_ReceiptPDU, 5);

	output(this);
}
/*@@end*/
/*@@frPDU:MsgChannel1.CHASSIS::SpringVlv_Stat_AR:*/
on frPDU MsgChannel1.CHASSIS::DTR_Stat_FR2
{
	if (TimeToElapse(Timer_LRRDTR_Stat_FR2_ReceiptPDU) >= 5/2)
	{
		//Timer nicht zu 50% abgelaufen (d.h. aktiv und Botschaft nicht mit halber Zykluszeit empfangen)
		//außer bei spontan
		@sysvar::CH_Nodes::CH__PDURECEIPT_RECEIVE_LRR_DTR_Stat_FR2 = 4;
	}
	else
	{
		//Timer zu 50% abgelaufen (d.h. Botschaft mit mindestens halber Zykluszeit empfangen)
		@sysvar::CH_Nodes::CH__PDURECEIPT_RECEIVE_LRR_DTR_Stat_FR2 = 3;
	}
	//Timer auf Zykluszeit setzen
	setTimer(Timer_LRRDTR_Stat_FR2_ReceiptPDU, 5);

	output(this);
}
/*@@end*/
/*@@frPDU:MsgChannel1.CHASSIS::SpringVlv_Stat_AR:*/
on frPDU MsgChannel1.CHASSIS::ROE_LRR
{
	if (TimeToElapse(Timer_LRRROE_LRR_ReceiptPDU) >= 5/2)
	{
		//Timer nicht zu 50% abgelaufen (d.h. aktiv und Botschaft nicht mit halber Zykluszeit empfangen)
		//außer bei spontan
	}
	else
	{
		//Timer zu 50% abgelaufen (d.h. Botschaft mit mindestens halber Zykluszeit empfangen)
		@sysvar::CH_Nodes::CH__PDURECEIPT_RECEIVE_LRR_ROE_LRR = 3;
	}
	//Timer auf Zykluszeit setzen
	setTimer(Timer_LRRROE_LRR_ReceiptPDU, 5);

	output(this);
}
/*@@end*/
/*@@frPDU:MsgChannel1.CHASSIS::SpringVlv_Stat_AR:*/
on frPDU MsgChannel1.CHASSIS::Cam_Stat_AR2
{
	if (TimeToElapse(Timer_MPCCam_Stat_AR2_ReceiptPDU) >= 20/2)
	{
		//Timer nicht zu 50% abgelaufen (d.h. aktiv und Botschaft nicht mit halber Zykluszeit empfangen)
		//außer bei spontan
		@sysvar::CH_Nodes::CH__PDURECEIPT_RECEIVE_MPC_Cam_Stat_AR2 = 4;
	}
	else
	{
		//Timer zu 50% abgelaufen (d.h. Botschaft mit mindestens halber Zykluszeit empfangen)
		@sysvar::CH_Nodes::CH__PDURECEIPT_RECEIVE_MPC_Cam_Stat_AR2 = 3;
	}
	//Timer auf Zykluszeit setzen
	setTimer(Timer_MPCCam_Stat_AR2_ReceiptPDU, 20);

	output(this);
}
/*@@end*/
/*@@frPDU:MsgChannel1.CHASSIS::SpringVlv_Stat_AR:*/
on frPDU MsgChannel1.CHASSIS::CamLane_Disp_Warn_Rq_Gw_AR2
{
	if (TimeToElapse(Timer_MPCCamLane_Disp_Warn_Rq_Gw_AR2_ReceiptPDU) >= 160/2)
	{
		//Timer nicht zu 50% abgelaufen (d.h. aktiv und Botschaft nicht mit halber Zykluszeit empfangen)
		//außer bei spontan
		@sysvar::CH_Nodes::CH__PDURECEIPT_RECEIVE_MPC_CamLane_Disp_Warn_Rq_Gw_AR2 = 4;
	}
	else
	{
		//Timer zu 50% abgelaufen (d.h. Botschaft mit mindestens halber Zykluszeit empfangen)
		@sysvar::CH_Nodes::CH__PDURECEIPT_RECEIVE_MPC_CamLane_Disp_Warn_Rq_Gw_AR2 = 3;
	}
	//Timer auf Zykluszeit setzen
	setTimer(Timer_MPCCamLane_Disp_Warn_Rq_Gw_AR2_ReceiptPDU, 160);

	output(this);
}
/*@@end*/
/*@@frPDU:MsgChannel1.CHASSIS::SpringVlv_Stat_AR:*/
on frPDU MsgChannel1.CHASSIS::CamLane_FastAttr1_FR2
{
	if (TimeToElapse(Timer_MPCCamLane_FastAttr1_FR2_ReceiptPDU) >= 10/2)
	{
		//Timer nicht zu 50% abgelaufen (d.h. aktiv und Botschaft nicht mit halber Zykluszeit empfangen)
		//außer bei spontan
		@sysvar::CH_Nodes::CH__PDURECEIPT_RECEIVE_MPC_CamLane_FastAttr1_FR2 = 4;
	}
	else
	{
		//Timer zu 50% abgelaufen (d.h. Botschaft mit mindestens halber Zykluszeit empfangen)
		@sysvar::CH_Nodes::CH__PDURECEIPT_RECEIVE_MPC_CamLane_FastAttr1_FR2 = 3;
	}
	//Timer auf Zykluszeit setzen
	setTimer(Timer_MPCCamLane_FastAttr1_FR2_ReceiptPDU, 10);

	output(this);
}
/*@@end*/
/*@@frPDU:MsgChannel1.CHASSIS::SpringVlv_Stat_AR:*/
on frPDU MsgChannel1.CHASSIS::CamLane_FastAttr2_FR2
{
	if (TimeToElapse(Timer_MPCCamLane_FastAttr2_FR2_ReceiptPDU) >= 10/2)
	{
		//Timer nicht zu 50% abgelaufen (d.h. aktiv und Botschaft nicht mit halber Zykluszeit empfangen)
		//außer bei spontan
		@sysvar::CH_Nodes::CH__PDURECEIPT_RECEIVE_MPC_CamLane_FastAttr2_FR2 = 4;
	}
	else
	{
		//Timer zu 50% abgelaufen (d.h. Botschaft mit mindestens halber Zykluszeit empfangen)
		@sysvar::CH_Nodes::CH__PDURECEIPT_RECEIVE_MPC_CamLane_FastAttr2_FR2 = 3;
	}
	//Timer auf Zykluszeit setzen
	setTimer(Timer_MPCCamLane_FastAttr2_FR2_ReceiptPDU, 10);

	output(this);
}
/*@@end*/
/*@@frPDU:MsgChannel1.CHASSIS::SpringVlv_Stat_AR:*/
on frPDU MsgChannel1.CHASSIS::CamLane_LaneAttr1_Gw_AR2
{
	if (TimeToElapse(Timer_MPCCamLane_LaneAttr1_Gw_AR2_ReceiptPDU) >= 40/2)
	{
		//Timer nicht zu 50% abgelaufen (d.h. aktiv und Botschaft nicht mit halber Zykluszeit empfangen)
		//außer bei spontan
		@sysvar::CH_Nodes::CH__PDURECEIPT_RECEIVE_MPC_CamLane_LaneAttr1_Gw_AR2 = 4;
	}
	else
	{
		//Timer zu 50% abgelaufen (d.h. Botschaft mit mindestens halber Zykluszeit empfangen)
		@sysvar::CH_Nodes::CH__PDURECEIPT_RECEIVE_MPC_CamLane_LaneAttr1_Gw_AR2 = 3;
	}
	//Timer auf Zykluszeit setzen
	setTimer(Timer_MPCCamLane_LaneAttr1_Gw_AR2_ReceiptPDU, 40);

	output(this);
}
/*@@end*/
/*@@frPDU:MsgChannel1.CHASSIS::SpringVlv_Stat_AR:*/
on frPDU MsgChannel1.CHASSIS::CamLane_LaneAttr2_Gw_AR2
{
	if (TimeToElapse(Timer_MPCCamLane_LaneAttr2_Gw_AR2_ReceiptPDU) >= 40/2)
	{
		//Timer nicht zu 50% abgelaufen (d.h. aktiv und Botschaft nicht mit halber Zykluszeit empfangen)
		//außer bei spontan
		@sysvar::CH_Nodes::CH__PDURECEIPT_RECEIVE_MPC_CamLane_LaneAttr2_Gw_AR2 = 4;
	}
	else
	{
		//Timer zu 50% abgelaufen (d.h. Botschaft mit mindestens halber Zykluszeit empfangen)
		@sysvar::CH_Nodes::CH__PDURECEIPT_RECEIVE_MPC_CamLane_LaneAttr2_Gw_AR2 = 3;
	}
	//Timer auf Zykluszeit setzen
	setTimer(Timer_MPCCamLane_LaneAttr2_Gw_AR2_ReceiptPDU, 40);

	output(this);
}
/*@@end*/
/*@@frPDU:MsgChannel1.CHASSIS::SpringVlv_Stat_AR:*/
on frPDU MsgChannel1.CHASSIS::CamLane_LaneAttr3_Gw_AR2
{
	if (TimeToElapse(Timer_MPCCamLane_LaneAttr3_Gw_AR2_ReceiptPDU) >= 40/2)
	{
		//Timer nicht zu 50% abgelaufen (d.h. aktiv und Botschaft nicht mit halber Zykluszeit empfangen)
		//außer bei spontan
		@sysvar::CH_Nodes::CH__PDURECEIPT_RECEIVE_MPC_CamLane_LaneAttr3_Gw_AR2 = 4;
	}
	else
	{
		//Timer zu 50% abgelaufen (d.h. Botschaft mit mindestens halber Zykluszeit empfangen)
		@sysvar::CH_Nodes::CH__PDURECEIPT_RECEIVE_MPC_CamLane_LaneAttr3_Gw_AR2 = 3;
	}
	//Timer auf Zykluszeit setzen
	setTimer(Timer_MPCCamLane_LaneAttr3_Gw_AR2_ReceiptPDU, 40);

	output(this);
}
/*@@end*/
/*@@frPDU:MsgChannel1.CHASSIS::SpringVlv_Stat_AR:*/
on frPDU MsgChannel1.CHASSIS::CamLane_LaneAttr4_FR2
{
	if (TimeToElapse(Timer_MPCCamLane_LaneAttr4_FR2_ReceiptPDU) >= 40/2)
	{
		//Timer nicht zu 50% abgelaufen (d.h. aktiv und Botschaft nicht mit halber Zykluszeit empfangen)
		//außer bei spontan
		@sysvar::CH_Nodes::CH__PDURECEIPT_RECEIVE_MPC_CamLane_LaneAttr4_FR2 = 4;
	}
	else
	{
		//Timer zu 50% abgelaufen (d.h. Botschaft mit mindestens halber Zykluszeit empfangen)
		@sysvar::CH_Nodes::CH__PDURECEIPT_RECEIVE_MPC_CamLane_LaneAttr4_FR2 = 3;
	}
	//Timer auf Zykluszeit setzen
	setTimer(Timer_MPCCamLane_LaneAttr4_FR2_ReceiptPDU, 40);

	output(this);
}
/*@@end*/
/*@@frPDU:MsgChannel1.CHASSIS::SpringVlv_Stat_AR:*/
on frPDU MsgChannel1.CHASSIS::CamLane_LaneAttr5_FR2
{
	if (TimeToElapse(Timer_MPCCamLane_LaneAttr5_FR2_ReceiptPDU) >= 40/2)
	{
		//Timer nicht zu 50% abgelaufen (d.h. aktiv und Botschaft nicht mit halber Zykluszeit empfangen)
		//außer bei spontan
		@sysvar::CH_Nodes::CH__PDURECEIPT_RECEIVE_MPC_CamLane_LaneAttr5_FR2 = 4;
	}
	else
	{
		//Timer zu 50% abgelaufen (d.h. Botschaft mit mindestens halber Zykluszeit empfangen)
		@sysvar::CH_Nodes::CH__PDURECEIPT_RECEIVE_MPC_CamLane_LaneAttr5_FR2 = 3;
	}
	//Timer auf Zykluszeit setzen
	setTimer(Timer_MPCCamLane_LaneAttr5_FR2_ReceiptPDU, 40);

	output(this);
}
/*@@end*/
/*@@frPDU:MsgChannel1.CHASSIS::SpringVlv_Stat_AR:*/
on frPDU MsgChannel1.CHASSIS::CamLane_LaneAttr6_Gw_AR2
{
	if (TimeToElapse(Timer_MPCCamLane_LaneAttr6_Gw_AR2_ReceiptPDU) >= 40/2)
	{
		//Timer nicht zu 50% abgelaufen (d.h. aktiv und Botschaft nicht mit halber Zykluszeit empfangen)
		//außer bei spontan
		@sysvar::CH_Nodes::CH__PDURECEIPT_RECEIVE_MPC_CamLane_LaneAttr6_Gw_AR2 = 4;
	}
	else
	{
		//Timer zu 50% abgelaufen (d.h. Botschaft mit mindestens halber Zykluszeit empfangen)
		@sysvar::CH_Nodes::CH__PDURECEIPT_RECEIVE_MPC_CamLane_LaneAttr6_Gw_AR2 = 3;
	}
	//Timer auf Zykluszeit setzen
	setTimer(Timer_MPCCamLane_LaneAttr6_Gw_AR2_ReceiptPDU, 40);

	output(this);
}
/*@@end*/
/*@@frPDU:MsgChannel1.CHASSIS::SpringVlv_Stat_AR:*/
on frPDU MsgChannel1.CHASSIS::CamLane_LaneAttr7_Gw_AR2
{
	if (TimeToElapse(Timer_MPCCamLane_LaneAttr7_Gw_AR2_ReceiptPDU) >= 40/2)
	{
		//Timer nicht zu 50% abgelaufen (d.h. aktiv und Botschaft nicht mit halber Zykluszeit empfangen)
		//außer bei spontan
		@sysvar::CH_Nodes::CH__PDURECEIPT_RECEIVE_MPC_CamLane_LaneAttr7_Gw_AR2 = 4;
	}
	else
	{
		//Timer zu 50% abgelaufen (d.h. Botschaft mit mindestens halber Zykluszeit empfangen)
		@sysvar::CH_Nodes::CH__PDURECEIPT_RECEIVE_MPC_CamLane_LaneAttr7_Gw_AR2 = 3;
	}
	//Timer auf Zykluszeit setzen
	setTimer(Timer_MPCCamLane_LaneAttr7_Gw_AR2_ReceiptPDU, 40);

	output(this);
}
/*@@end*/
/*@@frPDU:MsgChannel1.CHASSIS::SpringVlv_Stat_AR:*/
on frPDU MsgChannel1.CHASSIS::CamObj_A_Mtn_FR2
{
	if (TimeToElapse(Timer_MPCCamObj_A_Mtn_FR2_ReceiptPDU) >= 5/2)
	{
		//Timer nicht zu 50% abgelaufen (d.h. aktiv und Botschaft nicht mit halber Zykluszeit empfangen)
		//außer bei spontan
		@sysvar::CH_Nodes::CH__PDURECEIPT_RECEIVE_MPC_CamObj_A_Mtn_FR2 = 4;
	}
	else
	{
		//Timer zu 50% abgelaufen (d.h. Botschaft mit mindestens halber Zykluszeit empfangen)
		@sysvar::CH_Nodes::CH__PDURECEIPT_RECEIVE_MPC_CamObj_A_Mtn_FR2 = 3;
	}
	//Timer auf Zykluszeit setzen
	setTimer(Timer_MPCCamObj_A_Mtn_FR2_ReceiptPDU, 5);

	output(this);
}
/*@@end*/
/*@@frPDU:MsgChannel1.CHASSIS::SpringVlv_Stat_AR:*/
on frPDU MsgChannel1.CHASSIS::CamObj_A_Posn_FR2
{
	if (TimeToElapse(Timer_MPCCamObj_A_Posn_FR2_ReceiptPDU) >= 5/2)
	{
		//Timer nicht zu 50% abgelaufen (d.h. aktiv und Botschaft nicht mit halber Zykluszeit empfangen)
		//außer bei spontan
		@sysvar::CH_Nodes::CH__PDURECEIPT_RECEIVE_MPC_CamObj_A_Posn_FR2 = 4;
	}
	else
	{
		//Timer zu 50% abgelaufen (d.h. Botschaft mit mindestens halber Zykluszeit empfangen)
		@sysvar::CH_Nodes::CH__PDURECEIPT_RECEIVE_MPC_CamObj_A_Posn_FR2 = 3;
	}
	//Timer auf Zykluszeit setzen
	setTimer(Timer_MPCCamObj_A_Posn_FR2_ReceiptPDU, 5);

	output(this);
}
/*@@end*/
/*@@frPDU:MsgChannel1.CHASSIS::SpringVlv_Stat_AR:*/
on frPDU MsgChannel1.CHASSIS::CamObj_B_Mtn_FR2
{
	if (TimeToElapse(Timer_MPCCamObj_B_Mtn_FR2_ReceiptPDU) >= 5/2)
	{
		//Timer nicht zu 50% abgelaufen (d.h. aktiv und Botschaft nicht mit halber Zykluszeit empfangen)
		//außer bei spontan
		@sysvar::CH_Nodes::CH__PDURECEIPT_RECEIVE_MPC_CamObj_B_Mtn_FR2 = 4;
	}
	else
	{
		//Timer zu 50% abgelaufen (d.h. Botschaft mit mindestens halber Zykluszeit empfangen)
		@sysvar::CH_Nodes::CH__PDURECEIPT_RECEIVE_MPC_CamObj_B_Mtn_FR2 = 3;
	}
	//Timer auf Zykluszeit setzen
	setTimer(Timer_MPCCamObj_B_Mtn_FR2_ReceiptPDU, 5);

	output(this);
}
/*@@end*/
/*@@frPDU:MsgChannel1.CHASSIS::SpringVlv_Stat_AR:*/
on frPDU MsgChannel1.CHASSIS::CamObj_B_Posn_FR2
{
	if (TimeToElapse(Timer_MPCCamObj_B_Posn_FR2_ReceiptPDU) >= 5/2)
	{
		//Timer nicht zu 50% abgelaufen (d.h. aktiv und Botschaft nicht mit halber Zykluszeit empfangen)
		//außer bei spontan
		@sysvar::CH_Nodes::CH__PDURECEIPT_RECEIVE_MPC_CamObj_B_Posn_FR2 = 4;
	}
	else
	{
		//Timer zu 50% abgelaufen (d.h. Botschaft mit mindestens halber Zykluszeit empfangen)
		@sysvar::CH_Nodes::CH__PDURECEIPT_RECEIVE_MPC_CamObj_B_Posn_FR2 = 3;
	}
	//Timer auf Zykluszeit setzen
	setTimer(Timer_MPCCamObj_B_Posn_FR2_ReceiptPDU, 5);

	output(this);
}
/*@@end*/
/*@@frPDU:MsgChannel1.CHASSIS::SpringVlv_Stat_AR:*/
on frPDU MsgChannel1.CHASSIS::CamObj_C_Mtn_FR2
{
	if (TimeToElapse(Timer_MPCCamObj_C_Mtn_FR2_ReceiptPDU) >= 5/2)
	{
		//Timer nicht zu 50% abgelaufen (d.h. aktiv und Botschaft nicht mit halber Zykluszeit empfangen)
		//außer bei spontan
		@sysvar::CH_Nodes::CH__PDURECEIPT_RECEIVE_MPC_CamObj_C_Mtn_FR2 = 4;
	}
	else
	{
		//Timer zu 50% abgelaufen (d.h. Botschaft mit mindestens halber Zykluszeit empfangen)
		@sysvar::CH_Nodes::CH__PDURECEIPT_RECEIVE_MPC_CamObj_C_Mtn_FR2 = 3;
	}
	//Timer auf Zykluszeit setzen
	setTimer(Timer_MPCCamObj_C_Mtn_FR2_ReceiptPDU, 5);

	output(this);
}
/*@@end*/
/*@@frPDU:MsgChannel1.CHASSIS::SpringVlv_Stat_AR:*/
on frPDU MsgChannel1.CHASSIS::CamObj_C_Posn_FR2
{
	if (TimeToElapse(Timer_MPCCamObj_C_Posn_FR2_ReceiptPDU) >= 5/2)
	{
		//Timer nicht zu 50% abgelaufen (d.h. aktiv und Botschaft nicht mit halber Zykluszeit empfangen)
		//außer bei spontan
		@sysvar::CH_Nodes::CH__PDURECEIPT_RECEIVE_MPC_CamObj_C_Posn_FR2 = 4;
	}
	else
	{
		//Timer zu 50% abgelaufen (d.h. Botschaft mit mindestens halber Zykluszeit empfangen)
		@sysvar::CH_Nodes::CH__PDURECEIPT_RECEIVE_MPC_CamObj_C_Posn_FR2 = 3;
	}
	//Timer auf Zykluszeit setzen
	setTimer(Timer_MPCCamObj_C_Posn_FR2_ReceiptPDU, 5);

	output(this);
}
/*@@end*/
/*@@frPDU:MsgChannel1.CHASSIS::SpringVlv_Stat_AR:*/
on frPDU MsgChannel1.CHASSIS::IHC_Lgt_Stat_MPC_Gw_AR2
{
	if (TimeToElapse(Timer_MPCIHC_Lgt_Stat_MPC_Gw_AR2_ReceiptPDU) >= 40/2)
	{
		//Timer nicht zu 50% abgelaufen (d.h. aktiv und Botschaft nicht mit halber Zykluszeit empfangen)
		//außer bei spontan
		@sysvar::CH_Nodes::CH__PDURECEIPT_RECEIVE_MPC_IHC_Lgt_Stat_MPC_Gw_AR2 = 4;
	}
	else
	{
		//Timer zu 50% abgelaufen (d.h. Botschaft mit mindestens halber Zykluszeit empfangen)
		@sysvar::CH_Nodes::CH__PDURECEIPT_RECEIVE_MPC_IHC_Lgt_Stat_MPC_Gw_AR2 = 3;
	}
	//Timer auf Zykluszeit setzen
	setTimer(Timer_MPCIHC_Lgt_Stat_MPC_Gw_AR2_ReceiptPDU, 40);

	output(this);
}
/*@@end*/
/*@@frPDU:MsgChannel1.CHASSIS::SpringVlv_Stat_AR:*/
on frPDU MsgChannel1.CHASSIS::IHC_Plus_HL_Stat_AR2
{
	if (TimeToElapse(Timer_MPCIHC_Plus_HL_Stat_AR2_ReceiptPDU) >= 40/2)
	{
		//Timer nicht zu 50% abgelaufen (d.h. aktiv und Botschaft nicht mit halber Zykluszeit empfangen)
		//außer bei spontan
		@sysvar::CH_Nodes::CH__PDURECEIPT_RECEIVE_MPC_IHC_Plus_HL_Stat_AR2 = 4;
	}
	else
	{
		//Timer zu 50% abgelaufen (d.h. Botschaft mit mindestens halber Zykluszeit empfangen)
		@sysvar::CH_Nodes::CH__PDURECEIPT_RECEIVE_MPC_IHC_Plus_HL_Stat_AR2 = 3;
	}
	//Timer auf Zykluszeit setzen
	setTimer(Timer_MPCIHC_Plus_HL_Stat_AR2_ReceiptPDU, 40);

	output(this);
}
/*@@end*/
/*@@frPDU:MsgChannel1.CHASSIS::SpringVlv_Stat_AR:*/
on frPDU MsgChannel1.CHASSIS::IHC_Plus_Tunnel_3_4_AR2
{
	if (TimeToElapse(Timer_MPCIHC_Plus_Tunnel_3_4_AR2_ReceiptPDU) >= 40/2)
	{
		//Timer nicht zu 50% abgelaufen (d.h. aktiv und Botschaft nicht mit halber Zykluszeit empfangen)
		//außer bei spontan
		@sysvar::CH_Nodes::CH__PDURECEIPT_RECEIVE_MPC_IHC_Plus_Tunnel_3_4_AR2 = 4;
	}
	else
	{
		//Timer zu 50% abgelaufen (d.h. Botschaft mit mindestens halber Zykluszeit empfangen)
		@sysvar::CH_Nodes::CH__PDURECEIPT_RECEIVE_MPC_IHC_Plus_Tunnel_3_4_AR2 = 3;
	}
	//Timer auf Zykluszeit setzen
	setTimer(Timer_MPCIHC_Plus_Tunnel_3_4_AR2_ReceiptPDU, 40);

	output(this);
}
/*@@end*/
/*@@frPDU:MsgChannel1.CHASSIS::SpringVlv_Stat_AR:*/
on frPDU MsgChannel1.CHASSIS::IHC_Plus_Tunnel_AR2
{
	if (TimeToElapse(Timer_MPCIHC_Plus_Tunnel_AR2_ReceiptPDU) >= 40/2)
	{
		//Timer nicht zu 50% abgelaufen (d.h. aktiv und Botschaft nicht mit halber Zykluszeit empfangen)
		//außer bei spontan
		@sysvar::CH_Nodes::CH__PDURECEIPT_RECEIVE_MPC_IHC_Plus_Tunnel_AR2 = 4;
	}
	else
	{
		//Timer zu 50% abgelaufen (d.h. Botschaft mit mindestens halber Zykluszeit empfangen)
		@sysvar::CH_Nodes::CH__PDURECEIPT_RECEIVE_MPC_IHC_Plus_Tunnel_AR2 = 3;
	}
	//Timer auf Zykluszeit setzen
	setTimer(Timer_MPCIHC_Plus_Tunnel_AR2_ReceiptPDU, 40);

	output(this);
}
/*@@end*/
/*@@frPDU:MsgChannel1.CHASSIS::SpringVlv_Stat_AR:*/
on frPDU MsgChannel1.CHASSIS::Preview_Header1_FR2
{
	if (TimeToElapse(Timer_MPCPreview_Header1_FR2_ReceiptPDU) >= 20/2)
	{
		//Timer nicht zu 50% abgelaufen (d.h. aktiv und Botschaft nicht mit halber Zykluszeit empfangen)
		//außer bei spontan
		@sysvar::CH_Nodes::CH__PDURECEIPT_RECEIVE_MPC_Preview_Header1_FR2 = 4;
	}
	else
	{
		//Timer zu 50% abgelaufen (d.h. Botschaft mit mindestens halber Zykluszeit empfangen)
		@sysvar::CH_Nodes::CH__PDURECEIPT_RECEIVE_MPC_Preview_Header1_FR2 = 3;
	}
	//Timer auf Zykluszeit setzen
	setTimer(Timer_MPCPreview_Header1_FR2_ReceiptPDU, 20);

	output(this);
}
/*@@end*/
/*@@frPDU:MsgChannel1.CHASSIS::SpringVlv_Stat_AR:*/
on frPDU MsgChannel1.CHASSIS::Preview_Header2_FR2
{
	if (TimeToElapse(Timer_MPCPreview_Header2_FR2_ReceiptPDU) >= 20/2)
	{
		//Timer nicht zu 50% abgelaufen (d.h. aktiv und Botschaft nicht mit halber Zykluszeit empfangen)
		//außer bei spontan
		@sysvar::CH_Nodes::CH__PDURECEIPT_RECEIVE_MPC_Preview_Header2_FR2 = 4;
	}
	else
	{
		//Timer zu 50% abgelaufen (d.h. Botschaft mit mindestens halber Zykluszeit empfangen)
		@sysvar::CH_Nodes::CH__PDURECEIPT_RECEIVE_MPC_Preview_Header2_FR2 = 3;
	}
	//Timer auf Zykluszeit setzen
	setTimer(Timer_MPCPreview_Header2_FR2_ReceiptPDU, 20);

	output(this);
}
/*@@end*/
/*@@frPDU:MsgChannel1.CHASSIS::SpringVlv_Stat_AR:*/
on frPDU MsgChannel1.CHASSIS::Preview_ProfData1_FR2
{
	if (TimeToElapse(Timer_MPCPreview_ProfData1_FR2_ReceiptPDU) >= 5/2)
	{
		//Timer nicht zu 50% abgelaufen (d.h. aktiv und Botschaft nicht mit halber Zykluszeit empfangen)
		//außer bei spontan
		@sysvar::CH_Nodes::CH__PDURECEIPT_RECEIVE_MPC_Preview_ProfData1_FR2 = 4;
	}
	else
	{
		//Timer zu 50% abgelaufen (d.h. Botschaft mit mindestens halber Zykluszeit empfangen)
		@sysvar::CH_Nodes::CH__PDURECEIPT_RECEIVE_MPC_Preview_ProfData1_FR2 = 3;
	}
	//Timer auf Zykluszeit setzen
	setTimer(Timer_MPCPreview_ProfData1_FR2_ReceiptPDU, 5);

	output(this);
}
/*@@end*/
/*@@frPDU:MsgChannel1.CHASSIS::SpringVlv_Stat_AR:*/
on frPDU MsgChannel1.CHASSIS::Preview_ProfData2_FR2
{
	if (TimeToElapse(Timer_MPCPreview_ProfData2_FR2_ReceiptPDU) >= 5/2)
	{
		//Timer nicht zu 50% abgelaufen (d.h. aktiv und Botschaft nicht mit halber Zykluszeit empfangen)
		//außer bei spontan
		@sysvar::CH_Nodes::CH__PDURECEIPT_RECEIVE_MPC_Preview_ProfData2_FR2 = 4;
	}
	else
	{
		//Timer zu 50% abgelaufen (d.h. Botschaft mit mindestens halber Zykluszeit empfangen)
		@sysvar::CH_Nodes::CH__PDURECEIPT_RECEIVE_MPC_Preview_ProfData2_FR2 = 3;
	}
	//Timer auf Zykluszeit setzen
	setTimer(Timer_MPCPreview_ProfData2_FR2_ReceiptPDU, 5);

	output(this);
}
/*@@end*/
/*@@frPDU:MsgChannel1.CHASSIS::SpringVlv_Stat_AR:*/
on frPDU MsgChannel1.CHASSIS::ROE_SMPC
{
	if (TimeToElapse(Timer_MPCROE_SMPC_ReceiptPDU) >= 5/2)
	{
		//Timer nicht zu 50% abgelaufen (d.h. aktiv und Botschaft nicht mit halber Zykluszeit empfangen)
		//außer bei spontan
	}
	else
	{
		//Timer zu 50% abgelaufen (d.h. Botschaft mit mindestens halber Zykluszeit empfangen)
		@sysvar::CH_Nodes::CH__PDURECEIPT_RECEIVE_MPC_ROE_SMPC = 3;
	}
	//Timer auf Zykluszeit setzen
	setTimer(Timer_MPCROE_SMPC_ReceiptPDU, 5);

	output(this);
}
/*@@end*/
/*@@frPDU:MsgChannel1.CHASSIS::SpringVlv_Stat_AR:*/
on frPDU MsgChannel1.CHASSIS::SPL_Obj1_Obj2_MPC_AR2
{
	if (TimeToElapse(Timer_MPCSPL_Obj1_Obj2_MPC_AR2_ReceiptPDU) >= 80/2)
	{
		//Timer nicht zu 50% abgelaufen (d.h. aktiv und Botschaft nicht mit halber Zykluszeit empfangen)
		//außer bei spontan
		@sysvar::CH_Nodes::CH__PDURECEIPT_RECEIVE_MPC_SPL_Obj1_Obj2_MPC_AR2 = 4;
	}
	else
	{
		//Timer zu 50% abgelaufen (d.h. Botschaft mit mindestens halber Zykluszeit empfangen)
		@sysvar::CH_Nodes::CH__PDURECEIPT_RECEIVE_MPC_SPL_Obj1_Obj2_MPC_AR2 = 3;
	}
	//Timer auf Zykluszeit setzen
	setTimer(Timer_MPCSPL_Obj1_Obj2_MPC_AR2_ReceiptPDU, 80);

	output(this);
}
/*@@end*/
/*@@frPDU:MsgChannel1.CHASSIS::SpringVlv_Stat_AR:*/
on frPDU MsgChannel1.CHASSIS::TSA_Disp_Rq1_Gw_AR2
{
	if (TimeToElapse(Timer_MPCTSA_Disp_Rq1_Gw_AR2_ReceiptPDU) >= 200/2)
	{
		//Timer nicht zu 50% abgelaufen (d.h. aktiv und Botschaft nicht mit halber Zykluszeit empfangen)
		//außer bei spontan
		@sysvar::CH_Nodes::CH__PDURECEIPT_RECEIVE_MPC_TSA_Disp_Rq1_Gw_AR2 = 4;
	}
	else
	{
		//Timer zu 50% abgelaufen (d.h. Botschaft mit mindestens halber Zykluszeit empfangen)
		@sysvar::CH_Nodes::CH__PDURECEIPT_RECEIVE_MPC_TSA_Disp_Rq1_Gw_AR2 = 3;
	}
	//Timer auf Zykluszeit setzen
	setTimer(Timer_MPCTSA_Disp_Rq1_Gw_AR2_ReceiptPDU, 200);

	output(this);
}
/*@@end*/
/*@@frPDU:MsgChannel1.CHASSIS::SpringVlv_Stat_AR:*/
on frPDU MsgChannel1.CHASSIS::TSA_Disp_Rq2_Gw_AR
{
	if (TimeToElapse(Timer_MPCTSA_Disp_Rq2_Gw_AR_ReceiptPDU) >= 200/2)
	{
		//Timer nicht zu 50% abgelaufen (d.h. aktiv und Botschaft nicht mit halber Zykluszeit empfangen)
		//außer bei spontan
		@sysvar::CH_Nodes::CH__PDURECEIPT_RECEIVE_MPC_TSA_Disp_Rq2_Gw_AR = 4;
	}
	else
	{
		//Timer zu 50% abgelaufen (d.h. Botschaft mit mindestens halber Zykluszeit empfangen)
		@sysvar::CH_Nodes::CH__PDURECEIPT_RECEIVE_MPC_TSA_Disp_Rq2_Gw_AR = 3;
	}
	//Timer auf Zykluszeit setzen
	setTimer(Timer_MPCTSA_Disp_Rq2_Gw_AR_ReceiptPDU, 200);

	output(this);
}
/*@@end*/
/*@@frPDU:MsgChannel1.CHASSIS::SpringVlv_Stat_AR:*/
on frPDU MsgChannel1.CHASSIS::TSA_Disp_Rq3_Gw_AR
{
	if (TimeToElapse(Timer_MPCTSA_Disp_Rq3_Gw_AR_ReceiptPDU) >= 200/2)
	{
		//Timer nicht zu 50% abgelaufen (d.h. aktiv und Botschaft nicht mit halber Zykluszeit empfangen)
		//außer bei spontan
		@sysvar::CH_Nodes::CH__PDURECEIPT_RECEIVE_MPC_TSA_Disp_Rq3_Gw_AR = 4;
	}
	else
	{
		//Timer zu 50% abgelaufen (d.h. Botschaft mit mindestens halber Zykluszeit empfangen)
		@sysvar::CH_Nodes::CH__PDURECEIPT_RECEIVE_MPC_TSA_Disp_Rq3_Gw_AR = 3;
	}
	//Timer auf Zykluszeit setzen
	setTimer(Timer_MPCTSA_Disp_Rq3_Gw_AR_ReceiptPDU, 200);

	output(this);
}
/*@@end*/
/*@@frPDU:MsgChannel1.CHASSIS::SpringVlv_Stat_AR:*/
on frPDU MsgChannel1.CHASSIS::YMAS_Rq_MPC_Gw_AR2
{
	if (TimeToElapse(Timer_MPCYMAS_Rq_MPC_Gw_AR2_ReceiptPDU) >= 20/2)
	{
		//Timer nicht zu 50% abgelaufen (d.h. aktiv und Botschaft nicht mit halber Zykluszeit empfangen)
		//außer bei spontan
		@sysvar::CH_Nodes::CH__PDURECEIPT_RECEIVE_MPC_YMAS_Rq_MPC_Gw_AR2 = 4;
	}
	else
	{
		//Timer zu 50% abgelaufen (d.h. Botschaft mit mindestens halber Zykluszeit empfangen)
		@sysvar::CH_Nodes::CH__PDURECEIPT_RECEIVE_MPC_YMAS_Rq_MPC_Gw_AR2 = 3;
	}
	//Timer auf Zykluszeit setzen
	setTimer(Timer_MPCYMAS_Rq_MPC_Gw_AR2_ReceiptPDU, 20);

	output(this);
}
/*@@end*/
/*@@frPDU:MsgChannel1.CHASSIS::SpringVlv_Stat_AR:*/
on frPDU MsgChannel1.CHASSIS::Brk_Rq_PARK_AR2
{
	if (TimeToElapse(Timer_PARKBrk_Rq_PARK_AR2_ReceiptPDU) >= 20/2)
	{
		//Timer nicht zu 50% abgelaufen (d.h. aktiv und Botschaft nicht mit halber Zykluszeit empfangen)
		//außer bei spontan
		@sysvar::CH_Nodes::CH__PDURECEIPT_RECEIVE_PARK_Brk_Rq_PARK_AR2 = 4;
	}
	else
	{
		//Timer zu 50% abgelaufen (d.h. Botschaft mit mindestens halber Zykluszeit empfangen)
		@sysvar::CH_Nodes::CH__PDURECEIPT_RECEIVE_PARK_Brk_Rq_PARK_AR2 = 3;
	}
	//Timer auf Zykluszeit setzen
	setTimer(Timer_PARKBrk_Rq_PARK_AR2_ReceiptPDU, 20);

	output(this);
}
/*@@end*/
/*@@frPDU:MsgChannel1.CHASSIS::SpringVlv_Stat_AR:*/
on frPDU MsgChannel1.CHASSIS::ECU_INFO_RVC_AR
{
	if (TimeToElapse(Timer_PARKECU_INFO_RVC_AR_ReceiptPDU) >= 5000/2)
	{
		//Timer nicht zu 50% abgelaufen (d.h. aktiv und Botschaft nicht mit halber Zykluszeit empfangen)
		//außer bei spontan
		@sysvar::CH_Nodes::CH__PDURECEIPT_RECEIVE_PARK_ECU_INFO_RVC_AR = 4;
	}
	else
	{
		//Timer zu 50% abgelaufen (d.h. Botschaft mit mindestens halber Zykluszeit empfangen)
		@sysvar::CH_Nodes::CH__PDURECEIPT_RECEIVE_PARK_ECU_INFO_RVC_AR = 3;
	}
	//Timer auf Zykluszeit setzen
	setTimer(Timer_PARKECU_INFO_RVC_AR_ReceiptPDU, 5000);

	output(this);
}
/*@@end*/
/*@@frPDU:MsgChannel1.CHASSIS::SpringVlv_Stat_AR:*/
on frPDU MsgChannel1.CHASSIS::Park_Disp_Rq_AR2
{
	if (TimeToElapse(Timer_PARKPark_Disp_Rq_AR2_ReceiptPDU) >= 200/2)
	{
		//Timer nicht zu 50% abgelaufen (d.h. aktiv und Botschaft nicht mit halber Zykluszeit empfangen)
		//außer bei spontan
		@sysvar::CH_Nodes::CH__PDURECEIPT_RECEIVE_PARK_Park_Disp_Rq_AR2 = 4;
	}
	else
	{
		//Timer zu 50% abgelaufen (d.h. Botschaft mit mindestens halber Zykluszeit empfangen)
		@sysvar::CH_Nodes::CH__PDURECEIPT_RECEIVE_PARK_Park_Disp_Rq_AR2 = 3;
	}
	//Timer auf Zykluszeit setzen
	setTimer(Timer_PARKPark_Disp_Rq_AR2_ReceiptPDU, 200);

	output(this);
}
/*@@end*/
/*@@frPDU:MsgChannel1.CHASSIS::SpringVlv_Stat_AR:*/
on frPDU MsgChannel1.CHASSIS::Park_Set_Stat_AR2
{
	if (TimeToElapse(Timer_PARKPark_Set_Stat_AR2_ReceiptPDU) >= 500/2)
	{
		//Timer nicht zu 50% abgelaufen (d.h. aktiv und Botschaft nicht mit halber Zykluszeit empfangen)
		//außer bei spontan
		@sysvar::CH_Nodes::CH__PDURECEIPT_RECEIVE_PARK_Park_Set_Stat_AR2 = 4;
	}
	else
	{
		//Timer zu 50% abgelaufen (d.h. Botschaft mit mindestens halber Zykluszeit empfangen)
		@sysvar::CH_Nodes::CH__PDURECEIPT_RECEIVE_PARK_Park_Set_Stat_AR2 = 3;
	}
	//Timer auf Zykluszeit setzen
	setTimer(Timer_PARKPark_Set_Stat_AR2_ReceiptPDU, 500);

	output(this);
}
/*@@end*/
/*@@frPDU:MsgChannel1.CHASSIS::SpringVlv_Stat_AR:*/
on frPDU MsgChannel1.CHASSIS::Park_Stat_AR2
{
	if (TimeToElapse(Timer_PARKPark_Stat_AR2_ReceiptPDU) >= 200/2)
	{
		//Timer nicht zu 50% abgelaufen (d.h. aktiv und Botschaft nicht mit halber Zykluszeit empfangen)
		//außer bei spontan
		@sysvar::CH_Nodes::CH__PDURECEIPT_RECEIVE_PARK_Park_Stat_AR2 = 4;
	}
	else
	{
		//Timer zu 50% abgelaufen (d.h. Botschaft mit mindestens halber Zykluszeit empfangen)
		@sysvar::CH_Nodes::CH__PDURECEIPT_RECEIVE_PARK_Park_Stat_AR2 = 3;
	}
	//Timer auf Zykluszeit setzen
	setTimer(Timer_PARKPark_Stat_AR2_ReceiptPDU, 200);

	output(this);
}
/*@@end*/
/*@@frPDU:MsgChannel1.CHASSIS::SpringVlv_Stat_AR:*/
on frPDU MsgChannel1.CHASSIS::ParkSensObj_Stat1_FR2
{
	if (TimeToElapse(Timer_PARKParkSensObj_Stat1_FR2_ReceiptPDU) >= 40/2)
	{
		//Timer nicht zu 50% abgelaufen (d.h. aktiv und Botschaft nicht mit halber Zykluszeit empfangen)
		//außer bei spontan
		@sysvar::CH_Nodes::CH__PDURECEIPT_RECEIVE_PARK_ParkSensObj_Stat1_FR2 = 4;
	}
	else
	{
		//Timer zu 50% abgelaufen (d.h. Botschaft mit mindestens halber Zykluszeit empfangen)
		@sysvar::CH_Nodes::CH__PDURECEIPT_RECEIVE_PARK_ParkSensObj_Stat1_FR2 = 3;
	}
	//Timer auf Zykluszeit setzen
	setTimer(Timer_PARKParkSensObj_Stat1_FR2_ReceiptPDU, 40);

	output(this);
}
/*@@end*/
/*@@frPDU:MsgChannel1.CHASSIS::SpringVlv_Stat_AR:*/
on frPDU MsgChannel1.CHASSIS::ParkSensObj_Stat2_FR2
{
	if (TimeToElapse(Timer_PARKParkSensObj_Stat2_FR2_ReceiptPDU) >= 40/2)
	{
		//Timer nicht zu 50% abgelaufen (d.h. aktiv und Botschaft nicht mit halber Zykluszeit empfangen)
		//außer bei spontan
		@sysvar::CH_Nodes::CH__PDURECEIPT_RECEIVE_PARK_ParkSensObj_Stat2_FR2 = 4;
	}
	else
	{
		//Timer zu 50% abgelaufen (d.h. Botschaft mit mindestens halber Zykluszeit empfangen)
		@sysvar::CH_Nodes::CH__PDURECEIPT_RECEIVE_PARK_ParkSensObj_Stat2_FR2 = 3;
	}
	//Timer auf Zykluszeit setzen
	setTimer(Timer_PARKParkSensObj_Stat2_FR2_ReceiptPDU, 40);

	output(this);
}
/*@@end*/
/*@@frPDU:MsgChannel1.CHASSIS::SpringVlv_Stat_AR:*/
on frPDU MsgChannel1.CHASSIS::ParkSpaceMeas_Stat_AR
{
	if (TimeToElapse(Timer_PARKParkSpaceMeas_Stat_AR_ReceiptPDU) >= 1000/2)
	{
		//Timer nicht zu 50% abgelaufen (d.h. aktiv und Botschaft nicht mit halber Zykluszeit empfangen)
		//außer bei spontan
		@sysvar::CH_Nodes::CH__PDURECEIPT_RECEIVE_PARK_ParkSpaceMeas_Stat_AR = 4;
	}
	else
	{
		//Timer zu 50% abgelaufen (d.h. Botschaft mit mindestens halber Zykluszeit empfangen)
		@sysvar::CH_Nodes::CH__PDURECEIPT_RECEIVE_PARK_ParkSpaceMeas_Stat_AR = 3;
	}
	//Timer auf Zykluszeit setzen
	setTimer(Timer_PARKParkSpaceMeas_Stat_AR_ReceiptPDU, 1000);

	output(this);
}
/*@@end*/
/*@@frPDU:MsgChannel1.CHASSIS::SpringVlv_Stat_AR:*/
on frPDU MsgChannel1.CHASSIS::ParkWarn_AR2
{
	if (TimeToElapse(Timer_PARKParkWarn_AR2_ReceiptPDU) >= 200/2)
	{
		//Timer nicht zu 50% abgelaufen (d.h. aktiv und Botschaft nicht mit halber Zykluszeit empfangen)
		//außer bei spontan
		@sysvar::CH_Nodes::CH__PDURECEIPT_RECEIVE_PARK_ParkWarn_AR2 = 4;
	}
	else
	{
		//Timer zu 50% abgelaufen (d.h. Botschaft mit mindestens halber Zykluszeit empfangen)
		@sysvar::CH_Nodes::CH__PDURECEIPT_RECEIVE_PARK_ParkWarn_AR2 = 3;
	}
	//Timer auf Zykluszeit setzen
	setTimer(Timer_PARKParkWarn_AR2_ReceiptPDU, 200);

	output(this);
}
/*@@end*/
/*@@frPDU:MsgChannel1.CHASSIS::SpringVlv_Stat_AR:*/
on frPDU MsgChannel1.CHASSIS::RemPark_Rq_AR2
{
	if (TimeToElapse(Timer_PARKRemPark_Rq_AR2_ReceiptPDU) >= 200/2)
	{
		//Timer nicht zu 50% abgelaufen (d.h. aktiv und Botschaft nicht mit halber Zykluszeit empfangen)
		//außer bei spontan
		@sysvar::CH_Nodes::CH__PDURECEIPT_RECEIVE_PARK_RemPark_Rq_AR2 = 4;
	}
	else
	{
		//Timer zu 50% abgelaufen (d.h. Botschaft mit mindestens halber Zykluszeit empfangen)
		@sysvar::CH_Nodes::CH__PDURECEIPT_RECEIVE_PARK_RemPark_Rq_AR2 = 3;
	}
	//Timer auf Zykluszeit setzen
	setTimer(Timer_PARKRemPark_Rq_AR2_ReceiptPDU, 200);

	output(this);
}
/*@@end*/
/*@@frPDU:MsgChannel1.CHASSIS::SpringVlv_Stat_AR:*/
on frPDU MsgChannel1.CHASSIS::ROE_PARK
{
	if (TimeToElapse(Timer_PARKROE_PARK_ReceiptPDU) >= 5/2)
	{
		//Timer nicht zu 50% abgelaufen (d.h. aktiv und Botschaft nicht mit halber Zykluszeit empfangen)
		//außer bei spontan
	}
	else
	{
		//Timer zu 50% abgelaufen (d.h. Botschaft mit mindestens halber Zykluszeit empfangen)
		@sysvar::CH_Nodes::CH__PDURECEIPT_RECEIVE_PARK_ROE_PARK = 3;
	}
	//Timer auf Zykluszeit setzen
	setTimer(Timer_PARKROE_PARK_ReceiptPDU, 5);

	output(this);
}
/*@@end*/
/*@@frPDU:MsgChannel1.CHASSIS::SpringVlv_Stat_AR:*/
on frPDU MsgChannel1.CHASSIS::RVC_SVS_Park_Stat_AR2
{
	if (TimeToElapse(Timer_PARKRVC_SVS_Park_Stat_AR2_ReceiptPDU) >= 1000/2)
	{
		//Timer nicht zu 50% abgelaufen (d.h. aktiv und Botschaft nicht mit halber Zykluszeit empfangen)
		//außer bei spontan
		@sysvar::CH_Nodes::CH__PDURECEIPT_RECEIVE_PARK_RVC_SVS_Park_Stat_AR2 = 4;
	}
	else
	{
		//Timer zu 50% abgelaufen (d.h. Botschaft mit mindestens halber Zykluszeit empfangen)
		@sysvar::CH_Nodes::CH__PDURECEIPT_RECEIVE_PARK_RVC_SVS_Park_Stat_AR2 = 3;
	}
	//Timer auf Zykluszeit setzen
	setTimer(Timer_PARKRVC_SVS_Park_Stat_AR2_ReceiptPDU, 1000);

	output(this);
}
/*@@end*/
/*@@frPDU:MsgChannel1.CHASSIS::SpringVlv_Stat_AR:*/
on frPDU MsgChannel1.CHASSIS::SADR_Trgr_PARK_AR2
{
	if (TimeToElapse(Timer_PARKSADR_Trgr_PARK_AR2_ReceiptPDU) >= 5/2)
	{
		//Timer nicht zu 50% abgelaufen (d.h. aktiv und Botschaft nicht mit halber Zykluszeit empfangen)
		//außer bei spontan
		@sysvar::CH_Nodes::CH__PDURECEIPT_RECEIVE_PARK_SADR_Trgr_PARK_AR2 = 4;
	}
	else
	{
		//Timer zu 50% abgelaufen (d.h. Botschaft mit mindestens halber Zykluszeit empfangen)
		@sysvar::CH_Nodes::CH__PDURECEIPT_RECEIVE_PARK_SADR_Trgr_PARK_AR2 = 3;
	}
	//Timer auf Zykluszeit setzen
	setTimer(Timer_PARKSADR_Trgr_PARK_AR2_ReceiptPDU, 5);

	output(this);
}
/*@@end*/
/*@@frPDU:MsgChannel1.CHASSIS::SpringVlv_Stat_AR:*/
on frPDU MsgChannel1.CHASSIS::St_Rq_PARK_AR2
{
	if (TimeToElapse(Timer_PARKSt_Rq_PARK_AR2_ReceiptPDU) >= 20/2)
	{
		//Timer nicht zu 50% abgelaufen (d.h. aktiv und Botschaft nicht mit halber Zykluszeit empfangen)
		//außer bei spontan
		@sysvar::CH_Nodes::CH__PDURECEIPT_RECEIVE_PARK_St_Rq_PARK_AR2 = 4;
	}
	else
	{
		//Timer zu 50% abgelaufen (d.h. Botschaft mit mindestens halber Zykluszeit empfangen)
		@sysvar::CH_Nodes::CH__PDURECEIPT_RECEIVE_PARK_St_Rq_PARK_AR2 = 3;
	}
	//Timer auf Zykluszeit setzen
	setTimer(Timer_PARKSt_Rq_PARK_AR2_ReceiptPDU, 20);

	output(this);
}
/*@@end*/
/*@@frPDU:MsgChannel1.CHASSIS::SpringVlv_Stat_AR:*/
on frPDU MsgChannel1.CHASSIS::BrkSys_Rq_YMAS_AR2
{
	if (TimeToElapse(Timer_RDUBrkSys_Rq_YMAS_AR2_ReceiptPDU) >= 20/2)
	{
		//Timer nicht zu 50% abgelaufen (d.h. aktiv und Botschaft nicht mit halber Zykluszeit empfangen)
		//außer bei spontan
		@sysvar::CH_Nodes::CH__PDURECEIPT_RECEIVE_RDU_BrkSys_Rq_YMAS_AR2 = 4;
	}
	else
	{
		//Timer zu 50% abgelaufen (d.h. Botschaft mit mindestens halber Zykluszeit empfangen)
		@sysvar::CH_Nodes::CH__PDURECEIPT_RECEIVE_RDU_BrkSys_Rq_YMAS_AR2 = 3;
	}
	//Timer auf Zykluszeit setzen
	setTimer(Timer_RDUBrkSys_Rq_YMAS_AR2_ReceiptPDU, 20);

	output(this);
}
/*@@end*/
/*@@frPDU:MsgChannel1.CHASSIS::SpringVlv_Stat_AR:*/
on frPDU MsgChannel1.CHASSIS::BSM_Disp_Warn_Rq_Gw_AR2
{
	if (TimeToElapse(Timer_RDUBSM_Disp_Warn_Rq_Gw_AR2_ReceiptPDU) >= 200/2)
	{
		//Timer nicht zu 50% abgelaufen (d.h. aktiv und Botschaft nicht mit halber Zykluszeit empfangen)
		//außer bei spontan
		@sysvar::CH_Nodes::CH__PDURECEIPT_RECEIVE_RDU_BSM_Disp_Warn_Rq_Gw_AR2 = 4;
	}
	else
	{
		//Timer zu 50% abgelaufen (d.h. Botschaft mit mindestens halber Zykluszeit empfangen)
		@sysvar::CH_Nodes::CH__PDURECEIPT_RECEIVE_RDU_BSM_Disp_Warn_Rq_Gw_AR2 = 3;
	}
	//Timer auf Zykluszeit setzen
	setTimer(Timer_RDUBSM_Disp_Warn_Rq_Gw_AR2_ReceiptPDU, 200);

	output(this);
}
/*@@end*/
/*@@frPDU:MsgChannel1.CHASSIS::SpringVlv_Stat_AR:*/
on frPDU MsgChannel1.CHASSIS::CMS_PI_Sd_Stat_MMR_F1_AR2
{
	if (TimeToElapse(Timer_RDUCMS_PI_Sd_Stat_MMR_F1_AR2_ReceiptPDU) >= 5/2)
	{
		//Timer nicht zu 50% abgelaufen (d.h. aktiv und Botschaft nicht mit halber Zykluszeit empfangen)
		//außer bei spontan
	}
	else
	{
		//Timer zu 50% abgelaufen (d.h. Botschaft mit mindestens halber Zykluszeit empfangen)
		@sysvar::CH_Nodes::CH__PDURECEIPT_RECEIVE_RDU_CMS_PI_Sd_Stat_MMR_F1_AR2 = 3;
	}
	//Timer auf Zykluszeit setzen
	setTimer(Timer_RDUCMS_PI_Sd_Stat_MMR_F1_AR2_ReceiptPDU, 5);

	output(this);
}
/*@@end*/
/*@@frPDU:MsgChannel1.CHASSIS::SpringVlv_Stat_AR:*/
on frPDU MsgChannel1.CHASSIS::CMS_PI_Sd_Stat_MMR_F4_AR2
{
	if (TimeToElapse(Timer_RDUCMS_PI_Sd_Stat_MMR_F4_AR2_ReceiptPDU) >= 5/2)
	{
		//Timer nicht zu 50% abgelaufen (d.h. aktiv und Botschaft nicht mit halber Zykluszeit empfangen)
		//außer bei spontan
	}
	else
	{
		//Timer zu 50% abgelaufen (d.h. Botschaft mit mindestens halber Zykluszeit empfangen)
		@sysvar::CH_Nodes::CH__PDURECEIPT_RECEIVE_RDU_CMS_PI_Sd_Stat_MMR_F4_AR2 = 3;
	}
	//Timer auf Zykluszeit setzen
	setTimer(Timer_RDUCMS_PI_Sd_Stat_MMR_F4_AR2_ReceiptPDU, 5);

	output(this);
}
/*@@end*/
/*@@frPDU:MsgChannel1.CHASSIS::SpringVlv_Stat_AR:*/
on frPDU MsgChannel1.CHASSIS::DTQ_Disp_Warn_Rq_AR2
{
	if (TimeToElapse(Timer_RDUDTQ_Disp_Warn_Rq_AR2_ReceiptPDU) >= 200/2)
	{
		//Timer nicht zu 50% abgelaufen (d.h. aktiv und Botschaft nicht mit halber Zykluszeit empfangen)
		//außer bei spontan
		@sysvar::CH_Nodes::CH__PDURECEIPT_RECEIVE_RDU_DTQ_Disp_Warn_Rq_AR2 = 4;
	}
	else
	{
		//Timer zu 50% abgelaufen (d.h. Botschaft mit mindestens halber Zykluszeit empfangen)
		@sysvar::CH_Nodes::CH__PDURECEIPT_RECEIVE_RDU_DTQ_Disp_Warn_Rq_AR2 = 3;
	}
	//Timer auf Zykluszeit setzen
	setTimer(Timer_RDUDTQ_Disp_Warn_Rq_AR2_ReceiptPDU, 200);

	output(this);
}
/*@@end*/
/*@@frPDU:MsgChannel1.CHASSIS::SpringVlv_Stat_AR:*/
on frPDU MsgChannel1.CHASSIS::DTQ_Rq1_AR2
{
	if (TimeToElapse(Timer_RDUDTQ_Rq1_AR2_ReceiptPDU) >= 20/2)
	{
		//Timer nicht zu 50% abgelaufen (d.h. aktiv und Botschaft nicht mit halber Zykluszeit empfangen)
		//außer bei spontan
		@sysvar::CH_Nodes::CH__PDURECEIPT_RECEIVE_RDU_DTQ_Rq1_AR2 = 4;
	}
	else
	{
		//Timer zu 50% abgelaufen (d.h. Botschaft mit mindestens halber Zykluszeit empfangen)
		@sysvar::CH_Nodes::CH__PDURECEIPT_RECEIVE_RDU_DTQ_Rq1_AR2 = 3;
	}
	//Timer auf Zykluszeit setzen
	setTimer(Timer_RDUDTQ_Rq1_AR2_ReceiptPDU, 20);

	output(this);
}
/*@@end*/
/*@@frPDU:MsgChannel1.CHASSIS::SpringVlv_Stat_AR:*/
on frPDU MsgChannel1.CHASSIS::DTQ_Rq2_AR2
{
	if (TimeToElapse(Timer_RDUDTQ_Rq2_AR2_ReceiptPDU) >= 20/2)
	{
		//Timer nicht zu 50% abgelaufen (d.h. aktiv und Botschaft nicht mit halber Zykluszeit empfangen)
		//außer bei spontan
		@sysvar::CH_Nodes::CH__PDURECEIPT_RECEIVE_RDU_DTQ_Rq2_AR2 = 4;
	}
	else
	{
		//Timer zu 50% abgelaufen (d.h. Botschaft mit mindestens halber Zykluszeit empfangen)
		@sysvar::CH_Nodes::CH__PDURECEIPT_RECEIVE_RDU_DTQ_Rq2_AR2 = 3;
	}
	//Timer auf Zykluszeit setzen
	setTimer(Timer_RDUDTQ_Rq2_AR2_ReceiptPDU, 20);

	output(this);
}
/*@@end*/
/*@@frPDU:MsgChannel1.CHASSIS::SpringVlv_Stat_AR:*/
on frPDU MsgChannel1.CHASSIS::LDC_Disp_Rq_RDU_AR2
{
	if (TimeToElapse(Timer_RDULDC_Disp_Rq_RDU_AR2_ReceiptPDU) >= 200/2)
	{
		//Timer nicht zu 50% abgelaufen (d.h. aktiv und Botschaft nicht mit halber Zykluszeit empfangen)
		//außer bei spontan
		@sysvar::CH_Nodes::CH__PDURECEIPT_RECEIVE_RDU_LDC_Disp_Rq_RDU_AR2 = 4;
	}
	else
	{
		//Timer zu 50% abgelaufen (d.h. Botschaft mit mindestens halber Zykluszeit empfangen)
		@sysvar::CH_Nodes::CH__PDURECEIPT_RECEIVE_RDU_LDC_Disp_Rq_RDU_AR2 = 3;
	}
	//Timer auf Zykluszeit setzen
	setTimer(Timer_RDULDC_Disp_Rq_RDU_AR2_ReceiptPDU, 200);
	if (TimeToElapse(Timer_SDTRLDC_Disp_Rq_RDU_AR2_ReceiptPDU) >= 200/2)
	{
		//Timer nicht zu 50% abgelaufen (d.h. aktiv und Botschaft nicht mit halber Zykluszeit empfangen)
		//außer bei spontan
		@sysvar::CH_Nodes::CH__PDURECEIPT_RECEIVE_SDTR_LDC_Disp_Rq_RDU_AR2 = 4;
	}
	else
	{
		//Timer zu 50% abgelaufen (d.h. Botschaft mit mindestens halber Zykluszeit empfangen)
		@sysvar::CH_Nodes::CH__PDURECEIPT_RECEIVE_SDTR_LDC_Disp_Rq_RDU_AR2 = 3;
	}
	//Timer auf Zykluszeit setzen
	setTimer(Timer_SDTRLDC_Disp_Rq_RDU_AR2_ReceiptPDU, 200);

	output(this);
}
/*@@end*/
/*@@frPDU:MsgChannel1.CHASSIS::SpringVlv_Stat_AR:*/
on frPDU MsgChannel1.CHASSIS::LDP_Warn_Rq_AR2
{
	if (TimeToElapse(Timer_RDULDP_Warn_Rq_AR2_ReceiptPDU) >= 200/2)
	{
		//Timer nicht zu 50% abgelaufen (d.h. aktiv und Botschaft nicht mit halber Zykluszeit empfangen)
		//außer bei spontan
		@sysvar::CH_Nodes::CH__PDURECEIPT_RECEIVE_RDU_LDP_Warn_Rq_AR2 = 4;
	}
	else
	{
		//Timer zu 50% abgelaufen (d.h. Botschaft mit mindestens halber Zykluszeit empfangen)
		@sysvar::CH_Nodes::CH__PDURECEIPT_RECEIVE_RDU_LDP_Warn_Rq_AR2 = 3;
	}
	//Timer auf Zykluszeit setzen
	setTimer(Timer_RDULDP_Warn_Rq_AR2_ReceiptPDU, 200);

	output(this);
}
/*@@end*/
/*@@frPDU:MsgChannel1.CHASSIS::SpringVlv_Stat_AR:*/
on frPDU MsgChannel1.CHASSIS::RDU_GlobalAttr_AR2
{
	if (TimeToElapse(Timer_RDURDU_GlobalAttr_AR2_ReceiptPDU) >= 320/2)
	{
		//Timer nicht zu 50% abgelaufen (d.h. aktiv und Botschaft nicht mit halber Zykluszeit empfangen)
		//außer bei spontan
		@sysvar::CH_Nodes::CH__PDURECEIPT_RECEIVE_RDU_RDU_GlobalAttr_AR2 = 4;
	}
	else
	{
		//Timer zu 50% abgelaufen (d.h. Botschaft mit mindestens halber Zykluszeit empfangen)
		@sysvar::CH_Nodes::CH__PDURECEIPT_RECEIVE_RDU_RDU_GlobalAttr_AR2 = 3;
	}
	//Timer auf Zykluszeit setzen
	setTimer(Timer_RDURDU_GlobalAttr_AR2_ReceiptPDU, 320);

	output(this);
}
/*@@end*/
/*@@frPDU:MsgChannel1.CHASSIS::SpringVlv_Stat_AR:*/
on frPDU MsgChannel1.CHASSIS::RDU_Stat1_AR
{
	if (TimeToElapse(Timer_RDURDU_Stat1_AR_ReceiptPDU) >= 100/2)
	{
		//Timer nicht zu 50% abgelaufen (d.h. aktiv und Botschaft nicht mit halber Zykluszeit empfangen)
		//außer bei spontan
		@sysvar::CH_Nodes::CH__PDURECEIPT_RECEIVE_RDU_RDU_Stat1_AR = 4;
	}
	else
	{
		//Timer zu 50% abgelaufen (d.h. Botschaft mit mindestens halber Zykluszeit empfangen)
		@sysvar::CH_Nodes::CH__PDURECEIPT_RECEIVE_RDU_RDU_Stat1_AR = 3;
	}
	//Timer auf Zykluszeit setzen
	setTimer(Timer_RDURDU_Stat1_AR_ReceiptPDU, 100);
	if (TimeToElapse(Timer_SDTRRDU_Stat1_AR_ReceiptPDU) >= 100/2)
	{
		//Timer nicht zu 50% abgelaufen (d.h. aktiv und Botschaft nicht mit halber Zykluszeit empfangen)
		//außer bei spontan
		@sysvar::CH_Nodes::CH__PDURECEIPT_RECEIVE_SDTR_RDU_Stat1_AR = 4;
	}
	else
	{
		//Timer zu 50% abgelaufen (d.h. Botschaft mit mindestens halber Zykluszeit empfangen)
		@sysvar::CH_Nodes::CH__PDURECEIPT_RECEIVE_SDTR_RDU_Stat1_AR = 3;
	}
	//Timer auf Zykluszeit setzen
	setTimer(Timer_SDTRRDU_Stat1_AR_ReceiptPDU, 100);

	output(this);
}
/*@@end*/
/*@@frPDU:MsgChannel1.CHASSIS::SpringVlv_Stat_AR:*/
on frPDU MsgChannel1.CHASSIS::ROE_MMR_F1
{
	if (TimeToElapse(Timer_RDUROE_MMR_F1_ReceiptPDU) >= 5/2)
	{
		//Timer nicht zu 50% abgelaufen (d.h. aktiv und Botschaft nicht mit halber Zykluszeit empfangen)
		//außer bei spontan
	}
	else
	{
		//Timer zu 50% abgelaufen (d.h. Botschaft mit mindestens halber Zykluszeit empfangen)
		@sysvar::CH_Nodes::CH__PDURECEIPT_RECEIVE_RDU_ROE_MMR_F1 = 3;
	}
	//Timer auf Zykluszeit setzen
	setTimer(Timer_RDUROE_MMR_F1_ReceiptPDU, 5);

	output(this);
}
/*@@end*/
/*@@frPDU:MsgChannel1.CHASSIS::SpringVlv_Stat_AR:*/
on frPDU MsgChannel1.CHASSIS::ROE_MMR_F4
{
	if (TimeToElapse(Timer_RDUROE_MMR_F4_ReceiptPDU) >= 5/2)
	{
		//Timer nicht zu 50% abgelaufen (d.h. aktiv und Botschaft nicht mit halber Zykluszeit empfangen)
		//außer bei spontan
	}
	else
	{
		//Timer zu 50% abgelaufen (d.h. Botschaft mit mindestens halber Zykluszeit empfangen)
		@sysvar::CH_Nodes::CH__PDURECEIPT_RECEIVE_RDU_ROE_MMR_F4 = 3;
	}
	//Timer auf Zykluszeit setzen
	setTimer(Timer_RDUROE_MMR_F4_ReceiptPDU, 5);

	output(this);
}
/*@@end*/
/*@@frPDU:MsgChannel1.CHASSIS::SpringVlv_Stat_AR:*/
on frPDU MsgChannel1.CHASSIS::ROE_MMR_RM
{
	if (TimeToElapse(Timer_RDUROE_MMR_RM_ReceiptPDU) >= 5/2)
	{
		//Timer nicht zu 50% abgelaufen (d.h. aktiv und Botschaft nicht mit halber Zykluszeit empfangen)
		//außer bei spontan
	}
	else
	{
		//Timer zu 50% abgelaufen (d.h. Botschaft mit mindestens halber Zykluszeit empfangen)
		@sysvar::CH_Nodes::CH__PDURECEIPT_RECEIVE_RDU_ROE_MMR_RM = 3;
	}
	//Timer auf Zykluszeit setzen
	setTimer(Timer_RDUROE_MMR_RM_ReceiptPDU, 5);

	output(this);
}
/*@@end*/
/*@@frPDU:MsgChannel1.CHASSIS::SpringVlv_Stat_AR:*/
on frPDU MsgChannel1.CHASSIS::ROE_MMR_RS
{
	if (TimeToElapse(Timer_RDUROE_MMR_RS_ReceiptPDU) >= 5/2)
	{
		//Timer nicht zu 50% abgelaufen (d.h. aktiv und Botschaft nicht mit halber Zykluszeit empfangen)
		//außer bei spontan
	}
	else
	{
		//Timer zu 50% abgelaufen (d.h. Botschaft mit mindestens halber Zykluszeit empfangen)
		@sysvar::CH_Nodes::CH__PDURECEIPT_RECEIVE_RDU_ROE_MMR_RS = 3;
	}
	//Timer auf Zykluszeit setzen
	setTimer(Timer_RDUROE_MMR_RS_ReceiptPDU, 5);

	output(this);
}
/*@@end*/
/*@@frPDU:MsgChannel1.CHASSIS::SpringVlv_Stat_AR:*/
on frPDU MsgChannel1.CHASSIS::SCS_Stat1_RDU_AR2
{
	if (TimeToElapse(Timer_RDUSCS_Stat1_RDU_AR2_ReceiptPDU) >= 20/2)
	{
		//Timer nicht zu 50% abgelaufen (d.h. aktiv und Botschaft nicht mit halber Zykluszeit empfangen)
		//außer bei spontan
		@sysvar::CH_Nodes::CH__PDURECEIPT_RECEIVE_RDU_SCS_Stat1_RDU_AR2 = 4;
	}
	else
	{
		//Timer zu 50% abgelaufen (d.h. Botschaft mit mindestens halber Zykluszeit empfangen)
		@sysvar::CH_Nodes::CH__PDURECEIPT_RECEIVE_RDU_SCS_Stat1_RDU_AR2 = 3;
	}
	//Timer auf Zykluszeit setzen
	setTimer(Timer_RDUSCS_Stat1_RDU_AR2_ReceiptPDU, 20);

	output(this);
}
/*@@end*/
/*@@frPDU:MsgChannel1.CHASSIS::SpringVlv_Stat_AR:*/
on frPDU MsgChannel1.CHASSIS::SCS_Stat2_RDU_AR2
{
	if (TimeToElapse(Timer_RDUSCS_Stat2_RDU_AR2_ReceiptPDU) >= 20/2)
	{
		//Timer nicht zu 50% abgelaufen (d.h. aktiv und Botschaft nicht mit halber Zykluszeit empfangen)
		//außer bei spontan
		@sysvar::CH_Nodes::CH__PDURECEIPT_RECEIVE_RDU_SCS_Stat2_RDU_AR2 = 4;
	}
	else
	{
		//Timer zu 50% abgelaufen (d.h. Botschaft mit mindestens halber Zykluszeit empfangen)
		@sysvar::CH_Nodes::CH__PDURECEIPT_RECEIVE_RDU_SCS_Stat2_RDU_AR2 = 3;
	}
	//Timer auf Zykluszeit setzen
	setTimer(Timer_RDUSCS_Stat2_RDU_AR2_ReceiptPDU, 20);

	output(this);
}
/*@@end*/
/*@@frPDU:MsgChannel1.CHASSIS::SpringVlv_Stat_AR:*/
on frPDU MsgChannel1.CHASSIS::Veh_Stat_RDU_FR2
{
	if (TimeToElapse(Timer_RDUVeh_Stat_RDU_FR2_ReceiptPDU) >= 320/2)
	{
		//Timer nicht zu 50% abgelaufen (d.h. aktiv und Botschaft nicht mit halber Zykluszeit empfangen)
		//außer bei spontan
		@sysvar::CH_Nodes::CH__PDURECEIPT_RECEIVE_RDU_Veh_Stat_RDU_FR2 = 4;
	}
	else
	{
		//Timer zu 50% abgelaufen (d.h. Botschaft mit mindestens halber Zykluszeit empfangen)
		@sysvar::CH_Nodes::CH__PDURECEIPT_RECEIVE_RDU_Veh_Stat_RDU_FR2 = 3;
	}
	//Timer auf Zykluszeit setzen
	setTimer(Timer_RDUVeh_Stat_RDU_FR2_ReceiptPDU, 320);

	output(this);
}
/*@@end*/
/*@@frPDU:MsgChannel1.CHASSIS::SpringVlv_Stat_AR:*/
on frPDU MsgChannel1.CHASSIS::LDC_Rq_StWhl_AR2
{
	if (TimeToElapse(Timer_SCCMLDC_Rq_StWhl_AR2_ReceiptPDU) >= 200/2)
	{
		//Timer nicht zu 50% abgelaufen (d.h. aktiv und Botschaft nicht mit halber Zykluszeit empfangen)
		//außer bei spontan
		@sysvar::CH_Nodes::CH__PDURECEIPT_RECEIVE_SCCM_LDC_Rq_StWhl_AR2 = 4;
	}
	else
	{
		//Timer zu 50% abgelaufen (d.h. Botschaft mit mindestens halber Zykluszeit empfangen)
		@sysvar::CH_Nodes::CH__PDURECEIPT_RECEIVE_SCCM_LDC_Rq_StWhl_AR2 = 3;
	}
	//Timer auf Zykluszeit setzen
	setTimer(Timer_SCCMLDC_Rq_StWhl_AR2_ReceiptPDU, 200);

	output(this);
}
/*@@end*/
/*@@frPDU:MsgChannel1.CHASSIS::SpringVlv_Stat_AR:*/
on frPDU MsgChannel1.CHASSIS::LDC_SBW_Rq_SCCM_AR2
{
	if (TimeToElapse(Timer_SCCMLDC_SBW_Rq_SCCM_AR2_ReceiptPDU) >= 200/2)
	{
		//Timer nicht zu 50% abgelaufen (d.h. aktiv und Botschaft nicht mit halber Zykluszeit empfangen)
		//außer bei spontan
		@sysvar::CH_Nodes::CH__PDURECEIPT_RECEIVE_SCCM_LDC_SBW_Rq_SCCM_AR2 = 4;
	}
	else
	{
		//Timer zu 50% abgelaufen (d.h. Botschaft mit mindestens halber Zykluszeit empfangen)
		@sysvar::CH_Nodes::CH__PDURECEIPT_RECEIVE_SCCM_LDC_SBW_Rq_SCCM_AR2 = 3;
	}
	//Timer auf Zykluszeit setzen
	setTimer(Timer_SCCMLDC_SBW_Rq_SCCM_AR2_ReceiptPDU, 200);

	output(this);
}
/*@@end*/
/*@@frPDU:MsgChannel1.CHASSIS::SpringVlv_Stat_AR:*/
on frPDU MsgChannel1.CHASSIS::ROE_SCCM
{
	if (TimeToElapse(Timer_SCCMROE_SCCM_ReceiptPDU) >= 5/2)
	{
		//Timer nicht zu 50% abgelaufen (d.h. aktiv und Botschaft nicht mit halber Zykluszeit empfangen)
		//außer bei spontan
	}
	else
	{
		//Timer zu 50% abgelaufen (d.h. Botschaft mit mindestens halber Zykluszeit empfangen)
		@sysvar::CH_Nodes::CH__PDURECEIPT_RECEIVE_SCCM_ROE_SCCM = 3;
	}
	//Timer auf Zykluszeit setzen
	setTimer(Timer_SCCMROE_SCCM_ReceiptPDU, 5);

	output(this);
}
/*@@end*/
/*@@frPDU:MsgChannel1.CHASSIS::SpringVlv_Stat_AR:*/
on frPDU MsgChannel1.CHASSIS::ROE_SWSP
{
	if (TimeToElapse(Timer_SCCMROE_SWSP_ReceiptPDU) >= 5/2)
	{
		//Timer nicht zu 50% abgelaufen (d.h. aktiv und Botschaft nicht mit halber Zykluszeit empfangen)
		//außer bei spontan
	}
	else
	{
		//Timer zu 50% abgelaufen (d.h. Botschaft mit mindestens halber Zykluszeit empfangen)
		@sysvar::CH_Nodes::CH__PDURECEIPT_RECEIVE_SCCM_ROE_SWSP = 3;
	}
	//Timer auf Zykluszeit setzen
	setTimer(Timer_SCCMROE_SWSP_ReceiptPDU, 5);

	output(this);
}
/*@@end*/
/*@@frPDU:MsgChannel1.CHASSIS::SpringVlv_Stat_AR:*/
on frPDU MsgChannel1.CHASSIS::SCCM_Sw_Stat_AR2
{
	if (TimeToElapse(Timer_SCCMSCCM_Sw_Stat_AR2_ReceiptPDU) >= 100/2)
	{
		//Timer nicht zu 50% abgelaufen (d.h. aktiv und Botschaft nicht mit halber Zykluszeit empfangen)
		//außer bei spontan
		@sysvar::CH_Nodes::CH__PDURECEIPT_RECEIVE_SCCM_SCCM_Sw_Stat_AR2 = 4;
	}
	else
	{
		//Timer zu 50% abgelaufen (d.h. Botschaft mit mindestens halber Zykluszeit empfangen)
		@sysvar::CH_Nodes::CH__PDURECEIPT_RECEIVE_SCCM_SCCM_Sw_Stat_AR2 = 3;
	}
	//Timer auf Zykluszeit setzen
	setTimer(Timer_SCCMSCCM_Sw_Stat_AR2_ReceiptPDU, 100);

	output(this);
}
/*@@end*/
/*@@frPDU:MsgChannel1.CHASSIS::SpringVlv_Stat_AR:*/
on frPDU MsgChannel1.CHASSIS::StWhl_Angl_Stat_AR2
{
	if (TimeToElapse(Timer_SCCMStWhl_Angl_Stat_AR2_ReceiptPDU) >= 10/2)
	{
		//Timer nicht zu 50% abgelaufen (d.h. aktiv und Botschaft nicht mit halber Zykluszeit empfangen)
		//außer bei spontan
		@sysvar::CH_Nodes::CH__PDURECEIPT_RECEIVE_SCCM_StWhl_Angl_Stat_AR2 = 4;
	}
	else
	{
		//Timer zu 50% abgelaufen (d.h. Botschaft mit mindestens halber Zykluszeit empfangen)
		@sysvar::CH_Nodes::CH__PDURECEIPT_RECEIVE_SCCM_StWhl_Angl_Stat_AR2 = 3;
	}
	//Timer auf Zykluszeit setzen
	setTimer(Timer_SCCMStWhl_Angl_Stat_AR2_ReceiptPDU, 10);

	output(this);
}
/*@@end*/
/*@@frPDU:MsgChannel1.CHASSIS::SpringVlv_Stat_AR:*/
on frPDU MsgChannel1.CHASSIS::StWhl_OFN_Stat_AR2
{
	if (TimeToElapse(Timer_SCCMStWhl_OFN_Stat_AR2_ReceiptPDU) >= 100/2)
	{
		//Timer nicht zu 50% abgelaufen (d.h. aktiv und Botschaft nicht mit halber Zykluszeit empfangen)
		//außer bei spontan
		@sysvar::CH_Nodes::CH__PDURECEIPT_RECEIVE_SCCM_StWhl_OFN_Stat_AR2 = 4;
	}
	else
	{
		//Timer zu 50% abgelaufen (d.h. Botschaft mit mindestens halber Zykluszeit empfangen)
		@sysvar::CH_Nodes::CH__PDURECEIPT_RECEIVE_SCCM_StWhl_OFN_Stat_AR2 = 3;
	}
	//Timer auf Zykluszeit setzen
	setTimer(Timer_SCCMStWhl_OFN_Stat_AR2_ReceiptPDU, 100);

	output(this);
}
/*@@end*/
/*@@frPDU:MsgChannel1.CHASSIS::SpringVlv_Stat_AR:*/
on frPDU MsgChannel1.CHASSIS::StWhl_Sw_Stat_AR2
{
	if (TimeToElapse(Timer_SCCMStWhl_Sw_Stat_AR2_ReceiptPDU) >= 100/2)
	{
		//Timer nicht zu 50% abgelaufen (d.h. aktiv und Botschaft nicht mit halber Zykluszeit empfangen)
		//außer bei spontan
		@sysvar::CH_Nodes::CH__PDURECEIPT_RECEIVE_SCCM_StWhl_Sw_Stat_AR2 = 4;
	}
	else
	{
		//Timer zu 50% abgelaufen (d.h. Botschaft mit mindestens halber Zykluszeit empfangen)
		@sysvar::CH_Nodes::CH__PDURECEIPT_RECEIVE_SCCM_StWhl_Sw_Stat_AR2 = 3;
	}
	//Timer auf Zykluszeit setzen
	setTimer(Timer_SCCMStWhl_Sw_Stat_AR2_ReceiptPDU, 100);

	output(this);
}
/*@@end*/
/*@@frPDU:MsgChannel1.CHASSIS::SpringVlv_Stat_AR:*/
on frPDU MsgChannel1.CHASSIS::WUDOP_SCCM_FR
{
	if (TimeToElapse(Timer_SCCMWUDOP_SCCM_FR_ReceiptPDU) >= 320/2)
	{
		//Timer nicht zu 50% abgelaufen (d.h. aktiv und Botschaft nicht mit halber Zykluszeit empfangen)
		//außer bei spontan
		@sysvar::CH_Nodes::CH__PDURECEIPT_RECEIVE_SCCM_WUDOP_SCCM_FR = 4;
	}
	else
	{
		//Timer zu 50% abgelaufen (d.h. Botschaft mit mindestens halber Zykluszeit empfangen)
		@sysvar::CH_Nodes::CH__PDURECEIPT_RECEIVE_SCCM_WUDOP_SCCM_FR = 3;
	}
	//Timer auf Zykluszeit setzen
	setTimer(Timer_SCCMWUDOP_SCCM_FR_ReceiptPDU, 320);

	output(this);
}
/*@@end*/
/*@@frPDU:MsgChannel1.CHASSIS::SpringVlv_Stat_AR:*/
on frPDU MsgChannel1.CHASSIS::Eng_Rq_ABC_AR2
{
	if (TimeToElapse(Timer_SPCEng_Rq_ABC_AR2_ReceiptPDU) >= 20/2)
	{
		//Timer nicht zu 50% abgelaufen (d.h. aktiv und Botschaft nicht mit halber Zykluszeit empfangen)
		//außer bei spontan
		@sysvar::CH_Nodes::CH__PDURECEIPT_RECEIVE_SPC_Eng_Rq_ABC_AR2 = 4;
	}
	else
	{
		//Timer zu 50% abgelaufen (d.h. Botschaft mit mindestens halber Zykluszeit empfangen)
		@sysvar::CH_Nodes::CH__PDURECEIPT_RECEIVE_SPC_Eng_Rq_ABC_AR2 = 3;
	}
	//Timer auf Zykluszeit setzen
	setTimer(Timer_SPCEng_Rq_ABC_AR2_ReceiptPDU, 20);

	output(this);
}
/*@@end*/
/*@@frPDU:MsgChannel1.CHASSIS::SpringVlv_Stat_AR:*/
on frPDU MsgChannel1.CHASSIS::OffRoad_Disp_Rq_AR
{
	if (TimeToElapse(Timer_SPCOffRoad_Disp_Rq_AR_ReceiptPDU) >= 100/2)
	{
		//Timer nicht zu 50% abgelaufen (d.h. aktiv und Botschaft nicht mit halber Zykluszeit empfangen)
		//außer bei spontan
		@sysvar::CH_Nodes::CH__PDURECEIPT_RECEIVE_SPC_OffRoad_Disp_Rq_AR = 4;
	}
	else
	{
		//Timer zu 50% abgelaufen (d.h. Botschaft mit mindestens halber Zykluszeit empfangen)
		@sysvar::CH_Nodes::CH__PDURECEIPT_RECEIVE_SPC_OffRoad_Disp_Rq_AR = 3;
	}
	//Timer auf Zykluszeit setzen
	setTimer(Timer_SPCOffRoad_Disp_Rq_AR_ReceiptPDU, 100);

	output(this);
}
/*@@end*/
/*@@frPDU:MsgChannel1.CHASSIS::SpringVlv_Stat_AR:*/
on frPDU MsgChannel1.CHASSIS::Preview_Data_SPC_AR
{
	if (TimeToElapse(Timer_SPCPreview_Data_SPC_AR_ReceiptPDU) >= 20/2)
	{
		//Timer nicht zu 50% abgelaufen (d.h. aktiv und Botschaft nicht mit halber Zykluszeit empfangen)
		//außer bei spontan
		@sysvar::CH_Nodes::CH__PDURECEIPT_RECEIVE_SPC_Preview_Data_SPC_AR = 4;
	}
	else
	{
		//Timer zu 50% abgelaufen (d.h. Botschaft mit mindestens halber Zykluszeit empfangen)
		@sysvar::CH_Nodes::CH__PDURECEIPT_RECEIVE_SPC_Preview_Data_SPC_AR = 3;
	}
	//Timer auf Zykluszeit setzen
	setTimer(Timer_SPCPreview_Data_SPC_AR_ReceiptPDU, 20);

	output(this);
}
/*@@end*/
/*@@frPDU:MsgChannel1.CHASSIS::SpringVlv_Stat_AR:*/
on frPDU MsgChannel1.CHASSIS::ROE_MPU_FL
{
	if (TimeToElapse(Timer_SPCROE_MPU_FL_ReceiptPDU) >= 5/2)
	{
		//Timer nicht zu 50% abgelaufen (d.h. aktiv und Botschaft nicht mit halber Zykluszeit empfangen)
		//außer bei spontan
	}
	else
	{
		//Timer zu 50% abgelaufen (d.h. Botschaft mit mindestens halber Zykluszeit empfangen)
		@sysvar::CH_Nodes::CH__PDURECEIPT_RECEIVE_SPC_ROE_MPU_FL = 3;
	}
	//Timer auf Zykluszeit setzen
	setTimer(Timer_SPCROE_MPU_FL_ReceiptPDU, 5);

	output(this);
}
/*@@end*/
/*@@frPDU:MsgChannel1.CHASSIS::SpringVlv_Stat_AR:*/
on frPDU MsgChannel1.CHASSIS::ROE_MPU_FR
{
	if (TimeToElapse(Timer_SPCROE_MPU_FR_ReceiptPDU) >= 5/2)
	{
		//Timer nicht zu 50% abgelaufen (d.h. aktiv und Botschaft nicht mit halber Zykluszeit empfangen)
		//außer bei spontan
	}
	else
	{
		//Timer zu 50% abgelaufen (d.h. Botschaft mit mindestens halber Zykluszeit empfangen)
		@sysvar::CH_Nodes::CH__PDURECEIPT_RECEIVE_SPC_ROE_MPU_FR = 3;
	}
	//Timer auf Zykluszeit setzen
	setTimer(Timer_SPCROE_MPU_FR_ReceiptPDU, 5);

	output(this);
}
/*@@end*/
/*@@frPDU:MsgChannel1.CHASSIS::SpringVlv_Stat_AR:*/
on frPDU MsgChannel1.CHASSIS::ROE_MPU_RL
{
	if (TimeToElapse(Timer_SPCROE_MPU_RL_ReceiptPDU) >= 5/2)
	{
		//Timer nicht zu 50% abgelaufen (d.h. aktiv und Botschaft nicht mit halber Zykluszeit empfangen)
		//außer bei spontan
	}
	else
	{
		//Timer zu 50% abgelaufen (d.h. Botschaft mit mindestens halber Zykluszeit empfangen)
		@sysvar::CH_Nodes::CH__PDURECEIPT_RECEIVE_SPC_ROE_MPU_RL = 3;
	}
	//Timer auf Zykluszeit setzen
	setTimer(Timer_SPCROE_MPU_RL_ReceiptPDU, 5);

	output(this);
}
/*@@end*/
/*@@frPDU:MsgChannel1.CHASSIS::SpringVlv_Stat_AR:*/
on frPDU MsgChannel1.CHASSIS::ROE_MPU_RR
{
	if (TimeToElapse(Timer_SPCROE_MPU_RR_ReceiptPDU) >= 5/2)
	{
		//Timer nicht zu 50% abgelaufen (d.h. aktiv und Botschaft nicht mit halber Zykluszeit empfangen)
		//außer bei spontan
	}
	else
	{
		//Timer zu 50% abgelaufen (d.h. Botschaft mit mindestens halber Zykluszeit empfangen)
		@sysvar::CH_Nodes::CH__PDURECEIPT_RECEIVE_SPC_ROE_MPU_RR = 3;
	}
	//Timer auf Zykluszeit setzen
	setTimer(Timer_SPCROE_MPU_RR_ReceiptPDU, 5);

	output(this);
}
/*@@end*/
/*@@frPDU:MsgChannel1.CHASSIS::SpringVlv_Stat_AR:*/
on frPDU MsgChannel1.CHASSIS::ROE_SPC
{
	if (TimeToElapse(Timer_SPCROE_SPC_ReceiptPDU) >= 5/2)
	{
		//Timer nicht zu 50% abgelaufen (d.h. aktiv und Botschaft nicht mit halber Zykluszeit empfangen)
		//außer bei spontan
	}
	else
	{
		//Timer zu 50% abgelaufen (d.h. Botschaft mit mindestens halber Zykluszeit empfangen)
		@sysvar::CH_Nodes::CH__PDURECEIPT_RECEIVE_SPC_ROE_SPC = 3;
	}
	//Timer auf Zykluszeit setzen
	setTimer(Timer_SPCROE_SPC_ReceiptPDU, 5);

	output(this);
}
/*@@end*/
/*@@frPDU:MsgChannel1.CHASSIS::SpringVlv_Stat_AR:*/
on frPDU MsgChannel1.CHASSIS::SPC_Disp_Rq_AR
{
	if (TimeToElapse(Timer_SPCSPC_Disp_Rq_AR_ReceiptPDU) >= 200/2)
	{
		//Timer nicht zu 50% abgelaufen (d.h. aktiv und Botschaft nicht mit halber Zykluszeit empfangen)
		//außer bei spontan
		@sysvar::CH_Nodes::CH__PDURECEIPT_RECEIVE_SPC_SPC_Disp_Rq_AR = 4;
	}
	else
	{
		//Timer zu 50% abgelaufen (d.h. Botschaft mit mindestens halber Zykluszeit empfangen)
		@sysvar::CH_Nodes::CH__PDURECEIPT_RECEIVE_SPC_SPC_Disp_Rq_AR = 3;
	}
	//Timer auf Zykluszeit setzen
	setTimer(Timer_SPCSPC_Disp_Rq_AR_ReceiptPDU, 200);

	output(this);
}
/*@@end*/
/*@@frPDU:MsgChannel1.CHASSIS::SpringVlv_Stat_AR:*/
on frPDU MsgChannel1.CHASSIS::SPC_SwLED_Msg_Rq_AR2
{
	if (TimeToElapse(Timer_SPCSPC_SwLED_Msg_Rq_AR2_ReceiptPDU) >= 200/2)
	{
		//Timer nicht zu 50% abgelaufen (d.h. aktiv und Botschaft nicht mit halber Zykluszeit empfangen)
		//außer bei spontan
		@sysvar::CH_Nodes::CH__PDURECEIPT_RECEIVE_SPC_SPC_SwLED_Msg_Rq_AR2 = 4;
	}
	else
	{
		//Timer zu 50% abgelaufen (d.h. Botschaft mit mindestens halber Zykluszeit empfangen)
		@sysvar::CH_Nodes::CH__PDURECEIPT_RECEIVE_SPC_SPC_SwLED_Msg_Rq_AR2 = 3;
	}
	//Timer auf Zykluszeit setzen
	setTimer(Timer_SPCSPC_SwLED_Msg_Rq_AR2_ReceiptPDU, 200);

	output(this);
}
/*@@end*/
/*@@frPDU:MsgChannel1.CHASSIS::SpringVlv_Stat_AR:*/
on frPDU MsgChannel1.CHASSIS::SpringVlv_Rq_AR
{
	if (TimeToElapse(Timer_SPCSpringVlv_Rq_AR_ReceiptPDU) >= 10/2)
	{
		//Timer nicht zu 50% abgelaufen (d.h. aktiv und Botschaft nicht mit halber Zykluszeit empfangen)
		//außer bei spontan
		@sysvar::CH_Nodes::CH__PDURECEIPT_RECEIVE_SPC_SpringVlv_Rq_AR = 4;
	}
	else
	{
		//Timer zu 50% abgelaufen (d.h. Botschaft mit mindestens halber Zykluszeit empfangen)
		@sysvar::CH_Nodes::CH__PDURECEIPT_RECEIVE_SPC_SpringVlv_Rq_AR = 3;
	}
	//Timer auf Zykluszeit setzen
	setTimer(Timer_SPCSpringVlv_Rq_AR_ReceiptPDU, 10);

	output(this);
}
/*@@end*/
/*@@frPDU:MsgChannel1.CHASSIS::SpringVlv_Stat_AR:*/
on frPDU MsgChannel1.CHASSIS::VehCarv_Stat_AR
{
	if (TimeToElapse(Timer_SPCVehCarv_Stat_AR_ReceiptPDU) >= 20/2)
	{
		//Timer nicht zu 50% abgelaufen (d.h. aktiv und Botschaft nicht mit halber Zykluszeit empfangen)
		//außer bei spontan
		@sysvar::CH_Nodes::CH__PDURECEIPT_RECEIVE_SPC_VehCarv_Stat_AR = 4;
	}
	else
	{
		//Timer zu 50% abgelaufen (d.h. Botschaft mit mindestens halber Zykluszeit empfangen)
		@sysvar::CH_Nodes::CH__PDURECEIPT_RECEIVE_SPC_VehCarv_Stat_AR = 3;
	}
	//Timer auf Zykluszeit setzen
	setTimer(Timer_SPCVehCarv_Stat_AR_ReceiptPDU, 20);

	output(this);
}
/*@@end*/
/*@@frPDU:MsgChannel1.CHASSIS::SpringVlv_Stat_AR:*/
on frPDU MsgChannel1.CHASSIS::VehLvl_Stat_AR2
{
	if (TimeToElapse(Timer_SPCVehLvl_Stat_AR2_ReceiptPDU) >= 20/2)
	{
		//Timer nicht zu 50% abgelaufen (d.h. aktiv und Botschaft nicht mit halber Zykluszeit empfangen)
		//außer bei spontan
		@sysvar::CH_Nodes::CH__PDURECEIPT_RECEIVE_SPC_VehLvl_Stat_AR2 = 4;
	}
	else
	{
		//Timer zu 50% abgelaufen (d.h. Botschaft mit mindestens halber Zykluszeit empfangen)
		@sysvar::CH_Nodes::CH__PDURECEIPT_RECEIVE_SPC_VehLvl_Stat_AR2 = 3;
	}
	//Timer auf Zykluszeit setzen
	setTimer(Timer_SPCVehLvl_Stat_AR2_ReceiptPDU, 20);

	output(this);
}
/*@@end*/
/*@@frPDU:MsgChannel1.CHASSIS::SpringVlv_Stat_AR:*/
on frPDU MsgChannel1.CHASSIS::ROE_SPC_VX
{
	if (TimeToElapse(Timer_SPC_VXROE_SPC_VX_ReceiptPDU) >= 5/2)
	{
		//Timer nicht zu 50% abgelaufen (d.h. aktiv und Botschaft nicht mit halber Zykluszeit empfangen)
		//außer bei spontan
	}
	else
	{
		//Timer zu 50% abgelaufen (d.h. Botschaft mit mindestens halber Zykluszeit empfangen)
		@sysvar::CH_Nodes::CH__PDURECEIPT_RECEIVE_SPC_VX_ROE_SPC_VX = 3;
	}
	//Timer auf Zykluszeit setzen
	setTimer(Timer_SPC_VXROE_SPC_VX_ReceiptPDU, 5);

	output(this);
}
/*@@end*/
/*@@frPDU:MsgChannel1.CHASSIS::SpringVlv_Stat_AR:*/
on frPDU MsgChannel1.CHASSIS::SPC_VX_Stat1_AR
{
	if (TimeToElapse(Timer_SPC_VXSPC_VX_Stat1_AR_ReceiptPDU) >= 200/2)
	{
		//Timer nicht zu 50% abgelaufen (d.h. aktiv und Botschaft nicht mit halber Zykluszeit empfangen)
		//außer bei spontan
		@sysvar::CH_Nodes::CH__PDURECEIPT_RECEIVE_SPC_VX_SPC_VX_Stat1_AR = 4;
	}
	else
	{
		//Timer zu 50% abgelaufen (d.h. Botschaft mit mindestens halber Zykluszeit empfangen)
		@sysvar::CH_Nodes::CH__PDURECEIPT_RECEIVE_SPC_VX_SPC_VX_Stat1_AR = 3;
	}
	//Timer auf Zykluszeit setzen
	setTimer(Timer_SPC_VXSPC_VX_Stat1_AR_ReceiptPDU, 200);

	output(this);
}
/*@@end*/
/*@@frPDU:MsgChannel1.CHASSIS::SpringVlv_Stat_AR:*/
on frPDU MsgChannel1.CHASSIS::SpringVlv_Stat_AR
{
	if (TimeToElapse(Timer_SPC_VXSpringVlv_Stat_AR_ReceiptPDU) >= 20/2)
	{
		//Timer nicht zu 50% abgelaufen (d.h. aktiv und Botschaft nicht mit halber Zykluszeit empfangen)
		//außer bei spontan
		@sysvar::CH_Nodes::CH__PDURECEIPT_RECEIVE_SPC_VX_SpringVlv_Stat_AR = 4;
	}
	else
	{
		//Timer zu 50% abgelaufen (d.h. Botschaft mit mindestens halber Zykluszeit empfangen)
		@sysvar::CH_Nodes::CH__PDURECEIPT_RECEIVE_SPC_VX_SpringVlv_Stat_AR = 3;
	}
	//Timer auf Zykluszeit setzen
	setTimer(Timer_SPC_VXSpringVlv_Stat_AR_ReceiptPDU, 20);

	output(this);
}
/*@@end*/

/*@@frFrame:*:*/
on frFrame *
{
	//Damit auch FlexRay-Frames durch diesen Knoten kommen. Ohne diese Funktion wirkt der Knoten wie ein Filter für FlexRay-Frames.
	output(this);
}

/*@@frPDU:*:*/
on frPDU *
{
	output(this);
}
/*@@end*/

on linMessage *
{
	//Keeps LIN messages passing through.
	output(this);
}

/*@@msg:*:*/
on message *
{
	//Damit auch CAN-Botschaften durch diesen Knoten kommen. Ohne diese Funktion wirkt der Knoten wie ein Filter für CAN-PDUs.
	output(this);
}
/*@@end*/

/*@@sysvarChange:CH_Nodes::CH_STOPP_PDUS_ON:*/
on sysvar sysvar::CH_Nodes::CH_STOPP_PDUS_ON
{
	if (@this)
  	{
  		@sysvar::CH_Nodes::CH__STPDU_AWD_TCASE_AWD_TCASE_Disp_Rq_AR2 = 0;
  		@sysvar::CH_Nodes::CH__STPDU_AWD_TCASE_AWD_TCASE_Stat1_AR2 = 0;
  		@sysvar::CH_Nodes::CH__STPDU_AWD_TCASE_AWD_TCASE_Stat2_AR2 = 0;
  		@sysvar::CH_Nodes::CH__STPDU_AWD_TCASE_ROE_AWD_TCASE = 0;
  		@sysvar::CH_Nodes::CH__STPDU_CPC_Adblue_Disp_Rq_AR = 0;
  		@sysvar::CH_Nodes::CH__STPDU_CPC_Adblue_Disp_Warn_Rq_AR = 0;
  		@sysvar::CH_Nodes::CH__STPDU_CPC_Assyst_Stat2_AR = 0;
  		@sysvar::CH_Nodes::CH__STPDU_CPC_Assyst_Stat3_AR2 = 0;
  		@sysvar::CH_Nodes::CH__STPDU_CPC_Assyst_Stat_AR = 0;
  		@sysvar::CH_Nodes::CH__STPDU_CPC_CNG_Disp_Rq_AR2 = 0;
  		@sysvar::CH_Nodes::CH__STPDU_CPC_CPC_CHASSIS_R1_AR2 = 0;
  		@sysvar::CH_Nodes::CH__STPDU_CPC_CPC_CHASSIS_R2_AR2 = 0;
  		@sysvar::CH_Nodes::CH__STPDU_CPC_DCDC1_Rs1_AR2 = 0;
  		@sysvar::CH_Nodes::CH__STPDU_CPC_DPC_PT_Rs_AR = 0;
  		@sysvar::CH_Nodes::CH__STPDU_CPC_ECM_DAC4_AR = 0;
  		@sysvar::CH_Nodes::CH__STPDU_CPC_ECO_Homepage_Data = 0;
  		@sysvar::CH_Nodes::CH__STPDU_CPC_ECO_Score_Disp_Rq_AR = 0;
  		@sysvar::CH_Nodes::CH__STPDU_CPC_EM01_Stat1_AR2 = 0;
  		@sysvar::CH_Nodes::CH__STPDU_CPC_EM01_Stat2_AR2 = 0;
  		@sysvar::CH_Nodes::CH__STPDU_CPC_EM01_Trq_Rs_AR2 = 0;
  		@sysvar::CH_Nodes::CH__STPDU_CPC_EM_DAC4_AR = 0;
  		@sysvar::CH_Nodes::CH__STPDU_CPC_EMM_Data1_AR2 = 0;
  		@sysvar::CH_Nodes::CH__STPDU_CPC_EnergyMngmnt_PreCond_Stat_AR2 = 0;
  		@sysvar::CH_Nodes::CH__STPDU_CPC_Eng_Rs_1_AR2 = 0;
  		@sysvar::CH_Nodes::CH__STPDU_CPC_Eng_Rs_2_AR2 = 0;
  		@sysvar::CH_Nodes::CH__STPDU_CPC_Eng_Rs_3_AR2 = 0;
  		@sysvar::CH_Nodes::CH__STPDU_CPC_Eng_Rs_EM_AR2 = 0;
  		@sysvar::CH_Nodes::CH__STPDU_CPC_Eng_Rs_EngCtrl_AR2 = 0;
  		@sysvar::CH_Nodes::CH__STPDU_CPC_EngCtrl_Disp_Rq_AR2 = 0;
  		@sysvar::CH_Nodes::CH__STPDU_CPC_EngCtrl_OBD1_AR = 0;
  		@sysvar::CH_Nodes::CH__STPDU_CPC_EngCtrl_Stat_AR2 = 0;
  		@sysvar::CH_Nodes::CH__STPDU_CPC_ESP_OBD_Data_AR = 0;
  		@sysvar::CH_Nodes::CH__STPDU_CPC_Fuel_Stat2_AR2 = 0;
  		@sysvar::CH_Nodes::CH__STPDU_CPC_FuelLvl_Stat_AR2 = 0;
  		@sysvar::CH_Nodes::CH__STPDU_CPC_HumanMachineIfc_AR2 = 0;
  		@sysvar::CH_Nodes::CH__STPDU_CPC_HumanMachineIfc_Rq_AR = 0;
  		@sysvar::CH_Nodes::CH__STPDU_CPC_ISM_DAC4_AR = 0;
  		@sysvar::CH_Nodes::CH__STPDU_CPC_OBL_DC_Output_AR = 0;
  		@sysvar::CH_Nodes::CH__STPDU_CPC_PARK_Drv_Rs_TCM_AR2 = 0;
  		@sysvar::CH_Nodes::CH__STPDU_CPC_PN14_Gen_Rs_AR = 0;
  		@sysvar::CH_Nodes::CH__STPDU_CPC_PNHV_BMS_Stat_AR2 = 0;
  		@sysvar::CH_Nodes::CH__STPDU_CPC_PNHV_EnergyMngmnt_Disp_Rq_AR = 0;
  		@sysvar::CH_Nodes::CH__STPDU_CPC_PNHV_EnergyMngmnt_Stat2_AR2 = 0;
  		@sysvar::CH_Nodes::CH__STPDU_CPC_PNHV_EnergyMngmnt_Stat3_AR2 = 0;
  		@sysvar::CH_Nodes::CH__STPDU_CPC_PNHV_EnergyMngmntSet_Rs1_AR2 = 0;
  		@sysvar::CH_Nodes::CH__STPDU_CPC_PNHV_EnergyMngmntSet_Rs2_AR = 0;
  		@sysvar::CH_Nodes::CH__STPDU_CPC_PNHV_Stat_AR2 = 0;
  		@sysvar::CH_Nodes::CH__STPDU_CPC_PNHV_WeekDepTmTbl_Stat_AR2 = 0;
  		@sysvar::CH_Nodes::CH__STPDU_CPC_PT_DataContain_Rq_AR2 = 0;
  		@sysvar::CH_Nodes::CH__STPDU_CPC_PT_Disp_Rq2_AR = 0;
  		@sysvar::CH_Nodes::CH__STPDU_CPC_PT_ThermM_AR2 = 0;
  		@sysvar::CH_Nodes::CH__STPDU_CPC_PT_ThermM_Rq_AR2 = 0;
  		@sysvar::CH_Nodes::CH__STPDU_CPC_PtHyb_Mngmnt_Rq1_AR = 0;
  		@sysvar::CH_Nodes::CH__STPDU_CPC_PtMngmnt_Disp_Rq_AR2 = 0;
  		@sysvar::CH_Nodes::CH__STPDU_CPC_PtMngmnt_Rq_AR2 = 0;
  		@sysvar::CH_Nodes::CH__STPDU_CPC_PtMngmnt_Stat2_AR2 = 0;
  		@sysvar::CH_Nodes::CH__STPDU_CPC_PtMngmnt_Stat_AR2 = 0;
  		@sysvar::CH_Nodes::CH__STPDU_CPC_SBW_DrvPosn_Disp_Rq_ISM_AR2 = 0;
  		@sysvar::CH_Nodes::CH__STPDU_CPC_SBW_DrvPosn_Disp_Rq_TCM_AR2 = 0;
  		@sysvar::CH_Nodes::CH__STPDU_CPC_SBW_Stat_AR2 = 0;
  		@sysvar::CH_Nodes::CH__STPDU_CPC_SND_GEN_Stat_AR = 0;
  		@sysvar::CH_Nodes::CH__STPDU_CPC_TC_Disp_Rq_ECM_AR = 0;
  		@sysvar::CH_Nodes::CH__STPDU_CPC_TC_EBBC_Disp_Rq_ECM_AR = 0;
  		@sysvar::CH_Nodes::CH__STPDU_CPC_TC_EEBBC_Disp_Rq_AR = 0;
  		@sysvar::CH_Nodes::CH__STPDU_CPC_TCM_DAC4_AR = 0;
  		@sysvar::CH_Nodes::CH__STPDU_CPC_TCM_Data2_AR2 = 0;
  		@sysvar::CH_Nodes::CH__STPDU_CPC_TCM_Data3_AR2 = 0;
  		@sysvar::CH_Nodes::CH__STPDU_CPC_TCM_Disp_Rq_AMG_AR = 0;
  		@sysvar::CH_Nodes::CH__STPDU_CPC_TCM_State3_AR2 = 0;
  		@sysvar::CH_Nodes::CH__STPDU_CPC_TCU_Disp_Rq_AR2 = 0;
  		@sysvar::CH_Nodes::CH__STPDU_CPC_ThermMngmnt_1_AR2 = 0;
  		@sysvar::CH_Nodes::CH__STPDU_CPC_ThermMngmnt_4_AR = 0;
  		@sysvar::CH_Nodes::CH__STPDU_CPC_ThermMngmnt_EV_1_AR2 = 0;
  		@sysvar::CH_Nodes::CH__STPDU_CPC_VehPwrMngmnt_EMM_Stat2_AR2 = 0;
  		@sysvar::CH_Nodes::CH__STPDU_CPC_VehPwrMngmnt_Rq_AR = 0;
  		@sysvar::CH_Nodes::CH__STPDU_CPC_WIA_EngTrq_AR = 0;
  		@sysvar::CH_Nodes::CH__STPDU_CPC_WPT_Stat2_AR2 = 0;
  		@sysvar::CH_Nodes::CH__STPDU_DRVU_DPC_Disp_Rq_AMG_AR2 = 0;
  		@sysvar::CH_Nodes::CH__STPDU_DRVU_DPC_IndMd_Stat_AMG_AR2 = 0;
  		@sysvar::CH_Nodes::CH__STPDU_DRVU_DPC_IndMd_Style2_AMG_AR2 = 0;
  		@sysvar::CH_Nodes::CH__STPDU_DRVU_DPC_IndMd_Style_AMG_AR2 = 0;
  		@sysvar::CH_Nodes::CH__STPDU_DRVU_DPC_Master_Rq_AMG_AR2 = 0;
  		@sysvar::CH_Nodes::CH__STPDU_DRVU_DRVU_Stat_AR = 0;
  		@sysvar::CH_Nodes::CH__STPDU_DRVU_ESP_EDIFF_Rs_AR = 0;
  		@sysvar::CH_Nodes::CH__STPDU_EIS_ActvComf_Rq_AR2 = 0;
  		@sysvar::CH_Nodes::CH__STPDU_EIS_ADAS_CURRENT_ATTRIBUTES_AR = 0;
  		@sysvar::CH_Nodes::CH__STPDU_EIS_ADAS_POSITION_AR = 0;
  		@sysvar::CH_Nodes::CH__STPDU_EIS_ADAS_PREDICTION_AR = 0;
  		@sysvar::CH_Nodes::CH__STPDU_EIS_ADAS_PROFILE_LONG_AR = 0;
  		@sysvar::CH_Nodes::CH__STPDU_EIS_ADAS_PROFILE_SHORT_AR = 0;
  		@sysvar::CH_Nodes::CH__STPDU_EIS_ADASLR_POSITION_AR = 0;
  		@sysvar::CH_Nodes::CH__STPDU_EIS_ADASLR_PROFILE_LONG_AR = 0;
  		@sysvar::CH_Nodes::CH__STPDU_EIS_Assyst_Rq_AR2 = 0;
  		@sysvar::CH_Nodes::CH__STPDU_EIS_BC_F_Disp_Rq_AR = 0;
  		@sysvar::CH_Nodes::CH__STPDU_EIS_BC_F_Stat1_AR = 0;
  		@sysvar::CH_Nodes::CH__STPDU_EIS_BC_F_Stat2_AR2 = 0;
  		@sysvar::CH_Nodes::CH__STPDU_EIS_BC_R_Stat1_AR = 0;
  		@sysvar::CH_Nodes::CH__STPDU_EIS_BLSM_Disp_Stat_AR = 0;
  		@sysvar::CH_Nodes::CH__STPDU_EIS_BODY_CHASSIS_R1_AR = 0;
  		@sysvar::CH_Nodes::CH__STPDU_EIS_BSM_Disp_Warn_Rq_AR2 = 0;
  		@sysvar::CH_Nodes::CH__STPDU_EIS_CamLane_Disp_Warn_Rq_AR2 = 0;
  		@sysvar::CH_Nodes::CH__STPDU_EIS_CamLane_LaneAttr1_AR2 = 0;
  		@sysvar::CH_Nodes::CH__STPDU_EIS_CamLane_LaneAttr2_AR2 = 0;
  		@sysvar::CH_Nodes::CH__STPDU_EIS_CamLane_LaneAttr3_AR2 = 0;
  		@sysvar::CH_Nodes::CH__STPDU_EIS_CamLane_LaneAttr6_AR2 = 0;
  		@sysvar::CH_Nodes::CH__STPDU_EIS_CamLane_LaneAttr7_AR2 = 0;
  		@sysvar::CH_Nodes::CH__STPDU_EIS_CLkS_Rq_AR = 0;
  		@sysvar::CH_Nodes::CH__STPDU_EIS_CLkS_State_AR = 0;
  		@sysvar::CH_Nodes::CH__STPDU_EIS_ClockSync_Stat_FR2 = 0;
  		@sysvar::CH_Nodes::CH__STPDU_EIS_CMS_PI_State_Gw_AR2 = 0;
  		@sysvar::CH_Nodes::CH__STPDU_EIS_Config_HU4_AR2 = 0;
  		@sysvar::CH_Nodes::CH__STPDU_EIS_Config_HU5_AR2 = 0;
  		@sysvar::CH_Nodes::CH__STPDU_EIS_CRCM_Stat_AR = 0;
  		@sysvar::CH_Nodes::CH__STPDU_EIS_CTRL_C_Stat1_AR = 0;
  		@sysvar::CH_Nodes::CH__STPDU_EIS_DAC4_ECM_AR = 0;
  		@sysvar::CH_Nodes::CH__STPDU_EIS_DAC4_EM2_AR = 0;
  		@sysvar::CH_Nodes::CH__STPDU_EIS_DAC4_ISM_AR = 0;
  		@sysvar::CH_Nodes::CH__STPDU_EIS_DAC4_TCM_AR = 0;
  		@sysvar::CH_Nodes::CH__STPDU_EIS_Dimming_Stat_AR2 = 0;
  		@sysvar::CH_Nodes::CH__STPDU_EIS_Door_FL_Stat_AR2 = 0;
  		@sysvar::CH_Nodes::CH__STPDU_EIS_Door_FR_Stat_AR2 = 0;
  		@sysvar::CH_Nodes::CH__STPDU_EIS_Door_RL_Stat_AR2 = 0;
  		@sysvar::CH_Nodes::CH__STPDU_EIS_Door_RR_Stat_AR2 = 0;
  		@sysvar::CH_Nodes::CH__STPDU_EIS_DPC_IndMd_Rq_AR = 0;
  		@sysvar::CH_Nodes::CH__STPDU_EIS_EAC_Stat_AR = 0;
  		@sysvar::CH_Nodes::CH__STPDU_EIS_EL_Stat_AR2 = 0;
  		@sysvar::CH_Nodes::CH__STPDU_EIS_EL_TurnInd_Rq_AR2 = 0;
  		@sysvar::CH_Nodes::CH__STPDU_EIS_EPKB_Stat_AR2 = 0;
  		@sysvar::CH_Nodes::CH__STPDU_EIS_EVC_CfgBit_01_32_AR2 = 0;
  		@sysvar::CH_Nodes::CH__STPDU_EIS_EVC_CfgBit_33_64_AR2 = 0;
  		@sysvar::CH_Nodes::CH__STPDU_EIS_EVC_CfgBit_65_96_AR2 = 0;
  		@sysvar::CH_Nodes::CH__STPDU_EIS_EVC_CfgBit_97_C8_AR2 = 0;
  		@sysvar::CH_Nodes::CH__STPDU_EIS_EVC_CfgList_01_0C_AR2 = 0;
  		@sysvar::CH_Nodes::CH__STPDU_EIS_FCW_Disp_Rq_AR = 0;
  		@sysvar::CH_Nodes::CH__STPDU_EIS_HMI_CHASSIS_R1_AR2 = 0;
  		@sysvar::CH_Nodes::CH__STPDU_EIS_HU_Comf_Rq_AR2 = 0;
  		@sysvar::CH_Nodes::CH__STPDU_EIS_HU_State_AR = 0;
  		@sysvar::CH_Nodes::CH__STPDU_EIS_HVAC_Disp_Stat1_AR = 0;
  		@sysvar::CH_Nodes::CH__STPDU_EIS_HVAC_OBD_DTC_AR = 0;
  		@sysvar::CH_Nodes::CH__STPDU_EIS_HVAC_Rs2_AR = 0;
  		@sysvar::CH_Nodes::CH__STPDU_EIS_HVAC_Rs3_AR2 = 0;
  		@sysvar::CH_Nodes::CH__STPDU_EIS_HVAC_Rs_AR2 = 0;
  		@sysvar::CH_Nodes::CH__STPDU_EIS_HVAC_State1_AR = 0;
  		@sysvar::CH_Nodes::CH__STPDU_EIS_IC_BasicInfo_AR2 = 0;
  		@sysvar::CH_Nodes::CH__STPDU_EIS_IC_DriveAssistSys_AR2 = 0;
  		@sysvar::CH_Nodes::CH__STPDU_EIS_IC_Settings_AR2 = 0;
  		@sysvar::CH_Nodes::CH__STPDU_EIS_ICH_Stat_AR = 0;
  		@sysvar::CH_Nodes::CH__STPDU_EIS_Ign_Veh_Stat_AR2 = 0;
  		@sysvar::CH_Nodes::CH__STPDU_EIS_IHC_Lgt_Stat_HLI_2_AR2 = 0;
  		@sysvar::CH_Nodes::CH__STPDU_EIS_IHC_Lgt_Stat_HLI_AR2 = 0;
  		@sysvar::CH_Nodes::CH__STPDU_EIS_KG_State_AR2 = 0;
  		@sysvar::CH_Nodes::CH__STPDU_EIS_LDC_Disp_Stat_IC_AR2 = 0;
  		@sysvar::CH_Nodes::CH__STPDU_EIS_LgtSens_State_AR = 0;
  		@sysvar::CH_Nodes::CH__STPDU_EIS_Mirr_Adj_Lt_Rq_AR = 0;
  		@sysvar::CH_Nodes::CH__STPDU_EIS_Mirr_Adj_Rt_Rq_AR = 0;
  		@sysvar::CH_Nodes::CH__STPDU_EIS_NAVI_Pos1_AR = 0;
  		@sysvar::CH_Nodes::CH__STPDU_EIS_NAVI_Pos2_AR = 0;
  		@sysvar::CH_Nodes::CH__STPDU_EIS_NAVI_Pos3_AR = 0;
  		@sysvar::CH_Nodes::CH__STPDU_EIS_NAVI_Pos4_AR = 0;
  		@sysvar::CH_Nodes::CH__STPDU_EIS_NAVI_Pos5_AR = 0;
  		@sysvar::CH_Nodes::CH__STPDU_EIS_NVP_Stat1_AR2 = 0;
  		@sysvar::CH_Nodes::CH__STPDU_EIS_OHCM_Stat_AR2 = 0;
  		@sysvar::CH_Nodes::CH__STPDU_EIS_ORC_Disp_Stat_AR2 = 0;
  		@sysvar::CH_Nodes::CH__STPDU_EIS_ORC_Impact_AR2 = 0;
  		@sysvar::CH_Nodes::CH__STPDU_EIS_Park_Disp_Rs_AR2 = 0;
  		@sysvar::CH_Nodes::CH__STPDU_EIS_PHB_IHC_Plus_Tunnel_3_4_AR2 = 0;
  		@sysvar::CH_Nodes::CH__STPDU_EIS_PHB_IHC_Plus_Tunnel_AR2 = 0;
  		@sysvar::CH_Nodes::CH__STPDU_EIS_PN14_Disp_Rq_AR = 0;
  		@sysvar::CH_Nodes::CH__STPDU_EIS_PN14_Rs1_AR2 = 0;
  		@sysvar::CH_Nodes::CH__STPDU_EIS_PN14_Rs2_AR = 0;
  		@sysvar::CH_Nodes::CH__STPDU_EIS_PN14_Stat2_AR2 = 0;
  		@sysvar::CH_Nodes::CH__STPDU_EIS_PN14_Stat_AR = 0;
  		@sysvar::CH_Nodes::CH__STPDU_EIS_PN48_Bat_Stat2_AR2 = 0;
  		@sysvar::CH_Nodes::CH__STPDU_EIS_PN48_Bat_Stat_AR = 0;
  		@sysvar::CH_Nodes::CH__STPDU_EIS_PN48_BatLim_Stat_AR = 0;
  		@sysvar::CH_Nodes::CH__STPDU_EIS_PN48_DCDC48_LISB48_Stat_AR = 0;
  		@sysvar::CH_Nodes::CH__STPDU_EIS_PN48_Stat_AR = 0;
  		@sysvar::CH_Nodes::CH__STPDU_EIS_PNHV_WeekDepTmTbl_Rq_HU_AR2 = 0;
  		@sysvar::CH_Nodes::CH__STPDU_EIS_PreCond_On_Rq_AR = 0;
  		@sysvar::CH_Nodes::CH__STPDU_EIS_PreCond_Rq_HU_AR2 = 0;
  		@sysvar::CH_Nodes::CH__STPDU_EIS_PreCond_Stat_AR = 0;
  		@sysvar::CH_Nodes::CH__STPDU_EIS_PT_ObjIntrst_Gw_AR2 = 0;
  		@sysvar::CH_Nodes::CH__STPDU_EIS_RemPark_Auth_Rs_AR2 = 0;
  		@sysvar::CH_Nodes::CH__STPDU_EIS_RemPark_Stat_EIS_AR2 = 0;
  		@sysvar::CH_Nodes::CH__STPDU_EIS_RTC_Date_Time_AR2 = 0;
  		@sysvar::CH_Nodes::CH__STPDU_EIS_RTC_Stat1_AR2 = 0;
  		@sysvar::CH_Nodes::CH__STPDU_EIS_SADR_Trgr_FCW_AR2 = 0;
  		@sysvar::CH_Nodes::CH__STPDU_EIS_SeatAdj_FL_Rq_AR = 0;
  		@sysvar::CH_Nodes::CH__STPDU_EIS_SeatAdj_FR_Rq_AR = 0;
  		@sysvar::CH_Nodes::CH__STPDU_EIS_SPCR_Stat_BC_F_AR2 = 0;
  		@sysvar::CH_Nodes::CH__STPDU_EIS_SPL_Obj1_Obj2_NV_AR2 = 0;
  		@sysvar::CH_Nodes::CH__STPDU_EIS_SPV_Actn_Rq_AR2 = 0;
  		@sysvar::CH_Nodes::CH__STPDU_EIS_SPV_Alm_Rq_AR = 0;
  		@sysvar::CH_Nodes::CH__STPDU_EIS_SPV_Stat_AR2 = 0;
  		@sysvar::CH_Nodes::CH__STPDU_EIS_SVS_Rq_HU_AR2 = 0;
  		@sysvar::CH_Nodes::CH__STPDU_EIS_TBCSC_DAC_EPS_AR2 = 0;
  		@sysvar::CH_Nodes::CH__STPDU_EIS_TBCSC_DAC_ESP_AR2 = 0;
  		@sysvar::CH_Nodes::CH__STPDU_EIS_TBCSC_Hi_Rq1_AR2 = 0;
  		@sysvar::CH_Nodes::CH__STPDU_EIS_TBCSC_Hi_Rq2_AR2 = 0;
  		@sysvar::CH_Nodes::CH__STPDU_EIS_TBCSC_Lo_Rq1_AR2 = 0;
  		@sysvar::CH_Nodes::CH__STPDU_EIS_TBCSC_Lo_Rq2_AR2 = 0;
  		@sysvar::CH_Nodes::CH__STPDU_EIS_TC_Distance_AR = 0;
  		@sysvar::CH_Nodes::CH__STPDU_EIS_TGW_DateTm_Stat_AR = 0;
  		@sysvar::CH_Nodes::CH__STPDU_EIS_Tire_State_AR2 = 0;
  		@sysvar::CH_Nodes::CH__STPDU_EIS_TrafficInfo_AR = 0;
  		@sysvar::CH_Nodes::CH__STPDU_EIS_Trailer_Stat_AR2 = 0;
  		@sysvar::CH_Nodes::CH__STPDU_EIS_TSA_Disp_Rq1_AR2 = 0;
  		@sysvar::CH_Nodes::CH__STPDU_EIS_TSA_Disp_Rq2_AR = 0;
  		@sysvar::CH_Nodes::CH__STPDU_EIS_TSA_Disp_Rq3_AR = 0;
  		@sysvar::CH_Nodes::CH__STPDU_EIS_VehAccel_X_Rq_Gw_AR2 = 0;
  		@sysvar::CH_Nodes::CH__STPDU_EIS_VIN_AR = 0;
  		@sysvar::CH_Nodes::CH__STPDU_EIS_Wiper_Stat_AR = 0;
  		@sysvar::CH_Nodes::CH__STPDU_EIS_WUDOP_EIS_FR = 0;
  		@sysvar::CH_Nodes::CH__STPDU_EIS_YMAS_Rq_MPC_AR2 = 0;
  		@sysvar::CH_Nodes::CH__STPDU_EPS_DTQ_Rs_AR2 = 0;
  		@sysvar::CH_Nodes::CH__STPDU_EPS_EPS_Stat_Disp_Rq_AR2 = 0;
  		@sysvar::CH_Nodes::CH__STPDU_EPS_PARK_St_Rs_AR2 = 0;
  		@sysvar::CH_Nodes::CH__STPDU_EPS_ROE_EPS = 0;
  		@sysvar::CH_Nodes::CH__STPDU_EPS_STA_Rs1_AR2 = 0;
  		@sysvar::CH_Nodes::CH__STPDU_EPS_TBCSC_EPS_DAC_AR2 = 0;
  		@sysvar::CH_Nodes::CH__STPDU_EPS_TBCSC_Rs_EPS_AR2 = 0;
  		@sysvar::CH_Nodes::CH__STPDU_EPS_WUDOP_EPS_FR = 0;
  		@sysvar::CH_Nodes::CH__STPDU_ESP_AWD_TCASE_Rq_ESP_AR2 = 0;
  		@sysvar::CH_Nodes::CH__STPDU_ESP_BrkSys_Stat_AR2 = 0;
  		@sysvar::CH_Nodes::CH__STPDU_ESP_DPC_Disp_Rq_AR2 = 0;
  		@sysvar::CH_Nodes::CH__STPDU_ESP_DPC_IndMd_Stat_AR2 = 0;
  		@sysvar::CH_Nodes::CH__STPDU_ESP_DPC_IndMd_Style2_AR2 = 0;
  		@sysvar::CH_Nodes::CH__STPDU_ESP_DPC_IndMd_Style_AR2 = 0;
  		@sysvar::CH_Nodes::CH__STPDU_ESP_DPC_Master_Rq_AR2 = 0;
  		@sysvar::CH_Nodes::CH__STPDU_ESP_Eng_Susp_Rq_AS_AR2 = 0;
  		@sysvar::CH_Nodes::CH__STPDU_ESP_EPKB_Disp_IndLmp_Rq_2_AR2 = 0;
  		@sysvar::CH_Nodes::CH__STPDU_ESP_EPKB_Stat_Gw_AR2 = 0;
  		@sysvar::CH_Nodes::CH__STPDU_ESP_ESP_Disp_Rq2_AR2 = 0;
  		@sysvar::CH_Nodes::CH__STPDU_ESP_ESP_Disp_Rq3_AR = 0;
  		@sysvar::CH_Nodes::CH__STPDU_ESP_ESP_Disp_Rq_AMG_AR2 = 0;
  		@sysvar::CH_Nodes::CH__STPDU_ESP_ESP_Disp_Rq_AR2 = 0;
  		@sysvar::CH_Nodes::CH__STPDU_ESP_ESP_OBD_Stat_AR = 0;
  		@sysvar::CH_Nodes::CH__STPDU_ESP_ESP_Stat1_AR2 = 0;
  		@sysvar::CH_Nodes::CH__STPDU_ESP_LDC_Disp_Rq_ESP_AR = 0;
  		@sysvar::CH_Nodes::CH__STPDU_ESP_PARK_Brk_Rs_AR2 = 0;
  		@sysvar::CH_Nodes::CH__STPDU_ESP_PARK_Drv_Rq_ESP_AR2 = 0;
  		@sysvar::CH_Nodes::CH__STPDU_ESP_PresfCtrl_Rq_ESP_AR2 = 0;
  		@sysvar::CH_Nodes::CH__STPDU_ESP_PT_Rq_ESP_AR2 = 0;
  		@sysvar::CH_Nodes::CH__STPDU_ESP_ROE_ESP = 0;
  		@sysvar::CH_Nodes::CH__STPDU_ESP_SADR_Trgr_ESP_AR2 = 0;
  		@sysvar::CH_Nodes::CH__STPDU_ESP_St_Rq_STA_AR2 = 0;
  		@sysvar::CH_Nodes::CH__STPDU_ESP_TBCSC_ESP_DAC_AR2 = 0;
  		@sysvar::CH_Nodes::CH__STPDU_ESP_TBCSC_Rs1_ESP_AR2 = 0;
  		@sysvar::CH_Nodes::CH__STPDU_ESP_TBCSC_Rs2_ESP_AR2 = 0;
  		@sysvar::CH_Nodes::CH__STPDU_ESP_VehAccel_X_Rs1_AR2 = 0;
  		@sysvar::CH_Nodes::CH__STPDU_ESP_VehAccel_X_Rs2_AR2 = 0;
  		@sysvar::CH_Nodes::CH__STPDU_ESP_VehDyn_Stat1_AR2 = 0;
  		@sysvar::CH_Nodes::CH__STPDU_ESP_VehDyn_Stat2_AR2 = 0;
  		@sysvar::CH_Nodes::CH__STPDU_ESP_VehSpd_X_AR2 = 0;
  		@sysvar::CH_Nodes::CH__STPDU_ESP_Whl_Lt_Stat_AR2 = 0;
  		@sysvar::CH_Nodes::CH__STPDU_ESP_Whl_Rt_Stat_AR2 = 0;
  		@sysvar::CH_Nodes::CH__STPDU_ESP_WhlPlsCnt_TPM_AR2 = 0;
  		@sysvar::CH_Nodes::CH__STPDU_ESP_WUDOP_ESP_FR = 0;
  		@sysvar::CH_Nodes::CH__STPDU_ESP_YMAS_Rs_AR2 = 0;
  		@sysvar::CH_Nodes::CH__STPDU_FCW_CMS_PI_State_AR2 = 0;
  		@sysvar::CH_Nodes::CH__STPDU_FCW_FCW_Disp_Rq_Gw_AR = 0;
  		@sysvar::CH_Nodes::CH__STPDU_FCW_PT_ObjIntrst_AR2 = 0;
  		@sysvar::CH_Nodes::CH__STPDU_FCW_RDU_Disp_Rq_AR = 0;
  		@sysvar::CH_Nodes::CH__STPDU_FCW_ROE_RDU = 0;
  		@sysvar::CH_Nodes::CH__STPDU_FCW_SADR_Trgr_RDU_AR2 = 0;
  		@sysvar::CH_Nodes::CH__STPDU_FCW_VehAccel_X_Rq_AR2 = 0;
  		@sysvar::CH_Nodes::CH__STPDU_LRR_DTR_Obj_A_FR2 = 0;
  		@sysvar::CH_Nodes::CH__STPDU_LRR_DTR_Obj_B_FR2 = 0;
  		@sysvar::CH_Nodes::CH__STPDU_LRR_DTR_Obj_C_FR2 = 0;
  		@sysvar::CH_Nodes::CH__STPDU_LRR_DTR_Obj_D_FR2 = 0;
  		@sysvar::CH_Nodes::CH__STPDU_LRR_DTR_Obj_E_FR2 = 0;
  		@sysvar::CH_Nodes::CH__STPDU_LRR_DTR_Obj_F_FR2 = 0;
  		@sysvar::CH_Nodes::CH__STPDU_LRR_DTR_Obj_G_FR2 = 0;
  		@sysvar::CH_Nodes::CH__STPDU_LRR_DTR_ObjStat_FR2 = 0;
  		@sysvar::CH_Nodes::CH__STPDU_LRR_DTR_Polyg_Lt_FR2 = 0;
  		@sysvar::CH_Nodes::CH__STPDU_LRR_DTR_Polyg_Rt_FR2 = 0;
  		@sysvar::CH_Nodes::CH__STPDU_LRR_DTR_Stat_FR2 = 0;
  		@sysvar::CH_Nodes::CH__STPDU_LRR_ROE_LRR = 0;
  		@sysvar::CH_Nodes::CH__STPDU_MPC_Cam_Stat_AR2 = 0;
  		@sysvar::CH_Nodes::CH__STPDU_MPC_CamLane_Disp_Warn_Rq_Gw_AR2 = 0;
  		@sysvar::CH_Nodes::CH__STPDU_MPC_CamLane_FastAttr1_FR2 = 0;
  		@sysvar::CH_Nodes::CH__STPDU_MPC_CamLane_FastAttr2_FR2 = 0;
  		@sysvar::CH_Nodes::CH__STPDU_MPC_CamLane_LaneAttr1_Gw_AR2 = 0;
  		@sysvar::CH_Nodes::CH__STPDU_MPC_CamLane_LaneAttr2_Gw_AR2 = 0;
  		@sysvar::CH_Nodes::CH__STPDU_MPC_CamLane_LaneAttr3_Gw_AR2 = 0;
  		@sysvar::CH_Nodes::CH__STPDU_MPC_CamLane_LaneAttr4_FR2 = 0;
  		@sysvar::CH_Nodes::CH__STPDU_MPC_CamLane_LaneAttr5_FR2 = 0;
  		@sysvar::CH_Nodes::CH__STPDU_MPC_CamLane_LaneAttr6_Gw_AR2 = 0;
  		@sysvar::CH_Nodes::CH__STPDU_MPC_CamLane_LaneAttr7_Gw_AR2 = 0;
  		@sysvar::CH_Nodes::CH__STPDU_MPC_CamObj_A_Mtn_FR2 = 0;
  		@sysvar::CH_Nodes::CH__STPDU_MPC_CamObj_A_Posn_FR2 = 0;
  		@sysvar::CH_Nodes::CH__STPDU_MPC_CamObj_B_Mtn_FR2 = 0;
  		@sysvar::CH_Nodes::CH__STPDU_MPC_CamObj_B_Posn_FR2 = 0;
  		@sysvar::CH_Nodes::CH__STPDU_MPC_CamObj_C_Mtn_FR2 = 0;
  		@sysvar::CH_Nodes::CH__STPDU_MPC_CamObj_C_Posn_FR2 = 0;
  		@sysvar::CH_Nodes::CH__STPDU_MPC_IHC_Lgt_Stat_MPC_Gw_AR2 = 0;
  		@sysvar::CH_Nodes::CH__STPDU_MPC_IHC_Plus_HL_Stat_AR2 = 0;
  		@sysvar::CH_Nodes::CH__STPDU_MPC_IHC_Plus_Tunnel_3_4_AR2 = 0;
  		@sysvar::CH_Nodes::CH__STPDU_MPC_IHC_Plus_Tunnel_AR2 = 0;
  		@sysvar::CH_Nodes::CH__STPDU_MPC_Preview_Header1_FR2 = 0;
  		@sysvar::CH_Nodes::CH__STPDU_MPC_Preview_Header2_FR2 = 0;
  		@sysvar::CH_Nodes::CH__STPDU_MPC_Preview_ProfData1_FR2 = 0;
  		@sysvar::CH_Nodes::CH__STPDU_MPC_Preview_ProfData2_FR2 = 0;
  		@sysvar::CH_Nodes::CH__STPDU_MPC_ROE_SMPC = 0;
  		@sysvar::CH_Nodes::CH__STPDU_MPC_SPL_Obj1_Obj2_MPC_AR2 = 0;
  		@sysvar::CH_Nodes::CH__STPDU_MPC_TSA_Disp_Rq1_Gw_AR2 = 0;
  		@sysvar::CH_Nodes::CH__STPDU_MPC_TSA_Disp_Rq2_Gw_AR = 0;
  		@sysvar::CH_Nodes::CH__STPDU_MPC_TSA_Disp_Rq3_Gw_AR = 0;
  		@sysvar::CH_Nodes::CH__STPDU_MPC_YMAS_Rq_MPC_Gw_AR2 = 0;
  		@sysvar::CH_Nodes::CH__STPDU_PARK_Brk_Rq_PARK_AR2 = 0;
  		@sysvar::CH_Nodes::CH__STPDU_PARK_ECU_INFO_RVC_AR = 0;
  		@sysvar::CH_Nodes::CH__STPDU_PARK_Park_Disp_Rq_AR2 = 0;
  		@sysvar::CH_Nodes::CH__STPDU_PARK_Park_Set_Stat_AR2 = 0;
  		@sysvar::CH_Nodes::CH__STPDU_PARK_Park_Stat_AR2 = 0;
  		@sysvar::CH_Nodes::CH__STPDU_PARK_ParkSensObj_Stat1_FR2 = 0;
  		@sysvar::CH_Nodes::CH__STPDU_PARK_ParkSensObj_Stat2_FR2 = 0;
  		@sysvar::CH_Nodes::CH__STPDU_PARK_ParkSpaceMeas_Stat_AR = 0;
  		@sysvar::CH_Nodes::CH__STPDU_PARK_ParkWarn_AR2 = 0;
  		@sysvar::CH_Nodes::CH__STPDU_PARK_RemPark_Rq_AR2 = 0;
  		@sysvar::CH_Nodes::CH__STPDU_PARK_ROE_PARK = 0;
  		@sysvar::CH_Nodes::CH__STPDU_PARK_RVC_SVS_Park_Stat_AR2 = 0;
  		@sysvar::CH_Nodes::CH__STPDU_PARK_SADR_Trgr_PARK_AR2 = 0;
  		@sysvar::CH_Nodes::CH__STPDU_PARK_St_Rq_PARK_AR2 = 0;
  		@sysvar::CH_Nodes::CH__STPDU_RDU_BrkSys_Rq_YMAS_AR2 = 0;
  		@sysvar::CH_Nodes::CH__STPDU_RDU_BSM_Disp_Warn_Rq_Gw_AR2 = 0;
  		@sysvar::CH_Nodes::CH__STPDU_RDU_CMS_PI_Sd_Stat_MMR_F1_AR2 = 0;
  		@sysvar::CH_Nodes::CH__STPDU_RDU_CMS_PI_Sd_Stat_MMR_F4_AR2 = 0;
  		@sysvar::CH_Nodes::CH__STPDU_RDU_CMS_PI_State_AR2 = 0;
  		@sysvar::CH_Nodes::CH__STPDU_RDU_DTQ_Disp_Warn_Rq_AR2 = 0;
  		@sysvar::CH_Nodes::CH__STPDU_RDU_DTQ_Rq1_AR2 = 0;
  		@sysvar::CH_Nodes::CH__STPDU_RDU_DTQ_Rq2_AR2 = 0;
  		@sysvar::CH_Nodes::CH__STPDU_RDU_LDC_Disp_Rq_RDU_AR2 = 0;
  		@sysvar::CH_Nodes::CH__STPDU_RDU_LDP_Warn_Rq_AR2 = 0;
  		@sysvar::CH_Nodes::CH__STPDU_RDU_PT_ObjIntrst_AR2 = 0;
  		@sysvar::CH_Nodes::CH__STPDU_RDU_RDU_Disp_Rq_AR = 0;
  		@sysvar::CH_Nodes::CH__STPDU_RDU_RDU_GlobalAttr_AR2 = 0;
  		@sysvar::CH_Nodes::CH__STPDU_RDU_RDU_Stat1_AR = 0;
  		@sysvar::CH_Nodes::CH__STPDU_RDU_ROE_MMR_F1 = 0;
  		@sysvar::CH_Nodes::CH__STPDU_RDU_ROE_MMR_F4 = 0;
  		@sysvar::CH_Nodes::CH__STPDU_RDU_ROE_MMR_RM = 0;
  		@sysvar::CH_Nodes::CH__STPDU_RDU_ROE_MMR_RS = 0;
  		@sysvar::CH_Nodes::CH__STPDU_RDU_ROE_RDU = 0;
  		@sysvar::CH_Nodes::CH__STPDU_RDU_SADR_Trgr_RDU_AR2 = 0;
  		@sysvar::CH_Nodes::CH__STPDU_RDU_SCS_Stat1_RDU_AR2 = 0;
  		@sysvar::CH_Nodes::CH__STPDU_RDU_SCS_Stat2_RDU_AR2 = 0;
  		@sysvar::CH_Nodes::CH__STPDU_RDU_Veh_Stat_RDU_FR2 = 0;
  		@sysvar::CH_Nodes::CH__STPDU_RDU_VehAccel_X_Rq_AR2 = 0;
  		@sysvar::CH_Nodes::CH__STPDU_SCCM_LDC_Rq_StWhl_AR2 = 0;
  		@sysvar::CH_Nodes::CH__STPDU_SCCM_LDC_SBW_Rq_SCCM_AR2 = 0;
  		@sysvar::CH_Nodes::CH__STPDU_SCCM_ROE_SCCM = 0;
  		@sysvar::CH_Nodes::CH__STPDU_SCCM_ROE_SWSP = 0;
  		@sysvar::CH_Nodes::CH__STPDU_SCCM_SCCM_Sw_Stat_AR2 = 0;
  		@sysvar::CH_Nodes::CH__STPDU_SCCM_StWhl_Angl_Stat_AR2 = 0;
  		@sysvar::CH_Nodes::CH__STPDU_SCCM_StWhl_OFN_Stat_AR2 = 0;
  		@sysvar::CH_Nodes::CH__STPDU_SCCM_StWhl_Sw_Stat_AR2 = 0;
  		@sysvar::CH_Nodes::CH__STPDU_SCCM_WUDOP_SCCM_FR = 0;
  		@sysvar::CH_Nodes::CH__STPDU_SDTR_CMS_PI_State_AR2 = 0;
  		@sysvar::CH_Nodes::CH__STPDU_SDTR_LDC_Disp_Rq_RDU_AR2 = 0;
  		@sysvar::CH_Nodes::CH__STPDU_SDTR_PT_ObjIntrst_AR2 = 0;
  		@sysvar::CH_Nodes::CH__STPDU_SDTR_RDU_Disp_Rq_AR = 0;
  		@sysvar::CH_Nodes::CH__STPDU_SDTR_RDU_Stat1_AR = 0;
  		@sysvar::CH_Nodes::CH__STPDU_SDTR_ROE_RDU = 0;
  		@sysvar::CH_Nodes::CH__STPDU_SDTR_SADR_Trgr_RDU_AR2 = 0;
  		@sysvar::CH_Nodes::CH__STPDU_SDTR_VehAccel_X_Rq_AR2 = 0;
  		@sysvar::CH_Nodes::CH__STPDU_SPC_Eng_Rq_ABC_AR2 = 0;
  		@sysvar::CH_Nodes::CH__STPDU_SPC_OffRoad_Disp_Rq_AR = 0;
  		@sysvar::CH_Nodes::CH__STPDU_SPC_Preview_Data_SPC_AR = 0;
  		@sysvar::CH_Nodes::CH__STPDU_SPC_ROE_MPU_FL = 0;
  		@sysvar::CH_Nodes::CH__STPDU_SPC_ROE_MPU_FR = 0;
  		@sysvar::CH_Nodes::CH__STPDU_SPC_ROE_MPU_RL = 0;
  		@sysvar::CH_Nodes::CH__STPDU_SPC_ROE_MPU_RR = 0;
  		@sysvar::CH_Nodes::CH__STPDU_SPC_ROE_SPC = 0;
  		@sysvar::CH_Nodes::CH__STPDU_SPC_SPC_Disp_Rq_AR = 0;
  		@sysvar::CH_Nodes::CH__STPDU_SPC_SPC_SwLED_Msg_Rq_AR2 = 0;
  		@sysvar::CH_Nodes::CH__STPDU_SPC_SpringVlv_Rq_AR = 0;
  		@sysvar::CH_Nodes::CH__STPDU_SPC_VehCarv_Stat_AR = 0;
  		@sysvar::CH_Nodes::CH__STPDU_SPC_VehLvl_Stat_AR2 = 0;
  		@sysvar::CH_Nodes::CH__STPDU_SPC_VX_ROE_SPC_VX = 0;
  		@sysvar::CH_Nodes::CH__STPDU_SPC_VX_SPC_VX_Stat1_AR = 0;
  		@sysvar::CH_Nodes::CH__STPDU_SPC_VX_SpringVlv_Stat_AR = 0;
	}
}
/*@@end*/

/*@@sysvarChange:CH_Nodes::CH_STOPP_PDUS_OFF:*/
on sysvar sysvar::CH_Nodes::CH_STOPP_PDUS_OFF
{
	if (@this)
  	{
  		@sysvar::CH_Nodes::CH__STPDU_AWD_TCASE_AWD_TCASE_Disp_Rq_AR2 = 1;
  		@sysvar::CH_Nodes::CH__STPDU_AWD_TCASE_AWD_TCASE_Stat1_AR2 = 1;
  		@sysvar::CH_Nodes::CH__STPDU_AWD_TCASE_AWD_TCASE_Stat2_AR2 = 1;
  		@sysvar::CH_Nodes::CH__STPDU_AWD_TCASE_ROE_AWD_TCASE = 1;
  		@sysvar::CH_Nodes::CH__STPDU_CPC_Adblue_Disp_Rq_AR = 1;
  		@sysvar::CH_Nodes::CH__STPDU_CPC_Adblue_Disp_Warn_Rq_AR = 1;
  		@sysvar::CH_Nodes::CH__STPDU_CPC_Assyst_Stat2_AR = 1;
  		@sysvar::CH_Nodes::CH__STPDU_CPC_Assyst_Stat3_AR2 = 1;
  		@sysvar::CH_Nodes::CH__STPDU_CPC_Assyst_Stat_AR = 1;
  		@sysvar::CH_Nodes::CH__STPDU_CPC_CNG_Disp_Rq_AR2 = 1;
  		@sysvar::CH_Nodes::CH__STPDU_CPC_CPC_CHASSIS_R1_AR2 = 1;
  		@sysvar::CH_Nodes::CH__STPDU_CPC_CPC_CHASSIS_R2_AR2 = 1;
  		@sysvar::CH_Nodes::CH__STPDU_CPC_DCDC1_Rs1_AR2 = 1;
  		@sysvar::CH_Nodes::CH__STPDU_CPC_DPC_PT_Rs_AR = 1;
  		@sysvar::CH_Nodes::CH__STPDU_CPC_ECM_DAC4_AR = 1;
  		@sysvar::CH_Nodes::CH__STPDU_CPC_ECO_Homepage_Data = 1;
  		@sysvar::CH_Nodes::CH__STPDU_CPC_ECO_Score_Disp_Rq_AR = 1;
  		@sysvar::CH_Nodes::CH__STPDU_CPC_EM01_Stat1_AR2 = 1;
  		@sysvar::CH_Nodes::CH__STPDU_CPC_EM01_Stat2_AR2 = 1;
  		@sysvar::CH_Nodes::CH__STPDU_CPC_EM01_Trq_Rs_AR2 = 1;
  		@sysvar::CH_Nodes::CH__STPDU_CPC_EM_DAC4_AR = 1;
  		@sysvar::CH_Nodes::CH__STPDU_CPC_EMM_Data1_AR2 = 1;
  		@sysvar::CH_Nodes::CH__STPDU_CPC_EnergyMngmnt_PreCond_Stat_AR2 = 1;
  		@sysvar::CH_Nodes::CH__STPDU_CPC_Eng_Rs_1_AR2 = 1;
  		@sysvar::CH_Nodes::CH__STPDU_CPC_Eng_Rs_2_AR2 = 1;
  		@sysvar::CH_Nodes::CH__STPDU_CPC_Eng_Rs_3_AR2 = 1;
  		@sysvar::CH_Nodes::CH__STPDU_CPC_Eng_Rs_EM_AR2 = 1;
  		@sysvar::CH_Nodes::CH__STPDU_CPC_Eng_Rs_EngCtrl_AR2 = 1;
  		@sysvar::CH_Nodes::CH__STPDU_CPC_EngCtrl_Disp_Rq_AR2 = 1;
  		@sysvar::CH_Nodes::CH__STPDU_CPC_EngCtrl_OBD1_AR = 1;
  		@sysvar::CH_Nodes::CH__STPDU_CPC_EngCtrl_Stat_AR2 = 1;
  		@sysvar::CH_Nodes::CH__STPDU_CPC_ESP_OBD_Data_AR = 1;
  		@sysvar::CH_Nodes::CH__STPDU_CPC_Fuel_Stat2_AR2 = 1;
  		@sysvar::CH_Nodes::CH__STPDU_CPC_FuelLvl_Stat_AR2 = 1;
  		@sysvar::CH_Nodes::CH__STPDU_CPC_HumanMachineIfc_AR2 = 1;
  		@sysvar::CH_Nodes::CH__STPDU_CPC_HumanMachineIfc_Rq_AR = 1;
  		@sysvar::CH_Nodes::CH__STPDU_CPC_ISM_DAC4_AR = 1;
  		@sysvar::CH_Nodes::CH__STPDU_CPC_OBL_DC_Output_AR = 1;
  		@sysvar::CH_Nodes::CH__STPDU_CPC_PARK_Drv_Rs_TCM_AR2 = 1;
  		@sysvar::CH_Nodes::CH__STPDU_CPC_PN14_Gen_Rs_AR = 1;
  		@sysvar::CH_Nodes::CH__STPDU_CPC_PNHV_BMS_Stat_AR2 = 1;
  		@sysvar::CH_Nodes::CH__STPDU_CPC_PNHV_EnergyMngmnt_Disp_Rq_AR = 1;
  		@sysvar::CH_Nodes::CH__STPDU_CPC_PNHV_EnergyMngmnt_Stat2_AR2 = 1;
  		@sysvar::CH_Nodes::CH__STPDU_CPC_PNHV_EnergyMngmnt_Stat3_AR2 = 1;
  		@sysvar::CH_Nodes::CH__STPDU_CPC_PNHV_EnergyMngmntSet_Rs1_AR2 = 1;
  		@sysvar::CH_Nodes::CH__STPDU_CPC_PNHV_EnergyMngmntSet_Rs2_AR = 1;
  		@sysvar::CH_Nodes::CH__STPDU_CPC_PNHV_Stat_AR2 = 1;
  		@sysvar::CH_Nodes::CH__STPDU_CPC_PNHV_WeekDepTmTbl_Stat_AR2 = 1;
  		@sysvar::CH_Nodes::CH__STPDU_CPC_PT_DataContain_Rq_AR2 = 1;
  		@sysvar::CH_Nodes::CH__STPDU_CPC_PT_Disp_Rq2_AR = 1;
  		@sysvar::CH_Nodes::CH__STPDU_CPC_PT_ThermM_AR2 = 1;
  		@sysvar::CH_Nodes::CH__STPDU_CPC_PT_ThermM_Rq_AR2 = 1;
  		@sysvar::CH_Nodes::CH__STPDU_CPC_PtHyb_Mngmnt_Rq1_AR = 1;
  		@sysvar::CH_Nodes::CH__STPDU_CPC_PtMngmnt_Disp_Rq_AR2 = 1;
  		@sysvar::CH_Nodes::CH__STPDU_CPC_PtMngmnt_Rq_AR2 = 1;
  		@sysvar::CH_Nodes::CH__STPDU_CPC_PtMngmnt_Stat2_AR2 = 1;
  		@sysvar::CH_Nodes::CH__STPDU_CPC_PtMngmnt_Stat_AR2 = 1;
  		@sysvar::CH_Nodes::CH__STPDU_CPC_SBW_DrvPosn_Disp_Rq_ISM_AR2 = 1;
  		@sysvar::CH_Nodes::CH__STPDU_CPC_SBW_DrvPosn_Disp_Rq_TCM_AR2 = 1;
  		@sysvar::CH_Nodes::CH__STPDU_CPC_SBW_Stat_AR2 = 1;
  		@sysvar::CH_Nodes::CH__STPDU_CPC_SND_GEN_Stat_AR = 1;
  		@sysvar::CH_Nodes::CH__STPDU_CPC_TC_Disp_Rq_ECM_AR = 1;
  		@sysvar::CH_Nodes::CH__STPDU_CPC_TC_EBBC_Disp_Rq_ECM_AR = 1;
  		@sysvar::CH_Nodes::CH__STPDU_CPC_TC_EEBBC_Disp_Rq_AR = 1;
  		@sysvar::CH_Nodes::CH__STPDU_CPC_TCM_DAC4_AR = 1;
  		@sysvar::CH_Nodes::CH__STPDU_CPC_TCM_Data2_AR2 = 1;
  		@sysvar::CH_Nodes::CH__STPDU_CPC_TCM_Data3_AR2 = 1;
  		@sysvar::CH_Nodes::CH__STPDU_CPC_TCM_Disp_Rq_AMG_AR = 1;
  		@sysvar::CH_Nodes::CH__STPDU_CPC_TCM_State3_AR2 = 1;
  		@sysvar::CH_Nodes::CH__STPDU_CPC_TCU_Disp_Rq_AR2 = 1;
  		@sysvar::CH_Nodes::CH__STPDU_CPC_ThermMngmnt_1_AR2 = 1;
  		@sysvar::CH_Nodes::CH__STPDU_CPC_ThermMngmnt_4_AR = 1;
  		@sysvar::CH_Nodes::CH__STPDU_CPC_ThermMngmnt_EV_1_AR2 = 1;
  		@sysvar::CH_Nodes::CH__STPDU_CPC_VehPwrMngmnt_EMM_Stat2_AR2 = 1;
  		@sysvar::CH_Nodes::CH__STPDU_CPC_VehPwrMngmnt_Rq_AR = 1;
  		@sysvar::CH_Nodes::CH__STPDU_CPC_WIA_EngTrq_AR = 1;
  		@sysvar::CH_Nodes::CH__STPDU_CPC_WPT_Stat2_AR2 = 1;
  		@sysvar::CH_Nodes::CH__STPDU_DRVU_DPC_Disp_Rq_AMG_AR2 = 1;
  		@sysvar::CH_Nodes::CH__STPDU_DRVU_DPC_IndMd_Stat_AMG_AR2 = 1;
  		@sysvar::CH_Nodes::CH__STPDU_DRVU_DPC_IndMd_Style2_AMG_AR2 = 1;
  		@sysvar::CH_Nodes::CH__STPDU_DRVU_DPC_IndMd_Style_AMG_AR2 = 1;
  		@sysvar::CH_Nodes::CH__STPDU_DRVU_DPC_Master_Rq_AMG_AR2 = 1;
  		@sysvar::CH_Nodes::CH__STPDU_DRVU_DRVU_Stat_AR = 1;
  		@sysvar::CH_Nodes::CH__STPDU_DRVU_ESP_EDIFF_Rs_AR = 1;
  		@sysvar::CH_Nodes::CH__STPDU_EIS_ActvComf_Rq_AR2 = 1;
  		@sysvar::CH_Nodes::CH__STPDU_EIS_ADAS_CURRENT_ATTRIBUTES_AR = 1;
  		@sysvar::CH_Nodes::CH__STPDU_EIS_ADAS_POSITION_AR = 1;
  		@sysvar::CH_Nodes::CH__STPDU_EIS_ADAS_PREDICTION_AR = 1;
  		@sysvar::CH_Nodes::CH__STPDU_EIS_ADAS_PROFILE_LONG_AR = 1;
  		@sysvar::CH_Nodes::CH__STPDU_EIS_ADAS_PROFILE_SHORT_AR = 1;
  		@sysvar::CH_Nodes::CH__STPDU_EIS_ADASLR_POSITION_AR = 1;
  		@sysvar::CH_Nodes::CH__STPDU_EIS_ADASLR_PROFILE_LONG_AR = 1;
  		@sysvar::CH_Nodes::CH__STPDU_EIS_Assyst_Rq_AR2 = 1;
  		@sysvar::CH_Nodes::CH__STPDU_EIS_BC_F_Disp_Rq_AR = 1;
  		@sysvar::CH_Nodes::CH__STPDU_EIS_BC_F_Stat1_AR = 1;
  		@sysvar::CH_Nodes::CH__STPDU_EIS_BC_F_Stat2_AR2 = 1;
  		@sysvar::CH_Nodes::CH__STPDU_EIS_BC_R_Stat1_AR = 1;
  		@sysvar::CH_Nodes::CH__STPDU_EIS_BLSM_Disp_Stat_AR = 1;
  		@sysvar::CH_Nodes::CH__STPDU_EIS_BODY_CHASSIS_R1_AR = 1;
  		@sysvar::CH_Nodes::CH__STPDU_EIS_BSM_Disp_Warn_Rq_AR2 = 1;
  		@sysvar::CH_Nodes::CH__STPDU_EIS_CamLane_Disp_Warn_Rq_AR2 = 1;
  		@sysvar::CH_Nodes::CH__STPDU_EIS_CamLane_LaneAttr1_AR2 = 1;
  		@sysvar::CH_Nodes::CH__STPDU_EIS_CamLane_LaneAttr2_AR2 = 1;
  		@sysvar::CH_Nodes::CH__STPDU_EIS_CamLane_LaneAttr3_AR2 = 1;
  		@sysvar::CH_Nodes::CH__STPDU_EIS_CamLane_LaneAttr6_AR2 = 1;
  		@sysvar::CH_Nodes::CH__STPDU_EIS_CamLane_LaneAttr7_AR2 = 1;
  		@sysvar::CH_Nodes::CH__STPDU_EIS_CLkS_Rq_AR = 1;
  		@sysvar::CH_Nodes::CH__STPDU_EIS_CLkS_State_AR = 1;
  		@sysvar::CH_Nodes::CH__STPDU_EIS_ClockSync_Stat_FR2 = 1;
  		@sysvar::CH_Nodes::CH__STPDU_EIS_CMS_PI_State_Gw_AR2 = 1;
  		@sysvar::CH_Nodes::CH__STPDU_EIS_Config_HU4_AR2 = 1;
  		@sysvar::CH_Nodes::CH__STPDU_EIS_Config_HU5_AR2 = 1;
  		@sysvar::CH_Nodes::CH__STPDU_EIS_CRCM_Stat_AR = 1;
  		@sysvar::CH_Nodes::CH__STPDU_EIS_CTRL_C_Stat1_AR = 1;
  		@sysvar::CH_Nodes::CH__STPDU_EIS_DAC4_ECM_AR = 1;
  		@sysvar::CH_Nodes::CH__STPDU_EIS_DAC4_EM2_AR = 1;
  		@sysvar::CH_Nodes::CH__STPDU_EIS_DAC4_ISM_AR = 1;
  		@sysvar::CH_Nodes::CH__STPDU_EIS_DAC4_TCM_AR = 1;
  		@sysvar::CH_Nodes::CH__STPDU_EIS_Dimming_Stat_AR2 = 1;
  		@sysvar::CH_Nodes::CH__STPDU_EIS_Door_FL_Stat_AR2 = 1;
  		@sysvar::CH_Nodes::CH__STPDU_EIS_Door_FR_Stat_AR2 = 1;
  		@sysvar::CH_Nodes::CH__STPDU_EIS_Door_RL_Stat_AR2 = 1;
  		@sysvar::CH_Nodes::CH__STPDU_EIS_Door_RR_Stat_AR2 = 1;
  		@sysvar::CH_Nodes::CH__STPDU_EIS_DPC_IndMd_Rq_AR = 1;
  		@sysvar::CH_Nodes::CH__STPDU_EIS_EAC_Stat_AR = 1;
  		@sysvar::CH_Nodes::CH__STPDU_EIS_EL_Stat_AR2 = 1;
  		@sysvar::CH_Nodes::CH__STPDU_EIS_EL_TurnInd_Rq_AR2 = 1;
  		@sysvar::CH_Nodes::CH__STPDU_EIS_EPKB_Stat_AR2 = 1;
  		@sysvar::CH_Nodes::CH__STPDU_EIS_EVC_CfgBit_01_32_AR2 = 1;
  		@sysvar::CH_Nodes::CH__STPDU_EIS_EVC_CfgBit_33_64_AR2 = 1;
  		@sysvar::CH_Nodes::CH__STPDU_EIS_EVC_CfgBit_65_96_AR2 = 1;
  		@sysvar::CH_Nodes::CH__STPDU_EIS_EVC_CfgBit_97_C8_AR2 = 1;
  		@sysvar::CH_Nodes::CH__STPDU_EIS_EVC_CfgList_01_0C_AR2 = 1;
  		@sysvar::CH_Nodes::CH__STPDU_EIS_FCW_Disp_Rq_AR = 1;
  		@sysvar::CH_Nodes::CH__STPDU_EIS_HMI_CHASSIS_R1_AR2 = 1;
  		@sysvar::CH_Nodes::CH__STPDU_EIS_HU_Comf_Rq_AR2 = 1;
  		@sysvar::CH_Nodes::CH__STPDU_EIS_HU_State_AR = 1;
  		@sysvar::CH_Nodes::CH__STPDU_EIS_HVAC_Disp_Stat1_AR = 1;
  		@sysvar::CH_Nodes::CH__STPDU_EIS_HVAC_OBD_DTC_AR = 1;
  		@sysvar::CH_Nodes::CH__STPDU_EIS_HVAC_Rs2_AR = 1;
  		@sysvar::CH_Nodes::CH__STPDU_EIS_HVAC_Rs3_AR2 = 1;
  		@sysvar::CH_Nodes::CH__STPDU_EIS_HVAC_Rs_AR2 = 1;
  		@sysvar::CH_Nodes::CH__STPDU_EIS_HVAC_State1_AR = 1;
  		@sysvar::CH_Nodes::CH__STPDU_EIS_IC_BasicInfo_AR2 = 1;
  		@sysvar::CH_Nodes::CH__STPDU_EIS_IC_DriveAssistSys_AR2 = 1;
  		@sysvar::CH_Nodes::CH__STPDU_EIS_IC_Settings_AR2 = 1;
  		@sysvar::CH_Nodes::CH__STPDU_EIS_ICH_Stat_AR = 1;
  		@sysvar::CH_Nodes::CH__STPDU_EIS_Ign_Veh_Stat_AR2 = 1;
  		@sysvar::CH_Nodes::CH__STPDU_EIS_IHC_Lgt_Stat_HLI_2_AR2 = 1;
  		@sysvar::CH_Nodes::CH__STPDU_EIS_IHC_Lgt_Stat_HLI_AR2 = 1;
  		@sysvar::CH_Nodes::CH__STPDU_EIS_KG_State_AR2 = 1;
  		@sysvar::CH_Nodes::CH__STPDU_EIS_LDC_Disp_Stat_IC_AR2 = 1;
  		@sysvar::CH_Nodes::CH__STPDU_EIS_LgtSens_State_AR = 1;
  		@sysvar::CH_Nodes::CH__STPDU_EIS_Mirr_Adj_Lt_Rq_AR = 1;
  		@sysvar::CH_Nodes::CH__STPDU_EIS_Mirr_Adj_Rt_Rq_AR = 1;
  		@sysvar::CH_Nodes::CH__STPDU_EIS_NAVI_Pos1_AR = 1;
  		@sysvar::CH_Nodes::CH__STPDU_EIS_NAVI_Pos2_AR = 1;
  		@sysvar::CH_Nodes::CH__STPDU_EIS_NAVI_Pos3_AR = 1;
  		@sysvar::CH_Nodes::CH__STPDU_EIS_NAVI_Pos4_AR = 1;
  		@sysvar::CH_Nodes::CH__STPDU_EIS_NAVI_Pos5_AR = 1;
  		@sysvar::CH_Nodes::CH__STPDU_EIS_NVP_Stat1_AR2 = 1;
  		@sysvar::CH_Nodes::CH__STPDU_EIS_OHCM_Stat_AR2 = 1;
  		@sysvar::CH_Nodes::CH__STPDU_EIS_ORC_Disp_Stat_AR2 = 1;
  		@sysvar::CH_Nodes::CH__STPDU_EIS_ORC_Impact_AR2 = 1;
  		@sysvar::CH_Nodes::CH__STPDU_EIS_Park_Disp_Rs_AR2 = 1;
  		@sysvar::CH_Nodes::CH__STPDU_EIS_PHB_IHC_Plus_Tunnel_3_4_AR2 = 1;
  		@sysvar::CH_Nodes::CH__STPDU_EIS_PHB_IHC_Plus_Tunnel_AR2 = 1;
  		@sysvar::CH_Nodes::CH__STPDU_EIS_PN14_Disp_Rq_AR = 1;
  		@sysvar::CH_Nodes::CH__STPDU_EIS_PN14_Rs1_AR2 = 1;
  		@sysvar::CH_Nodes::CH__STPDU_EIS_PN14_Rs2_AR = 1;
  		@sysvar::CH_Nodes::CH__STPDU_EIS_PN14_Stat2_AR2 = 1;
  		@sysvar::CH_Nodes::CH__STPDU_EIS_PN14_Stat_AR = 1;
  		@sysvar::CH_Nodes::CH__STPDU_EIS_PN48_Bat_Stat2_AR2 = 1;
  		@sysvar::CH_Nodes::CH__STPDU_EIS_PN48_Bat_Stat_AR = 1;
  		@sysvar::CH_Nodes::CH__STPDU_EIS_PN48_BatLim_Stat_AR = 1;
  		@sysvar::CH_Nodes::CH__STPDU_EIS_PN48_DCDC48_LISB48_Stat_AR = 1;
  		@sysvar::CH_Nodes::CH__STPDU_EIS_PN48_Stat_AR = 1;
  		@sysvar::CH_Nodes::CH__STPDU_EIS_PNHV_WeekDepTmTbl_Rq_HU_AR2 = 1;
  		@sysvar::CH_Nodes::CH__STPDU_EIS_PreCond_On_Rq_AR = 1;
  		@sysvar::CH_Nodes::CH__STPDU_EIS_PreCond_Rq_HU_AR2 = 1;
  		@sysvar::CH_Nodes::CH__STPDU_EIS_PreCond_Stat_AR = 1;
  		@sysvar::CH_Nodes::CH__STPDU_EIS_PT_ObjIntrst_Gw_AR2 = 1;
  		@sysvar::CH_Nodes::CH__STPDU_EIS_RemPark_Auth_Rs_AR2 = 1;
  		@sysvar::CH_Nodes::CH__STPDU_EIS_RemPark_Stat_EIS_AR2 = 1;
  		@sysvar::CH_Nodes::CH__STPDU_EIS_RTC_Date_Time_AR2 = 1;
  		@sysvar::CH_Nodes::CH__STPDU_EIS_RTC_Stat1_AR2 = 1;
  		@sysvar::CH_Nodes::CH__STPDU_EIS_SADR_Trgr_FCW_AR2 = 1;
  		@sysvar::CH_Nodes::CH__STPDU_EIS_SeatAdj_FL_Rq_AR = 1;
  		@sysvar::CH_Nodes::CH__STPDU_EIS_SeatAdj_FR_Rq_AR = 1;
  		@sysvar::CH_Nodes::CH__STPDU_EIS_SPCR_Stat_BC_F_AR2 = 1;
  		@sysvar::CH_Nodes::CH__STPDU_EIS_SPL_Obj1_Obj2_NV_AR2 = 1;
  		@sysvar::CH_Nodes::CH__STPDU_EIS_SPV_Actn_Rq_AR2 = 1;
  		@sysvar::CH_Nodes::CH__STPDU_EIS_SPV_Alm_Rq_AR = 1;
  		@sysvar::CH_Nodes::CH__STPDU_EIS_SPV_Stat_AR2 = 1;
  		@sysvar::CH_Nodes::CH__STPDU_EIS_SVS_Rq_HU_AR2 = 1;
  		@sysvar::CH_Nodes::CH__STPDU_EIS_TBCSC_DAC_EPS_AR2 = 1;
  		@sysvar::CH_Nodes::CH__STPDU_EIS_TBCSC_DAC_ESP_AR2 = 1;
  		@sysvar::CH_Nodes::CH__STPDU_EIS_TBCSC_Hi_Rq1_AR2 = 1;
  		@sysvar::CH_Nodes::CH__STPDU_EIS_TBCSC_Hi_Rq2_AR2 = 1;
  		@sysvar::CH_Nodes::CH__STPDU_EIS_TBCSC_Lo_Rq1_AR2 = 1;
  		@sysvar::CH_Nodes::CH__STPDU_EIS_TBCSC_Lo_Rq2_AR2 = 1;
  		@sysvar::CH_Nodes::CH__STPDU_EIS_TC_Distance_AR = 1;
  		@sysvar::CH_Nodes::CH__STPDU_EIS_TGW_DateTm_Stat_AR = 1;
  		@sysvar::CH_Nodes::CH__STPDU_EIS_Tire_State_AR2 = 1;
  		@sysvar::CH_Nodes::CH__STPDU_EIS_TrafficInfo_AR = 1;
  		@sysvar::CH_Nodes::CH__STPDU_EIS_Trailer_Stat_AR2 = 1;
  		@sysvar::CH_Nodes::CH__STPDU_EIS_TSA_Disp_Rq1_AR2 = 1;
  		@sysvar::CH_Nodes::CH__STPDU_EIS_TSA_Disp_Rq2_AR = 1;
  		@sysvar::CH_Nodes::CH__STPDU_EIS_TSA_Disp_Rq3_AR = 1;
  		@sysvar::CH_Nodes::CH__STPDU_EIS_VehAccel_X_Rq_Gw_AR2 = 1;
  		@sysvar::CH_Nodes::CH__STPDU_EIS_VIN_AR = 1;
  		@sysvar::CH_Nodes::CH__STPDU_EIS_Wiper_Stat_AR = 1;
  		@sysvar::CH_Nodes::CH__STPDU_EIS_WUDOP_EIS_FR = 1;
  		@sysvar::CH_Nodes::CH__STPDU_EIS_YMAS_Rq_MPC_AR2 = 1;
  		@sysvar::CH_Nodes::CH__STPDU_EPS_DTQ_Rs_AR2 = 1;
  		@sysvar::CH_Nodes::CH__STPDU_EPS_EPS_Stat_Disp_Rq_AR2 = 1;
  		@sysvar::CH_Nodes::CH__STPDU_EPS_PARK_St_Rs_AR2 = 1;
  		@sysvar::CH_Nodes::CH__STPDU_EPS_ROE_EPS = 1;
  		@sysvar::CH_Nodes::CH__STPDU_EPS_STA_Rs1_AR2 = 1;
  		@sysvar::CH_Nodes::CH__STPDU_EPS_TBCSC_EPS_DAC_AR2 = 1;
  		@sysvar::CH_Nodes::CH__STPDU_EPS_TBCSC_Rs_EPS_AR2 = 1;
  		@sysvar::CH_Nodes::CH__STPDU_EPS_WUDOP_EPS_FR = 1;
  		@sysvar::CH_Nodes::CH__STPDU_ESP_AWD_TCASE_Rq_ESP_AR2 = 1;
  		@sysvar::CH_Nodes::CH__STPDU_ESP_BrkSys_Stat_AR2 = 1;
  		@sysvar::CH_Nodes::CH__STPDU_ESP_DPC_Disp_Rq_AR2 = 1;
  		@sysvar::CH_Nodes::CH__STPDU_ESP_DPC_IndMd_Stat_AR2 = 1;
  		@sysvar::CH_Nodes::CH__STPDU_ESP_DPC_IndMd_Style2_AR2 = 1;
  		@sysvar::CH_Nodes::CH__STPDU_ESP_DPC_IndMd_Style_AR2 = 1;
  		@sysvar::CH_Nodes::CH__STPDU_ESP_DPC_Master_Rq_AR2 = 1;
  		@sysvar::CH_Nodes::CH__STPDU_ESP_Eng_Susp_Rq_AS_AR2 = 1;
  		@sysvar::CH_Nodes::CH__STPDU_ESP_EPKB_Disp_IndLmp_Rq_2_AR2 = 1;
  		@sysvar::CH_Nodes::CH__STPDU_ESP_EPKB_Stat_Gw_AR2 = 1;
  		@sysvar::CH_Nodes::CH__STPDU_ESP_ESP_Disp_Rq2_AR2 = 1;
  		@sysvar::CH_Nodes::CH__STPDU_ESP_ESP_Disp_Rq3_AR = 1;
  		@sysvar::CH_Nodes::CH__STPDU_ESP_ESP_Disp_Rq_AMG_AR2 = 1;
  		@sysvar::CH_Nodes::CH__STPDU_ESP_ESP_Disp_Rq_AR2 = 1;
  		@sysvar::CH_Nodes::CH__STPDU_ESP_ESP_OBD_Stat_AR = 1;
  		@sysvar::CH_Nodes::CH__STPDU_ESP_ESP_Stat1_AR2 = 1;
  		@sysvar::CH_Nodes::CH__STPDU_ESP_LDC_Disp_Rq_ESP_AR = 1;
  		@sysvar::CH_Nodes::CH__STPDU_ESP_PARK_Brk_Rs_AR2 = 1;
  		@sysvar::CH_Nodes::CH__STPDU_ESP_PARK_Drv_Rq_ESP_AR2 = 1;
  		@sysvar::CH_Nodes::CH__STPDU_ESP_PresfCtrl_Rq_ESP_AR2 = 1;
  		@sysvar::CH_Nodes::CH__STPDU_ESP_PT_Rq_ESP_AR2 = 1;
  		@sysvar::CH_Nodes::CH__STPDU_ESP_ROE_ESP = 1;
  		@sysvar::CH_Nodes::CH__STPDU_ESP_SADR_Trgr_ESP_AR2 = 1;
  		@sysvar::CH_Nodes::CH__STPDU_ESP_St_Rq_STA_AR2 = 1;
  		@sysvar::CH_Nodes::CH__STPDU_ESP_TBCSC_ESP_DAC_AR2 = 1;
  		@sysvar::CH_Nodes::CH__STPDU_ESP_TBCSC_Rs1_ESP_AR2 = 1;
  		@sysvar::CH_Nodes::CH__STPDU_ESP_TBCSC_Rs2_ESP_AR2 = 1;
  		@sysvar::CH_Nodes::CH__STPDU_ESP_VehAccel_X_Rs1_AR2 = 1;
  		@sysvar::CH_Nodes::CH__STPDU_ESP_VehAccel_X_Rs2_AR2 = 1;
  		@sysvar::CH_Nodes::CH__STPDU_ESP_VehDyn_Stat1_AR2 = 1;
  		@sysvar::CH_Nodes::CH__STPDU_ESP_VehDyn_Stat2_AR2 = 1;
  		@sysvar::CH_Nodes::CH__STPDU_ESP_VehSpd_X_AR2 = 1;
  		@sysvar::CH_Nodes::CH__STPDU_ESP_Whl_Lt_Stat_AR2 = 1;
  		@sysvar::CH_Nodes::CH__STPDU_ESP_Whl_Rt_Stat_AR2 = 1;
  		@sysvar::CH_Nodes::CH__STPDU_ESP_WhlPlsCnt_TPM_AR2 = 1;
  		@sysvar::CH_Nodes::CH__STPDU_ESP_WUDOP_ESP_FR = 1;
  		@sysvar::CH_Nodes::CH__STPDU_ESP_YMAS_Rs_AR2 = 1;
  		@sysvar::CH_Nodes::CH__STPDU_FCW_CMS_PI_State_AR2 = 1;
  		@sysvar::CH_Nodes::CH__STPDU_FCW_FCW_Disp_Rq_Gw_AR = 1;
  		@sysvar::CH_Nodes::CH__STPDU_FCW_PT_ObjIntrst_AR2 = 1;
  		@sysvar::CH_Nodes::CH__STPDU_FCW_RDU_Disp_Rq_AR = 1;
  		@sysvar::CH_Nodes::CH__STPDU_FCW_ROE_RDU = 1;
  		@sysvar::CH_Nodes::CH__STPDU_FCW_SADR_Trgr_RDU_AR2 = 1;
  		@sysvar::CH_Nodes::CH__STPDU_FCW_VehAccel_X_Rq_AR2 = 1;
  		@sysvar::CH_Nodes::CH__STPDU_LRR_DTR_Obj_A_FR2 = 1;
  		@sysvar::CH_Nodes::CH__STPDU_LRR_DTR_Obj_B_FR2 = 1;
  		@sysvar::CH_Nodes::CH__STPDU_LRR_DTR_Obj_C_FR2 = 1;
  		@sysvar::CH_Nodes::CH__STPDU_LRR_DTR_Obj_D_FR2 = 1;
  		@sysvar::CH_Nodes::CH__STPDU_LRR_DTR_Obj_E_FR2 = 1;
  		@sysvar::CH_Nodes::CH__STPDU_LRR_DTR_Obj_F_FR2 = 1;
  		@sysvar::CH_Nodes::CH__STPDU_LRR_DTR_Obj_G_FR2 = 1;
  		@sysvar::CH_Nodes::CH__STPDU_LRR_DTR_ObjStat_FR2 = 1;
  		@sysvar::CH_Nodes::CH__STPDU_LRR_DTR_Polyg_Lt_FR2 = 1;
  		@sysvar::CH_Nodes::CH__STPDU_LRR_DTR_Polyg_Rt_FR2 = 1;
  		@sysvar::CH_Nodes::CH__STPDU_LRR_DTR_Stat_FR2 = 1;
  		@sysvar::CH_Nodes::CH__STPDU_LRR_ROE_LRR = 1;
  		@sysvar::CH_Nodes::CH__STPDU_MPC_Cam_Stat_AR2 = 1;
  		@sysvar::CH_Nodes::CH__STPDU_MPC_CamLane_Disp_Warn_Rq_Gw_AR2 = 1;
  		@sysvar::CH_Nodes::CH__STPDU_MPC_CamLane_FastAttr1_FR2 = 1;
  		@sysvar::CH_Nodes::CH__STPDU_MPC_CamLane_FastAttr2_FR2 = 1;
  		@sysvar::CH_Nodes::CH__STPDU_MPC_CamLane_LaneAttr1_Gw_AR2 = 1;
  		@sysvar::CH_Nodes::CH__STPDU_MPC_CamLane_LaneAttr2_Gw_AR2 = 1;
  		@sysvar::CH_Nodes::CH__STPDU_MPC_CamLane_LaneAttr3_Gw_AR2 = 1;
  		@sysvar::CH_Nodes::CH__STPDU_MPC_CamLane_LaneAttr4_FR2 = 1;
  		@sysvar::CH_Nodes::CH__STPDU_MPC_CamLane_LaneAttr5_FR2 = 1;
  		@sysvar::CH_Nodes::CH__STPDU_MPC_CamLane_LaneAttr6_Gw_AR2 = 1;
  		@sysvar::CH_Nodes::CH__STPDU_MPC_CamLane_LaneAttr7_Gw_AR2 = 1;
  		@sysvar::CH_Nodes::CH__STPDU_MPC_CamObj_A_Mtn_FR2 = 1;
  		@sysvar::CH_Nodes::CH__STPDU_MPC_CamObj_A_Posn_FR2 = 1;
  		@sysvar::CH_Nodes::CH__STPDU_MPC_CamObj_B_Mtn_FR2 = 1;
  		@sysvar::CH_Nodes::CH__STPDU_MPC_CamObj_B_Posn_FR2 = 1;
  		@sysvar::CH_Nodes::CH__STPDU_MPC_CamObj_C_Mtn_FR2 = 1;
  		@sysvar::CH_Nodes::CH__STPDU_MPC_CamObj_C_Posn_FR2 = 1;
  		@sysvar::CH_Nodes::CH__STPDU_MPC_IHC_Lgt_Stat_MPC_Gw_AR2 = 1;
  		@sysvar::CH_Nodes::CH__STPDU_MPC_IHC_Plus_HL_Stat_AR2 = 1;
  		@sysvar::CH_Nodes::CH__STPDU_MPC_IHC_Plus_Tunnel_3_4_AR2 = 1;
  		@sysvar::CH_Nodes::CH__STPDU_MPC_IHC_Plus_Tunnel_AR2 = 1;
  		@sysvar::CH_Nodes::CH__STPDU_MPC_Preview_Header1_FR2 = 1;
  		@sysvar::CH_Nodes::CH__STPDU_MPC_Preview_Header2_FR2 = 1;
  		@sysvar::CH_Nodes::CH__STPDU_MPC_Preview_ProfData1_FR2 = 1;
  		@sysvar::CH_Nodes::CH__STPDU_MPC_Preview_ProfData2_FR2 = 1;
  		@sysvar::CH_Nodes::CH__STPDU_MPC_ROE_SMPC = 1;
  		@sysvar::CH_Nodes::CH__STPDU_MPC_SPL_Obj1_Obj2_MPC_AR2 = 1;
  		@sysvar::CH_Nodes::CH__STPDU_MPC_TSA_Disp_Rq1_Gw_AR2 = 1;
  		@sysvar::CH_Nodes::CH__STPDU_MPC_TSA_Disp_Rq2_Gw_AR = 1;
  		@sysvar::CH_Nodes::CH__STPDU_MPC_TSA_Disp_Rq3_Gw_AR = 1;
  		@sysvar::CH_Nodes::CH__STPDU_MPC_YMAS_Rq_MPC_Gw_AR2 = 1;
  		@sysvar::CH_Nodes::CH__STPDU_PARK_Brk_Rq_PARK_AR2 = 1;
  		@sysvar::CH_Nodes::CH__STPDU_PARK_ECU_INFO_RVC_AR = 1;
  		@sysvar::CH_Nodes::CH__STPDU_PARK_Park_Disp_Rq_AR2 = 1;
  		@sysvar::CH_Nodes::CH__STPDU_PARK_Park_Set_Stat_AR2 = 1;
  		@sysvar::CH_Nodes::CH__STPDU_PARK_Park_Stat_AR2 = 1;
  		@sysvar::CH_Nodes::CH__STPDU_PARK_ParkSensObj_Stat1_FR2 = 1;
  		@sysvar::CH_Nodes::CH__STPDU_PARK_ParkSensObj_Stat2_FR2 = 1;
  		@sysvar::CH_Nodes::CH__STPDU_PARK_ParkSpaceMeas_Stat_AR = 1;
  		@sysvar::CH_Nodes::CH__STPDU_PARK_ParkWarn_AR2 = 1;
  		@sysvar::CH_Nodes::CH__STPDU_PARK_RemPark_Rq_AR2 = 1;
  		@sysvar::CH_Nodes::CH__STPDU_PARK_ROE_PARK = 1;
  		@sysvar::CH_Nodes::CH__STPDU_PARK_RVC_SVS_Park_Stat_AR2 = 1;
  		@sysvar::CH_Nodes::CH__STPDU_PARK_SADR_Trgr_PARK_AR2 = 1;
  		@sysvar::CH_Nodes::CH__STPDU_PARK_St_Rq_PARK_AR2 = 1;
  		@sysvar::CH_Nodes::CH__STPDU_RDU_BrkSys_Rq_YMAS_AR2 = 1;
  		@sysvar::CH_Nodes::CH__STPDU_RDU_BSM_Disp_Warn_Rq_Gw_AR2 = 1;
  		@sysvar::CH_Nodes::CH__STPDU_RDU_CMS_PI_Sd_Stat_MMR_F1_AR2 = 1;
  		@sysvar::CH_Nodes::CH__STPDU_RDU_CMS_PI_Sd_Stat_MMR_F4_AR2 = 1;
  		@sysvar::CH_Nodes::CH__STPDU_RDU_CMS_PI_State_AR2 = 1;
  		@sysvar::CH_Nodes::CH__STPDU_RDU_DTQ_Disp_Warn_Rq_AR2 = 1;
  		@sysvar::CH_Nodes::CH__STPDU_RDU_DTQ_Rq1_AR2 = 1;
  		@sysvar::CH_Nodes::CH__STPDU_RDU_DTQ_Rq2_AR2 = 1;
  		@sysvar::CH_Nodes::CH__STPDU_RDU_LDC_Disp_Rq_RDU_AR2 = 1;
  		@sysvar::CH_Nodes::CH__STPDU_RDU_LDP_Warn_Rq_AR2 = 1;
  		@sysvar::CH_Nodes::CH__STPDU_RDU_PT_ObjIntrst_AR2 = 1;
  		@sysvar::CH_Nodes::CH__STPDU_RDU_RDU_Disp_Rq_AR = 1;
  		@sysvar::CH_Nodes::CH__STPDU_RDU_RDU_GlobalAttr_AR2 = 1;
  		@sysvar::CH_Nodes::CH__STPDU_RDU_RDU_Stat1_AR = 1;
  		@sysvar::CH_Nodes::CH__STPDU_RDU_ROE_MMR_F1 = 1;
  		@sysvar::CH_Nodes::CH__STPDU_RDU_ROE_MMR_F4 = 1;
  		@sysvar::CH_Nodes::CH__STPDU_RDU_ROE_MMR_RM = 1;
  		@sysvar::CH_Nodes::CH__STPDU_RDU_ROE_MMR_RS = 1;
  		@sysvar::CH_Nodes::CH__STPDU_RDU_ROE_RDU = 1;
  		@sysvar::CH_Nodes::CH__STPDU_RDU_SADR_Trgr_RDU_AR2 = 1;
  		@sysvar::CH_Nodes::CH__STPDU_RDU_SCS_Stat1_RDU_AR2 = 1;
  		@sysvar::CH_Nodes::CH__STPDU_RDU_SCS_Stat2_RDU_AR2 = 1;
  		@sysvar::CH_Nodes::CH__STPDU_RDU_Veh_Stat_RDU_FR2 = 1;
  		@sysvar::CH_Nodes::CH__STPDU_RDU_VehAccel_X_Rq_AR2 = 1;
  		@sysvar::CH_Nodes::CH__STPDU_SCCM_LDC_Rq_StWhl_AR2 = 1;
  		@sysvar::CH_Nodes::CH__STPDU_SCCM_LDC_SBW_Rq_SCCM_AR2 = 1;
  		@sysvar::CH_Nodes::CH__STPDU_SCCM_ROE_SCCM = 1;
  		@sysvar::CH_Nodes::CH__STPDU_SCCM_ROE_SWSP = 1;
  		@sysvar::CH_Nodes::CH__STPDU_SCCM_SCCM_Sw_Stat_AR2 = 1;
  		@sysvar::CH_Nodes::CH__STPDU_SCCM_StWhl_Angl_Stat_AR2 = 1;
  		@sysvar::CH_Nodes::CH__STPDU_SCCM_StWhl_OFN_Stat_AR2 = 1;
  		@sysvar::CH_Nodes::CH__STPDU_SCCM_StWhl_Sw_Stat_AR2 = 1;
  		@sysvar::CH_Nodes::CH__STPDU_SCCM_WUDOP_SCCM_FR = 1;
  		@sysvar::CH_Nodes::CH__STPDU_SDTR_CMS_PI_State_AR2 = 1;
  		@sysvar::CH_Nodes::CH__STPDU_SDTR_LDC_Disp_Rq_RDU_AR2 = 1;
  		@sysvar::CH_Nodes::CH__STPDU_SDTR_PT_ObjIntrst_AR2 = 1;
  		@sysvar::CH_Nodes::CH__STPDU_SDTR_RDU_Disp_Rq_AR = 1;
  		@sysvar::CH_Nodes::CH__STPDU_SDTR_RDU_Stat1_AR = 1;
  		@sysvar::CH_Nodes::CH__STPDU_SDTR_ROE_RDU = 1;
  		@sysvar::CH_Nodes::CH__STPDU_SDTR_SADR_Trgr_RDU_AR2 = 1;
  		@sysvar::CH_Nodes::CH__STPDU_SDTR_VehAccel_X_Rq_AR2 = 1;
  		@sysvar::CH_Nodes::CH__STPDU_SPC_Eng_Rq_ABC_AR2 = 1;
  		@sysvar::CH_Nodes::CH__STPDU_SPC_OffRoad_Disp_Rq_AR = 1;
  		@sysvar::CH_Nodes::CH__STPDU_SPC_Preview_Data_SPC_AR = 1;
  		@sysvar::CH_Nodes::CH__STPDU_SPC_ROE_MPU_FL = 1;
  		@sysvar::CH_Nodes::CH__STPDU_SPC_ROE_MPU_FR = 1;
  		@sysvar::CH_Nodes::CH__STPDU_SPC_ROE_MPU_RL = 1;
  		@sysvar::CH_Nodes::CH__STPDU_SPC_ROE_MPU_RR = 1;
  		@sysvar::CH_Nodes::CH__STPDU_SPC_ROE_SPC = 1;
  		@sysvar::CH_Nodes::CH__STPDU_SPC_SPC_Disp_Rq_AR = 1;
  		@sysvar::CH_Nodes::CH__STPDU_SPC_SPC_SwLED_Msg_Rq_AR2 = 1;
  		@sysvar::CH_Nodes::CH__STPDU_SPC_SpringVlv_Rq_AR = 1;
  		@sysvar::CH_Nodes::CH__STPDU_SPC_VehCarv_Stat_AR = 1;
  		@sysvar::CH_Nodes::CH__STPDU_SPC_VehLvl_Stat_AR2 = 1;
  		@sysvar::CH_Nodes::CH__STPDU_SPC_VX_ROE_SPC_VX = 1;
  		@sysvar::CH_Nodes::CH__STPDU_SPC_VX_SPC_VX_Stat1_AR = 1;
  		@sysvar::CH_Nodes::CH__STPDU_SPC_VX_SpringVlv_Stat_AR = 1;
	}
}
/*@@end*/

/*@@timer:Timer_AWD_TCASE_Disp_Rq_AR2_ReceiptPDU:*/
on timer Timer_AWD_TCASEAWD_TCASE_Disp_Rq_AR2_ReceiptPDU
{
	//cyclic, dual cycle und cyclicandchange
	@sysvar::CH_Nodes::CH__PDURECEIPT_RECEIVE_AWD_TCASE_AWD_TCASE_Disp_Rq_AR2 = 1;
}
/*@@end*/
/*@@timer:Timer_AWD_TCASE_Stat1_AR2_ReceiptPDU:*/
on timer Timer_AWD_TCASEAWD_TCASE_Stat1_AR2_ReceiptPDU
{
	//cyclic, dual cycle und cyclicandchange
	@sysvar::CH_Nodes::CH__PDURECEIPT_RECEIVE_AWD_TCASE_AWD_TCASE_Stat1_AR2 = 1;
}
/*@@end*/
/*@@timer:Timer_AWD_TCASE_Stat2_AR2_ReceiptPDU:*/
on timer Timer_AWD_TCASEAWD_TCASE_Stat2_AR2_ReceiptPDU
{
	//cyclic, dual cycle und cyclicandchange
	@sysvar::CH_Nodes::CH__PDURECEIPT_RECEIVE_AWD_TCASE_AWD_TCASE_Stat2_AR2 = 1;
}
/*@@end*/
/*@@timer:Timer_ROE_AWD_TCASE_ReceiptPDU:*/
on timer Timer_AWD_TCASEROE_AWD_TCASE_ReceiptPDU
{
	//BAF, spontaneous und onchange
	@sysvar::CH_Nodes::CH__PDURECEIPT_RECEIVE_AWD_TCASE_ROE_AWD_TCASE = 2;
}
/*@@end*/
/*@@timer:Timer_Adblue_Disp_Rq_AR_ReceiptPDU:*/
on timer Timer_CPCAdblue_Disp_Rq_AR_ReceiptPDU
{
	//cyclic, dual cycle und cyclicandchange
	@sysvar::CH_Nodes::CH__PDURECEIPT_RECEIVE_CPC_Adblue_Disp_Rq_AR = 1;
}
/*@@end*/
/*@@timer:Timer_Adblue_Disp_Warn_Rq_AR_ReceiptPDU:*/
on timer Timer_CPCAdblue_Disp_Warn_Rq_AR_ReceiptPDU
{
	//cyclic, dual cycle und cyclicandchange
	@sysvar::CH_Nodes::CH__PDURECEIPT_RECEIVE_CPC_Adblue_Disp_Warn_Rq_AR = 1;
}
/*@@end*/
/*@@timer:Timer_Assyst_Stat2_AR_ReceiptPDU:*/
on timer Timer_CPCAssyst_Stat2_AR_ReceiptPDU
{
	//cyclic, dual cycle und cyclicandchange
	@sysvar::CH_Nodes::CH__PDURECEIPT_RECEIVE_CPC_Assyst_Stat2_AR = 1;
}
/*@@end*/
/*@@timer:Timer_Assyst_Stat3_AR2_ReceiptPDU:*/
on timer Timer_CPCAssyst_Stat3_AR2_ReceiptPDU
{
	//cyclic, dual cycle und cyclicandchange
	@sysvar::CH_Nodes::CH__PDURECEIPT_RECEIVE_CPC_Assyst_Stat3_AR2 = 1;
}
/*@@end*/
/*@@timer:Timer_Assyst_Stat_AR_ReceiptPDU:*/
on timer Timer_CPCAssyst_Stat_AR_ReceiptPDU
{
	//cyclic, dual cycle und cyclicandchange
	@sysvar::CH_Nodes::CH__PDURECEIPT_RECEIVE_CPC_Assyst_Stat_AR = 1;
}
/*@@end*/
/*@@timer:Timer_CNG_Disp_Rq_AR2_ReceiptPDU:*/
on timer Timer_CPCCNG_Disp_Rq_AR2_ReceiptPDU
{
	//cyclic, dual cycle und cyclicandchange
	@sysvar::CH_Nodes::CH__PDURECEIPT_RECEIVE_CPC_CNG_Disp_Rq_AR2 = 1;
}
/*@@end*/
/*@@timer:Timer_CPC_CHASSIS_R1_AR2_ReceiptPDU:*/
on timer Timer_CPCCPC_CHASSIS_R1_AR2_ReceiptPDU
{
	//cyclic, dual cycle und cyclicandchange
	@sysvar::CH_Nodes::CH__PDURECEIPT_RECEIVE_CPC_CPC_CHASSIS_R1_AR2 = 1;
}
/*@@end*/
/*@@timer:Timer_CPC_CHASSIS_R2_AR2_ReceiptPDU:*/
on timer Timer_CPCCPC_CHASSIS_R2_AR2_ReceiptPDU
{
	//cyclic, dual cycle und cyclicandchange
	@sysvar::CH_Nodes::CH__PDURECEIPT_RECEIVE_CPC_CPC_CHASSIS_R2_AR2 = 1;
}
/*@@end*/
/*@@timer:Timer_DCDC1_Rs1_AR2_ReceiptPDU:*/
on timer Timer_CPCDCDC1_Rs1_AR2_ReceiptPDU
{
	//cyclic, dual cycle und cyclicandchange
	@sysvar::CH_Nodes::CH__PDURECEIPT_RECEIVE_CPC_DCDC1_Rs1_AR2 = 1;
}
/*@@end*/
/*@@timer:Timer_DPC_PT_Rs_AR_ReceiptPDU:*/
on timer Timer_CPCDPC_PT_Rs_AR_ReceiptPDU
{
	//cyclic, dual cycle und cyclicandchange
	@sysvar::CH_Nodes::CH__PDURECEIPT_RECEIVE_CPC_DPC_PT_Rs_AR = 1;
}
/*@@end*/
/*@@timer:Timer_ECM_DAC4_AR_ReceiptPDU:*/
on timer Timer_CPCECM_DAC4_AR_ReceiptPDU
{
	//BAF, spontaneous und onchange
	@sysvar::CH_Nodes::CH__PDURECEIPT_RECEIVE_CPC_ECM_DAC4_AR = 2;
}
/*@@end*/
/*@@timer:Timer_ECO_Homepage_Data_ReceiptPDU:*/
on timer Timer_CPCECO_Homepage_Data_ReceiptPDU
{
	//cyclic, dual cycle und cyclicandchange
	@sysvar::CH_Nodes::CH__PDURECEIPT_RECEIVE_CPC_ECO_Homepage_Data = 1;
}
/*@@end*/
/*@@timer:Timer_ECO_Score_Disp_Rq_AR_ReceiptPDU:*/
on timer Timer_CPCECO_Score_Disp_Rq_AR_ReceiptPDU
{
	//cyclic, dual cycle und cyclicandchange
	@sysvar::CH_Nodes::CH__PDURECEIPT_RECEIVE_CPC_ECO_Score_Disp_Rq_AR = 1;
}
/*@@end*/
/*@@timer:Timer_EM01_Stat1_AR2_ReceiptPDU:*/
on timer Timer_CPCEM01_Stat1_AR2_ReceiptPDU
{
	//cyclic, dual cycle und cyclicandchange
	@sysvar::CH_Nodes::CH__PDURECEIPT_RECEIVE_CPC_EM01_Stat1_AR2 = 1;
}
/*@@end*/
/*@@timer:Timer_EM01_Stat2_AR2_ReceiptPDU:*/
on timer Timer_CPCEM01_Stat2_AR2_ReceiptPDU
{
	//cyclic, dual cycle und cyclicandchange
	@sysvar::CH_Nodes::CH__PDURECEIPT_RECEIVE_CPC_EM01_Stat2_AR2 = 1;
}
/*@@end*/
/*@@timer:Timer_EM01_Trq_Rs_AR2_ReceiptPDU:*/
on timer Timer_CPCEM01_Trq_Rs_AR2_ReceiptPDU
{
	//cyclic, dual cycle und cyclicandchange
	@sysvar::CH_Nodes::CH__PDURECEIPT_RECEIVE_CPC_EM01_Trq_Rs_AR2 = 1;
}
/*@@end*/
/*@@timer:Timer_EM_DAC4_AR_ReceiptPDU:*/
on timer Timer_CPCEM_DAC4_AR_ReceiptPDU
{
	//BAF, spontaneous und onchange
	@sysvar::CH_Nodes::CH__PDURECEIPT_RECEIVE_CPC_EM_DAC4_AR = 2;
}
/*@@end*/
/*@@timer:Timer_EMM_Data1_AR2_ReceiptPDU:*/
on timer Timer_CPCEMM_Data1_AR2_ReceiptPDU
{
	//cyclic, dual cycle und cyclicandchange
	@sysvar::CH_Nodes::CH__PDURECEIPT_RECEIVE_CPC_EMM_Data1_AR2 = 1;
}
/*@@end*/
/*@@timer:Timer_EnergyMngmnt_PreCond_Stat_AR2_ReceiptPDU:*/
on timer Timer_CPCEnergyMngmnt_PreCond_Stat_AR2_ReceiptPDU
{
	//cyclic, dual cycle und cyclicandchange
	@sysvar::CH_Nodes::CH__PDURECEIPT_RECEIVE_CPC_EnergyMngmnt_PreCond_Stat_AR2 = 1;
}
/*@@end*/
/*@@timer:Timer_Eng_Rs_1_AR2_ReceiptPDU:*/
on timer Timer_CPCEng_Rs_1_AR2_ReceiptPDU
{
	//cyclic, dual cycle und cyclicandchange
	@sysvar::CH_Nodes::CH__PDURECEIPT_RECEIVE_CPC_Eng_Rs_1_AR2 = 1;
}
/*@@end*/
/*@@timer:Timer_Eng_Rs_2_AR2_ReceiptPDU:*/
on timer Timer_CPCEng_Rs_2_AR2_ReceiptPDU
{
	//cyclic, dual cycle und cyclicandchange
	@sysvar::CH_Nodes::CH__PDURECEIPT_RECEIVE_CPC_Eng_Rs_2_AR2 = 1;
}
/*@@end*/
/*@@timer:Timer_Eng_Rs_3_AR2_ReceiptPDU:*/
on timer Timer_CPCEng_Rs_3_AR2_ReceiptPDU
{
	//cyclic, dual cycle und cyclicandchange
	@sysvar::CH_Nodes::CH__PDURECEIPT_RECEIVE_CPC_Eng_Rs_3_AR2 = 1;
}
/*@@end*/
/*@@timer:Timer_Eng_Rs_EM_AR2_ReceiptPDU:*/
on timer Timer_CPCEng_Rs_EM_AR2_ReceiptPDU
{
	//cyclic, dual cycle und cyclicandchange
	@sysvar::CH_Nodes::CH__PDURECEIPT_RECEIVE_CPC_Eng_Rs_EM_AR2 = 1;
}
/*@@end*/
/*@@timer:Timer_Eng_Rs_EngCtrl_AR2_ReceiptPDU:*/
on timer Timer_CPCEng_Rs_EngCtrl_AR2_ReceiptPDU
{
	//cyclic, dual cycle und cyclicandchange
	@sysvar::CH_Nodes::CH__PDURECEIPT_RECEIVE_CPC_Eng_Rs_EngCtrl_AR2 = 1;
}
/*@@end*/
/*@@timer:Timer_EngCtrl_Disp_Rq_AR2_ReceiptPDU:*/
on timer Timer_CPCEngCtrl_Disp_Rq_AR2_ReceiptPDU
{
	//cyclic, dual cycle und cyclicandchange
	@sysvar::CH_Nodes::CH__PDURECEIPT_RECEIVE_CPC_EngCtrl_Disp_Rq_AR2 = 1;
}
/*@@end*/
/*@@timer:Timer_EngCtrl_OBD1_AR_ReceiptPDU:*/
on timer Timer_CPCEngCtrl_OBD1_AR_ReceiptPDU
{
	//cyclic, dual cycle und cyclicandchange
	@sysvar::CH_Nodes::CH__PDURECEIPT_RECEIVE_CPC_EngCtrl_OBD1_AR = 1;
}
/*@@end*/
/*@@timer:Timer_EngCtrl_Stat_AR2_ReceiptPDU:*/
on timer Timer_CPCEngCtrl_Stat_AR2_ReceiptPDU
{
	//cyclic, dual cycle und cyclicandchange
	@sysvar::CH_Nodes::CH__PDURECEIPT_RECEIVE_CPC_EngCtrl_Stat_AR2 = 1;
}
/*@@end*/
/*@@timer:Timer_ESP_OBD_Data_AR_ReceiptPDU:*/
on timer Timer_CPCESP_OBD_Data_AR_ReceiptPDU
{
	//cyclic, dual cycle und cyclicandchange
	@sysvar::CH_Nodes::CH__PDURECEIPT_RECEIVE_CPC_ESP_OBD_Data_AR = 1;
}
/*@@end*/
/*@@timer:Timer_Fuel_Stat2_AR2_ReceiptPDU:*/
on timer Timer_CPCFuel_Stat2_AR2_ReceiptPDU
{
	//cyclic, dual cycle und cyclicandchange
	@sysvar::CH_Nodes::CH__PDURECEIPT_RECEIVE_CPC_Fuel_Stat2_AR2 = 1;
}
/*@@end*/
/*@@timer:Timer_FuelLvl_Stat_AR2_ReceiptPDU:*/
on timer Timer_CPCFuelLvl_Stat_AR2_ReceiptPDU
{
	//cyclic, dual cycle und cyclicandchange
	@sysvar::CH_Nodes::CH__PDURECEIPT_RECEIVE_CPC_FuelLvl_Stat_AR2 = 1;
}
/*@@end*/
/*@@timer:Timer_HumanMachineIfc_AR2_ReceiptPDU:*/
on timer Timer_CPCHumanMachineIfc_AR2_ReceiptPDU
{
	//cyclic, dual cycle und cyclicandchange
	@sysvar::CH_Nodes::CH__PDURECEIPT_RECEIVE_CPC_HumanMachineIfc_AR2 = 1;
}
/*@@end*/
/*@@timer:Timer_HumanMachineIfc_Rq_AR_ReceiptPDU:*/
on timer Timer_CPCHumanMachineIfc_Rq_AR_ReceiptPDU
{
	//cyclic, dual cycle und cyclicandchange
	@sysvar::CH_Nodes::CH__PDURECEIPT_RECEIVE_CPC_HumanMachineIfc_Rq_AR = 1;
}
/*@@end*/
/*@@timer:Timer_ISM_DAC4_AR_ReceiptPDU:*/
on timer Timer_CPCISM_DAC4_AR_ReceiptPDU
{
	//BAF, spontaneous und onchange
	@sysvar::CH_Nodes::CH__PDURECEIPT_RECEIVE_CPC_ISM_DAC4_AR = 2;
}
/*@@end*/
/*@@timer:Timer_OBL_DC_Output_AR_ReceiptPDU:*/
on timer Timer_CPCOBL_DC_Output_AR_ReceiptPDU
{
	//cyclic, dual cycle und cyclicandchange
	@sysvar::CH_Nodes::CH__PDURECEIPT_RECEIVE_CPC_OBL_DC_Output_AR = 1;
}
/*@@end*/
/*@@timer:Timer_PARK_Drv_Rs_TCM_AR2_ReceiptPDU:*/
on timer Timer_CPCPARK_Drv_Rs_TCM_AR2_ReceiptPDU
{
	//cyclic, dual cycle und cyclicandchange
	@sysvar::CH_Nodes::CH__PDURECEIPT_RECEIVE_CPC_PARK_Drv_Rs_TCM_AR2 = 1;
}
/*@@end*/
/*@@timer:Timer_PN14_Gen_Rs_AR_ReceiptPDU:*/
on timer Timer_CPCPN14_Gen_Rs_AR_ReceiptPDU
{
	//cyclic, dual cycle und cyclicandchange
	@sysvar::CH_Nodes::CH__PDURECEIPT_RECEIVE_CPC_PN14_Gen_Rs_AR = 1;
}
/*@@end*/
/*@@timer:Timer_PNHV_BMS_Stat_AR2_ReceiptPDU:*/
on timer Timer_CPCPNHV_BMS_Stat_AR2_ReceiptPDU
{
	//cyclic, dual cycle und cyclicandchange
	@sysvar::CH_Nodes::CH__PDURECEIPT_RECEIVE_CPC_PNHV_BMS_Stat_AR2 = 1;
}
/*@@end*/
/*@@timer:Timer_PNHV_EnergyMngmnt_Disp_Rq_AR_ReceiptPDU:*/
on timer Timer_CPCPNHV_EnergyMngmnt_Disp_Rq_AR_ReceiptPDU
{
	//cyclic, dual cycle und cyclicandchange
	@sysvar::CH_Nodes::CH__PDURECEIPT_RECEIVE_CPC_PNHV_EnergyMngmnt_Disp_Rq_AR = 1;
}
/*@@end*/
/*@@timer:Timer_PNHV_EnergyMngmnt_Stat2_AR2_ReceiptPDU:*/
on timer Timer_CPCPNHV_EnergyMngmnt_Stat2_AR2_ReceiptPDU
{
	//cyclic, dual cycle und cyclicandchange
	@sysvar::CH_Nodes::CH__PDURECEIPT_RECEIVE_CPC_PNHV_EnergyMngmnt_Stat2_AR2 = 1;
}
/*@@end*/
/*@@timer:Timer_PNHV_EnergyMngmnt_Stat3_AR2_ReceiptPDU:*/
on timer Timer_CPCPNHV_EnergyMngmnt_Stat3_AR2_ReceiptPDU
{
	//cyclic, dual cycle und cyclicandchange
	@sysvar::CH_Nodes::CH__PDURECEIPT_RECEIVE_CPC_PNHV_EnergyMngmnt_Stat3_AR2 = 1;
}
/*@@end*/
/*@@timer:Timer_PNHV_EnergyMngmntSet_Rs1_AR2_ReceiptPDU:*/
on timer Timer_CPCPNHV_EnergyMngmntSet_Rs1_AR2_ReceiptPDU
{
	//cyclic, dual cycle und cyclicandchange
	@sysvar::CH_Nodes::CH__PDURECEIPT_RECEIVE_CPC_PNHV_EnergyMngmntSet_Rs1_AR2 = 1;
}
/*@@end*/
/*@@timer:Timer_PNHV_EnergyMngmntSet_Rs2_AR_ReceiptPDU:*/
on timer Timer_CPCPNHV_EnergyMngmntSet_Rs2_AR_ReceiptPDU
{
	//cyclic, dual cycle und cyclicandchange
	@sysvar::CH_Nodes::CH__PDURECEIPT_RECEIVE_CPC_PNHV_EnergyMngmntSet_Rs2_AR = 1;
}
/*@@end*/
/*@@timer:Timer_PNHV_Stat_AR2_ReceiptPDU:*/
on timer Timer_CPCPNHV_Stat_AR2_ReceiptPDU
{
	//cyclic, dual cycle und cyclicandchange
	@sysvar::CH_Nodes::CH__PDURECEIPT_RECEIVE_CPC_PNHV_Stat_AR2 = 1;
}
/*@@end*/
/*@@timer:Timer_PNHV_WeekDepTmTbl_Stat_AR2_ReceiptPDU:*/
on timer Timer_CPCPNHV_WeekDepTmTbl_Stat_AR2_ReceiptPDU
{
	//BAF, spontaneous und onchange
	@sysvar::CH_Nodes::CH__PDURECEIPT_RECEIVE_CPC_PNHV_WeekDepTmTbl_Stat_AR2 = 2;
}
/*@@end*/
/*@@timer:Timer_PT_DataContain_Rq_AR2_ReceiptPDU:*/
on timer Timer_CPCPT_DataContain_Rq_AR2_ReceiptPDU
{
	//cyclic, dual cycle und cyclicandchange
	@sysvar::CH_Nodes::CH__PDURECEIPT_RECEIVE_CPC_PT_DataContain_Rq_AR2 = 1;
}
/*@@end*/
/*@@timer:Timer_PT_Disp_Rq2_AR_ReceiptPDU:*/
on timer Timer_CPCPT_Disp_Rq2_AR_ReceiptPDU
{
	//cyclic, dual cycle und cyclicandchange
	@sysvar::CH_Nodes::CH__PDURECEIPT_RECEIVE_CPC_PT_Disp_Rq2_AR = 1;
}
/*@@end*/
/*@@timer:Timer_PT_ThermM_AR2_ReceiptPDU:*/
on timer Timer_CPCPT_ThermM_AR2_ReceiptPDU
{
	//cyclic, dual cycle und cyclicandchange
	@sysvar::CH_Nodes::CH__PDURECEIPT_RECEIVE_CPC_PT_ThermM_AR2 = 1;
}
/*@@end*/
/*@@timer:Timer_PT_ThermM_Rq_AR2_ReceiptPDU:*/
on timer Timer_CPCPT_ThermM_Rq_AR2_ReceiptPDU
{
	//cyclic, dual cycle und cyclicandchange
	@sysvar::CH_Nodes::CH__PDURECEIPT_RECEIVE_CPC_PT_ThermM_Rq_AR2 = 1;
}
/*@@end*/
/*@@timer:Timer_PtHyb_Mngmnt_Rq1_AR_ReceiptPDU:*/
on timer Timer_CPCPtHyb_Mngmnt_Rq1_AR_ReceiptPDU
{
	//cyclic, dual cycle und cyclicandchange
	@sysvar::CH_Nodes::CH__PDURECEIPT_RECEIVE_CPC_PtHyb_Mngmnt_Rq1_AR = 1;
}
/*@@end*/
/*@@timer:Timer_PtMngmnt_Disp_Rq_AR2_ReceiptPDU:*/
on timer Timer_CPCPtMngmnt_Disp_Rq_AR2_ReceiptPDU
{
	//cyclic, dual cycle und cyclicandchange
	@sysvar::CH_Nodes::CH__PDURECEIPT_RECEIVE_CPC_PtMngmnt_Disp_Rq_AR2 = 1;
}
/*@@end*/
/*@@timer:Timer_PtMngmnt_Rq_AR2_ReceiptPDU:*/
on timer Timer_CPCPtMngmnt_Rq_AR2_ReceiptPDU
{
	//cyclic, dual cycle und cyclicandchange
	@sysvar::CH_Nodes::CH__PDURECEIPT_RECEIVE_CPC_PtMngmnt_Rq_AR2 = 1;
}
/*@@end*/
/*@@timer:Timer_PtMngmnt_Stat2_AR2_ReceiptPDU:*/
on timer Timer_CPCPtMngmnt_Stat2_AR2_ReceiptPDU
{
	//cyclic, dual cycle und cyclicandchange
	@sysvar::CH_Nodes::CH__PDURECEIPT_RECEIVE_CPC_PtMngmnt_Stat2_AR2 = 1;
}
/*@@end*/
/*@@timer:Timer_PtMngmnt_Stat_AR2_ReceiptPDU:*/
on timer Timer_CPCPtMngmnt_Stat_AR2_ReceiptPDU
{
	//cyclic, dual cycle und cyclicandchange
	@sysvar::CH_Nodes::CH__PDURECEIPT_RECEIVE_CPC_PtMngmnt_Stat_AR2 = 1;
}
/*@@end*/
/*@@timer:Timer_SBW_DrvPosn_Disp_Rq_ISM_AR2_ReceiptPDU:*/
on timer Timer_CPCSBW_DrvPosn_Disp_Rq_ISM_AR2_ReceiptPDU
{
	//cyclic, dual cycle und cyclicandchange
	@sysvar::CH_Nodes::CH__PDURECEIPT_RECEIVE_CPC_SBW_DrvPosn_Disp_Rq_ISM_AR2 = 1;
}
/*@@end*/
/*@@timer:Timer_SBW_DrvPosn_Disp_Rq_TCM_AR2_ReceiptPDU:*/
on timer Timer_CPCSBW_DrvPosn_Disp_Rq_TCM_AR2_ReceiptPDU
{
	//cyclic, dual cycle und cyclicandchange
	@sysvar::CH_Nodes::CH__PDURECEIPT_RECEIVE_CPC_SBW_DrvPosn_Disp_Rq_TCM_AR2 = 1;
}
/*@@end*/
/*@@timer:Timer_SBW_Stat_AR2_ReceiptPDU:*/
on timer Timer_CPCSBW_Stat_AR2_ReceiptPDU
{
	//cyclic, dual cycle und cyclicandchange
	@sysvar::CH_Nodes::CH__PDURECEIPT_RECEIVE_CPC_SBW_Stat_AR2 = 1;
}
/*@@end*/
/*@@timer:Timer_SND_GEN_Stat_AR_ReceiptPDU:*/
on timer Timer_CPCSND_GEN_Stat_AR_ReceiptPDU
{
	//cyclic, dual cycle und cyclicandchange
	@sysvar::CH_Nodes::CH__PDURECEIPT_RECEIVE_CPC_SND_GEN_Stat_AR = 1;
}
/*@@end*/
/*@@timer:Timer_TC_Disp_Rq_ECM_AR_ReceiptPDU:*/
on timer Timer_CPCTC_Disp_Rq_ECM_AR_ReceiptPDU
{
	//cyclic, dual cycle und cyclicandchange
	@sysvar::CH_Nodes::CH__PDURECEIPT_RECEIVE_CPC_TC_Disp_Rq_ECM_AR = 1;
}
/*@@end*/
/*@@timer:Timer_TC_EBBC_Disp_Rq_ECM_AR_ReceiptPDU:*/
on timer Timer_CPCTC_EBBC_Disp_Rq_ECM_AR_ReceiptPDU
{
	//cyclic, dual cycle und cyclicandchange
	@sysvar::CH_Nodes::CH__PDURECEIPT_RECEIVE_CPC_TC_EBBC_Disp_Rq_ECM_AR = 1;
}
/*@@end*/
/*@@timer:Timer_TC_EEBBC_Disp_Rq_AR_ReceiptPDU:*/
on timer Timer_CPCTC_EEBBC_Disp_Rq_AR_ReceiptPDU
{
	//cyclic, dual cycle und cyclicandchange
	@sysvar::CH_Nodes::CH__PDURECEIPT_RECEIVE_CPC_TC_EEBBC_Disp_Rq_AR = 1;
}
/*@@end*/
/*@@timer:Timer_TCM_DAC4_AR_ReceiptPDU:*/
on timer Timer_CPCTCM_DAC4_AR_ReceiptPDU
{
	//BAF, spontaneous und onchange
	@sysvar::CH_Nodes::CH__PDURECEIPT_RECEIVE_CPC_TCM_DAC4_AR = 2;
}
/*@@end*/
/*@@timer:Timer_TCM_Data2_AR2_ReceiptPDU:*/
on timer Timer_CPCTCM_Data2_AR2_ReceiptPDU
{
	//cyclic, dual cycle und cyclicandchange
	@sysvar::CH_Nodes::CH__PDURECEIPT_RECEIVE_CPC_TCM_Data2_AR2 = 1;
}
/*@@end*/
/*@@timer:Timer_TCM_Data3_AR2_ReceiptPDU:*/
on timer Timer_CPCTCM_Data3_AR2_ReceiptPDU
{
	//cyclic, dual cycle und cyclicandchange
	@sysvar::CH_Nodes::CH__PDURECEIPT_RECEIVE_CPC_TCM_Data3_AR2 = 1;
}
/*@@end*/
/*@@timer:Timer_TCM_Disp_Rq_AMG_AR_ReceiptPDU:*/
on timer Timer_CPCTCM_Disp_Rq_AMG_AR_ReceiptPDU
{
	//cyclic, dual cycle und cyclicandchange
	@sysvar::CH_Nodes::CH__PDURECEIPT_RECEIVE_CPC_TCM_Disp_Rq_AMG_AR = 1;
}
/*@@end*/
/*@@timer:Timer_TCM_State3_AR2_ReceiptPDU:*/
on timer Timer_CPCTCM_State3_AR2_ReceiptPDU
{
	//cyclic, dual cycle und cyclicandchange
	@sysvar::CH_Nodes::CH__PDURECEIPT_RECEIVE_CPC_TCM_State3_AR2 = 1;
}
/*@@end*/
/*@@timer:Timer_TCU_Disp_Rq_AR2_ReceiptPDU:*/
on timer Timer_CPCTCU_Disp_Rq_AR2_ReceiptPDU
{
	//cyclic, dual cycle und cyclicandchange
	@sysvar::CH_Nodes::CH__PDURECEIPT_RECEIVE_CPC_TCU_Disp_Rq_AR2 = 1;
}
/*@@end*/
/*@@timer:Timer_ThermMngmnt_1_AR2_ReceiptPDU:*/
on timer Timer_CPCThermMngmnt_1_AR2_ReceiptPDU
{
	//cyclic, dual cycle und cyclicandchange
	@sysvar::CH_Nodes::CH__PDURECEIPT_RECEIVE_CPC_ThermMngmnt_1_AR2 = 1;
}
/*@@end*/
/*@@timer:Timer_ThermMngmnt_4_AR_ReceiptPDU:*/
on timer Timer_CPCThermMngmnt_4_AR_ReceiptPDU
{
	//cyclic, dual cycle und cyclicandchange
	@sysvar::CH_Nodes::CH__PDURECEIPT_RECEIVE_CPC_ThermMngmnt_4_AR = 1;
}
/*@@end*/
/*@@timer:Timer_ThermMngmnt_EV_1_AR2_ReceiptPDU:*/
on timer Timer_CPCThermMngmnt_EV_1_AR2_ReceiptPDU
{
	//cyclic, dual cycle und cyclicandchange
	@sysvar::CH_Nodes::CH__PDURECEIPT_RECEIVE_CPC_ThermMngmnt_EV_1_AR2 = 1;
}
/*@@end*/
/*@@timer:Timer_VehPwrMngmnt_EMM_Stat2_AR2_ReceiptPDU:*/
on timer Timer_CPCVehPwrMngmnt_EMM_Stat2_AR2_ReceiptPDU
{
	//cyclic, dual cycle und cyclicandchange
	@sysvar::CH_Nodes::CH__PDURECEIPT_RECEIVE_CPC_VehPwrMngmnt_EMM_Stat2_AR2 = 1;
}
/*@@end*/
/*@@timer:Timer_VehPwrMngmnt_Rq_AR_ReceiptPDU:*/
on timer Timer_CPCVehPwrMngmnt_Rq_AR_ReceiptPDU
{
	//cyclic, dual cycle und cyclicandchange
	@sysvar::CH_Nodes::CH__PDURECEIPT_RECEIVE_CPC_VehPwrMngmnt_Rq_AR = 1;
}
/*@@end*/
/*@@timer:Timer_WIA_EngTrq_AR_ReceiptPDU:*/
on timer Timer_CPCWIA_EngTrq_AR_ReceiptPDU
{
	//cyclic, dual cycle und cyclicandchange
	@sysvar::CH_Nodes::CH__PDURECEIPT_RECEIVE_CPC_WIA_EngTrq_AR = 1;
}
/*@@end*/
/*@@timer:Timer_WPT_Stat2_AR2_ReceiptPDU:*/
on timer Timer_CPCWPT_Stat2_AR2_ReceiptPDU
{
	//cyclic, dual cycle und cyclicandchange
	@sysvar::CH_Nodes::CH__PDURECEIPT_RECEIVE_CPC_WPT_Stat2_AR2 = 1;
}
/*@@end*/
/*@@timer:Timer_DPC_Disp_Rq_AMG_AR2_ReceiptPDU:*/
on timer Timer_DRVUDPC_Disp_Rq_AMG_AR2_ReceiptPDU
{
	//cyclic, dual cycle und cyclicandchange
	@sysvar::CH_Nodes::CH__PDURECEIPT_RECEIVE_DRVU_DPC_Disp_Rq_AMG_AR2 = 1;
}
/*@@end*/
/*@@timer:Timer_DPC_IndMd_Stat_AMG_AR2_ReceiptPDU:*/
on timer Timer_DRVUDPC_IndMd_Stat_AMG_AR2_ReceiptPDU
{
	//cyclic, dual cycle und cyclicandchange
	@sysvar::CH_Nodes::CH__PDURECEIPT_RECEIVE_DRVU_DPC_IndMd_Stat_AMG_AR2 = 1;
}
/*@@end*/
/*@@timer:Timer_DPC_IndMd_Style2_AMG_AR2_ReceiptPDU:*/
on timer Timer_DRVUDPC_IndMd_Style2_AMG_AR2_ReceiptPDU
{
	//cyclic, dual cycle und cyclicandchange
	@sysvar::CH_Nodes::CH__PDURECEIPT_RECEIVE_DRVU_DPC_IndMd_Style2_AMG_AR2 = 1;
}
/*@@end*/
/*@@timer:Timer_DPC_IndMd_Style_AMG_AR2_ReceiptPDU:*/
on timer Timer_DRVUDPC_IndMd_Style_AMG_AR2_ReceiptPDU
{
	//cyclic, dual cycle und cyclicandchange
	@sysvar::CH_Nodes::CH__PDURECEIPT_RECEIVE_DRVU_DPC_IndMd_Style_AMG_AR2 = 1;
}
/*@@end*/
/*@@timer:Timer_DPC_Master_Rq_AMG_AR2_ReceiptPDU:*/
on timer Timer_DRVUDPC_Master_Rq_AMG_AR2_ReceiptPDU
{
	//cyclic, dual cycle und cyclicandchange
	@sysvar::CH_Nodes::CH__PDURECEIPT_RECEIVE_DRVU_DPC_Master_Rq_AMG_AR2 = 1;
}
/*@@end*/
/*@@timer:Timer_DRVU_Stat_AR_ReceiptPDU:*/
on timer Timer_DRVUDRVU_Stat_AR_ReceiptPDU
{
	//cyclic, dual cycle und cyclicandchange
	@sysvar::CH_Nodes::CH__PDURECEIPT_RECEIVE_DRVU_DRVU_Stat_AR = 1;
}
/*@@end*/
/*@@timer:Timer_ESP_EDIFF_Rs_AR_ReceiptPDU:*/
on timer Timer_DRVUESP_EDIFF_Rs_AR_ReceiptPDU
{
	//cyclic, dual cycle und cyclicandchange
	@sysvar::CH_Nodes::CH__PDURECEIPT_RECEIVE_DRVU_ESP_EDIFF_Rs_AR = 1;
}
/*@@end*/
/*@@timer:Timer_ActvComf_Rq_AR2_ReceiptPDU:*/
on timer Timer_EISActvComf_Rq_AR2_ReceiptPDU
{
	//cyclic, dual cycle und cyclicandchange
	@sysvar::CH_Nodes::CH__PDURECEIPT_RECEIVE_EIS_ActvComf_Rq_AR2 = 1;
}
/*@@end*/
/*@@timer:Timer_ADAS_CURRENT_ATTRIBUTES_AR_ReceiptPDU:*/
on timer Timer_EISADAS_CURRENT_ATTRIBUTES_AR_ReceiptPDU
{
	//cyclic, dual cycle und cyclicandchange
	@sysvar::CH_Nodes::CH__PDURECEIPT_RECEIVE_EIS_ADAS_CURRENT_ATTRIBUTES_AR = 1;
}
/*@@end*/
/*@@timer:Timer_ADAS_POSITION_AR_ReceiptPDU:*/
on timer Timer_EISADAS_POSITION_AR_ReceiptPDU
{
	//cyclic, dual cycle und cyclicandchange
	@sysvar::CH_Nodes::CH__PDURECEIPT_RECEIVE_EIS_ADAS_POSITION_AR = 1;
}
/*@@end*/
/*@@timer:Timer_ADAS_PREDICTION_AR_ReceiptPDU:*/
on timer Timer_EISADAS_PREDICTION_AR_ReceiptPDU
{
	//cyclic, dual cycle und cyclicandchange
	@sysvar::CH_Nodes::CH__PDURECEIPT_RECEIVE_EIS_ADAS_PREDICTION_AR = 1;
}
/*@@end*/
/*@@timer:Timer_ADAS_PROFILE_LONG_AR_ReceiptPDU:*/
on timer Timer_EISADAS_PROFILE_LONG_AR_ReceiptPDU
{
	//cyclic, dual cycle und cyclicandchange
	@sysvar::CH_Nodes::CH__PDURECEIPT_RECEIVE_EIS_ADAS_PROFILE_LONG_AR = 1;
}
/*@@end*/
/*@@timer:Timer_ADAS_PROFILE_SHORT_AR_ReceiptPDU:*/
on timer Timer_EISADAS_PROFILE_SHORT_AR_ReceiptPDU
{
	//cyclic, dual cycle und cyclicandchange
	@sysvar::CH_Nodes::CH__PDURECEIPT_RECEIVE_EIS_ADAS_PROFILE_SHORT_AR = 1;
}
/*@@end*/
/*@@timer:Timer_ADASLR_POSITION_AR_ReceiptPDU:*/
on timer Timer_EISADASLR_POSITION_AR_ReceiptPDU
{
	//cyclic, dual cycle und cyclicandchange
	@sysvar::CH_Nodes::CH__PDURECEIPT_RECEIVE_EIS_ADASLR_POSITION_AR = 1;
}
/*@@end*/
/*@@timer:Timer_ADASLR_PROFILE_LONG_AR_ReceiptPDU:*/
on timer Timer_EISADASLR_PROFILE_LONG_AR_ReceiptPDU
{
	//cyclic, dual cycle und cyclicandchange
	@sysvar::CH_Nodes::CH__PDURECEIPT_RECEIVE_EIS_ADASLR_PROFILE_LONG_AR = 1;
}
/*@@end*/
/*@@timer:Timer_Assyst_Rq_AR2_ReceiptPDU:*/
on timer Timer_EISAssyst_Rq_AR2_ReceiptPDU
{
	//cyclic, dual cycle und cyclicandchange
	@sysvar::CH_Nodes::CH__PDURECEIPT_RECEIVE_EIS_Assyst_Rq_AR2 = 1;
}
/*@@end*/
/*@@timer:Timer_BC_F_Disp_Rq_AR_ReceiptPDU:*/
on timer Timer_EISBC_F_Disp_Rq_AR_ReceiptPDU
{
	//cyclic, dual cycle und cyclicandchange
	@sysvar::CH_Nodes::CH__PDURECEIPT_RECEIVE_EIS_BC_F_Disp_Rq_AR = 1;
}
/*@@end*/
/*@@timer:Timer_BC_F_Stat1_AR_ReceiptPDU:*/
on timer Timer_EISBC_F_Stat1_AR_ReceiptPDU
{
	//cyclic, dual cycle und cyclicandchange
	@sysvar::CH_Nodes::CH__PDURECEIPT_RECEIVE_EIS_BC_F_Stat1_AR = 1;
}
/*@@end*/
/*@@timer:Timer_BC_F_Stat2_AR2_ReceiptPDU:*/
on timer Timer_EISBC_F_Stat2_AR2_ReceiptPDU
{
	//cyclic, dual cycle und cyclicandchange
	@sysvar::CH_Nodes::CH__PDURECEIPT_RECEIVE_EIS_BC_F_Stat2_AR2 = 1;
}
/*@@end*/
/*@@timer:Timer_BC_R_Stat1_AR_ReceiptPDU:*/
on timer Timer_EISBC_R_Stat1_AR_ReceiptPDU
{
	//cyclic, dual cycle und cyclicandchange
	@sysvar::CH_Nodes::CH__PDURECEIPT_RECEIVE_EIS_BC_R_Stat1_AR = 1;
}
/*@@end*/
/*@@timer:Timer_BLSM_Disp_Stat_AR_ReceiptPDU:*/
on timer Timer_EISBLSM_Disp_Stat_AR_ReceiptPDU
{
	//BAF, spontaneous und onchange
	@sysvar::CH_Nodes::CH__PDURECEIPT_RECEIVE_EIS_BLSM_Disp_Stat_AR = 2;
}
/*@@end*/
/*@@timer:Timer_BODY_CHASSIS_R1_AR_ReceiptPDU:*/
on timer Timer_EISBODY_CHASSIS_R1_AR_ReceiptPDU
{
	//cyclic, dual cycle und cyclicandchange
	@sysvar::CH_Nodes::CH__PDURECEIPT_RECEIVE_EIS_BODY_CHASSIS_R1_AR = 1;
}
/*@@end*/
/*@@timer:Timer_BSM_Disp_Warn_Rq_AR2_ReceiptPDU:*/
on timer Timer_EISBSM_Disp_Warn_Rq_AR2_ReceiptPDU
{
	//cyclic, dual cycle und cyclicandchange
	@sysvar::CH_Nodes::CH__PDURECEIPT_RECEIVE_EIS_BSM_Disp_Warn_Rq_AR2 = 1;
}
/*@@end*/
/*@@timer:Timer_CamLane_Disp_Warn_Rq_AR2_ReceiptPDU:*/
on timer Timer_EISCamLane_Disp_Warn_Rq_AR2_ReceiptPDU
{
	//cyclic, dual cycle und cyclicandchange
	@sysvar::CH_Nodes::CH__PDURECEIPT_RECEIVE_EIS_CamLane_Disp_Warn_Rq_AR2 = 1;
}
/*@@end*/
/*@@timer:Timer_CamLane_LaneAttr1_AR2_ReceiptPDU:*/
on timer Timer_EISCamLane_LaneAttr1_AR2_ReceiptPDU
{
	//cyclic, dual cycle und cyclicandchange
	@sysvar::CH_Nodes::CH__PDURECEIPT_RECEIVE_EIS_CamLane_LaneAttr1_AR2 = 1;
}
/*@@end*/
/*@@timer:Timer_CamLane_LaneAttr2_AR2_ReceiptPDU:*/
on timer Timer_EISCamLane_LaneAttr2_AR2_ReceiptPDU
{
	//cyclic, dual cycle und cyclicandchange
	@sysvar::CH_Nodes::CH__PDURECEIPT_RECEIVE_EIS_CamLane_LaneAttr2_AR2 = 1;
}
/*@@end*/
/*@@timer:Timer_CamLane_LaneAttr3_AR2_ReceiptPDU:*/
on timer Timer_EISCamLane_LaneAttr3_AR2_ReceiptPDU
{
	//cyclic, dual cycle und cyclicandchange
	@sysvar::CH_Nodes::CH__PDURECEIPT_RECEIVE_EIS_CamLane_LaneAttr3_AR2 = 1;
}
/*@@end*/
/*@@timer:Timer_CamLane_LaneAttr6_AR2_ReceiptPDU:*/
on timer Timer_EISCamLane_LaneAttr6_AR2_ReceiptPDU
{
	//cyclic, dual cycle und cyclicandchange
	@sysvar::CH_Nodes::CH__PDURECEIPT_RECEIVE_EIS_CamLane_LaneAttr6_AR2 = 1;
}
/*@@end*/
/*@@timer:Timer_CamLane_LaneAttr7_AR2_ReceiptPDU:*/
on timer Timer_EISCamLane_LaneAttr7_AR2_ReceiptPDU
{
	//cyclic, dual cycle und cyclicandchange
	@sysvar::CH_Nodes::CH__PDURECEIPT_RECEIVE_EIS_CamLane_LaneAttr7_AR2 = 1;
}
/*@@end*/
/*@@timer:Timer_CLkS_Rq_AR_ReceiptPDU:*/
on timer Timer_EISCLkS_Rq_AR_ReceiptPDU
{
	//cyclic, dual cycle und cyclicandchange
	@sysvar::CH_Nodes::CH__PDURECEIPT_RECEIVE_EIS_CLkS_Rq_AR = 1;
}
/*@@end*/
/*@@timer:Timer_CLkS_State_AR_ReceiptPDU:*/
on timer Timer_EISCLkS_State_AR_ReceiptPDU
{
	//cyclic, dual cycle und cyclicandchange
	@sysvar::CH_Nodes::CH__PDURECEIPT_RECEIVE_EIS_CLkS_State_AR = 1;
}
/*@@end*/
/*@@timer:Timer_ClockSync_Stat_FR2_ReceiptPDU:*/
on timer Timer_EISClockSync_Stat_FR2_ReceiptPDU
{
	//BAF, spontaneous und onchange
	@sysvar::CH_Nodes::CH__PDURECEIPT_RECEIVE_EIS_ClockSync_Stat_FR2 = 2;
}
/*@@end*/
/*@@timer:Timer_CMS_PI_State_Gw_AR2_ReceiptPDU:*/
on timer Timer_EISCMS_PI_State_Gw_AR2_ReceiptPDU
{
	//cyclic, dual cycle und cyclicandchange
	@sysvar::CH_Nodes::CH__PDURECEIPT_RECEIVE_EIS_CMS_PI_State_Gw_AR2 = 1;
}
/*@@end*/
/*@@timer:Timer_Config_HU4_AR2_ReceiptPDU:*/
on timer Timer_EISConfig_HU4_AR2_ReceiptPDU
{
	//cyclic, dual cycle und cyclicandchange
	@sysvar::CH_Nodes::CH__PDURECEIPT_RECEIVE_EIS_Config_HU4_AR2 = 1;
}
/*@@end*/
/*@@timer:Timer_Config_HU5_AR2_ReceiptPDU:*/
on timer Timer_EISConfig_HU5_AR2_ReceiptPDU
{
	//cyclic, dual cycle und cyclicandchange
	@sysvar::CH_Nodes::CH__PDURECEIPT_RECEIVE_EIS_Config_HU5_AR2 = 1;
}
/*@@end*/
/*@@timer:Timer_CRCM_Stat_AR_ReceiptPDU:*/
on timer Timer_EISCRCM_Stat_AR_ReceiptPDU
{
	//cyclic, dual cycle und cyclicandchange
	@sysvar::CH_Nodes::CH__PDURECEIPT_RECEIVE_EIS_CRCM_Stat_AR = 1;
}
/*@@end*/
/*@@timer:Timer_CTRL_C_Stat1_AR_ReceiptPDU:*/
on timer Timer_EISCTRL_C_Stat1_AR_ReceiptPDU
{
	//cyclic, dual cycle und cyclicandchange
	@sysvar::CH_Nodes::CH__PDURECEIPT_RECEIVE_EIS_CTRL_C_Stat1_AR = 1;
}
/*@@end*/
/*@@timer:Timer_DAC4_ECM_AR_ReceiptPDU:*/
on timer Timer_EISDAC4_ECM_AR_ReceiptPDU
{
	//BAF, spontaneous und onchange
	@sysvar::CH_Nodes::CH__PDURECEIPT_RECEIVE_EIS_DAC4_ECM_AR = 2;
}
/*@@end*/
/*@@timer:Timer_DAC4_EM2_AR_ReceiptPDU:*/
on timer Timer_EISDAC4_EM2_AR_ReceiptPDU
{
	//BAF, spontaneous und onchange
	@sysvar::CH_Nodes::CH__PDURECEIPT_RECEIVE_EIS_DAC4_EM2_AR = 2;
}
/*@@end*/
/*@@timer:Timer_DAC4_ISM_AR_ReceiptPDU:*/
on timer Timer_EISDAC4_ISM_AR_ReceiptPDU
{
	//BAF, spontaneous und onchange
	@sysvar::CH_Nodes::CH__PDURECEIPT_RECEIVE_EIS_DAC4_ISM_AR = 2;
}
/*@@end*/
/*@@timer:Timer_DAC4_TCM_AR_ReceiptPDU:*/
on timer Timer_EISDAC4_TCM_AR_ReceiptPDU
{
	//BAF, spontaneous und onchange
	@sysvar::CH_Nodes::CH__PDURECEIPT_RECEIVE_EIS_DAC4_TCM_AR = 2;
}
/*@@end*/
/*@@timer:Timer_Dimming_Stat_AR2_ReceiptPDU:*/
on timer Timer_EISDimming_Stat_AR2_ReceiptPDU
{
	//cyclic, dual cycle und cyclicandchange
	@sysvar::CH_Nodes::CH__PDURECEIPT_RECEIVE_EIS_Dimming_Stat_AR2 = 1;
}
/*@@end*/
/*@@timer:Timer_Door_FL_Stat_AR2_ReceiptPDU:*/
on timer Timer_EISDoor_FL_Stat_AR2_ReceiptPDU
{
	//cyclic, dual cycle und cyclicandchange
	@sysvar::CH_Nodes::CH__PDURECEIPT_RECEIVE_EIS_Door_FL_Stat_AR2 = 1;
}
/*@@end*/
/*@@timer:Timer_Door_FR_Stat_AR2_ReceiptPDU:*/
on timer Timer_EISDoor_FR_Stat_AR2_ReceiptPDU
{
	//cyclic, dual cycle und cyclicandchange
	@sysvar::CH_Nodes::CH__PDURECEIPT_RECEIVE_EIS_Door_FR_Stat_AR2 = 1;
}
/*@@end*/
/*@@timer:Timer_Door_RL_Stat_AR2_ReceiptPDU:*/
on timer Timer_EISDoor_RL_Stat_AR2_ReceiptPDU
{
	//cyclic, dual cycle und cyclicandchange
	@sysvar::CH_Nodes::CH__PDURECEIPT_RECEIVE_EIS_Door_RL_Stat_AR2 = 1;
}
/*@@end*/
/*@@timer:Timer_Door_RR_Stat_AR2_ReceiptPDU:*/
on timer Timer_EISDoor_RR_Stat_AR2_ReceiptPDU
{
	//cyclic, dual cycle und cyclicandchange
	@sysvar::CH_Nodes::CH__PDURECEIPT_RECEIVE_EIS_Door_RR_Stat_AR2 = 1;
}
/*@@end*/
/*@@timer:Timer_DPC_IndMd_Rq_AR_ReceiptPDU:*/
on timer Timer_EISDPC_IndMd_Rq_AR_ReceiptPDU
{
	//cyclic, dual cycle und cyclicandchange
	@sysvar::CH_Nodes::CH__PDURECEIPT_RECEIVE_EIS_DPC_IndMd_Rq_AR = 1;
}
/*@@end*/
/*@@timer:Timer_EAC_Stat_AR_ReceiptPDU:*/
on timer Timer_EISEAC_Stat_AR_ReceiptPDU
{
	//cyclic, dual cycle und cyclicandchange
	@sysvar::CH_Nodes::CH__PDURECEIPT_RECEIVE_EIS_EAC_Stat_AR = 1;
}
/*@@end*/
/*@@timer:Timer_EL_Stat_AR2_ReceiptPDU:*/
on timer Timer_EISEL_Stat_AR2_ReceiptPDU
{
	//cyclic, dual cycle und cyclicandchange
	@sysvar::CH_Nodes::CH__PDURECEIPT_RECEIVE_EIS_EL_Stat_AR2 = 1;
}
/*@@end*/
/*@@timer:Timer_EL_TurnInd_Rq_AR2_ReceiptPDU:*/
on timer Timer_EISEL_TurnInd_Rq_AR2_ReceiptPDU
{
	//BAF, spontaneous und onchange
	@sysvar::CH_Nodes::CH__PDURECEIPT_RECEIVE_EIS_EL_TurnInd_Rq_AR2 = 2;
}
/*@@end*/
/*@@timer:Timer_EPKB_Stat_AR2_ReceiptPDU:*/
on timer Timer_EISEPKB_Stat_AR2_ReceiptPDU
{
	//cyclic, dual cycle und cyclicandchange
	@sysvar::CH_Nodes::CH__PDURECEIPT_RECEIVE_EIS_EPKB_Stat_AR2 = 1;
}
/*@@end*/
/*@@timer:Timer_EVC_CfgBit_01_32_AR2_ReceiptPDU:*/
on timer Timer_EISEVC_CfgBit_01_32_AR2_ReceiptPDU
{
	//cyclic, dual cycle und cyclicandchange
	@sysvar::CH_Nodes::CH__PDURECEIPT_RECEIVE_EIS_EVC_CfgBit_01_32_AR2 = 1;
}
/*@@end*/
/*@@timer:Timer_EVC_CfgBit_33_64_AR2_ReceiptPDU:*/
on timer Timer_EISEVC_CfgBit_33_64_AR2_ReceiptPDU
{
	//cyclic, dual cycle und cyclicandchange
	@sysvar::CH_Nodes::CH__PDURECEIPT_RECEIVE_EIS_EVC_CfgBit_33_64_AR2 = 1;
}
/*@@end*/
/*@@timer:Timer_EVC_CfgBit_65_96_AR2_ReceiptPDU:*/
on timer Timer_EISEVC_CfgBit_65_96_AR2_ReceiptPDU
{
	//cyclic, dual cycle und cyclicandchange
	@sysvar::CH_Nodes::CH__PDURECEIPT_RECEIVE_EIS_EVC_CfgBit_65_96_AR2 = 1;
}
/*@@end*/
/*@@timer:Timer_EVC_CfgBit_97_C8_AR2_ReceiptPDU:*/
on timer Timer_EISEVC_CfgBit_97_C8_AR2_ReceiptPDU
{
	//cyclic, dual cycle und cyclicandchange
	@sysvar::CH_Nodes::CH__PDURECEIPT_RECEIVE_EIS_EVC_CfgBit_97_C8_AR2 = 1;
}
/*@@end*/
/*@@timer:Timer_EVC_CfgList_01_0C_AR2_ReceiptPDU:*/
on timer Timer_EISEVC_CfgList_01_0C_AR2_ReceiptPDU
{
	//cyclic, dual cycle und cyclicandchange
	@sysvar::CH_Nodes::CH__PDURECEIPT_RECEIVE_EIS_EVC_CfgList_01_0C_AR2 = 1;
}
/*@@end*/
/*@@timer:Timer_FCW_Disp_Rq_AR_ReceiptPDU:*/
on timer Timer_EISFCW_Disp_Rq_AR_ReceiptPDU
{
	//cyclic, dual cycle und cyclicandchange
	@sysvar::CH_Nodes::CH__PDURECEIPT_RECEIVE_EIS_FCW_Disp_Rq_AR = 1;
}
/*@@end*/
/*@@timer:Timer_HMI_CHASSIS_R1_AR2_ReceiptPDU:*/
on timer Timer_EISHMI_CHASSIS_R1_AR2_ReceiptPDU
{
	//cyclic, dual cycle und cyclicandchange
	@sysvar::CH_Nodes::CH__PDURECEIPT_RECEIVE_EIS_HMI_CHASSIS_R1_AR2 = 1;
}
/*@@end*/
/*@@timer:Timer_HU_Comf_Rq_AR2_ReceiptPDU:*/
on timer Timer_EISHU_Comf_Rq_AR2_ReceiptPDU
{
	//cyclic, dual cycle und cyclicandchange
	@sysvar::CH_Nodes::CH__PDURECEIPT_RECEIVE_EIS_HU_Comf_Rq_AR2 = 1;
}
/*@@end*/
/*@@timer:Timer_HU_State_AR_ReceiptPDU:*/
on timer Timer_EISHU_State_AR_ReceiptPDU
{
	//cyclic, dual cycle und cyclicandchange
	@sysvar::CH_Nodes::CH__PDURECEIPT_RECEIVE_EIS_HU_State_AR = 1;
}
/*@@end*/
/*@@timer:Timer_HVAC_Disp_Stat1_AR_ReceiptPDU:*/
on timer Timer_EISHVAC_Disp_Stat1_AR_ReceiptPDU
{
	//cyclic, dual cycle und cyclicandchange
	@sysvar::CH_Nodes::CH__PDURECEIPT_RECEIVE_EIS_HVAC_Disp_Stat1_AR = 1;
}
/*@@end*/
/*@@timer:Timer_HVAC_OBD_DTC_AR_ReceiptPDU:*/
on timer Timer_EISHVAC_OBD_DTC_AR_ReceiptPDU
{
	//cyclic, dual cycle und cyclicandchange
	@sysvar::CH_Nodes::CH__PDURECEIPT_RECEIVE_EIS_HVAC_OBD_DTC_AR = 1;
}
/*@@end*/
/*@@timer:Timer_HVAC_Rs2_AR_ReceiptPDU:*/
on timer Timer_EISHVAC_Rs2_AR_ReceiptPDU
{
	//cyclic, dual cycle und cyclicandchange
	@sysvar::CH_Nodes::CH__PDURECEIPT_RECEIVE_EIS_HVAC_Rs2_AR = 1;
}
/*@@end*/
/*@@timer:Timer_HVAC_Rs3_AR2_ReceiptPDU:*/
on timer Timer_EISHVAC_Rs3_AR2_ReceiptPDU
{
	//cyclic, dual cycle und cyclicandchange
	@sysvar::CH_Nodes::CH__PDURECEIPT_RECEIVE_EIS_HVAC_Rs3_AR2 = 1;
}
/*@@end*/
/*@@timer:Timer_HVAC_Rs_AR2_ReceiptPDU:*/
on timer Timer_EISHVAC_Rs_AR2_ReceiptPDU
{
	//cyclic, dual cycle und cyclicandchange
	@sysvar::CH_Nodes::CH__PDURECEIPT_RECEIVE_EIS_HVAC_Rs_AR2 = 1;
}
/*@@end*/
/*@@timer:Timer_HVAC_State1_AR_ReceiptPDU:*/
on timer Timer_EISHVAC_State1_AR_ReceiptPDU
{
	//cyclic, dual cycle und cyclicandchange
	@sysvar::CH_Nodes::CH__PDURECEIPT_RECEIVE_EIS_HVAC_State1_AR = 1;
}
/*@@end*/
/*@@timer:Timer_IC_BasicInfo_AR2_ReceiptPDU:*/
on timer Timer_EISIC_BasicInfo_AR2_ReceiptPDU
{
	//cyclic, dual cycle und cyclicandchange
	@sysvar::CH_Nodes::CH__PDURECEIPT_RECEIVE_EIS_IC_BasicInfo_AR2 = 1;
}
/*@@end*/
/*@@timer:Timer_IC_DriveAssistSys_AR2_ReceiptPDU:*/
on timer Timer_EISIC_DriveAssistSys_AR2_ReceiptPDU
{
	//cyclic, dual cycle und cyclicandchange
	@sysvar::CH_Nodes::CH__PDURECEIPT_RECEIVE_EIS_IC_DriveAssistSys_AR2 = 1;
}
/*@@end*/
/*@@timer:Timer_IC_Settings_AR2_ReceiptPDU:*/
on timer Timer_EISIC_Settings_AR2_ReceiptPDU
{
	//cyclic, dual cycle und cyclicandchange
	@sysvar::CH_Nodes::CH__PDURECEIPT_RECEIVE_EIS_IC_Settings_AR2 = 1;
}
/*@@end*/
/*@@timer:Timer_ICH_Stat_AR_ReceiptPDU:*/
on timer Timer_EISICH_Stat_AR_ReceiptPDU
{
	//cyclic, dual cycle und cyclicandchange
	@sysvar::CH_Nodes::CH__PDURECEIPT_RECEIVE_EIS_ICH_Stat_AR = 1;
}
/*@@end*/
/*@@timer:Timer_Ign_Veh_Stat_AR2_ReceiptPDU:*/
on timer Timer_EISIgn_Veh_Stat_AR2_ReceiptPDU
{
	//cyclic, dual cycle und cyclicandchange
	@sysvar::CH_Nodes::CH__PDURECEIPT_RECEIVE_EIS_Ign_Veh_Stat_AR2 = 1;
}
/*@@end*/
/*@@timer:Timer_IHC_Lgt_Stat_HLI_2_AR2_ReceiptPDU:*/
on timer Timer_EISIHC_Lgt_Stat_HLI_2_AR2_ReceiptPDU
{
	//cyclic, dual cycle und cyclicandchange
	@sysvar::CH_Nodes::CH__PDURECEIPT_RECEIVE_EIS_IHC_Lgt_Stat_HLI_2_AR2 = 1;
}
/*@@end*/
/*@@timer:Timer_IHC_Lgt_Stat_HLI_AR2_ReceiptPDU:*/
on timer Timer_EISIHC_Lgt_Stat_HLI_AR2_ReceiptPDU
{
	//cyclic, dual cycle und cyclicandchange
	@sysvar::CH_Nodes::CH__PDURECEIPT_RECEIVE_EIS_IHC_Lgt_Stat_HLI_AR2 = 1;
}
/*@@end*/
/*@@timer:Timer_KG_State_AR2_ReceiptPDU:*/
on timer Timer_EISKG_State_AR2_ReceiptPDU
{
	//cyclic, dual cycle und cyclicandchange
	@sysvar::CH_Nodes::CH__PDURECEIPT_RECEIVE_EIS_KG_State_AR2 = 1;
}
/*@@end*/
/*@@timer:Timer_LDC_Disp_Stat_IC_AR2_ReceiptPDU:*/
on timer Timer_EISLDC_Disp_Stat_IC_AR2_ReceiptPDU
{
	//cyclic, dual cycle und cyclicandchange
	@sysvar::CH_Nodes::CH__PDURECEIPT_RECEIVE_EIS_LDC_Disp_Stat_IC_AR2 = 1;
}
/*@@end*/
/*@@timer:Timer_LgtSens_State_AR_ReceiptPDU:*/
on timer Timer_EISLgtSens_State_AR_ReceiptPDU
{
	//cyclic, dual cycle und cyclicandchange
	@sysvar::CH_Nodes::CH__PDURECEIPT_RECEIVE_EIS_LgtSens_State_AR = 1;
}
/*@@end*/
/*@@timer:Timer_Mirr_Adj_Lt_Rq_AR_ReceiptPDU:*/
on timer Timer_EISMirr_Adj_Lt_Rq_AR_ReceiptPDU
{
	//BAF, spontaneous und onchange
	@sysvar::CH_Nodes::CH__PDURECEIPT_RECEIVE_EIS_Mirr_Adj_Lt_Rq_AR = 2;
}
/*@@end*/
/*@@timer:Timer_Mirr_Adj_Rt_Rq_AR_ReceiptPDU:*/
on timer Timer_EISMirr_Adj_Rt_Rq_AR_ReceiptPDU
{
	//BAF, spontaneous und onchange
	@sysvar::CH_Nodes::CH__PDURECEIPT_RECEIVE_EIS_Mirr_Adj_Rt_Rq_AR = 2;
}
/*@@end*/
/*@@timer:Timer_NAVI_Pos1_AR_ReceiptPDU:*/
on timer Timer_EISNAVI_Pos1_AR_ReceiptPDU
{
	//cyclic, dual cycle und cyclicandchange
	@sysvar::CH_Nodes::CH__PDURECEIPT_RECEIVE_EIS_NAVI_Pos1_AR = 1;
}
/*@@end*/
/*@@timer:Timer_NAVI_Pos2_AR_ReceiptPDU:*/
on timer Timer_EISNAVI_Pos2_AR_ReceiptPDU
{
	//cyclic, dual cycle und cyclicandchange
	@sysvar::CH_Nodes::CH__PDURECEIPT_RECEIVE_EIS_NAVI_Pos2_AR = 1;
}
/*@@end*/
/*@@timer:Timer_NAVI_Pos3_AR_ReceiptPDU:*/
on timer Timer_EISNAVI_Pos3_AR_ReceiptPDU
{
	//cyclic, dual cycle und cyclicandchange
	@sysvar::CH_Nodes::CH__PDURECEIPT_RECEIVE_EIS_NAVI_Pos3_AR = 1;
}
/*@@end*/
/*@@timer:Timer_NAVI_Pos4_AR_ReceiptPDU:*/
on timer Timer_EISNAVI_Pos4_AR_ReceiptPDU
{
	//cyclic, dual cycle und cyclicandchange
	@sysvar::CH_Nodes::CH__PDURECEIPT_RECEIVE_EIS_NAVI_Pos4_AR = 1;
}
/*@@end*/
/*@@timer:Timer_NAVI_Pos5_AR_ReceiptPDU:*/
on timer Timer_EISNAVI_Pos5_AR_ReceiptPDU
{
	//cyclic, dual cycle und cyclicandchange
	@sysvar::CH_Nodes::CH__PDURECEIPT_RECEIVE_EIS_NAVI_Pos5_AR = 1;
}
/*@@end*/
/*@@timer:Timer_NVP_Stat1_AR2_ReceiptPDU:*/
on timer Timer_EISNVP_Stat1_AR2_ReceiptPDU
{
	//cyclic, dual cycle und cyclicandchange
	@sysvar::CH_Nodes::CH__PDURECEIPT_RECEIVE_EIS_NVP_Stat1_AR2 = 1;
}
/*@@end*/
/*@@timer:Timer_OHCM_Stat_AR2_ReceiptPDU:*/
on timer Timer_EISOHCM_Stat_AR2_ReceiptPDU
{
	//cyclic, dual cycle und cyclicandchange
	@sysvar::CH_Nodes::CH__PDURECEIPT_RECEIVE_EIS_OHCM_Stat_AR2 = 1;
}
/*@@end*/
/*@@timer:Timer_ORC_Disp_Stat_AR2_ReceiptPDU:*/
on timer Timer_EISORC_Disp_Stat_AR2_ReceiptPDU
{
	//cyclic, dual cycle und cyclicandchange
	@sysvar::CH_Nodes::CH__PDURECEIPT_RECEIVE_EIS_ORC_Disp_Stat_AR2 = 1;
}
/*@@end*/
/*@@timer:Timer_ORC_Impact_AR2_ReceiptPDU:*/
on timer Timer_EISORC_Impact_AR2_ReceiptPDU
{
	//cyclic, dual cycle und cyclicandchange
	@sysvar::CH_Nodes::CH__PDURECEIPT_RECEIVE_EIS_ORC_Impact_AR2 = 1;
}
/*@@end*/
/*@@timer:Timer_Park_Disp_Rs_AR2_ReceiptPDU:*/
on timer Timer_EISPark_Disp_Rs_AR2_ReceiptPDU
{
	//cyclic, dual cycle und cyclicandchange
	@sysvar::CH_Nodes::CH__PDURECEIPT_RECEIVE_EIS_Park_Disp_Rs_AR2 = 1;
}
/*@@end*/
/*@@timer:Timer_PHB_IHC_Plus_Tunnel_3_4_AR2_ReceiptPDU:*/
on timer Timer_EISPHB_IHC_Plus_Tunnel_3_4_AR2_ReceiptPDU
{
	//cyclic, dual cycle und cyclicandchange
	@sysvar::CH_Nodes::CH__PDURECEIPT_RECEIVE_EIS_PHB_IHC_Plus_Tunnel_3_4_AR2 = 1;
}
/*@@end*/
/*@@timer:Timer_PHB_IHC_Plus_Tunnel_AR2_ReceiptPDU:*/
on timer Timer_EISPHB_IHC_Plus_Tunnel_AR2_ReceiptPDU
{
	//cyclic, dual cycle und cyclicandchange
	@sysvar::CH_Nodes::CH__PDURECEIPT_RECEIVE_EIS_PHB_IHC_Plus_Tunnel_AR2 = 1;
}
/*@@end*/
/*@@timer:Timer_PN14_Disp_Rq_AR_ReceiptPDU:*/
on timer Timer_EISPN14_Disp_Rq_AR_ReceiptPDU
{
	//cyclic, dual cycle und cyclicandchange
	@sysvar::CH_Nodes::CH__PDURECEIPT_RECEIVE_EIS_PN14_Disp_Rq_AR = 1;
}
/*@@end*/
/*@@timer:Timer_PN14_Rs1_AR2_ReceiptPDU:*/
on timer Timer_EISPN14_Rs1_AR2_ReceiptPDU
{
	//cyclic, dual cycle und cyclicandchange
	@sysvar::CH_Nodes::CH__PDURECEIPT_RECEIVE_EIS_PN14_Rs1_AR2 = 1;
}
/*@@end*/
/*@@timer:Timer_PN14_Rs2_AR_ReceiptPDU:*/
on timer Timer_EISPN14_Rs2_AR_ReceiptPDU
{
	//cyclic, dual cycle und cyclicandchange
	@sysvar::CH_Nodes::CH__PDURECEIPT_RECEIVE_EIS_PN14_Rs2_AR = 1;
}
/*@@end*/
/*@@timer:Timer_PN14_Stat2_AR2_ReceiptPDU:*/
on timer Timer_EISPN14_Stat2_AR2_ReceiptPDU
{
	//cyclic, dual cycle und cyclicandchange
	@sysvar::CH_Nodes::CH__PDURECEIPT_RECEIVE_EIS_PN14_Stat2_AR2 = 1;
}
/*@@end*/
/*@@timer:Timer_PN14_Stat_AR_ReceiptPDU:*/
on timer Timer_EISPN14_Stat_AR_ReceiptPDU
{
	//cyclic, dual cycle und cyclicandchange
	@sysvar::CH_Nodes::CH__PDURECEIPT_RECEIVE_EIS_PN14_Stat_AR = 1;
}
/*@@end*/
/*@@timer:Timer_PN48_Bat_Stat2_AR2_ReceiptPDU:*/
on timer Timer_EISPN48_Bat_Stat2_AR2_ReceiptPDU
{
	//cyclic, dual cycle und cyclicandchange
	@sysvar::CH_Nodes::CH__PDURECEIPT_RECEIVE_EIS_PN48_Bat_Stat2_AR2 = 1;
}
/*@@end*/
/*@@timer:Timer_PN48_Bat_Stat_AR_ReceiptPDU:*/
on timer Timer_EISPN48_Bat_Stat_AR_ReceiptPDU
{
	//cyclic, dual cycle und cyclicandchange
	@sysvar::CH_Nodes::CH__PDURECEIPT_RECEIVE_EIS_PN48_Bat_Stat_AR = 1;
}
/*@@end*/
/*@@timer:Timer_PN48_BatLim_Stat_AR_ReceiptPDU:*/
on timer Timer_EISPN48_BatLim_Stat_AR_ReceiptPDU
{
	//cyclic, dual cycle und cyclicandchange
	@sysvar::CH_Nodes::CH__PDURECEIPT_RECEIVE_EIS_PN48_BatLim_Stat_AR = 1;
}
/*@@end*/
/*@@timer:Timer_PN48_DCDC48_LISB48_Stat_AR_ReceiptPDU:*/
on timer Timer_EISPN48_DCDC48_LISB48_Stat_AR_ReceiptPDU
{
	//cyclic, dual cycle und cyclicandchange
	@sysvar::CH_Nodes::CH__PDURECEIPT_RECEIVE_EIS_PN48_DCDC48_LISB48_Stat_AR = 1;
}
/*@@end*/
/*@@timer:Timer_PN48_Stat_AR_ReceiptPDU:*/
on timer Timer_EISPN48_Stat_AR_ReceiptPDU
{
	//cyclic, dual cycle und cyclicandchange
	@sysvar::CH_Nodes::CH__PDURECEIPT_RECEIVE_EIS_PN48_Stat_AR = 1;
}
/*@@end*/
/*@@timer:Timer_PNHV_WeekDepTmTbl_Rq_HU_AR2_ReceiptPDU:*/
on timer Timer_EISPNHV_WeekDepTmTbl_Rq_HU_AR2_ReceiptPDU
{
	//cyclic, dual cycle und cyclicandchange
	@sysvar::CH_Nodes::CH__PDURECEIPT_RECEIVE_EIS_PNHV_WeekDepTmTbl_Rq_HU_AR2 = 1;
}
/*@@end*/
/*@@timer:Timer_PreCond_On_Rq_AR_ReceiptPDU:*/
on timer Timer_EISPreCond_On_Rq_AR_ReceiptPDU
{
	//cyclic, dual cycle und cyclicandchange
	@sysvar::CH_Nodes::CH__PDURECEIPT_RECEIVE_EIS_PreCond_On_Rq_AR = 1;
}
/*@@end*/
/*@@timer:Timer_PreCond_Rq_HU_AR2_ReceiptPDU:*/
on timer Timer_EISPreCond_Rq_HU_AR2_ReceiptPDU
{
	//cyclic, dual cycle und cyclicandchange
	@sysvar::CH_Nodes::CH__PDURECEIPT_RECEIVE_EIS_PreCond_Rq_HU_AR2 = 1;
}
/*@@end*/
/*@@timer:Timer_PreCond_Stat_AR_ReceiptPDU:*/
on timer Timer_EISPreCond_Stat_AR_ReceiptPDU
{
	//cyclic, dual cycle und cyclicandchange
	@sysvar::CH_Nodes::CH__PDURECEIPT_RECEIVE_EIS_PreCond_Stat_AR = 1;
}
/*@@end*/
/*@@timer:Timer_PT_ObjIntrst_Gw_AR2_ReceiptPDU:*/
on timer Timer_EISPT_ObjIntrst_Gw_AR2_ReceiptPDU
{
	//cyclic, dual cycle und cyclicandchange
	@sysvar::CH_Nodes::CH__PDURECEIPT_RECEIVE_EIS_PT_ObjIntrst_Gw_AR2 = 1;
}
/*@@end*/
/*@@timer:Timer_RemPark_Auth_Rs_AR2_ReceiptPDU:*/
on timer Timer_EISRemPark_Auth_Rs_AR2_ReceiptPDU
{
	//cyclic, dual cycle und cyclicandchange
	@sysvar::CH_Nodes::CH__PDURECEIPT_RECEIVE_EIS_RemPark_Auth_Rs_AR2 = 1;
}
/*@@end*/
/*@@timer:Timer_RemPark_Stat_EIS_AR2_ReceiptPDU:*/
on timer Timer_EISRemPark_Stat_EIS_AR2_ReceiptPDU
{
	//cyclic, dual cycle und cyclicandchange
	@sysvar::CH_Nodes::CH__PDURECEIPT_RECEIVE_EIS_RemPark_Stat_EIS_AR2 = 1;
}
/*@@end*/
/*@@timer:Timer_RTC_Date_Time_AR2_ReceiptPDU:*/
on timer Timer_EISRTC_Date_Time_AR2_ReceiptPDU
{
	//cyclic, dual cycle und cyclicandchange
	@sysvar::CH_Nodes::CH__PDURECEIPT_RECEIVE_EIS_RTC_Date_Time_AR2 = 1;
}
/*@@end*/
/*@@timer:Timer_RTC_Stat1_AR2_ReceiptPDU:*/
on timer Timer_EISRTC_Stat1_AR2_ReceiptPDU
{
	//cyclic, dual cycle und cyclicandchange
	@sysvar::CH_Nodes::CH__PDURECEIPT_RECEIVE_EIS_RTC_Stat1_AR2 = 1;
}
/*@@end*/
/*@@timer:Timer_SADR_Trgr_FCW_AR2_ReceiptPDU:*/
on timer Timer_EISSADR_Trgr_FCW_AR2_ReceiptPDU
{
	//BAF, spontaneous und onchange
	@sysvar::CH_Nodes::CH__PDURECEIPT_RECEIVE_EIS_SADR_Trgr_FCW_AR2 = 2;
}
/*@@end*/
/*@@timer:Timer_SeatAdj_FL_Rq_AR_ReceiptPDU:*/
on timer Timer_EISSeatAdj_FL_Rq_AR_ReceiptPDU
{
	//BAF, spontaneous und onchange
	@sysvar::CH_Nodes::CH__PDURECEIPT_RECEIVE_EIS_SeatAdj_FL_Rq_AR = 2;
}
/*@@end*/
/*@@timer:Timer_SeatAdj_FR_Rq_AR_ReceiptPDU:*/
on timer Timer_EISSeatAdj_FR_Rq_AR_ReceiptPDU
{
	//BAF, spontaneous und onchange
	@sysvar::CH_Nodes::CH__PDURECEIPT_RECEIVE_EIS_SeatAdj_FR_Rq_AR = 2;
}
/*@@end*/
/*@@timer:Timer_SPCR_Stat_BC_F_AR2_ReceiptPDU:*/
on timer Timer_EISSPCR_Stat_BC_F_AR2_ReceiptPDU
{
	//cyclic, dual cycle und cyclicandchange
	@sysvar::CH_Nodes::CH__PDURECEIPT_RECEIVE_EIS_SPCR_Stat_BC_F_AR2 = 1;
}
/*@@end*/
/*@@timer:Timer_SPL_Obj1_Obj2_NV_AR2_ReceiptPDU:*/
on timer Timer_EISSPL_Obj1_Obj2_NV_AR2_ReceiptPDU
{
	//cyclic, dual cycle und cyclicandchange
	@sysvar::CH_Nodes::CH__PDURECEIPT_RECEIVE_EIS_SPL_Obj1_Obj2_NV_AR2 = 1;
}
/*@@end*/
/*@@timer:Timer_SPV_Actn_Rq_AR2_ReceiptPDU:*/
on timer Timer_EISSPV_Actn_Rq_AR2_ReceiptPDU
{
	//cyclic, dual cycle und cyclicandchange
	@sysvar::CH_Nodes::CH__PDURECEIPT_RECEIVE_EIS_SPV_Actn_Rq_AR2 = 1;
}
/*@@end*/
/*@@timer:Timer_SPV_Alm_Rq_AR_ReceiptPDU:*/
on timer Timer_EISSPV_Alm_Rq_AR_ReceiptPDU
{
	//cyclic, dual cycle und cyclicandchange
	@sysvar::CH_Nodes::CH__PDURECEIPT_RECEIVE_EIS_SPV_Alm_Rq_AR = 1;
}
/*@@end*/
/*@@timer:Timer_SPV_Stat_AR2_ReceiptPDU:*/
on timer Timer_EISSPV_Stat_AR2_ReceiptPDU
{
	//cyclic, dual cycle und cyclicandchange
	@sysvar::CH_Nodes::CH__PDURECEIPT_RECEIVE_EIS_SPV_Stat_AR2 = 1;
}
/*@@end*/
/*@@timer:Timer_SVS_Rq_HU_AR2_ReceiptPDU:*/
on timer Timer_EISSVS_Rq_HU_AR2_ReceiptPDU
{
	//cyclic, dual cycle und cyclicandchange
	@sysvar::CH_Nodes::CH__PDURECEIPT_RECEIVE_EIS_SVS_Rq_HU_AR2 = 1;
}
/*@@end*/
/*@@timer:Timer_TBCSC_DAC_EPS_AR2_ReceiptPDU:*/
on timer Timer_EISTBCSC_DAC_EPS_AR2_ReceiptPDU
{
	//BAF, spontaneous und onchange
	@sysvar::CH_Nodes::CH__PDURECEIPT_RECEIVE_EIS_TBCSC_DAC_EPS_AR2 = 2;
}
/*@@end*/
/*@@timer:Timer_TBCSC_DAC_ESP_AR2_ReceiptPDU:*/
on timer Timer_EISTBCSC_DAC_ESP_AR2_ReceiptPDU
{
	//BAF, spontaneous und onchange
	@sysvar::CH_Nodes::CH__PDURECEIPT_RECEIVE_EIS_TBCSC_DAC_ESP_AR2 = 2;
}
/*@@end*/
/*@@timer:Timer_TBCSC_Hi_Rq1_AR2_ReceiptPDU:*/
on timer Timer_EISTBCSC_Hi_Rq1_AR2_ReceiptPDU
{
	//BAF, spontaneous und onchange
	@sysvar::CH_Nodes::CH__PDURECEIPT_RECEIVE_EIS_TBCSC_Hi_Rq1_AR2 = 2;
}
/*@@end*/
/*@@timer:Timer_TBCSC_Hi_Rq2_AR2_ReceiptPDU:*/
on timer Timer_EISTBCSC_Hi_Rq2_AR2_ReceiptPDU
{
	//BAF, spontaneous und onchange
	@sysvar::CH_Nodes::CH__PDURECEIPT_RECEIVE_EIS_TBCSC_Hi_Rq2_AR2 = 2;
}
/*@@end*/
/*@@timer:Timer_TBCSC_Lo_Rq1_AR2_ReceiptPDU:*/
on timer Timer_EISTBCSC_Lo_Rq1_AR2_ReceiptPDU
{
	//BAF, spontaneous und onchange
	@sysvar::CH_Nodes::CH__PDURECEIPT_RECEIVE_EIS_TBCSC_Lo_Rq1_AR2 = 2;
}
/*@@end*/
/*@@timer:Timer_TBCSC_Lo_Rq2_AR2_ReceiptPDU:*/
on timer Timer_EISTBCSC_Lo_Rq2_AR2_ReceiptPDU
{
	//BAF, spontaneous und onchange
	@sysvar::CH_Nodes::CH__PDURECEIPT_RECEIVE_EIS_TBCSC_Lo_Rq2_AR2 = 2;
}
/*@@end*/
/*@@timer:Timer_TC_Distance_AR_ReceiptPDU:*/
on timer Timer_EISTC_Distance_AR_ReceiptPDU
{
	//cyclic, dual cycle und cyclicandchange
	@sysvar::CH_Nodes::CH__PDURECEIPT_RECEIVE_EIS_TC_Distance_AR = 1;
}
/*@@end*/
/*@@timer:Timer_TGW_DateTm_Stat_AR_ReceiptPDU:*/
on timer Timer_EISTGW_DateTm_Stat_AR_ReceiptPDU
{
	//cyclic, dual cycle und cyclicandchange
	@sysvar::CH_Nodes::CH__PDURECEIPT_RECEIVE_EIS_TGW_DateTm_Stat_AR = 1;
}
/*@@end*/
/*@@timer:Timer_Tire_State_AR2_ReceiptPDU:*/
on timer Timer_EISTire_State_AR2_ReceiptPDU
{
	//cyclic, dual cycle und cyclicandchange
	@sysvar::CH_Nodes::CH__PDURECEIPT_RECEIVE_EIS_Tire_State_AR2 = 1;
}
/*@@end*/
/*@@timer:Timer_TrafficInfo_AR_ReceiptPDU:*/
on timer Timer_EISTrafficInfo_AR_ReceiptPDU
{
	//cyclic, dual cycle und cyclicandchange
	@sysvar::CH_Nodes::CH__PDURECEIPT_RECEIVE_EIS_TrafficInfo_AR = 1;
}
/*@@end*/
/*@@timer:Timer_Trailer_Stat_AR2_ReceiptPDU:*/
on timer Timer_EISTrailer_Stat_AR2_ReceiptPDU
{
	//cyclic, dual cycle und cyclicandchange
	@sysvar::CH_Nodes::CH__PDURECEIPT_RECEIVE_EIS_Trailer_Stat_AR2 = 1;
}
/*@@end*/
/*@@timer:Timer_TSA_Disp_Rq1_AR2_ReceiptPDU:*/
on timer Timer_EISTSA_Disp_Rq1_AR2_ReceiptPDU
{
	//cyclic, dual cycle und cyclicandchange
	@sysvar::CH_Nodes::CH__PDURECEIPT_RECEIVE_EIS_TSA_Disp_Rq1_AR2 = 1;
}
/*@@end*/
/*@@timer:Timer_TSA_Disp_Rq2_AR_ReceiptPDU:*/
on timer Timer_EISTSA_Disp_Rq2_AR_ReceiptPDU
{
	//cyclic, dual cycle und cyclicandchange
	@sysvar::CH_Nodes::CH__PDURECEIPT_RECEIVE_EIS_TSA_Disp_Rq2_AR = 1;
}
/*@@end*/
/*@@timer:Timer_TSA_Disp_Rq3_AR_ReceiptPDU:*/
on timer Timer_EISTSA_Disp_Rq3_AR_ReceiptPDU
{
	//cyclic, dual cycle und cyclicandchange
	@sysvar::CH_Nodes::CH__PDURECEIPT_RECEIVE_EIS_TSA_Disp_Rq3_AR = 1;
}
/*@@end*/
/*@@timer:Timer_VehAccel_X_Rq_Gw_AR2_ReceiptPDU:*/
on timer Timer_EISVehAccel_X_Rq_Gw_AR2_ReceiptPDU
{
	//cyclic, dual cycle und cyclicandchange
	@sysvar::CH_Nodes::CH__PDURECEIPT_RECEIVE_EIS_VehAccel_X_Rq_Gw_AR2 = 1;
}
/*@@end*/
/*@@timer:Timer_VIN_AR_ReceiptPDU:*/
on timer Timer_EISVIN_AR_ReceiptPDU
{
	//BAF, spontaneous und onchange
	@sysvar::CH_Nodes::CH__PDURECEIPT_RECEIVE_EIS_VIN_AR = 2;
}
/*@@end*/
/*@@timer:Timer_Wiper_Stat_AR_ReceiptPDU:*/
on timer Timer_EISWiper_Stat_AR_ReceiptPDU
{
	//cyclic, dual cycle und cyclicandchange
	@sysvar::CH_Nodes::CH__PDURECEIPT_RECEIVE_EIS_Wiper_Stat_AR = 1;
}
/*@@end*/
/*@@timer:Timer_WUDOP_EIS_FR_ReceiptPDU:*/
on timer Timer_EISWUDOP_EIS_FR_ReceiptPDU
{
	//cyclic, dual cycle und cyclicandchange
	@sysvar::CH_Nodes::CH__PDURECEIPT_RECEIVE_EIS_WUDOP_EIS_FR = 1;
}
/*@@end*/
/*@@timer:Timer_YMAS_Rq_MPC_AR2_ReceiptPDU:*/
on timer Timer_EISYMAS_Rq_MPC_AR2_ReceiptPDU
{
	//cyclic, dual cycle und cyclicandchange
	@sysvar::CH_Nodes::CH__PDURECEIPT_RECEIVE_EIS_YMAS_Rq_MPC_AR2 = 1;
}
/*@@end*/
/*@@timer:Timer_DTQ_Rs_AR2_ReceiptPDU:*/
on timer Timer_EPSDTQ_Rs_AR2_ReceiptPDU
{
	//cyclic, dual cycle und cyclicandchange
	@sysvar::CH_Nodes::CH__PDURECEIPT_RECEIVE_EPS_DTQ_Rs_AR2 = 1;
}
/*@@end*/
/*@@timer:Timer_EPS_Stat_Disp_Rq_AR2_ReceiptPDU:*/
on timer Timer_EPSEPS_Stat_Disp_Rq_AR2_ReceiptPDU
{
	//cyclic, dual cycle und cyclicandchange
	@sysvar::CH_Nodes::CH__PDURECEIPT_RECEIVE_EPS_EPS_Stat_Disp_Rq_AR2 = 1;
}
/*@@end*/
/*@@timer:Timer_PARK_St_Rs_AR2_ReceiptPDU:*/
on timer Timer_EPSPARK_St_Rs_AR2_ReceiptPDU
{
	//cyclic, dual cycle und cyclicandchange
	@sysvar::CH_Nodes::CH__PDURECEIPT_RECEIVE_EPS_PARK_St_Rs_AR2 = 1;
}
/*@@end*/
/*@@timer:Timer_ROE_EPS_ReceiptPDU:*/
on timer Timer_EPSROE_EPS_ReceiptPDU
{
	//BAF, spontaneous und onchange
	@sysvar::CH_Nodes::CH__PDURECEIPT_RECEIVE_EPS_ROE_EPS = 2;
}
/*@@end*/
/*@@timer:Timer_STA_Rs1_AR2_ReceiptPDU:*/
on timer Timer_EPSSTA_Rs1_AR2_ReceiptPDU
{
	//cyclic, dual cycle und cyclicandchange
	@sysvar::CH_Nodes::CH__PDURECEIPT_RECEIVE_EPS_STA_Rs1_AR2 = 1;
}
/*@@end*/
/*@@timer:Timer_TBCSC_EPS_DAC_AR2_ReceiptPDU:*/
on timer Timer_EPSTBCSC_EPS_DAC_AR2_ReceiptPDU
{
	//BAF, spontaneous und onchange
	@sysvar::CH_Nodes::CH__PDURECEIPT_RECEIVE_EPS_TBCSC_EPS_DAC_AR2 = 2;
}
/*@@end*/
/*@@timer:Timer_TBCSC_Rs_EPS_AR2_ReceiptPDU:*/
on timer Timer_EPSTBCSC_Rs_EPS_AR2_ReceiptPDU
{
	//BAF, spontaneous und onchange
	@sysvar::CH_Nodes::CH__PDURECEIPT_RECEIVE_EPS_TBCSC_Rs_EPS_AR2 = 2;
}
/*@@end*/
/*@@timer:Timer_WUDOP_EPS_FR_ReceiptPDU:*/
on timer Timer_EPSWUDOP_EPS_FR_ReceiptPDU
{
	//cyclic, dual cycle und cyclicandchange
	@sysvar::CH_Nodes::CH__PDURECEIPT_RECEIVE_EPS_WUDOP_EPS_FR = 1;
}
/*@@end*/
/*@@timer:Timer_AWD_TCASE_Rq_ESP_AR2_ReceiptPDU:*/
on timer Timer_ESPAWD_TCASE_Rq_ESP_AR2_ReceiptPDU
{
	//cyclic, dual cycle und cyclicandchange
	@sysvar::CH_Nodes::CH__PDURECEIPT_RECEIVE_ESP_AWD_TCASE_Rq_ESP_AR2 = 1;
}
/*@@end*/
/*@@timer:Timer_BrkSys_Stat_AR2_ReceiptPDU:*/
on timer Timer_ESPBrkSys_Stat_AR2_ReceiptPDU
{
	//cyclic, dual cycle und cyclicandchange
	@sysvar::CH_Nodes::CH__PDURECEIPT_RECEIVE_ESP_BrkSys_Stat_AR2 = 1;
}
/*@@end*/
/*@@timer:Timer_DPC_Disp_Rq_AR2_ReceiptPDU:*/
on timer Timer_ESPDPC_Disp_Rq_AR2_ReceiptPDU
{
	//cyclic, dual cycle und cyclicandchange
	@sysvar::CH_Nodes::CH__PDURECEIPT_RECEIVE_ESP_DPC_Disp_Rq_AR2 = 1;
}
/*@@end*/
/*@@timer:Timer_DPC_IndMd_Stat_AR2_ReceiptPDU:*/
on timer Timer_ESPDPC_IndMd_Stat_AR2_ReceiptPDU
{
	//cyclic, dual cycle und cyclicandchange
	@sysvar::CH_Nodes::CH__PDURECEIPT_RECEIVE_ESP_DPC_IndMd_Stat_AR2 = 1;
}
/*@@end*/
/*@@timer:Timer_DPC_IndMd_Style2_AR2_ReceiptPDU:*/
on timer Timer_ESPDPC_IndMd_Style2_AR2_ReceiptPDU
{
	//cyclic, dual cycle und cyclicandchange
	@sysvar::CH_Nodes::CH__PDURECEIPT_RECEIVE_ESP_DPC_IndMd_Style2_AR2 = 1;
}
/*@@end*/
/*@@timer:Timer_DPC_IndMd_Style_AR2_ReceiptPDU:*/
on timer Timer_ESPDPC_IndMd_Style_AR2_ReceiptPDU
{
	//cyclic, dual cycle und cyclicandchange
	@sysvar::CH_Nodes::CH__PDURECEIPT_RECEIVE_ESP_DPC_IndMd_Style_AR2 = 1;
}
/*@@end*/
/*@@timer:Timer_DPC_Master_Rq_AR2_ReceiptPDU:*/
on timer Timer_ESPDPC_Master_Rq_AR2_ReceiptPDU
{
	//cyclic, dual cycle und cyclicandchange
	@sysvar::CH_Nodes::CH__PDURECEIPT_RECEIVE_ESP_DPC_Master_Rq_AR2 = 1;
}
/*@@end*/
/*@@timer:Timer_Eng_Susp_Rq_AS_AR2_ReceiptPDU:*/
on timer Timer_ESPEng_Susp_Rq_AS_AR2_ReceiptPDU
{
	//cyclic, dual cycle und cyclicandchange
	@sysvar::CH_Nodes::CH__PDURECEIPT_RECEIVE_ESP_Eng_Susp_Rq_AS_AR2 = 1;
}
/*@@end*/
/*@@timer:Timer_EPKB_Disp_IndLmp_Rq_2_AR2_ReceiptPDU:*/
on timer Timer_ESPEPKB_Disp_IndLmp_Rq_2_AR2_ReceiptPDU
{
	//cyclic, dual cycle und cyclicandchange
	@sysvar::CH_Nodes::CH__PDURECEIPT_RECEIVE_ESP_EPKB_Disp_IndLmp_Rq_2_AR2 = 1;
}
/*@@end*/
/*@@timer:Timer_EPKB_Stat_Gw_AR2_ReceiptPDU:*/
on timer Timer_ESPEPKB_Stat_Gw_AR2_ReceiptPDU
{
	//cyclic, dual cycle und cyclicandchange
	@sysvar::CH_Nodes::CH__PDURECEIPT_RECEIVE_ESP_EPKB_Stat_Gw_AR2 = 1;
}
/*@@end*/
/*@@timer:Timer_ESP_Disp_Rq2_AR2_ReceiptPDU:*/
on timer Timer_ESPESP_Disp_Rq2_AR2_ReceiptPDU
{
	//cyclic, dual cycle und cyclicandchange
	@sysvar::CH_Nodes::CH__PDURECEIPT_RECEIVE_ESP_ESP_Disp_Rq2_AR2 = 1;
}
/*@@end*/
/*@@timer:Timer_ESP_Disp_Rq3_AR_ReceiptPDU:*/
on timer Timer_ESPESP_Disp_Rq3_AR_ReceiptPDU
{
	//cyclic, dual cycle und cyclicandchange
	@sysvar::CH_Nodes::CH__PDURECEIPT_RECEIVE_ESP_ESP_Disp_Rq3_AR = 1;
}
/*@@end*/
/*@@timer:Timer_ESP_Disp_Rq_AMG_AR2_ReceiptPDU:*/
on timer Timer_ESPESP_Disp_Rq_AMG_AR2_ReceiptPDU
{
	//cyclic, dual cycle und cyclicandchange
	@sysvar::CH_Nodes::CH__PDURECEIPT_RECEIVE_ESP_ESP_Disp_Rq_AMG_AR2 = 1;
}
/*@@end*/
/*@@timer:Timer_ESP_Disp_Rq_AR2_ReceiptPDU:*/
on timer Timer_ESPESP_Disp_Rq_AR2_ReceiptPDU
{
	//cyclic, dual cycle und cyclicandchange
	@sysvar::CH_Nodes::CH__PDURECEIPT_RECEIVE_ESP_ESP_Disp_Rq_AR2 = 1;
}
/*@@end*/
/*@@timer:Timer_ESP_OBD_Stat_AR_ReceiptPDU:*/
on timer Timer_ESPESP_OBD_Stat_AR_ReceiptPDU
{
	//cyclic, dual cycle und cyclicandchange
	@sysvar::CH_Nodes::CH__PDURECEIPT_RECEIVE_ESP_ESP_OBD_Stat_AR = 1;
}
/*@@end*/
/*@@timer:Timer_ESP_Stat1_AR2_ReceiptPDU:*/
on timer Timer_ESPESP_Stat1_AR2_ReceiptPDU
{
	//cyclic, dual cycle und cyclicandchange
	@sysvar::CH_Nodes::CH__PDURECEIPT_RECEIVE_ESP_ESP_Stat1_AR2 = 1;
}
/*@@end*/
/*@@timer:Timer_LDC_Disp_Rq_ESP_AR_ReceiptPDU:*/
on timer Timer_ESPLDC_Disp_Rq_ESP_AR_ReceiptPDU
{
	//cyclic, dual cycle und cyclicandchange
	@sysvar::CH_Nodes::CH__PDURECEIPT_RECEIVE_ESP_LDC_Disp_Rq_ESP_AR = 1;
}
/*@@end*/
/*@@timer:Timer_PARK_Brk_Rs_AR2_ReceiptPDU:*/
on timer Timer_ESPPARK_Brk_Rs_AR2_ReceiptPDU
{
	//cyclic, dual cycle und cyclicandchange
	@sysvar::CH_Nodes::CH__PDURECEIPT_RECEIVE_ESP_PARK_Brk_Rs_AR2 = 1;
}
/*@@end*/
/*@@timer:Timer_PARK_Drv_Rq_ESP_AR2_ReceiptPDU:*/
on timer Timer_ESPPARK_Drv_Rq_ESP_AR2_ReceiptPDU
{
	//cyclic, dual cycle und cyclicandchange
	@sysvar::CH_Nodes::CH__PDURECEIPT_RECEIVE_ESP_PARK_Drv_Rq_ESP_AR2 = 1;
}
/*@@end*/
/*@@timer:Timer_PresfCtrl_Rq_ESP_AR2_ReceiptPDU:*/
on timer Timer_ESPPresfCtrl_Rq_ESP_AR2_ReceiptPDU
{
	//cyclic, dual cycle und cyclicandchange
	@sysvar::CH_Nodes::CH__PDURECEIPT_RECEIVE_ESP_PresfCtrl_Rq_ESP_AR2 = 1;
}
/*@@end*/
/*@@timer:Timer_PT_Rq_ESP_AR2_ReceiptPDU:*/
on timer Timer_ESPPT_Rq_ESP_AR2_ReceiptPDU
{
	//cyclic, dual cycle und cyclicandchange
	@sysvar::CH_Nodes::CH__PDURECEIPT_RECEIVE_ESP_PT_Rq_ESP_AR2 = 1;
}
/*@@end*/
/*@@timer:Timer_ROE_ESP_ReceiptPDU:*/
on timer Timer_ESPROE_ESP_ReceiptPDU
{
	//BAF, spontaneous und onchange
	@sysvar::CH_Nodes::CH__PDURECEIPT_RECEIVE_ESP_ROE_ESP = 2;
}
/*@@end*/
/*@@timer:Timer_SADR_Trgr_ESP_AR2_ReceiptPDU:*/
on timer Timer_ESPSADR_Trgr_ESP_AR2_ReceiptPDU
{
	//BAF, spontaneous und onchange
	@sysvar::CH_Nodes::CH__PDURECEIPT_RECEIVE_ESP_SADR_Trgr_ESP_AR2 = 2;
}
/*@@end*/
/*@@timer:Timer_St_Rq_STA_AR2_ReceiptPDU:*/
on timer Timer_ESPSt_Rq_STA_AR2_ReceiptPDU
{
	//cyclic, dual cycle und cyclicandchange
	@sysvar::CH_Nodes::CH__PDURECEIPT_RECEIVE_ESP_St_Rq_STA_AR2 = 1;
}
/*@@end*/
/*@@timer:Timer_TBCSC_ESP_DAC_AR2_ReceiptPDU:*/
on timer Timer_ESPTBCSC_ESP_DAC_AR2_ReceiptPDU
{
	//BAF, spontaneous und onchange
	@sysvar::CH_Nodes::CH__PDURECEIPT_RECEIVE_ESP_TBCSC_ESP_DAC_AR2 = 2;
}
/*@@end*/
/*@@timer:Timer_TBCSC_Rs1_ESP_AR2_ReceiptPDU:*/
on timer Timer_ESPTBCSC_Rs1_ESP_AR2_ReceiptPDU
{
	//BAF, spontaneous und onchange
	@sysvar::CH_Nodes::CH__PDURECEIPT_RECEIVE_ESP_TBCSC_Rs1_ESP_AR2 = 2;
}
/*@@end*/
/*@@timer:Timer_TBCSC_Rs2_ESP_AR2_ReceiptPDU:*/
on timer Timer_ESPTBCSC_Rs2_ESP_AR2_ReceiptPDU
{
	//BAF, spontaneous und onchange
	@sysvar::CH_Nodes::CH__PDURECEIPT_RECEIVE_ESP_TBCSC_Rs2_ESP_AR2 = 2;
}
/*@@end*/
/*@@timer:Timer_VehAccel_X_Rs1_AR2_ReceiptPDU:*/
on timer Timer_ESPVehAccel_X_Rs1_AR2_ReceiptPDU
{
	//cyclic, dual cycle und cyclicandchange
	@sysvar::CH_Nodes::CH__PDURECEIPT_RECEIVE_ESP_VehAccel_X_Rs1_AR2 = 1;
}
/*@@end*/
/*@@timer:Timer_VehAccel_X_Rs2_AR2_ReceiptPDU:*/
on timer Timer_ESPVehAccel_X_Rs2_AR2_ReceiptPDU
{
	//cyclic, dual cycle und cyclicandchange
	@sysvar::CH_Nodes::CH__PDURECEIPT_RECEIVE_ESP_VehAccel_X_Rs2_AR2 = 1;
}
/*@@end*/
/*@@timer:Timer_VehDyn_Stat1_AR2_ReceiptPDU:*/
on timer Timer_ESPVehDyn_Stat1_AR2_ReceiptPDU
{
	//cyclic, dual cycle und cyclicandchange
	@sysvar::CH_Nodes::CH__PDURECEIPT_RECEIVE_ESP_VehDyn_Stat1_AR2 = 1;
}
/*@@end*/
/*@@timer:Timer_VehDyn_Stat2_AR2_ReceiptPDU:*/
on timer Timer_ESPVehDyn_Stat2_AR2_ReceiptPDU
{
	//cyclic, dual cycle und cyclicandchange
	@sysvar::CH_Nodes::CH__PDURECEIPT_RECEIVE_ESP_VehDyn_Stat2_AR2 = 1;
}
/*@@end*/
/*@@timer:Timer_VehSpd_X_AR2_ReceiptPDU:*/
on timer Timer_ESPVehSpd_X_AR2_ReceiptPDU
{
	//cyclic, dual cycle und cyclicandchange
	@sysvar::CH_Nodes::CH__PDURECEIPT_RECEIVE_ESP_VehSpd_X_AR2 = 1;
}
/*@@end*/
/*@@timer:Timer_Whl_Lt_Stat_AR2_ReceiptPDU:*/
on timer Timer_ESPWhl_Lt_Stat_AR2_ReceiptPDU
{
	//cyclic, dual cycle und cyclicandchange
	@sysvar::CH_Nodes::CH__PDURECEIPT_RECEIVE_ESP_Whl_Lt_Stat_AR2 = 1;
}
/*@@end*/
/*@@timer:Timer_Whl_Rt_Stat_AR2_ReceiptPDU:*/
on timer Timer_ESPWhl_Rt_Stat_AR2_ReceiptPDU
{
	//cyclic, dual cycle und cyclicandchange
	@sysvar::CH_Nodes::CH__PDURECEIPT_RECEIVE_ESP_Whl_Rt_Stat_AR2 = 1;
}
/*@@end*/
/*@@timer:Timer_WhlPlsCnt_TPM_AR2_ReceiptPDU:*/
on timer Timer_ESPWhlPlsCnt_TPM_AR2_ReceiptPDU
{
	//cyclic, dual cycle und cyclicandchange
	@sysvar::CH_Nodes::CH__PDURECEIPT_RECEIVE_ESP_WhlPlsCnt_TPM_AR2 = 1;
}
/*@@end*/
/*@@timer:Timer_WUDOP_ESP_FR_ReceiptPDU:*/
on timer Timer_ESPWUDOP_ESP_FR_ReceiptPDU
{
	//cyclic, dual cycle und cyclicandchange
	@sysvar::CH_Nodes::CH__PDURECEIPT_RECEIVE_ESP_WUDOP_ESP_FR = 1;
}
/*@@end*/
/*@@timer:Timer_YMAS_Rs_AR2_ReceiptPDU:*/
on timer Timer_ESPYMAS_Rs_AR2_ReceiptPDU
{
	//cyclic, dual cycle und cyclicandchange
	@sysvar::CH_Nodes::CH__PDURECEIPT_RECEIVE_ESP_YMAS_Rs_AR2 = 1;
}
/*@@end*/
/*@@timer:Timer_CMS_PI_State_AR2_ReceiptPDU:*/
on timer Timer_FCWCMS_PI_State_AR2_ReceiptPDU
{
	//cyclic, dual cycle und cyclicandchange
	@sysvar::CH_Nodes::CH__PDURECEIPT_RECEIVE_FCW_CMS_PI_State_AR2 = 1;
}
/*@@end*/
/*@@timer:Timer_FCW_Disp_Rq_Gw_AR_ReceiptPDU:*/
on timer Timer_FCWFCW_Disp_Rq_Gw_AR_ReceiptPDU
{
	//cyclic, dual cycle und cyclicandchange
	@sysvar::CH_Nodes::CH__PDURECEIPT_RECEIVE_FCW_FCW_Disp_Rq_Gw_AR = 1;
}
/*@@end*/
/*@@timer:Timer_PT_ObjIntrst_AR2_ReceiptPDU:*/
on timer Timer_FCWPT_ObjIntrst_AR2_ReceiptPDU
{
	//cyclic, dual cycle und cyclicandchange
	@sysvar::CH_Nodes::CH__PDURECEIPT_RECEIVE_FCW_PT_ObjIntrst_AR2 = 1;
}
/*@@end*/
/*@@timer:Timer_RDU_Disp_Rq_AR_ReceiptPDU:*/
on timer Timer_FCWRDU_Disp_Rq_AR_ReceiptPDU
{
	//cyclic, dual cycle und cyclicandchange
	@sysvar::CH_Nodes::CH__PDURECEIPT_RECEIVE_FCW_RDU_Disp_Rq_AR = 1;
}
/*@@end*/
/*@@timer:Timer_ROE_RDU_ReceiptPDU:*/
on timer Timer_FCWROE_RDU_ReceiptPDU
{
	//BAF, spontaneous und onchange
	@sysvar::CH_Nodes::CH__PDURECEIPT_RECEIVE_FCW_ROE_RDU = 2;
}
/*@@end*/
/*@@timer:Timer_SADR_Trgr_RDU_AR2_ReceiptPDU:*/
on timer Timer_FCWSADR_Trgr_RDU_AR2_ReceiptPDU
{
	//BAF, spontaneous und onchange
	@sysvar::CH_Nodes::CH__PDURECEIPT_RECEIVE_FCW_SADR_Trgr_RDU_AR2 = 2;
}
/*@@end*/
/*@@timer:Timer_VehAccel_X_Rq_AR2_ReceiptPDU:*/
on timer Timer_FCWVehAccel_X_Rq_AR2_ReceiptPDU
{
	//cyclic, dual cycle und cyclicandchange
	@sysvar::CH_Nodes::CH__PDURECEIPT_RECEIVE_FCW_VehAccel_X_Rq_AR2 = 1;
}
/*@@end*/
/*@@timer:Timer_DTR_Obj_A_FR2_ReceiptPDU:*/
on timer Timer_LRRDTR_Obj_A_FR2_ReceiptPDU
{
	//cyclic, dual cycle und cyclicandchange
	@sysvar::CH_Nodes::CH__PDURECEIPT_RECEIVE_LRR_DTR_Obj_A_FR2 = 1;
}
/*@@end*/
/*@@timer:Timer_DTR_Obj_B_FR2_ReceiptPDU:*/
on timer Timer_LRRDTR_Obj_B_FR2_ReceiptPDU
{
	//cyclic, dual cycle und cyclicandchange
	@sysvar::CH_Nodes::CH__PDURECEIPT_RECEIVE_LRR_DTR_Obj_B_FR2 = 1;
}
/*@@end*/
/*@@timer:Timer_DTR_Obj_C_FR2_ReceiptPDU:*/
on timer Timer_LRRDTR_Obj_C_FR2_ReceiptPDU
{
	//cyclic, dual cycle und cyclicandchange
	@sysvar::CH_Nodes::CH__PDURECEIPT_RECEIVE_LRR_DTR_Obj_C_FR2 = 1;
}
/*@@end*/
/*@@timer:Timer_DTR_Obj_D_FR2_ReceiptPDU:*/
on timer Timer_LRRDTR_Obj_D_FR2_ReceiptPDU
{
	//cyclic, dual cycle und cyclicandchange
	@sysvar::CH_Nodes::CH__PDURECEIPT_RECEIVE_LRR_DTR_Obj_D_FR2 = 1;
}
/*@@end*/
/*@@timer:Timer_DTR_Obj_E_FR2_ReceiptPDU:*/
on timer Timer_LRRDTR_Obj_E_FR2_ReceiptPDU
{
	//cyclic, dual cycle und cyclicandchange
	@sysvar::CH_Nodes::CH__PDURECEIPT_RECEIVE_LRR_DTR_Obj_E_FR2 = 1;
}
/*@@end*/
/*@@timer:Timer_DTR_Obj_F_FR2_ReceiptPDU:*/
on timer Timer_LRRDTR_Obj_F_FR2_ReceiptPDU
{
	//cyclic, dual cycle und cyclicandchange
	@sysvar::CH_Nodes::CH__PDURECEIPT_RECEIVE_LRR_DTR_Obj_F_FR2 = 1;
}
/*@@end*/
/*@@timer:Timer_DTR_Obj_G_FR2_ReceiptPDU:*/
on timer Timer_LRRDTR_Obj_G_FR2_ReceiptPDU
{
	//cyclic, dual cycle und cyclicandchange
	@sysvar::CH_Nodes::CH__PDURECEIPT_RECEIVE_LRR_DTR_Obj_G_FR2 = 1;
}
/*@@end*/
/*@@timer:Timer_DTR_ObjStat_FR2_ReceiptPDU:*/
on timer Timer_LRRDTR_ObjStat_FR2_ReceiptPDU
{
	//cyclic, dual cycle und cyclicandchange
	@sysvar::CH_Nodes::CH__PDURECEIPT_RECEIVE_LRR_DTR_ObjStat_FR2 = 1;
}
/*@@end*/
/*@@timer:Timer_DTR_Polyg_Lt_FR2_ReceiptPDU:*/
on timer Timer_LRRDTR_Polyg_Lt_FR2_ReceiptPDU
{
	//cyclic, dual cycle und cyclicandchange
	@sysvar::CH_Nodes::CH__PDURECEIPT_RECEIVE_LRR_DTR_Polyg_Lt_FR2 = 1;
}
/*@@end*/
/*@@timer:Timer_DTR_Polyg_Rt_FR2_ReceiptPDU:*/
on timer Timer_LRRDTR_Polyg_Rt_FR2_ReceiptPDU
{
	//cyclic, dual cycle und cyclicandchange
	@sysvar::CH_Nodes::CH__PDURECEIPT_RECEIVE_LRR_DTR_Polyg_Rt_FR2 = 1;
}
/*@@end*/
/*@@timer:Timer_DTR_Stat_FR2_ReceiptPDU:*/
on timer Timer_LRRDTR_Stat_FR2_ReceiptPDU
{
	//cyclic, dual cycle und cyclicandchange
	@sysvar::CH_Nodes::CH__PDURECEIPT_RECEIVE_LRR_DTR_Stat_FR2 = 1;
}
/*@@end*/
/*@@timer:Timer_ROE_LRR_ReceiptPDU:*/
on timer Timer_LRRROE_LRR_ReceiptPDU
{
	//BAF, spontaneous und onchange
	@sysvar::CH_Nodes::CH__PDURECEIPT_RECEIVE_LRR_ROE_LRR = 2;
}
/*@@end*/
/*@@timer:Timer_Cam_Stat_AR2_ReceiptPDU:*/
on timer Timer_MPCCam_Stat_AR2_ReceiptPDU
{
	//cyclic, dual cycle und cyclicandchange
	@sysvar::CH_Nodes::CH__PDURECEIPT_RECEIVE_MPC_Cam_Stat_AR2 = 1;
}
/*@@end*/
/*@@timer:Timer_CamLane_Disp_Warn_Rq_Gw_AR2_ReceiptPDU:*/
on timer Timer_MPCCamLane_Disp_Warn_Rq_Gw_AR2_ReceiptPDU
{
	//cyclic, dual cycle und cyclicandchange
	@sysvar::CH_Nodes::CH__PDURECEIPT_RECEIVE_MPC_CamLane_Disp_Warn_Rq_Gw_AR2 = 1;
}
/*@@end*/
/*@@timer:Timer_CamLane_FastAttr1_FR2_ReceiptPDU:*/
on timer Timer_MPCCamLane_FastAttr1_FR2_ReceiptPDU
{
	//cyclic, dual cycle und cyclicandchange
	@sysvar::CH_Nodes::CH__PDURECEIPT_RECEIVE_MPC_CamLane_FastAttr1_FR2 = 1;
}
/*@@end*/
/*@@timer:Timer_CamLane_FastAttr2_FR2_ReceiptPDU:*/
on timer Timer_MPCCamLane_FastAttr2_FR2_ReceiptPDU
{
	//cyclic, dual cycle und cyclicandchange
	@sysvar::CH_Nodes::CH__PDURECEIPT_RECEIVE_MPC_CamLane_FastAttr2_FR2 = 1;
}
/*@@end*/
/*@@timer:Timer_CamLane_LaneAttr1_Gw_AR2_ReceiptPDU:*/
on timer Timer_MPCCamLane_LaneAttr1_Gw_AR2_ReceiptPDU
{
	//cyclic, dual cycle und cyclicandchange
	@sysvar::CH_Nodes::CH__PDURECEIPT_RECEIVE_MPC_CamLane_LaneAttr1_Gw_AR2 = 1;
}
/*@@end*/
/*@@timer:Timer_CamLane_LaneAttr2_Gw_AR2_ReceiptPDU:*/
on timer Timer_MPCCamLane_LaneAttr2_Gw_AR2_ReceiptPDU
{
	//cyclic, dual cycle und cyclicandchange
	@sysvar::CH_Nodes::CH__PDURECEIPT_RECEIVE_MPC_CamLane_LaneAttr2_Gw_AR2 = 1;
}
/*@@end*/
/*@@timer:Timer_CamLane_LaneAttr3_Gw_AR2_ReceiptPDU:*/
on timer Timer_MPCCamLane_LaneAttr3_Gw_AR2_ReceiptPDU
{
	//cyclic, dual cycle und cyclicandchange
	@sysvar::CH_Nodes::CH__PDURECEIPT_RECEIVE_MPC_CamLane_LaneAttr3_Gw_AR2 = 1;
}
/*@@end*/
/*@@timer:Timer_CamLane_LaneAttr4_FR2_ReceiptPDU:*/
on timer Timer_MPCCamLane_LaneAttr4_FR2_ReceiptPDU
{
	//cyclic, dual cycle und cyclicandchange
	@sysvar::CH_Nodes::CH__PDURECEIPT_RECEIVE_MPC_CamLane_LaneAttr4_FR2 = 1;
}
/*@@end*/
/*@@timer:Timer_CamLane_LaneAttr5_FR2_ReceiptPDU:*/
on timer Timer_MPCCamLane_LaneAttr5_FR2_ReceiptPDU
{
	//cyclic, dual cycle und cyclicandchange
	@sysvar::CH_Nodes::CH__PDURECEIPT_RECEIVE_MPC_CamLane_LaneAttr5_FR2 = 1;
}
/*@@end*/
/*@@timer:Timer_CamLane_LaneAttr6_Gw_AR2_ReceiptPDU:*/
on timer Timer_MPCCamLane_LaneAttr6_Gw_AR2_ReceiptPDU
{
	//cyclic, dual cycle und cyclicandchange
	@sysvar::CH_Nodes::CH__PDURECEIPT_RECEIVE_MPC_CamLane_LaneAttr6_Gw_AR2 = 1;
}
/*@@end*/
/*@@timer:Timer_CamLane_LaneAttr7_Gw_AR2_ReceiptPDU:*/
on timer Timer_MPCCamLane_LaneAttr7_Gw_AR2_ReceiptPDU
{
	//cyclic, dual cycle und cyclicandchange
	@sysvar::CH_Nodes::CH__PDURECEIPT_RECEIVE_MPC_CamLane_LaneAttr7_Gw_AR2 = 1;
}
/*@@end*/
/*@@timer:Timer_CamObj_A_Mtn_FR2_ReceiptPDU:*/
on timer Timer_MPCCamObj_A_Mtn_FR2_ReceiptPDU
{
	//cyclic, dual cycle und cyclicandchange
	@sysvar::CH_Nodes::CH__PDURECEIPT_RECEIVE_MPC_CamObj_A_Mtn_FR2 = 1;
}
/*@@end*/
/*@@timer:Timer_CamObj_A_Posn_FR2_ReceiptPDU:*/
on timer Timer_MPCCamObj_A_Posn_FR2_ReceiptPDU
{
	//cyclic, dual cycle und cyclicandchange
	@sysvar::CH_Nodes::CH__PDURECEIPT_RECEIVE_MPC_CamObj_A_Posn_FR2 = 1;
}
/*@@end*/
/*@@timer:Timer_CamObj_B_Mtn_FR2_ReceiptPDU:*/
on timer Timer_MPCCamObj_B_Mtn_FR2_ReceiptPDU
{
	//cyclic, dual cycle und cyclicandchange
	@sysvar::CH_Nodes::CH__PDURECEIPT_RECEIVE_MPC_CamObj_B_Mtn_FR2 = 1;
}
/*@@end*/
/*@@timer:Timer_CamObj_B_Posn_FR2_ReceiptPDU:*/
on timer Timer_MPCCamObj_B_Posn_FR2_ReceiptPDU
{
	//cyclic, dual cycle und cyclicandchange
	@sysvar::CH_Nodes::CH__PDURECEIPT_RECEIVE_MPC_CamObj_B_Posn_FR2 = 1;
}
/*@@end*/
/*@@timer:Timer_CamObj_C_Mtn_FR2_ReceiptPDU:*/
on timer Timer_MPCCamObj_C_Mtn_FR2_ReceiptPDU
{
	//cyclic, dual cycle und cyclicandchange
	@sysvar::CH_Nodes::CH__PDURECEIPT_RECEIVE_MPC_CamObj_C_Mtn_FR2 = 1;
}
/*@@end*/
/*@@timer:Timer_CamObj_C_Posn_FR2_ReceiptPDU:*/
on timer Timer_MPCCamObj_C_Posn_FR2_ReceiptPDU
{
	//cyclic, dual cycle und cyclicandchange
	@sysvar::CH_Nodes::CH__PDURECEIPT_RECEIVE_MPC_CamObj_C_Posn_FR2 = 1;
}
/*@@end*/
/*@@timer:Timer_IHC_Lgt_Stat_MPC_Gw_AR2_ReceiptPDU:*/
on timer Timer_MPCIHC_Lgt_Stat_MPC_Gw_AR2_ReceiptPDU
{
	//cyclic, dual cycle und cyclicandchange
	@sysvar::CH_Nodes::CH__PDURECEIPT_RECEIVE_MPC_IHC_Lgt_Stat_MPC_Gw_AR2 = 1;
}
/*@@end*/
/*@@timer:Timer_IHC_Plus_HL_Stat_AR2_ReceiptPDU:*/
on timer Timer_MPCIHC_Plus_HL_Stat_AR2_ReceiptPDU
{
	//cyclic, dual cycle und cyclicandchange
	@sysvar::CH_Nodes::CH__PDURECEIPT_RECEIVE_MPC_IHC_Plus_HL_Stat_AR2 = 1;
}
/*@@end*/
/*@@timer:Timer_IHC_Plus_Tunnel_3_4_AR2_ReceiptPDU:*/
on timer Timer_MPCIHC_Plus_Tunnel_3_4_AR2_ReceiptPDU
{
	//cyclic, dual cycle und cyclicandchange
	@sysvar::CH_Nodes::CH__PDURECEIPT_RECEIVE_MPC_IHC_Plus_Tunnel_3_4_AR2 = 1;
}
/*@@end*/
/*@@timer:Timer_IHC_Plus_Tunnel_AR2_ReceiptPDU:*/
on timer Timer_MPCIHC_Plus_Tunnel_AR2_ReceiptPDU
{
	//cyclic, dual cycle und cyclicandchange
	@sysvar::CH_Nodes::CH__PDURECEIPT_RECEIVE_MPC_IHC_Plus_Tunnel_AR2 = 1;
}
/*@@end*/
/*@@timer:Timer_Preview_Header1_FR2_ReceiptPDU:*/
on timer Timer_MPCPreview_Header1_FR2_ReceiptPDU
{
	//cyclic, dual cycle und cyclicandchange
	@sysvar::CH_Nodes::CH__PDURECEIPT_RECEIVE_MPC_Preview_Header1_FR2 = 1;
}
/*@@end*/
/*@@timer:Timer_Preview_Header2_FR2_ReceiptPDU:*/
on timer Timer_MPCPreview_Header2_FR2_ReceiptPDU
{
	//cyclic, dual cycle und cyclicandchange
	@sysvar::CH_Nodes::CH__PDURECEIPT_RECEIVE_MPC_Preview_Header2_FR2 = 1;
}
/*@@end*/
/*@@timer:Timer_Preview_ProfData1_FR2_ReceiptPDU:*/
on timer Timer_MPCPreview_ProfData1_FR2_ReceiptPDU
{
	//cyclic, dual cycle und cyclicandchange
	@sysvar::CH_Nodes::CH__PDURECEIPT_RECEIVE_MPC_Preview_ProfData1_FR2 = 1;
}
/*@@end*/
/*@@timer:Timer_Preview_ProfData2_FR2_ReceiptPDU:*/
on timer Timer_MPCPreview_ProfData2_FR2_ReceiptPDU
{
	//cyclic, dual cycle und cyclicandchange
	@sysvar::CH_Nodes::CH__PDURECEIPT_RECEIVE_MPC_Preview_ProfData2_FR2 = 1;
}
/*@@end*/
/*@@timer:Timer_ROE_SMPC_ReceiptPDU:*/
on timer Timer_MPCROE_SMPC_ReceiptPDU
{
	//BAF, spontaneous und onchange
	@sysvar::CH_Nodes::CH__PDURECEIPT_RECEIVE_MPC_ROE_SMPC = 2;
}
/*@@end*/
/*@@timer:Timer_SPL_Obj1_Obj2_MPC_AR2_ReceiptPDU:*/
on timer Timer_MPCSPL_Obj1_Obj2_MPC_AR2_ReceiptPDU
{
	//cyclic, dual cycle und cyclicandchange
	@sysvar::CH_Nodes::CH__PDURECEIPT_RECEIVE_MPC_SPL_Obj1_Obj2_MPC_AR2 = 1;
}
/*@@end*/
/*@@timer:Timer_TSA_Disp_Rq1_Gw_AR2_ReceiptPDU:*/
on timer Timer_MPCTSA_Disp_Rq1_Gw_AR2_ReceiptPDU
{
	//cyclic, dual cycle und cyclicandchange
	@sysvar::CH_Nodes::CH__PDURECEIPT_RECEIVE_MPC_TSA_Disp_Rq1_Gw_AR2 = 1;
}
/*@@end*/
/*@@timer:Timer_TSA_Disp_Rq2_Gw_AR_ReceiptPDU:*/
on timer Timer_MPCTSA_Disp_Rq2_Gw_AR_ReceiptPDU
{
	//cyclic, dual cycle und cyclicandchange
	@sysvar::CH_Nodes::CH__PDURECEIPT_RECEIVE_MPC_TSA_Disp_Rq2_Gw_AR = 1;
}
/*@@end*/
/*@@timer:Timer_TSA_Disp_Rq3_Gw_AR_ReceiptPDU:*/
on timer Timer_MPCTSA_Disp_Rq3_Gw_AR_ReceiptPDU
{
	//cyclic, dual cycle und cyclicandchange
	@sysvar::CH_Nodes::CH__PDURECEIPT_RECEIVE_MPC_TSA_Disp_Rq3_Gw_AR = 1;
}
/*@@end*/
/*@@timer:Timer_YMAS_Rq_MPC_Gw_AR2_ReceiptPDU:*/
on timer Timer_MPCYMAS_Rq_MPC_Gw_AR2_ReceiptPDU
{
	//cyclic, dual cycle und cyclicandchange
	@sysvar::CH_Nodes::CH__PDURECEIPT_RECEIVE_MPC_YMAS_Rq_MPC_Gw_AR2 = 1;
}
/*@@end*/
/*@@timer:Timer_Brk_Rq_PARK_AR2_ReceiptPDU:*/
on timer Timer_PARKBrk_Rq_PARK_AR2_ReceiptPDU
{
	//cyclic, dual cycle und cyclicandchange
	@sysvar::CH_Nodes::CH__PDURECEIPT_RECEIVE_PARK_Brk_Rq_PARK_AR2 = 1;
}
/*@@end*/
/*@@timer:Timer_ECU_INFO_RVC_AR_ReceiptPDU:*/
on timer Timer_PARKECU_INFO_RVC_AR_ReceiptPDU
{
	//cyclic, dual cycle und cyclicandchange
	@sysvar::CH_Nodes::CH__PDURECEIPT_RECEIVE_PARK_ECU_INFO_RVC_AR = 1;
}
/*@@end*/
/*@@timer:Timer_Park_Disp_Rq_AR2_ReceiptPDU:*/
on timer Timer_PARKPark_Disp_Rq_AR2_ReceiptPDU
{
	//cyclic, dual cycle und cyclicandchange
	@sysvar::CH_Nodes::CH__PDURECEIPT_RECEIVE_PARK_Park_Disp_Rq_AR2 = 1;
}
/*@@end*/
/*@@timer:Timer_Park_Set_Stat_AR2_ReceiptPDU:*/
on timer Timer_PARKPark_Set_Stat_AR2_ReceiptPDU
{
	//cyclic, dual cycle und cyclicandchange
	@sysvar::CH_Nodes::CH__PDURECEIPT_RECEIVE_PARK_Park_Set_Stat_AR2 = 1;
}
/*@@end*/
/*@@timer:Timer_Park_Stat_AR2_ReceiptPDU:*/
on timer Timer_PARKPark_Stat_AR2_ReceiptPDU
{
	//cyclic, dual cycle und cyclicandchange
	@sysvar::CH_Nodes::CH__PDURECEIPT_RECEIVE_PARK_Park_Stat_AR2 = 1;
}
/*@@end*/
/*@@timer:Timer_ParkSensObj_Stat1_FR2_ReceiptPDU:*/
on timer Timer_PARKParkSensObj_Stat1_FR2_ReceiptPDU
{
	//cyclic, dual cycle und cyclicandchange
	@sysvar::CH_Nodes::CH__PDURECEIPT_RECEIVE_PARK_ParkSensObj_Stat1_FR2 = 1;
}
/*@@end*/
/*@@timer:Timer_ParkSensObj_Stat2_FR2_ReceiptPDU:*/
on timer Timer_PARKParkSensObj_Stat2_FR2_ReceiptPDU
{
	//cyclic, dual cycle und cyclicandchange
	@sysvar::CH_Nodes::CH__PDURECEIPT_RECEIVE_PARK_ParkSensObj_Stat2_FR2 = 1;
}
/*@@end*/
/*@@timer:Timer_ParkSpaceMeas_Stat_AR_ReceiptPDU:*/
on timer Timer_PARKParkSpaceMeas_Stat_AR_ReceiptPDU
{
	//cyclic, dual cycle und cyclicandchange
	@sysvar::CH_Nodes::CH__PDURECEIPT_RECEIVE_PARK_ParkSpaceMeas_Stat_AR = 1;
}
/*@@end*/
/*@@timer:Timer_ParkWarn_AR2_ReceiptPDU:*/
on timer Timer_PARKParkWarn_AR2_ReceiptPDU
{
	//cyclic, dual cycle und cyclicandchange
	@sysvar::CH_Nodes::CH__PDURECEIPT_RECEIVE_PARK_ParkWarn_AR2 = 1;
}
/*@@end*/
/*@@timer:Timer_RemPark_Rq_AR2_ReceiptPDU:*/
on timer Timer_PARKRemPark_Rq_AR2_ReceiptPDU
{
	//cyclic, dual cycle und cyclicandchange
	@sysvar::CH_Nodes::CH__PDURECEIPT_RECEIVE_PARK_RemPark_Rq_AR2 = 1;
}
/*@@end*/
/*@@timer:Timer_ROE_PARK_ReceiptPDU:*/
on timer Timer_PARKROE_PARK_ReceiptPDU
{
	//BAF, spontaneous und onchange
	@sysvar::CH_Nodes::CH__PDURECEIPT_RECEIVE_PARK_ROE_PARK = 2;
}
/*@@end*/
/*@@timer:Timer_RVC_SVS_Park_Stat_AR2_ReceiptPDU:*/
on timer Timer_PARKRVC_SVS_Park_Stat_AR2_ReceiptPDU
{
	//cyclic, dual cycle und cyclicandchange
	@sysvar::CH_Nodes::CH__PDURECEIPT_RECEIVE_PARK_RVC_SVS_Park_Stat_AR2 = 1;
}
/*@@end*/
/*@@timer:Timer_SADR_Trgr_PARK_AR2_ReceiptPDU:*/
on timer Timer_PARKSADR_Trgr_PARK_AR2_ReceiptPDU
{
	//BAF, spontaneous und onchange
	@sysvar::CH_Nodes::CH__PDURECEIPT_RECEIVE_PARK_SADR_Trgr_PARK_AR2 = 2;
}
/*@@end*/
/*@@timer:Timer_St_Rq_PARK_AR2_ReceiptPDU:*/
on timer Timer_PARKSt_Rq_PARK_AR2_ReceiptPDU
{
	//cyclic, dual cycle und cyclicandchange
	@sysvar::CH_Nodes::CH__PDURECEIPT_RECEIVE_PARK_St_Rq_PARK_AR2 = 1;
}
/*@@end*/
/*@@timer:Timer_BrkSys_Rq_YMAS_AR2_ReceiptPDU:*/
on timer Timer_RDUBrkSys_Rq_YMAS_AR2_ReceiptPDU
{
	//cyclic, dual cycle und cyclicandchange
	@sysvar::CH_Nodes::CH__PDURECEIPT_RECEIVE_RDU_BrkSys_Rq_YMAS_AR2 = 1;
}
/*@@end*/
/*@@timer:Timer_BSM_Disp_Warn_Rq_Gw_AR2_ReceiptPDU:*/
on timer Timer_RDUBSM_Disp_Warn_Rq_Gw_AR2_ReceiptPDU
{
	//cyclic, dual cycle und cyclicandchange
	@sysvar::CH_Nodes::CH__PDURECEIPT_RECEIVE_RDU_BSM_Disp_Warn_Rq_Gw_AR2 = 1;
}
/*@@end*/
/*@@timer:Timer_CMS_PI_Sd_Stat_MMR_F1_AR2_ReceiptPDU:*/
on timer Timer_RDUCMS_PI_Sd_Stat_MMR_F1_AR2_ReceiptPDU
{
	//BAF, spontaneous und onchange
	@sysvar::CH_Nodes::CH__PDURECEIPT_RECEIVE_RDU_CMS_PI_Sd_Stat_MMR_F1_AR2 = 2;
}
/*@@end*/
/*@@timer:Timer_CMS_PI_Sd_Stat_MMR_F4_AR2_ReceiptPDU:*/
on timer Timer_RDUCMS_PI_Sd_Stat_MMR_F4_AR2_ReceiptPDU
{
	//BAF, spontaneous und onchange
	@sysvar::CH_Nodes::CH__PDURECEIPT_RECEIVE_RDU_CMS_PI_Sd_Stat_MMR_F4_AR2 = 2;
}
/*@@end*/
/*@@timer:Timer_CMS_PI_State_AR2_ReceiptPDU:*/
on timer Timer_RDUCMS_PI_State_AR2_ReceiptPDU
{
	//cyclic, dual cycle und cyclicandchange
	@sysvar::CH_Nodes::CH__PDURECEIPT_RECEIVE_RDU_CMS_PI_State_AR2 = 1;
}
/*@@end*/
/*@@timer:Timer_DTQ_Disp_Warn_Rq_AR2_ReceiptPDU:*/
on timer Timer_RDUDTQ_Disp_Warn_Rq_AR2_ReceiptPDU
{
	//cyclic, dual cycle und cyclicandchange
	@sysvar::CH_Nodes::CH__PDURECEIPT_RECEIVE_RDU_DTQ_Disp_Warn_Rq_AR2 = 1;
}
/*@@end*/
/*@@timer:Timer_DTQ_Rq1_AR2_ReceiptPDU:*/
on timer Timer_RDUDTQ_Rq1_AR2_ReceiptPDU
{
	//cyclic, dual cycle und cyclicandchange
	@sysvar::CH_Nodes::CH__PDURECEIPT_RECEIVE_RDU_DTQ_Rq1_AR2 = 1;
}
/*@@end*/
/*@@timer:Timer_DTQ_Rq2_AR2_ReceiptPDU:*/
on timer Timer_RDUDTQ_Rq2_AR2_ReceiptPDU
{
	//cyclic, dual cycle und cyclicandchange
	@sysvar::CH_Nodes::CH__PDURECEIPT_RECEIVE_RDU_DTQ_Rq2_AR2 = 1;
}
/*@@end*/
/*@@timer:Timer_LDC_Disp_Rq_RDU_AR2_ReceiptPDU:*/
on timer Timer_RDULDC_Disp_Rq_RDU_AR2_ReceiptPDU
{
	//cyclic, dual cycle und cyclicandchange
	@sysvar::CH_Nodes::CH__PDURECEIPT_RECEIVE_RDU_LDC_Disp_Rq_RDU_AR2 = 1;
}
/*@@end*/
/*@@timer:Timer_LDP_Warn_Rq_AR2_ReceiptPDU:*/
on timer Timer_RDULDP_Warn_Rq_AR2_ReceiptPDU
{
	//cyclic, dual cycle und cyclicandchange
	@sysvar::CH_Nodes::CH__PDURECEIPT_RECEIVE_RDU_LDP_Warn_Rq_AR2 = 1;
}
/*@@end*/
/*@@timer:Timer_PT_ObjIntrst_AR2_ReceiptPDU:*/
on timer Timer_RDUPT_ObjIntrst_AR2_ReceiptPDU
{
	//cyclic, dual cycle und cyclicandchange
	@sysvar::CH_Nodes::CH__PDURECEIPT_RECEIVE_RDU_PT_ObjIntrst_AR2 = 1;
}
/*@@end*/
/*@@timer:Timer_RDU_Disp_Rq_AR_ReceiptPDU:*/
on timer Timer_RDURDU_Disp_Rq_AR_ReceiptPDU
{
	//cyclic, dual cycle und cyclicandchange
	@sysvar::CH_Nodes::CH__PDURECEIPT_RECEIVE_RDU_RDU_Disp_Rq_AR = 1;
}
/*@@end*/
/*@@timer:Timer_RDU_GlobalAttr_AR2_ReceiptPDU:*/
on timer Timer_RDURDU_GlobalAttr_AR2_ReceiptPDU
{
	//cyclic, dual cycle und cyclicandchange
	@sysvar::CH_Nodes::CH__PDURECEIPT_RECEIVE_RDU_RDU_GlobalAttr_AR2 = 1;
}
/*@@end*/
/*@@timer:Timer_RDU_Stat1_AR_ReceiptPDU:*/
on timer Timer_RDURDU_Stat1_AR_ReceiptPDU
{
	//cyclic, dual cycle und cyclicandchange
	@sysvar::CH_Nodes::CH__PDURECEIPT_RECEIVE_RDU_RDU_Stat1_AR = 1;
}
/*@@end*/
/*@@timer:Timer_ROE_MMR_F1_ReceiptPDU:*/
on timer Timer_RDUROE_MMR_F1_ReceiptPDU
{
	//BAF, spontaneous und onchange
	@sysvar::CH_Nodes::CH__PDURECEIPT_RECEIVE_RDU_ROE_MMR_F1 = 2;
}
/*@@end*/
/*@@timer:Timer_ROE_MMR_F4_ReceiptPDU:*/
on timer Timer_RDUROE_MMR_F4_ReceiptPDU
{
	//BAF, spontaneous und onchange
	@sysvar::CH_Nodes::CH__PDURECEIPT_RECEIVE_RDU_ROE_MMR_F4 = 2;
}
/*@@end*/
/*@@timer:Timer_ROE_MMR_RM_ReceiptPDU:*/
on timer Timer_RDUROE_MMR_RM_ReceiptPDU
{
	//BAF, spontaneous und onchange
	@sysvar::CH_Nodes::CH__PDURECEIPT_RECEIVE_RDU_ROE_MMR_RM = 2;
}
/*@@end*/
/*@@timer:Timer_ROE_MMR_RS_ReceiptPDU:*/
on timer Timer_RDUROE_MMR_RS_ReceiptPDU
{
	//BAF, spontaneous und onchange
	@sysvar::CH_Nodes::CH__PDURECEIPT_RECEIVE_RDU_ROE_MMR_RS = 2;
}
/*@@end*/
/*@@timer:Timer_ROE_RDU_ReceiptPDU:*/
on timer Timer_RDUROE_RDU_ReceiptPDU
{
	//BAF, spontaneous und onchange
	@sysvar::CH_Nodes::CH__PDURECEIPT_RECEIVE_RDU_ROE_RDU = 2;
}
/*@@end*/
/*@@timer:Timer_SADR_Trgr_RDU_AR2_ReceiptPDU:*/
on timer Timer_RDUSADR_Trgr_RDU_AR2_ReceiptPDU
{
	//BAF, spontaneous und onchange
	@sysvar::CH_Nodes::CH__PDURECEIPT_RECEIVE_RDU_SADR_Trgr_RDU_AR2 = 2;
}
/*@@end*/
/*@@timer:Timer_SCS_Stat1_RDU_AR2_ReceiptPDU:*/
on timer Timer_RDUSCS_Stat1_RDU_AR2_ReceiptPDU
{
	//cyclic, dual cycle und cyclicandchange
	@sysvar::CH_Nodes::CH__PDURECEIPT_RECEIVE_RDU_SCS_Stat1_RDU_AR2 = 1;
}
/*@@end*/
/*@@timer:Timer_SCS_Stat2_RDU_AR2_ReceiptPDU:*/
on timer Timer_RDUSCS_Stat2_RDU_AR2_ReceiptPDU
{
	//cyclic, dual cycle und cyclicandchange
	@sysvar::CH_Nodes::CH__PDURECEIPT_RECEIVE_RDU_SCS_Stat2_RDU_AR2 = 1;
}
/*@@end*/
/*@@timer:Timer_Veh_Stat_RDU_FR2_ReceiptPDU:*/
on timer Timer_RDUVeh_Stat_RDU_FR2_ReceiptPDU
{
	//cyclic, dual cycle und cyclicandchange
	@sysvar::CH_Nodes::CH__PDURECEIPT_RECEIVE_RDU_Veh_Stat_RDU_FR2 = 1;
}
/*@@end*/
/*@@timer:Timer_VehAccel_X_Rq_AR2_ReceiptPDU:*/
on timer Timer_RDUVehAccel_X_Rq_AR2_ReceiptPDU
{
	//cyclic, dual cycle und cyclicandchange
	@sysvar::CH_Nodes::CH__PDURECEIPT_RECEIVE_RDU_VehAccel_X_Rq_AR2 = 1;
}
/*@@end*/
/*@@timer:Timer_LDC_Rq_StWhl_AR2_ReceiptPDU:*/
on timer Timer_SCCMLDC_Rq_StWhl_AR2_ReceiptPDU
{
	//cyclic, dual cycle und cyclicandchange
	@sysvar::CH_Nodes::CH__PDURECEIPT_RECEIVE_SCCM_LDC_Rq_StWhl_AR2 = 1;
}
/*@@end*/
/*@@timer:Timer_LDC_SBW_Rq_SCCM_AR2_ReceiptPDU:*/
on timer Timer_SCCMLDC_SBW_Rq_SCCM_AR2_ReceiptPDU
{
	//cyclic, dual cycle und cyclicandchange
	@sysvar::CH_Nodes::CH__PDURECEIPT_RECEIVE_SCCM_LDC_SBW_Rq_SCCM_AR2 = 1;
}
/*@@end*/
/*@@timer:Timer_ROE_SCCM_ReceiptPDU:*/
on timer Timer_SCCMROE_SCCM_ReceiptPDU
{
	//BAF, spontaneous und onchange
	@sysvar::CH_Nodes::CH__PDURECEIPT_RECEIVE_SCCM_ROE_SCCM = 2;
}
/*@@end*/
/*@@timer:Timer_ROE_SWSP_ReceiptPDU:*/
on timer Timer_SCCMROE_SWSP_ReceiptPDU
{
	//BAF, spontaneous und onchange
	@sysvar::CH_Nodes::CH__PDURECEIPT_RECEIVE_SCCM_ROE_SWSP = 2;
}
/*@@end*/
/*@@timer:Timer_SCCM_Sw_Stat_AR2_ReceiptPDU:*/
on timer Timer_SCCMSCCM_Sw_Stat_AR2_ReceiptPDU
{
	//cyclic, dual cycle und cyclicandchange
	@sysvar::CH_Nodes::CH__PDURECEIPT_RECEIVE_SCCM_SCCM_Sw_Stat_AR2 = 1;
}
/*@@end*/
/*@@timer:Timer_StWhl_Angl_Stat_AR2_ReceiptPDU:*/
on timer Timer_SCCMStWhl_Angl_Stat_AR2_ReceiptPDU
{
	//cyclic, dual cycle und cyclicandchange
	@sysvar::CH_Nodes::CH__PDURECEIPT_RECEIVE_SCCM_StWhl_Angl_Stat_AR2 = 1;
}
/*@@end*/
/*@@timer:Timer_StWhl_OFN_Stat_AR2_ReceiptPDU:*/
on timer Timer_SCCMStWhl_OFN_Stat_AR2_ReceiptPDU
{
	//cyclic, dual cycle und cyclicandchange
	@sysvar::CH_Nodes::CH__PDURECEIPT_RECEIVE_SCCM_StWhl_OFN_Stat_AR2 = 1;
}
/*@@end*/
/*@@timer:Timer_StWhl_Sw_Stat_AR2_ReceiptPDU:*/
on timer Timer_SCCMStWhl_Sw_Stat_AR2_ReceiptPDU
{
	//cyclic, dual cycle und cyclicandchange
	@sysvar::CH_Nodes::CH__PDURECEIPT_RECEIVE_SCCM_StWhl_Sw_Stat_AR2 = 1;
}
/*@@end*/
/*@@timer:Timer_WUDOP_SCCM_FR_ReceiptPDU:*/
on timer Timer_SCCMWUDOP_SCCM_FR_ReceiptPDU
{
	//cyclic, dual cycle und cyclicandchange
	@sysvar::CH_Nodes::CH__PDURECEIPT_RECEIVE_SCCM_WUDOP_SCCM_FR = 1;
}
/*@@end*/
/*@@timer:Timer_CMS_PI_State_AR2_ReceiptPDU:*/
on timer Timer_SDTRCMS_PI_State_AR2_ReceiptPDU
{
	//cyclic, dual cycle und cyclicandchange
	@sysvar::CH_Nodes::CH__PDURECEIPT_RECEIVE_SDTR_CMS_PI_State_AR2 = 1;
}
/*@@end*/
/*@@timer:Timer_LDC_Disp_Rq_RDU_AR2_ReceiptPDU:*/
on timer Timer_SDTRLDC_Disp_Rq_RDU_AR2_ReceiptPDU
{
	//cyclic, dual cycle und cyclicandchange
	@sysvar::CH_Nodes::CH__PDURECEIPT_RECEIVE_SDTR_LDC_Disp_Rq_RDU_AR2 = 1;
}
/*@@end*/
/*@@timer:Timer_PT_ObjIntrst_AR2_ReceiptPDU:*/
on timer Timer_SDTRPT_ObjIntrst_AR2_ReceiptPDU
{
	//cyclic, dual cycle und cyclicandchange
	@sysvar::CH_Nodes::CH__PDURECEIPT_RECEIVE_SDTR_PT_ObjIntrst_AR2 = 1;
}
/*@@end*/
/*@@timer:Timer_RDU_Disp_Rq_AR_ReceiptPDU:*/
on timer Timer_SDTRRDU_Disp_Rq_AR_ReceiptPDU
{
	//cyclic, dual cycle und cyclicandchange
	@sysvar::CH_Nodes::CH__PDURECEIPT_RECEIVE_SDTR_RDU_Disp_Rq_AR = 1;
}
/*@@end*/
/*@@timer:Timer_RDU_Stat1_AR_ReceiptPDU:*/
on timer Timer_SDTRRDU_Stat1_AR_ReceiptPDU
{
	//cyclic, dual cycle und cyclicandchange
	@sysvar::CH_Nodes::CH__PDURECEIPT_RECEIVE_SDTR_RDU_Stat1_AR = 1;
}
/*@@end*/
/*@@timer:Timer_ROE_RDU_ReceiptPDU:*/
on timer Timer_SDTRROE_RDU_ReceiptPDU
{
	//BAF, spontaneous und onchange
	@sysvar::CH_Nodes::CH__PDURECEIPT_RECEIVE_SDTR_ROE_RDU = 2;
}
/*@@end*/
/*@@timer:Timer_SADR_Trgr_RDU_AR2_ReceiptPDU:*/
on timer Timer_SDTRSADR_Trgr_RDU_AR2_ReceiptPDU
{
	//BAF, spontaneous und onchange
	@sysvar::CH_Nodes::CH__PDURECEIPT_RECEIVE_SDTR_SADR_Trgr_RDU_AR2 = 2;
}
/*@@end*/
/*@@timer:Timer_VehAccel_X_Rq_AR2_ReceiptPDU:*/
on timer Timer_SDTRVehAccel_X_Rq_AR2_ReceiptPDU
{
	//cyclic, dual cycle und cyclicandchange
	@sysvar::CH_Nodes::CH__PDURECEIPT_RECEIVE_SDTR_VehAccel_X_Rq_AR2 = 1;
}
/*@@end*/
/*@@timer:Timer_Eng_Rq_ABC_AR2_ReceiptPDU:*/
on timer Timer_SPCEng_Rq_ABC_AR2_ReceiptPDU
{
	//cyclic, dual cycle und cyclicandchange
	@sysvar::CH_Nodes::CH__PDURECEIPT_RECEIVE_SPC_Eng_Rq_ABC_AR2 = 1;
}
/*@@end*/
/*@@timer:Timer_OffRoad_Disp_Rq_AR_ReceiptPDU:*/
on timer Timer_SPCOffRoad_Disp_Rq_AR_ReceiptPDU
{
	//cyclic, dual cycle und cyclicandchange
	@sysvar::CH_Nodes::CH__PDURECEIPT_RECEIVE_SPC_OffRoad_Disp_Rq_AR = 1;
}
/*@@end*/
/*@@timer:Timer_Preview_Data_SPC_AR_ReceiptPDU:*/
on timer Timer_SPCPreview_Data_SPC_AR_ReceiptPDU
{
	//cyclic, dual cycle und cyclicandchange
	@sysvar::CH_Nodes::CH__PDURECEIPT_RECEIVE_SPC_Preview_Data_SPC_AR = 1;
}
/*@@end*/
/*@@timer:Timer_ROE_MPU_FL_ReceiptPDU:*/
on timer Timer_SPCROE_MPU_FL_ReceiptPDU
{
	//BAF, spontaneous und onchange
	@sysvar::CH_Nodes::CH__PDURECEIPT_RECEIVE_SPC_ROE_MPU_FL = 2;
}
/*@@end*/
/*@@timer:Timer_ROE_MPU_FR_ReceiptPDU:*/
on timer Timer_SPCROE_MPU_FR_ReceiptPDU
{
	//BAF, spontaneous und onchange
	@sysvar::CH_Nodes::CH__PDURECEIPT_RECEIVE_SPC_ROE_MPU_FR = 2;
}
/*@@end*/
/*@@timer:Timer_ROE_MPU_RL_ReceiptPDU:*/
on timer Timer_SPCROE_MPU_RL_ReceiptPDU
{
	//BAF, spontaneous und onchange
	@sysvar::CH_Nodes::CH__PDURECEIPT_RECEIVE_SPC_ROE_MPU_RL = 2;
}
/*@@end*/
/*@@timer:Timer_ROE_MPU_RR_ReceiptPDU:*/
on timer Timer_SPCROE_MPU_RR_ReceiptPDU
{
	//BAF, spontaneous und onchange
	@sysvar::CH_Nodes::CH__PDURECEIPT_RECEIVE_SPC_ROE_MPU_RR = 2;
}
/*@@end*/
/*@@timer:Timer_ROE_SPC_ReceiptPDU:*/
on timer Timer_SPCROE_SPC_ReceiptPDU
{
	//BAF, spontaneous und onchange
	@sysvar::CH_Nodes::CH__PDURECEIPT_RECEIVE_SPC_ROE_SPC = 2;
}
/*@@end*/
/*@@timer:Timer_SPC_Disp_Rq_AR_ReceiptPDU:*/
on timer Timer_SPCSPC_Disp_Rq_AR_ReceiptPDU
{
	//cyclic, dual cycle und cyclicandchange
	@sysvar::CH_Nodes::CH__PDURECEIPT_RECEIVE_SPC_SPC_Disp_Rq_AR = 1;
}
/*@@end*/
/*@@timer:Timer_SPC_SwLED_Msg_Rq_AR2_ReceiptPDU:*/
on timer Timer_SPCSPC_SwLED_Msg_Rq_AR2_ReceiptPDU
{
	//cyclic, dual cycle und cyclicandchange
	@sysvar::CH_Nodes::CH__PDURECEIPT_RECEIVE_SPC_SPC_SwLED_Msg_Rq_AR2 = 1;
}
/*@@end*/
/*@@timer:Timer_SpringVlv_Rq_AR_ReceiptPDU:*/
on timer Timer_SPCSpringVlv_Rq_AR_ReceiptPDU
{
	//cyclic, dual cycle und cyclicandchange
	@sysvar::CH_Nodes::CH__PDURECEIPT_RECEIVE_SPC_SpringVlv_Rq_AR = 1;
}
/*@@end*/
/*@@timer:Timer_VehCarv_Stat_AR_ReceiptPDU:*/
on timer Timer_SPCVehCarv_Stat_AR_ReceiptPDU
{
	//cyclic, dual cycle und cyclicandchange
	@sysvar::CH_Nodes::CH__PDURECEIPT_RECEIVE_SPC_VehCarv_Stat_AR = 1;
}
/*@@end*/
/*@@timer:Timer_VehLvl_Stat_AR2_ReceiptPDU:*/
on timer Timer_SPCVehLvl_Stat_AR2_ReceiptPDU
{
	//cyclic, dual cycle und cyclicandchange
	@sysvar::CH_Nodes::CH__PDURECEIPT_RECEIVE_SPC_VehLvl_Stat_AR2 = 1;
}
/*@@end*/
/*@@timer:Timer_ROE_SPC_VX_ReceiptPDU:*/
on timer Timer_SPC_VXROE_SPC_VX_ReceiptPDU
{
	//BAF, spontaneous und onchange
	@sysvar::CH_Nodes::CH__PDURECEIPT_RECEIVE_SPC_VX_ROE_SPC_VX = 2;
}
/*@@end*/
/*@@timer:Timer_SPC_VX_Stat1_AR_ReceiptPDU:*/
on timer Timer_SPC_VXSPC_VX_Stat1_AR_ReceiptPDU
{
	//cyclic, dual cycle und cyclicandchange
	@sysvar::CH_Nodes::CH__PDURECEIPT_RECEIVE_SPC_VX_SPC_VX_Stat1_AR = 1;
}
/*@@end*/
/*@@timer:Timer_SpringVlv_Stat_AR_ReceiptPDU:*/
on timer Timer_SPC_VXSpringVlv_Stat_AR_ReceiptPDU
{
	//cyclic, dual cycle und cyclicandchange
	@sysvar::CH_Nodes::CH__PDURECEIPT_RECEIVE_SPC_VX_SpringVlv_Stat_AR = 1;
}
/*@@end*/

