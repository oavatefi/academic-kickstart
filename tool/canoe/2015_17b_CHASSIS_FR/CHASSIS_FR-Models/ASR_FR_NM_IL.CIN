/*@@includes:*/
includes
{
	#include "FR_BUS_CTRL.CIN"
}
/*@@end*/

/*@@var:*/
/*
|==========================================================================================|
|                                                                                          |
|                                                                                          |
|                                         COPYRIGHT                                        |
|                                                                                          |
|                   Copyright (c) by Daimler AG Abt. RD/EEV 2015                           |
|                                                                                          |
|                                                                                          |
|==========================================================================================|
|                                                                                          |
|                                   CAPL AUTHOR IDENTITY                                   |
|                                   --------------------                                   |
|                                                                                          |
| Initials   | Name                 | Company                                              |
| -----------+----------------------+----------------------------------------------------- |
| BH         | Björn Haßelkus       | Firma TZM (EXTERN im Auftrag der Daimler AG)         |
| RS         | Rainer Schulte       | Firma TZM (EXTERN im Auftrag der Daimler AG)         |
|            |                      |                                                      |
|                                                                                          |
|==========================================================================================|
|                                                                                          |
|                                     REVISION HISTORY                                     |
|                                     ----------------                                     |
|                                                                                          |
| Date       | Ver   | Author       | Description                                          |
| -----------+-------+--------------+----------------------------------------------------- |
| 27.04.15   | 1.0   | RS           | creation                                             |
|            |       |              |                                                      |
|                                                                                          |
|------------------------------------------------------------------------------------------|
*/

variables
{
		/* DAG CAPL NM-IL Include for FlexRay Daimler Interaction Layer with AUTOSAR Network Management
		*
		* This include file establishes the coupling between NM <-> IL.
		* This include is intended for KL30 nodes, which are controlled by an Network Management (NM)
		* and not by the KL15 'ignition' state.
		*
		* ATTENTION:
		*   This include file requires to include the CAPL file "FR_BUS_CTRL.CIN". Consider also the ATTENTION section in that file!
		*   This include requires the simulation node to load the following components:
		*     - DAGFrIL.dll
		*     - AutosarFlexRayNM.dll
		*   This include requires some system variables to be defined:
		*     - @sysvar::CH_NM::CH_IlState as INT of range 0 - 255 initially set to 0
		*     - @sysvar::CH_NM::CH__NMSimStat_%NODE_NAME% as INT of range 0 - 4
		*     - @sysvar::CH_Nodes::CH__NMAwake_%NODE_NAME% as INT in order to set or release a bus request from a panel initially set to 0
		*     - @sysvar::CH_Nodes::CH__NMActive_%NODE_NAME% as INT in order to set the NM to active or passive mode from a panel initially set to 1
		*   This include requires two functions to be defined in the CAPL main program:
		*     - void StartSim(int)
		*     - void StopSim()
		*   The AutosarFlexRayNM.dll requires an INI file in the same directory of the CFG file with the name "<BusName>.ini",
		*     where <BusName> is the name of the bus in CANoes simulation setup, this node %NODE_NAME% belongs to. "%NODE_NAME%" is
		*     the name of the node in the database, this simulation node is attached to. The INI file
		*     needs at least a node section for each node that uses the NM DLL. The node section requires at least
		*     a unique node identifier and an initial passive state for the NM (cf. the User Manual of the DLL), e.g.:
		*       [EIS]
		*       NodeIdentifier=0x7
		*       Passive=0
		*
		* Version 1.1, 2013 Vector Informatik GmbH, Department for Networks and Distributed Systems
		*/

	// Some constants:
	enum tFrNM1_ASR_STATE {
		cFrNM1_ASR_STATE_UNDEFINED         = 0,
		cFrNM1_ASR_STATE_BUS_SLEEP         = 1,
		cFrNM1_ASR_STATE_PREPARE_BUS_SLEEP = 2,
		cFrNM1_ASR_STATE_READY_SLEEP       = 3,
		cFrNM1_ASR_STATE_NORMAL_OPERATION  = 4,
		cFrNM1_ASR_STATE_REPEAT_MESSAGE    = 5,
		cFrNM1_ASR_STATE_SYNCHRONIZE       = 6
	};

	enum tFrNM1_NODE_MODE {
		cFrNM1_NODE_MODE_Undefined         = -1,
		cFrNM1_NODE_MODE_Sleep_Mode        = 0,
		cFrNM1_NODE_MODE_Network_Mode      = 1,
		cFrNM1_NODE_MODE_Synchronize_Mode  = 2
	};

	// Internally used variables and timers:
	long    gFrNM1_ILisOn                = 0;
	long    gFrNM1_CurrentNMState        = cFrNM1_ASR_STATE_UNDEFINED;
	long    gFrNM1_CurrentNodeState      = cFrNM1_NODE_MODE_Undefined;
}
/*@@end*/

/*@@preStart:PreStart:*/
/*****************************************************************************
 * Include Initialization
 *****************************************************************************/

on preStart
{
	//FrNmSetVerbosity(3);
  
	//gFrNM1_DebugFlags |= cFrNM1_InitDebug;

	if (strncmp("%NODE_NAME%", "SPC", 50) == 0)
	{
//		gFrNM1_DebugFlags |= cFrNM1_NMIndDebug;
//		gFrNM1_DebugFlags |= cFrNM1_InitDebug;
//		gFrNM1_DebugFlags |= cFrNM1_NMControlDebug;
//		gFrNM1_DebugFlags |= cFrNM1_BusControlDebug;
//		gFrNM1_DebugFlags |= cFrNM1_ILControlDebug;
//		gFrNM1_DebugFlags |= cFrNM1_ShowPOCDebug;
//		gFrNM1_DebugFlags |= cFrNM1_ShowSymbolDebug;
//		gFrNM1_DebugFlags |= cFrNM1_ShowWakeupDebug;
  }
}
/*@@end*/

/*@@startStart:Start:*/
on start
{
	long result;

	if (gFrNM1_DebugFlags & cFrNM1_InitDebug)
	{
		write("+++++++++ %NODE_NAME%: on start() KL30/NM+IL");
	}

	SetBusContext(gFrNM1_BusContext);
	FrNm_NetworkRelease();
	result = ControlResume();
	StopSim(); // to be defined in main CAPL program
	result = ControlWait();
	gFrNM1_ILisOn = 0;
}
/*@@end*/

/*@@sysvarChange:CH_Nodes::CH__NMAwake_%NODE_NAME%:*/
/*****************************************************************************
 * NM Control
 * These functions can be called from the main program or react on
 * panel controls in order to manipulate the NM status of the controlled node.
 *****************************************************************************/

on sysvar sysvar::CH_Nodes::CH__NMAwake_%NODE_NAME%
{
// ECU needs or does not need bus
	if (@this > 0)
	{
		if (gFrNM1_DebugFlags & cFrNM1_NMControlDebug)
		{
			write("[%.6f %NODE_NAME%]: FrNm_NetworkRequest()", TimeNowNS()/cFrNM1_NS2S);
		}
		SetBusContext(gFrNM1_BusContext);
		FrNm_NetworkRequest();
	}
	else
	{
		if (gFrNM1_DebugFlags & cFrNM1_NMControlDebug)
		{
			write("[%.6f %NODE_NAME%]: FrNm_NetworkRelease()", TimeNowNS()/cFrNM1_NS2S);
		}
		SetBusContext(gFrNM1_BusContext);
		FrNm_NetworkRelease();
	}
}
/*@@end*/

/*@@sysvarChange:CH_Nodes::CH__NMActive_%NODE_NAME%:*/
on sysvar sysvar::CH_Nodes::CH__NMActive_%NODE_NAME%
{
// diasable or enables passive Mode of ECU
	if (@this == 1)
	{
		if (gFrNM1_DebugFlags & cFrNM1_NMControlDebug)
		{
			write("[%.6f %NODE_NAME%]: FrNm_DisablePassiveMode()", TimeNowNS()/cFrNM1_NS2S);
		}
		SetBusContext(gFrNM1_BusContext);
		FrNm_DisablePassiveMode();
	}
	else
	{
		if (gFrNM1_DebugFlags & cFrNM1_NMControlDebug)
		{
			write("[%.6f %NODE_NAME%]: FrNm_EnablePassiveMode()", TimeNowNS()/cFrNM1_NS2S);
		}
		SetBusContext(gFrNM1_BusContext);
		FrNm_EnablePassiveMode();
	}
}
/*@@end*/

/*@@caplFunc:FrNm_BusSleepModeInd():*///callback
/*****************************************************************************
 * NM Indications
 * They are called from the NM simulation in order to control the IL.
 *****************************************************************************/

void FrNm_BusSleepModeInd()
{
	// This callback is called when neither an internal nor any external request is active.
	// Thus, the IL must be stopped sending.
  if (gFrNM1_DebugFlags & cFrNM1_NMIndDebug)
	{
		Write("[%.6f %NODE_NAME%]: FrNm_BusSleepModeInd: Sleep Mode", TimeNowNS()/cFrNM1_NS2S);
	}
	// Stop sending of the IL
	FrNM1_StopIL();
}
/*@@end*/

/*@@caplFunc:FrNm_ControlBitVectorInd(dword,dword):*///callback
void FrNm_ControlBitVectorInd( DWORD sourceId, DWORD controlBits)
{
	if (gFrNM1_DebugFlags & cFrNM1_NMIndDebug)
	{
		Write("[%.6f %NODE_NAME%]: FrNm_ControlBitVectorInd: from node %d, bits %02x", TimeNowNS()/cFrNM1_NS2S, sourceId, controlBits);
	}
}
/*@@end*/

/*@@caplFunc:FrNm_NetworkModeInd():*///callback
void FrNm_NetworkModeInd()
{
	// This callback is called because the NM has an internal or external bus request pending and the IL must be started.
	if (gFrNM1_DebugFlags & cFrNM1_NMIndDebug)
	{
		Write("[%.6f %NODE_NAME%]: FrNm_NetworkModeInd: Network Mode", TimeNowNS()/cFrNM1_NS2S);
	}
	// start sending of the IL
	FrNM1_StartIL();
}
/*@@end*/

/*@@caplFunc:FrNm_NetworkStartInd():*///callback
void FrNm_NetworkStartInd()
{
	// This Callback is called when the NM is sleeping ("BUS_SLEEP" or "PREPARE_BUS_SLEEP") and is receiving the first external NM mesage:
	if (gFrNM1_DebugFlags & cFrNM1_NMIndDebug)
	{
		Write("[%.6f %NODE_NAME%]: FrNm_NetworkStartInd: Network started", TimeNowNS()/cFrNM1_NS2S);
	}
	SetBusContext(gFrNM1_BusContext);
	// activate NM by going to "REPEAT_MESSAGE" and further to "READY_SLEEP" (internal request not present) or "NORMAL_OPERATION" (internal request is present)
	FrNm_PassiveStartUp();
}
/*@@end*/

/*@@caplFunc:FrNm_PduRxInd(dword,dword,long,byte[]):*///callback
void FrNm_PduRxInd( DWORD slotId, DWORD identifier, long bRepeatMessageBit, BYTE data[])
{
	if (gFrNM1_DebugFlags & cFrNM1_NMIndDebug)
	{
		//Write("[%.6f %NODE_NAME%]: FrNm_PduRxInd: slot id=0x%x, NM id=%d, RM=%d, %d byte", TimeNowNS()/cFrNM1_NS2S, slotId, identifier, bRepeatMessageBit, elcount(data) );
	}
}
/*@@end*/

/*@@caplFunc:FrNm_PreSendInd(word[],byte[]):*///callback
void FrNm_PreSendInd( WORD dlcInOut[], BYTE data[])
{
	if (gFrNM1_DebugFlags & cFrNM1_NMIndDebug)
	{
	}
}
/*@@end*/

/*@@caplFunc:FrNm_SynchronizeModeInd():*///callback
void FrNm_SynchronizeModeInd()
{
	// This callback is called when the NM is sleeping ("BUS_SLEEP" or "PREPARE_BUS_SLEEP") and is awoken by any internal or external bus request.
	// Purpose: Start the FlexRay bus and run it synchronously in order to be able to communicate.
	if (gFrNM1_DebugFlags & cFrNM1_NMIndDebug)
	{
		Write("[%.6f %NODE_NAME%]: FrNm_SynchronizeModeInd: Synchronize Mode", TimeNowNS()/cFrNM1_NS2S);
	}
	// We start the bus indirectly by starting the IL first (cf. function implementation)
	FrNM1_StartIL();
}
/*@@end*/

/*@@caplFunc:FrNm_RemoteSleepInd(long):*///callback
void FrNm_RemoteSleepInd( long flag)
{
	if (gFrNM1_DebugFlags & cFrNM1_NMIndDebug)
	{
		if (flag)
			Write("[%.6f %NODE_NAME%]: FrNm_RemoteSleepInd: Other nodes ready to sleep", TimeNowNS()/cFrNM1_NS2S);
		else
			Write("[%.6f %NODE_NAME%]: FrNm_RemoteSleepInd: Another node requests network", TimeNowNS()/cFrNM1_NS2S);
	}
}
/*@@end*/

/*@@caplFunc:FrNm_StateChangeNotification(long,long):*///callback
void FrNm_StateChangeNotification( long previousState, long currentState)
{
	if (gFrNM1_DebugFlags & cFrNM1_NMIndDebug)
	{
		Write("[%.6f %NODE_NAME%]: FrNm_StateChangeNotification: From %d to %d", TimeNowNS()/cFrNM1_NS2S, previousState, currentState);
	}
  
	gFrNM1_CurrentNMState = currentState;

	if ((currentState <= cFrNM1_ASR_STATE_BUS_SLEEP) || (currentState > cFrNM1_ASR_STATE_SYNCHRONIZE))
	{
		gFrNM1_CurrentNodeState = cFrNM1_NODE_MODE_Sleep_Mode;
	}
	else
	{
		if (currentState == cFrNM1_ASR_STATE_SYNCHRONIZE)
		{
			gFrNM1_CurrentNodeState = cFrNM1_NODE_MODE_Synchronize_Mode;
		}
		else
		{
			gFrNM1_CurrentNodeState = cFrNM1_NODE_MODE_Network_Mode;
		}
	}

	if ((previousState == 3) && (currentState == 4))
	{
		// From READY_SLEEP to NORMAL (we got an internal request):
		if (@sysvar::CH_NM::CH__BusState == cFrNM1_BUS_STATE_ASYNC)
		{
			FrNM1_StartFlexRayBus(1);
			@sysvar::CH_NM::CH__IlState++;
		}
	}

	switch (currentState) 
	{
		case (1): //bus sleep
			enableControl("CHASSIS_FR Netzmanagement", "CH__NMActive_%NODE_NAME%", 1);
			@sysvar::CH_NM::CH__NMSimStat_%NODE_NAME% = 0;
			break;
		case (2): //prepare bus sleep
			enableControl("CHASSIS_FR Netzmanagement", "CH__NMActive_%NODE_NAME%", 0);
			@sysvar::CH_NM::CH__NMSimStat_%NODE_NAME% = 1;
			break;
		case (3): //ready sleep
			enableControl("CHASSIS_FR Netzmanagement", "CH__NMActive_%NODE_NAME%", 0);
			@sysvar::CH_NM::CH__NMSimStat_%NODE_NAME% = 2;
			break;
		case (4): //normal
			enableControl("CHASSIS_FR Netzmanagement", "CH__NMActive_%NODE_NAME%", 0);
			@sysvar::CH_NM::CH__NMSimStat_%NODE_NAME% = 3;
			break;
		case (5): //repeat message
			enableControl("CHASSIS_FR Netzmanagement", "CH__NMActive_%NODE_NAME%", 0);
			@sysvar::CH_NM::CH__NMSimStat_%NODE_NAME% = 4;
			break;
		default:
			break;
	}
}
/*@@end*/

/*@@caplFunc:FrNM1_StartIL():*/
	/*****************************************************************************
 * IL Control
 * These functions control the sending behavior of the node and are called
 * from the NM indications or from the control panel.
 *****************************************************************************/

FrNM1_StartIL ()
{
	long result;
	SetBusContext(gFrNM1_BusContext);
	result = ControlResume(); // The IL starts sending
	StartSim(1); // to be defined in main CAPL program
	if (gFrNM1_ILisOn == 0)
	{
		// The IL was off
		if (@sysvar::CH_NM::CH__IlState >= 0)
			@sysvar::CH_NM::CH__IlState++; // Increment (counter with number of running ILs)
		else
			@sysvar::CH_NM::CH__IlState = 1; // We seem to be the first running IL
		if (gFrNM1_DebugFlags & cFrNM1_ILControlDebug)
		{
			write("[%.6f %NODE_NAME%]: @sysvar::CH_NM::CH__IlState INC = %d", TimeNowNS()/cFrNM1_NS2S, @sysvar::CH_NM::CH__IlState);
		}
	}
	gFrNM1_ILisOn = 1; // Remember that IL is on
}
/*@@end*/

/*@@caplFunc:FrNM1_StopIL():*/
FrNM1_StopIL ()
{
	long result;
	SetBusContext(gFrNM1_BusContext);
	StopSim(); // to be defined in main CAPL program
	result = ControlWait(); // Stop sending of the IL
	if (gFrNM1_ILisOn > 0)
	{
		// The IL was on
		if (@sysvar::CH_NM::CH__IlState > 0)
			@sysvar::CH_NM::CH__IlState--; // Decrement (counter with number of running ILs)
		if (gFrNM1_DebugFlags & cFrNM1_ILControlDebug)
		{
			write("[%.6f %NODE_NAME%]: @sysvar::CH_NM::CH__IlState DEC = %d", TimeNowNS()/cFrNM1_NS2S, @sysvar::CH_NM::CH__IlState);
		}
	}
	gFrNM1_ILisOn = 0; // Remember that IL is off
}
/*@@end*/

/*@@sysvarUpdate@sysvar::CH_NM::CH__IlState:*/
/*****************************************************************************
 * Bus Control
 * These functions control the bus shutdown and startup and is called
 * from within the NM simulation or the control panel.
 *****************************************************************************/

on sysvar_update sysvar::CH_NM::CH__IlState
{
	if (gFrNM1_DebugFlags & cFrNM1_ILControlDebug)
	{
		write("[%.6f %NODE_NAME%]: @sysvar::CH_NM::CH__IlState = %d", TimeNowNS()/cFrNM1_NS2S, @this);
	}

	if (@this > 0)
	{
		// Any IL wants to run:
		FrNM1_StartFlexRayBus(1);
	}
	else
	{
		// All simulated ILs are stopped:
		FrNM1_StopFlexRayBus();
	}
}
/*@@end*/

/*@@caplFunc:FrNM1_RestartAfterWakeupRX():*///callback
FrNM1_RestartAfterWakeupRX() // callback from the bus control after receiving a wakeup
{
	double lastWakeupTime = -1;
	double thisTime;
	thisTime = TimeNowNS()/cFrNM1_NS2S;

	if ( (lastWakeupTime == -1) || ((thisTime - lastWakeupTime) >= 0.005) )
	{
		if (gFrNM1_DebugFlags & cFrNM1_ShowWakeupDebug)
		{
			write("[%.6f %NODE_NAME%]: WAKEUP PROCEDURE ACTIVATED", TimeNowNS()/cFrNM1_NS2S);
		}
		// When we receive a wakeup pattern on FlexRay, then we also start the bus:
		FrNM1_StartFlexRayBus(0);
		SetBusContext(gFrNM1_BusContext);
		FrNm_PassiveStartUp();
		lastWakeupTime = thisTime;  
	}
}
/*@@end*/

/*****************************************************************************
 * EOF
 *****************************************************************************/


