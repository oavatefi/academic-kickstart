/*@!Encoding:1252*/
includes
{
	#include "ASR_FR_NM_IL.CIN"
}

/*
|==========================================================================================|
|                                                                                          |
|                                                                                          |
|                                         COPYRIGHT                                        |
|                                                                                          |
|                   Copyright (c) by Daimler AG Abt. RD/EEV 2015                           |
|                                                                                          |
|                                                                                          |
|==========================================================================================|
|                                                                                          |
|                                   CAPL AUTHOR IDENTITY                                   |
|                                   --------------------                                   |
|                                                                                          |
| Initials   | Name                 | Company                                              |
| -----------+----------------------+----------------------------------------------------- |
| BH         | Björn Haßelkus       | Firma TZM (EXTERN im Auftrag der Daimler AG)         |
| RS         | Rainer Schulte       | Firma TZM (EXTERN im Auftrag der Daimler AG)         |
|            |                      |                                                      |
|                                                                                          |
|==========================================================================================|
|                                                                                          |
|                                     REVISION HISTORY                                     |
|                                     ----------------                                     |
|                                                                                          |
| Date       | Ver   | Author       | Description                                          |
| -----------+-------+--------------+----------------------------------------------------- |
| 27.04.15   | 1.0   | RS           | creation                                             |
|            |       |              |                                                      |
|                                                                                          |
|------------------------------------------------------------------------------------------|
*/

variables
{
	long ret_Register;
	// global variable for getting (showing) results auf dll-Functions
	long result;

	FrPDU ADAS_PREDICTION_AR PDU_ADAS_PREDICTION_AR;
	FrPDU ADAS_PROFILE_LONG_AR PDU_ADAS_PROFILE_LONG_AR;
	FrPDU ADAS_PROFILE_SHORT_AR PDU_ADAS_PROFILE_SHORT_AR;
	FrPDU ADASLR_PROFILE_LONG_AR PDU_ADASLR_PROFILE_LONG_AR;
	int TGL_VAL_ckl_Sw_3L_SAM_R_;	
	int TGL_ckl_Sw_3L_SAM_R_;	
	int TGL_VAL_ckl_Sw_3R_SAM_R_;	
	int TGL_ckl_Sw_3R_SAM_R_;	
	int TGL_VAL_ckl_Sw_RL_SAM_R_;	
	int TGL_ckl_Sw_RL_SAM_R_;	
	int TGL_VAL_ckl_Sw_RM_SAM_R_;	
	int TGL_ckl_Sw_RM_SAM_R_;	
	int TGL_VAL_ckl_Sw_RR_SAM_R_;	
	int TGL_ckl_Sw_RR_SAM_R_;	
	int CRC_CamLane_Disp_Warn_Rq_Pr2;
	dword CounterValForCRC_CamLane_Disp_Warn_Rq_Pr2;
	int SQC_VAL_CamLane_Disp_Warn_Rq_Pr2;
	int SQC_CamLane_Disp_Warn_Rq_Pr2;
	int CRC_CamLane_LaneAttr1_Pr2;
	dword CounterValForCRC_CamLane_LaneAttr1_Pr2;
	int SQC_VAL_CamLane_LaneAttr1_Pr2;
	int SQC_CamLane_LaneAttr1_Pr2;
	int CRC_CamLane_LaneAttr2_Pr2;
	dword CounterValForCRC_CamLane_LaneAttr2_Pr2;
	int SQC_VAL_CamLane_LaneAttr2_Pr2;
	int SQC_CamLane_LaneAttr2_Pr2;
	int CRC_CamLane_LaneAttr3_Pr2;
	dword CounterValForCRC_CamLane_LaneAttr3_Pr2;
	int SQC_VAL_CamLane_LaneAttr3_Pr2;
	int SQC_CamLane_LaneAttr3_Pr2;
	int CRC_CamLane_LaneAttr6_Pr2;
	dword CounterValForCRC_CamLane_LaneAttr6_Pr2;
	int SQC_VAL_CamLane_LaneAttr6_Pr2;
	int SQC_CamLane_LaneAttr6_Pr2;
	int CRC_CamLane_LaneAttr7_Pr2;
	dword CounterValForCRC_CamLane_LaneAttr7_Pr2;
	int SQC_VAL_CamLane_LaneAttr7_Pr2;
	int SQC_CamLane_LaneAttr7_Pr2;
	int CRC_ClockSync_Stat_Pr2;
	dword CounterValForCRC_ClockSync_Stat_Pr2;
	int SQC_VAL_ClockSync_Stat_Pr2;
	int SQC_ClockSync_Stat_Pr2;

  // required for ClockSync_Stat_FR2 function emulation
	msTimer Timer_EIS_ClockSync_Stat_FR2_1;
  int64 slot1_passed_Time_ns;
  byte slot1_Cycle;
  int64 ClockSync_Backup_ns = 0;
  int64 ClockSync_DeltaSimTime_ns = 0;
  byte ClockSync_DeltaCalculated = 0;
  
	int CRC_CMS_PI_Stat_Pr2;
	dword CounterValForCRC_CMS_PI_Stat_Pr2;
	int SQC_VAL_CMS_PI_Stat_Pr2;
	int SQC_CMS_PI_Stat_Pr2;
	int OldVal_OnKey_Psd = 0;
	int OldVal_PhoneKey_Psd = 0;
	int OldVal_RadioKey_Psd = 0;
	int OldVal_SeatKey_Psd = 0;
	int OldVal_NaviKey_Psd = 0;
	int OldVal_MediaKey_Psd = 0;
	int OldVal_CarKey_Psd = 0;
	int OldVal_ReturnKey_Psd = 0;
	int OldVal_MenuKey_Psd = 0;
	int OldVal_MuteKey_Psd = 0;
	int CRC_Door_FL_Stat_Pr2;
	dword CounterValForCRC_Door_FL_Stat_Pr2;
	int SQC_VAL_Door_FL_Stat_Pr2;
	int SQC_Door_FL_Stat_Pr2;
	int CRC_Door_FR_Stat_Pr2;
	dword CounterValForCRC_Door_FR_Stat_Pr2;
	int SQC_VAL_Door_FR_Stat_Pr2;
	int SQC_Door_FR_Stat_Pr2;
	int CRC_Door_RL_Stat_Pr2;
	dword CounterValForCRC_Door_RL_Stat_Pr2;
	int SQC_VAL_Door_RL_Stat_Pr2;
	int SQC_Door_RL_Stat_Pr2;
	int CRC_Door_RR_Stat_Pr2;
	dword CounterValForCRC_Door_RR_Stat_Pr2;
	int SQC_VAL_Door_RR_Stat_Pr2;
	int SQC_Door_RR_Stat_Pr2;
	int CRC_ExtLgt_Lmp_On_Rq_Pr2;
	dword CounterValForCRC_ExtLgt_Lmp_On_Rq_Pr2;
	int SQC_VAL_ExtLgt_Lmp_On_Rq_Pr2;
	int SQC_ExtLgt_Lmp_On_Rq_Pr2;
	int CRC_EL_TurnInd_On_Rq_Pr2;
	dword CounterValForCRC_EL_TurnInd_On_Rq_Pr2;
	int SQC_VAL_EL_TurnInd_On_Rq_Pr2;
	int SQC_EL_TurnInd_On_Rq_Pr2;
	int CRC_EPKB_Stat_Pr2;
	dword CounterValForCRC_EPKB_Stat_Pr2;
	int SQC_VAL_EPKB_Stat_Pr2;
	int SQC_EPKB_Stat_Pr2;
	int CRC_EVC_CfgBit_01_32_Pr2;
	dword CounterValForCRC_EVC_CfgBit_01_32_Pr2;
	int SQC_VAL_EVC_CfgBit_01_32_Pr2;
	int SQC_EVC_CfgBit_01_32_Pr2;
	int CRC_EVC_CfgBit_33_64_Pr2;
	dword CounterValForCRC_EVC_CfgBit_33_64_Pr2;
	int SQC_VAL_EVC_CfgBit_33_64_Pr2;
	int SQC_EVC_CfgBit_33_64_Pr2;
	int CRC_EVC_CfgBit_65_96_Pr2;
	dword CounterValForCRC_EVC_CfgBit_65_96_Pr2;
	int SQC_VAL_EVC_CfgBit_65_96_Pr2;
	int SQC_EVC_CfgBit_65_96_Pr2;
	int CRC_EVC_CfgBit_97_C8_Pr2;
	dword CounterValForCRC_EVC_CfgBit_97_C8_Pr2;
	int SQC_VAL_EVC_CfgBit_97_C8_Pr2;
	int SQC_EVC_CfgBit_97_C8_Pr2;
	int CRC_EVC_CfgList_01_0C_Pr2;
	dword CounterValForCRC_EVC_CfgList_01_0C_Pr2;
	int SQC_VAL_EVC_CfgList_01_0C_Pr2;
	int SQC_EVC_CfgList_01_0C_Pr2;
	int OldVal_Park_Disp_Stat = 0;
	int CRC_CTRL_L_Stat_Pr2;
	dword CounterValForCRC_CTRL_L_Stat_Pr2;
	int SQC_VAL_CTRL_L_Stat_Pr2;
	int SQC_CTRL_L_Stat_Pr2;
	int CRC_CTRL_L2_Stat_Pr2;
	dword CounterValForCRC_CTRL_L2_Stat_Pr2;
	int SQC_VAL_CTRL_L2_Stat_Pr2;
	int SQC_CTRL_L2_Stat_Pr2;
	int CRC_HVAC_CompTrq_Pr2;
	dword CounterValForCRC_HVAC_CompTrq_Pr2;
	int SQC_VAL_HVAC_CompTrq_Pr2;
	int SQC_HVAC_CompTrq_Pr2;
	int CRC_Ign_Stat_Pr2;
	dword CounterValForCRC_Ign_Stat_Pr2;
	int SQC_VAL_Ign_Stat_Pr2;
	int SQC_Ign_Stat_Pr2;

	// Simulation des Zündungsstatus
	int ISw_Stat_Old = 0;

	int CRC_IHC_Lgt_Stat_HLI_Pr2;
	dword CounterValForCRC_IHC_Lgt_Stat_HLI_Pr2;
	int SQC_VAL_IHC_Lgt_Stat_HLI_Pr2;
	int SQC_IHC_Lgt_Stat_HLI_Pr2;
	int CRC_RemPark_Stat_KG_Pr2;
	dword CounterValForCRC_RemPark_Stat_KG_Pr2;
	int SQC_VAL_RemPark_Stat_KG_Pr2;
	int SQC_RemPark_Stat_KG_Pr2;
	int CRC_NVP_Stat1_Pr2;
	dword CounterValForCRC_NVP_Stat1_Pr2;
	int SQC_VAL_NVP_Stat1_Pr2;
	int SQC_NVP_Stat1_Pr2;
	int CRC_Bckl_Sw_Ft_Stat_Pr2;
	dword CounterValForCRC_Bckl_Sw_Ft_Stat_Pr2;
	int SQC_VAL_Bckl_Sw_Ft_Stat_Pr2;
	int SQC_Bckl_Sw_Ft_Stat_Pr2;
	int CRC_Impact_Pr2;
	dword CounterValForCRC_Impact_Pr2;
	int SQC_VAL_Impact_Pr2;
	int SQC_Impact_Pr2;
	int TGL_VAL_mpact_;	
	int TGL_mpact_;	
	int CRC_PHB_IHC_Plus_Tunnel_3_4_Pr2;
	dword CounterValForCRC_PHB_IHC_Plus_Tunnel_3_4_Pr2;
	int SQC_VAL_PHB_IHC_Plus_Tunnel_3_4_Pr2;
	int SQC_PHB_IHC_Plus_Tunnel_3_4_Pr2;
	int CRC_PHB_IHC_Plus_Tunnel_Pr2;
	dword CounterValForCRC_PHB_IHC_Plus_Tunnel_Pr2;
	int SQC_VAL_PHB_IHC_Plus_Tunnel_Pr2;
	int SQC_PHB_IHC_Plus_Tunnel_Pr2;
	int CRC_PN14_Rs1_Pr2;
	dword CounterValForCRC_PN14_Rs1_Pr2;
	int SQC_VAL_PN14_Rs1_Pr2;
	int SQC_PN14_Rs1_Pr2;
	int CRC_PT_ObjIntrst_Pr2;
	dword CounterValForCRC_PT_ObjIntrst_Pr2;
	int SQC_VAL_PT_ObjIntrst_Pr2;
	int SQC_PT_ObjIntrst_Pr2;
	int CRC_RemPark_Auth_Rs_Pr2;
	dword CounterValForCRC_RemPark_Auth_Rs_Pr2;
	int SQC_VAL_RemPark_Auth_Rs_Pr2;
	int SQC_RemPark_Auth_Rs_Pr2;
	int CRC_RemPark_Stat_EIS_Pr2;
	dword CounterValForCRC_RemPark_Stat_EIS_Pr2;
	int SQC_VAL_RemPark_Stat_EIS_Pr2;
	int SQC_RemPark_Stat_EIS_Pr2;
	int CRC_SADR_Trgr_FCW_Pr2;
	dword CounterValForCRC_SADR_Trgr_FCW_Pr2;
	int SQC_VAL_SADR_Trgr_FCW_Pr2;
	int SQC_SADR_Trgr_FCW_Pr2;
	int TGL_VAL_eat_FL_;	
	int TGL_eat_FL_;	
	int TGL_VAL_eat_FR_;	
	int TGL_eat_FR_;	
	int CRC_SPCR_Stat_BC_F_Pr2;
	dword CounterValForCRC_SPCR_Stat_BC_F_Pr2;
	int SQC_VAL_SPCR_Stat_BC_F_Pr2;
	int SQC_SPCR_Stat_BC_F_Pr2;
	int CRC_SPL_Obj1_Obj2_NV_Pr2;
	dword CounterValForCRC_SPL_Obj1_Obj2_NV_Pr2;
	int SQC_VAL_SPL_Obj1_Obj2_NV_Pr2;
	int SQC_SPL_Obj1_Obj2_NV_Pr2;
	int CRC_SPV_ExtLgt_Rq_Pr2;
	dword CounterValForCRC_SPV_ExtLgt_Rq_Pr2;
	int SQC_VAL_SPV_ExtLgt_Rq_Pr2;
	int SQC_SPV_ExtLgt_Rq_Pr2;
	int CRC_SPV_WprWash_Rq_Pr2;
	dword CounterValForCRC_SPV_WprWash_Rq_Pr2;
	int SQC_VAL_SPV_WprWash_Rq_Pr2;
	int SQC_SPV_WprWash_Rq_Pr2;
	int CRC_TBCSC_Hi_Rq1_Pr2;
	dword CounterValForCRC_TBCSC_Hi_Rq1_Pr2;
	int SQC_VAL_TBCSC_Hi_Rq1_Pr2;
	int SQC_TBCSC_Hi_Rq1_Pr2;
	int CRC_TBCSC_Hi_Rq2_Pr2;
	dword CounterValForCRC_TBCSC_Hi_Rq2_Pr2;
	int SQC_VAL_TBCSC_Hi_Rq2_Pr2;
	int SQC_TBCSC_Hi_Rq2_Pr2;
	int CRC_TBCSC_Lo_Rq1_Pr2;
	dword CounterValForCRC_TBCSC_Lo_Rq1_Pr2;
	int SQC_VAL_TBCSC_Lo_Rq1_Pr2;
	int SQC_TBCSC_Lo_Rq1_Pr2;
	int CRC_TBCSC_Lo_Rq2_Pr2;
	dword CounterValForCRC_TBCSC_Lo_Rq2_Pr2;
	int SQC_VAL_TBCSC_Lo_Rq2_Pr2;
	int SQC_TBCSC_Lo_Rq2_Pr2;
	FrPDU TC_Distance_AR PDU_TC_Distance_AR;
	int CRC_ElecTrlrHtch_Stat_Pr2;
	dword CounterValForCRC_ElecTrlrHtch_Stat_Pr2;
	int SQC_VAL_ElecTrlrHtch_Stat_Pr2;
	int SQC_ElecTrlrHtch_Stat_Pr2;
	int CRC_VehAccel_X_Rq_Pr2;
	dword CounterValForCRC_VehAccel_X_Rq_Pr2;
	int SQC_VAL_VehAccel_X_Rq_Pr2;
	int SQC_VehAccel_X_Rq_Pr2;

	// Simulation der VIN-Botschaft
	mstimer TimerVIN;
	int VINMsgPart = 2;
	char EIS_VINBuffer[24];

	int CRC_YMAS_Rq_MPC_Pr2;
	dword CounterValForCRC_YMAS_Rq_MPC_Pr2;
	int SQC_VAL_YMAS_Rq_MPC_Pr2;
	int SQC_YMAS_Rq_MPC_Pr2;

	msTimer Timer_EIS_ActvComf_Rq_AR2;
	msTimer Timer_EIS_ADAS_CURRENT_ATTRIBUTES_AR;
	msTimer Timer_EIS_ADAS_POSITION_AR;
	msTimer Timer_EIS_ADAS_PREDICTION_AR;
	msTimer Timer_EIS_ADAS_PROFILE_LONG_AR;
	msTimer Timer_EIS_ADAS_PROFILE_SHORT_AR;
	msTimer Timer_EIS_ADASLR_POSITION_AR;
	msTimer Timer_EIS_ADASLR_PROFILE_LONG_AR;
	msTimer Timer_EIS_Assyst_Rq_AR2;
	msTimer Timer_EIS_BC_F_Disp_Rq_AR;
	msTimer Timer_EIS_BC_F_Stat1_AR;
	msTimer Timer_EIS_BC_F_Stat2_AR2;
	msTimer Timer_EIS_BC_R_Stat1_AR;
	msTimer Timer_EIS_BLSM_Disp_Stat_AR;
	msTimer Timer_EIS_BODY_CHASSIS_R1_AR;
	msTimer Timer_EIS_BSM_Disp_Warn_Rq_AR2;
	msTimer Timer_EIS_CamLane_Disp_Warn_Rq_AR2;
	msTimer Timer_EIS_CamLane_LaneAttr1_AR2;
	msTimer Timer_EIS_CamLane_LaneAttr2_AR2;
	msTimer Timer_EIS_CamLane_LaneAttr3_AR2;
	msTimer Timer_EIS_CamLane_LaneAttr6_AR2;
	msTimer Timer_EIS_CamLane_LaneAttr7_AR2;
	msTimer Timer_EIS_CLkS_Rq_AR;
	msTimer Timer_EIS_CLkS_State_AR;
	msTimer Timer_EIS_ClockSync_Stat_FR2;
	msTimer Timer_EIS_CMS_PI_State_Gw_AR2;
	msTimer Timer_EIS_Config_HU4_AR2;
	msTimer Timer_EIS_Config_HU5_AR2;
	msTimer Timer_EIS_CRCM_Stat_AR;
	msTimer Timer_EIS_CTRL_C_Stat1_AR;
	msTimer Timer_EIS_DAC4_ECM_AR;
	msTimer Timer_EIS_DAC4_EM2_AR;
	msTimer Timer_EIS_DAC4_ISM_AR;
	msTimer Timer_EIS_DAC4_TCM_AR;
	msTimer Timer_EIS_Dimming_Stat_AR2;
	msTimer Timer_EIS_Door_FL_Stat_AR2;
	msTimer Timer_EIS_Door_FR_Stat_AR2;
	msTimer Timer_EIS_Door_RL_Stat_AR2;
	msTimer Timer_EIS_Door_RR_Stat_AR2;
	msTimer Timer_EIS_DPC_IndMd_Rq_AR;
	msTimer Timer_EIS_EAC_Stat_AR;
	msTimer Timer_EIS_EL_Stat_AR2;
	msTimer Timer_EIS_EL_TurnInd_Rq_AR2;
	msTimer Timer_EIS_EPKB_Stat_AR2;
	msTimer Timer_EIS_EVC_CfgBit_01_32_AR2;
	msTimer Timer_EIS_EVC_CfgBit_33_64_AR2;
	msTimer Timer_EIS_EVC_CfgBit_65_96_AR2;
	msTimer Timer_EIS_EVC_CfgBit_97_C8_AR2;
	msTimer Timer_EIS_EVC_CfgList_01_0C_AR2;
	msTimer Timer_EIS_FCW_Disp_Rq_AR;
	msTimer Timer_EIS_HMI_CHASSIS_R1_AR2;
	msTimer Timer_EIS_HU_Comf_Rq_AR2;
	msTimer Timer_EIS_HU_State_AR;
	msTimer Timer_EIS_HVAC_Disp_Stat1_AR;
	msTimer Timer_EIS_HVAC_OBD_DTC_AR;
	msTimer Timer_EIS_HVAC_Rs2_AR;
	msTimer Timer_EIS_HVAC_Rs3_AR2;
	msTimer Timer_EIS_HVAC_Rs_AR2;
	msTimer Timer_EIS_HVAC_State1_AR;
	msTimer Timer_EIS_IC_BasicInfo_AR2;
	msTimer Timer_EIS_IC_DriveAssistSys_AR2;
	msTimer Timer_EIS_IC_Settings_AR2;
	msTimer Timer_EIS_ICH_Stat_AR;
	msTimer Timer_EIS_Ign_Veh_Stat_AR2;
	msTimer Timer_EIS_IHC_Lgt_Stat_HLI_2_AR2;
	msTimer Timer_EIS_IHC_Lgt_Stat_HLI_AR2;
	msTimer Timer_EIS_KG_State_AR2;
	msTimer Timer_EIS_LDC_Disp_Stat_IC_AR2;
	msTimer Timer_EIS_LgtSens_State_AR;
	msTimer Timer_EIS_Mirr_Adj_Lt_Rq_AR;
	msTimer Timer_EIS_Mirr_Adj_Rt_Rq_AR;
	msTimer Timer_EIS_NAVI_Pos1_AR;
	msTimer Timer_EIS_NAVI_Pos2_AR;
	msTimer Timer_EIS_NAVI_Pos3_AR;
	msTimer Timer_EIS_NAVI_Pos4_AR;
	msTimer Timer_EIS_NAVI_Pos5_AR;
	msTimer Timer_EIS_NVP_Stat1_AR2;
	msTimer Timer_EIS_OHCM_Stat_AR2;
	msTimer Timer_EIS_ORC_Disp_Stat_AR2;
	msTimer Timer_EIS_ORC_Impact_AR2;
	msTimer Timer_EIS_Park_Disp_Rs_AR2;
	msTimer Timer_EIS_PHB_IHC_Plus_Tunnel_3_4_AR2;
	msTimer Timer_EIS_PHB_IHC_Plus_Tunnel_AR2;
	msTimer Timer_EIS_PN14_Disp_Rq_AR;
	msTimer Timer_EIS_PN14_Rs1_AR2;
	msTimer Timer_EIS_PN14_Rs2_AR;
	msTimer Timer_EIS_PN14_Stat2_AR2;
	msTimer Timer_EIS_PN14_Stat_AR;
	msTimer Timer_EIS_PN48_Bat_Stat2_AR2;
	msTimer Timer_EIS_PN48_Bat_Stat_AR;
	msTimer Timer_EIS_PN48_BatLim_Stat_AR;
	msTimer Timer_EIS_PN48_DCDC48_LISB48_Stat_AR;
	msTimer Timer_EIS_PN48_Stat_AR;
	msTimer Timer_EIS_PNHV_WeekDepTmTbl_Rq_HU_AR2;
	msTimer Timer_EIS_PreCond_On_Rq_AR;
	msTimer Timer_EIS_PreCond_Rq_HU_AR2;
	msTimer Timer_EIS_PreCond_Stat_AR;
	msTimer Timer_EIS_PT_ObjIntrst_Gw_AR2;
	msTimer Timer_EIS_RemPark_Auth_Rs_AR2;
	msTimer Timer_EIS_RemPark_Stat_EIS_AR2;
	msTimer Timer_EIS_RTC_Date_Time_AR2;
	msTimer Timer_EIS_RTC_Stat1_AR2;
	msTimer Timer_EIS_SADR_Trgr_FCW_AR2;
	msTimer Timer_EIS_SeatAdj_FL_Rq_AR;
	msTimer Timer_EIS_SeatAdj_FR_Rq_AR;
	msTimer Timer_EIS_SPCR_Stat_BC_F_AR2;
	msTimer Timer_EIS_SPL_Obj1_Obj2_NV_AR2;
	msTimer Timer_EIS_SPV_Actn_Rq_AR2;
	msTimer Timer_EIS_SPV_Alm_Rq_AR;
	msTimer Timer_EIS_SPV_Stat_AR2;
	msTimer Timer_EIS_SVS_Rq_HU_AR2;
	msTimer Timer_EIS_TBCSC_DAC_EPS_AR2;
	msTimer Timer_EIS_TBCSC_DAC_ESP_AR2;
	msTimer Timer_EIS_TBCSC_Hi_Rq1_AR2;
	msTimer Timer_EIS_TBCSC_Hi_Rq2_AR2;
	msTimer Timer_EIS_TBCSC_Lo_Rq1_AR2;
	msTimer Timer_EIS_TBCSC_Lo_Rq2_AR2;
	msTimer Timer_EIS_TC_Distance_AR;
	msTimer Timer_EIS_TGW_DateTm_Stat_AR;
	msTimer Timer_EIS_Tire_State_AR2;
	msTimer Timer_EIS_TrafficInfo_AR;
	msTimer Timer_EIS_Trailer_Stat_AR2;
	msTimer Timer_EIS_TSA_Disp_Rq1_AR2;
	msTimer Timer_EIS_TSA_Disp_Rq2_AR;
	msTimer Timer_EIS_TSA_Disp_Rq3_AR;
	msTimer Timer_EIS_VehAccel_X_Rq_Gw_AR2;
	msTimer Timer_EIS_VIN_AR;
	msTimer Timer_EIS_Wiper_Stat_AR;
	msTimer Timer_EIS_WUDOP_EIS_FR;
	msTimer Timer_EIS_YMAS_Rq_MPC_AR2;

   byte  crctable[256] = {
      0x00, 0x1D, 0x3A, 0x27, 0x74, 0x69, 0x4E, 0x53,
      0xE8, 0xF5, 0xD2, 0xCF, 0x9C, 0x81, 0xA6, 0xBB,
      0xCD, 0xD0, 0xF7, 0xEA, 0xB9, 0xA4, 0x83, 0x9E,
      0x25, 0x38, 0x1F, 0x02, 0x51, 0x4C, 0x6B, 0x76,
      0x87, 0x9A, 0xBD, 0xA0, 0xF3, 0xEE, 0xC9, 0xD4,
      0x6F, 0x72, 0x55, 0x48, 0x1B, 0x06, 0x21, 0x3C,
      0x4A, 0x57, 0x70, 0x6D, 0x3E, 0x23, 0x04, 0x19,
      0xA2, 0xBF, 0x98, 0x85, 0xD6, 0xCB, 0xEC, 0xF1,
      0x13, 0x0E, 0x29, 0x34, 0x67, 0x7A, 0x5D, 0x40,
      0xFB, 0xE6, 0xC1, 0xDC, 0x8F, 0x92, 0xB5, 0xA8,
      0xDE, 0xC3, 0xE4, 0xF9, 0xAA, 0xB7, 0x90, 0x8D,
      0x36, 0x2B, 0x0C, 0x11, 0x42, 0x5F, 0x78, 0x65,
      0x94, 0x89, 0xAE, 0xB3, 0xE0, 0xFD, 0xDA, 0xC7,
      0x7C, 0x61, 0x46, 0x5B, 0x08, 0x15, 0x32, 0x2F,
      0x59, 0x44, 0x63, 0x7E, 0x2D, 0x30, 0x17, 0x0A,
      0xB1, 0xAC, 0x8B, 0x96, 0xC5, 0xD8, 0xFF, 0xE2,
      0x26, 0x3B, 0x1C, 0x01, 0x52, 0x4F, 0x68, 0x75,
      0xCE, 0xD3, 0xF4, 0xE9, 0xBA, 0xA7, 0x80, 0x9D,
      0xEB, 0xF6, 0xD1, 0xCC, 0x9F, 0x82, 0xA5, 0xB8,
      0x03, 0x1E, 0x39, 0x24, 0x77, 0x6A, 0x4D, 0x50,
      0xA1, 0xBC, 0x9B, 0x86, 0xD5, 0xC8, 0xEF, 0xF2,
      0x49, 0x54, 0x73, 0x6E, 0x3D, 0x20, 0x07, 0x1A,
      0x6C, 0x71, 0x56, 0x4B, 0x18, 0x05, 0x22, 0x3F,
      0x84, 0x99, 0xBE, 0xA3, 0xF0, 0xED, 0xCA, 0xD7,
      0x35, 0x28, 0x0F, 0x12, 0x41, 0x5C, 0x7B, 0x66,
      0xDD, 0xC0, 0xE7, 0xFA, 0xA9, 0xB4, 0x93, 0x8E,
      0xF8, 0xE5, 0xC2, 0xDF, 0x8C, 0x91, 0xB6, 0xAB,
      0x10, 0x0D, 0x2A, 0x37, 0x64, 0x79, 0x5E, 0x43,
      0xB2, 0xAF, 0x88, 0x95, 0xC6, 0xDB, 0xFC, 0xE1,
      0x5A, 0x47, 0x60, 0x7D, 0x2E, 0x33, 0x14, 0x09,
      0x7F, 0x62, 0x45, 0x58, 0x0B, 0x16, 0x31, 0x2C,
      0x97, 0x8A, 0xAD, 0xB0, 0xE3, 0xFE, 0xD9, 0xC4
   };

   byte  crctableProfTwo[256] = {
			0x00, 0x2F, 0x5E, 0x71, 0xBC, 0x93, 0xE2, 0xCD,
			0x57, 0x78, 0x09, 0x26, 0xEB, 0xC4, 0xB5, 0x9A,
			0xAE, 0x81, 0xF0, 0xDF, 0x12, 0x3D, 0x4C, 0x63,
			0xF9, 0xD6, 0xA7, 0x88, 0x45, 0x6A, 0x1B, 0x34,
			0x73, 0x5C, 0x2D, 0x02, 0xCF, 0xE0, 0x91, 0xBE,
			0x24, 0x0B, 0x7A, 0x55, 0x98, 0xB7, 0xC6, 0xE9,
			0xDD, 0xF2, 0x83, 0xAC, 0x61, 0x4E, 0x3F, 0x10,
			0x8A, 0xA5, 0xD4, 0xFB, 0x36, 0x19, 0x68, 0x47,
			0xE6, 0xC9, 0xB8, 0x97, 0x5A, 0x75, 0x04, 0x2B,
			0xB1, 0x9E, 0xEF, 0xC0, 0x0D, 0x22, 0x53, 0x7C,
			0x48, 0x67, 0x16, 0x39, 0xF4, 0xDB, 0xAA, 0x85,
			0x1F, 0x30, 0x41, 0x6E, 0xA3, 0x8C, 0xFD, 0xD2,
			0x95, 0xBA, 0xCB, 0xE4, 0x29, 0x06, 0x77, 0x58,
			0xC2, 0xED, 0x9C, 0xB3, 0x7E, 0x51, 0x20, 0x0F,
			0x3B, 0x14, 0x65, 0x4A, 0x87, 0xA8, 0xD9, 0xF6,
			0x6C, 0x43, 0x32, 0x1D, 0xD0, 0xFF, 0x8E, 0xA1,
			0xE3, 0xCC, 0xBD, 0x92, 0x5F, 0x70, 0x01, 0x2E,
			0xB4, 0x9B, 0xEA, 0xC5, 0x08, 0x27, 0x56, 0x79,
			0x4D, 0x62, 0x13, 0x3C, 0xF1, 0xDE, 0xAF, 0x80,
			0x1A, 0x35, 0x44, 0x6B, 0xA6, 0x89, 0xF8, 0xD7,
			0x90, 0xBF, 0xCE, 0xE1, 0x2C, 0x03, 0x72, 0x5D,
			0xC7, 0xE8, 0x99, 0xB6, 0x7B, 0x54, 0x25, 0x0A,
			0x3E, 0x11, 0x60, 0x4F, 0x82, 0xAD, 0xDC, 0xF3,
			0x69, 0x46, 0x37, 0x18, 0xD5, 0xFA, 0x8B, 0xA4,
			0x05, 0x2A, 0x5B, 0x74, 0xB9, 0x96, 0xE7, 0xC8,
			0x52, 0x7D, 0x0C, 0x23, 0xEE, 0xC1, 0xB0, 0x9F,
			0xAB, 0x84, 0xF5, 0xDA, 0x17, 0x38, 0x49, 0x66,
			0xFC, 0xD3, 0xA2, 0x8D, 0x40, 0x6F, 0x1E, 0x31,
			0x76, 0x59, 0x28, 0x07, 0xCA, 0xE5, 0x94, 0xBB,
			0x21, 0x0E, 0x7F, 0x50, 0x9D, 0xB2, 0xC3, 0xEC,
			0xD8, 0xF7, 0x86, 0xA9, 0x64, 0x4B, 0x3A, 0x15,
			0x8F, 0xA0, 0xD1, 0xFE, 0x33, 0x1C, 0x6D, 0x42
   };
}

on start
{
	result = EnableCRC("", 0); // 1 = on, 0 = off
	result = EnableTGL("", 0); // 1 = on, 0 = off 
	result = EnableSQC("", 0); // 1 = on, 0 = off 
	result = EnableMC("", 0); // 1 = on, 0 = off 

	@sysvar::CH_Nodes::CH__PDURECEIPT_SIM_EIS_ActvComf_Rq_AR2 = 1;
	@sysvar::CH_Nodes::CH__PDURECEIPT_SIM_EIS_ADAS_CURRENT_ATTRIBUTES_AR = 1;
	@sysvar::CH_Nodes::CH__PDURECEIPT_SIM_EIS_ADAS_POSITION_AR = 1;
	ret_Register = RegisterSignalDriver(ADAS_Seg_Offset,"callback_ADAS_PREDICTION_ARADAS_Seg_Offset");
	ret_Register = RegisterSignalDriver(ADAS_Seg_PathIdx,"callback_ADAS_PREDICTION_ARADAS_Seg_PathIdx");
	ret_Register = RegisterSignalDriver(ADAS_Seg_CycCnt,"callback_ADAS_PREDICTION_ARADAS_Seg_CycCnt");
	ret_Register = RegisterSignalDriver(ADAS_Seg_Updt,"callback_ADAS_PREDICTION_ARADAS_Seg_Updt");
	ret_Register = RegisterSignalDriver(ADAS_Seg_ReTr,"callback_ADAS_PREDICTION_ARADAS_Seg_ReTr");
	ret_Register = RegisterSignalDriver(ADAS_Seg_AreaBuildUp,"callback_ADAS_PREDICTION_ARADAS_Seg_AreaBuildUp");
	ret_Register = RegisterSignalDriver(ADAS_Seg_Bridge,"callback_ADAS_PREDICTION_ARADAS_Seg_Bridge");
	ret_Register = RegisterSignalDriver(ADAS_Seg_Tunnel,"callback_ADAS_PREDICTION_ARADAS_Seg_Tunnel");
	ret_Register = RegisterSignalDriver(ADAS_Seg_FuncRoadClass,"callback_ADAS_PREDICTION_ARADAS_Seg_FuncRoadClass");
	ret_Register = RegisterSignalDriver(ADAS_Seg_RelProbb,"callback_ADAS_PREDICTION_ARADAS_Seg_RelProbb");
	ret_Register = RegisterSignalDriver(ADAS_Seg_WayForm,"callback_ADAS_PREDICTION_ARADAS_Seg_WayForm");
	ret_Register = RegisterSignalDriver(ADAS_Seg_CmpxInsct,"callback_ADAS_PREDICTION_ARADAS_Seg_CmpxInsct");
	ret_Register = RegisterSignalDriver(ADAS_Seg_PartRoute,"callback_ADAS_PREDICTION_ARADAS_Seg_PartRoute");
	ret_Register = RegisterSignalDriver(ADAS_Seg_EffSpdLmtType,"callback_ADAS_PREDICTION_ARADAS_Seg_EffSpdLmtType");
	ret_Register = RegisterSignalDriver(ADAS_Seg_EffSpdLmt,"callback_ADAS_PREDICTION_ARADAS_Seg_EffSpdLmt");
	ret_Register = RegisterSignalDriver(ADAS_Seg_NumOfLaneDrvDir,"callback_ADAS_PREDICTION_ARADAS_Seg_NumOfLaneDrvDir");
	ret_Register = RegisterSignalDriver(ADAS_Seg_NumOfLaneOppDir,"callback_ADAS_PREDICTION_ARADAS_Seg_NumOfLaneOppDir");
	ret_Register = RegisterSignalDriver(ADAS_Seg_RoadDivd,"callback_ADAS_PREDICTION_ARADAS_Seg_RoadDivd");
	@sysvar::CH_Nodes::CH__PDURECEIPT_SIM_EIS_ADAS_PREDICTION_AR = 1;
	ret_Register = RegisterSignalDriver(ADAS_ProfLong_MsgTyp_Longi,"callback_ADAS_PROFILE_LONG_ARADAS_ProfLong_MsgTyp_Longi");
	ret_Register = RegisterSignalDriver(ADAS_ProfLong_Offset_Longi,"callback_ADAS_PROFILE_LONG_ARADAS_ProfLong_Offset_Longi");
	ret_Register = RegisterSignalDriver(ADAS_ProfLong_PathIdx_Longi,"callback_ADAS_PROFILE_LONG_ARADAS_ProfLong_PathIdx_Longi");
	ret_Register = RegisterSignalDriver(ADAS_ProfLong_CycCnt_Longi,"callback_ADAS_PROFILE_LONG_ARADAS_ProfLong_CycCnt_Longi");
	ret_Register = RegisterSignalDriver(ADAS_ProfLong_Updt_Longi,"callback_ADAS_PROFILE_LONG_ARADAS_ProfLong_Updt_Longi");
	ret_Register = RegisterSignalDriver(ADAS_ProfLong_ReTr_Longi,"callback_ADAS_PROFILE_LONG_ARADAS_ProfLong_ReTr_Longi");
	ret_Register = RegisterSignalDriver(ADAS_ProfLong_CtrlPoint_Longi,"callback_ADAS_PROFILE_LONG_ARADAS_ProfLong_CtrlPoint_Longi");
	ret_Register = RegisterSignalDriver(ADAS_ProfLong_Val_Longit,"callback_ADAS_PROFILE_LONG_ARADAS_ProfLong_Val_Longit");
	@sysvar::CH_Nodes::CH__PDURECEIPT_SIM_EIS_ADAS_PROFILE_LONG_AR = 1;
	ret_Register = RegisterSignalDriver(ADAS_ProfShort_MsgTyp_CL,"callback_ADAS_PROFILE_SHORT_ARADAS_ProfShort_MsgTyp_CL");
	ret_Register = RegisterSignalDriver(ADAS_ProfShort_Offset_CL,"callback_ADAS_PROFILE_SHORT_ARADAS_ProfShort_Offset_CL");
	ret_Register = RegisterSignalDriver(ADAS_ProfShort_PathIdx_CL,"callback_ADAS_PROFILE_SHORT_ARADAS_ProfShort_PathIdx_CL");
	ret_Register = RegisterSignalDriver(ADAS_ProfShort_CycCnt_CL,"callback_ADAS_PROFILE_SHORT_ARADAS_ProfShort_CycCnt_CL");
	ret_Register = RegisterSignalDriver(ADAS_ProfShort_Updt_CL,"callback_ADAS_PROFILE_SHORT_ARADAS_ProfShort_Updt_CL");
	ret_Register = RegisterSignalDriver(ADAS_ProfShort_ReTr_CL,"callback_ADAS_PROFILE_SHORT_ARADAS_ProfShort_ReTr_CL");
	ret_Register = RegisterSignalDriver(ADAS_ProfShort_CtrlPoint_CL,"callback_ADAS_PROFILE_SHORT_ARADAS_ProfShort_CtrlPoint_CL");
	ret_Register = RegisterSignalDriver(ADAS_ProfShort_AccurClass_CL,"callback_ADAS_PROFILE_SHORT_ARADAS_ProfShort_AccurClass_CL");
	ret_Register = RegisterSignalDriver(ADAS_ProfShort_Value0_CL,"callback_ADAS_PROFILE_SHORT_ARADAS_ProfShort_Value0_CL");
	ret_Register = RegisterSignalDriver(ADAS_ProfShort_Dist1_CL,"callback_ADAS_PROFILE_SHORT_ARADAS_ProfShort_Dist1_CL");
	ret_Register = RegisterSignalDriver(ADAS_ProfShort_Value1_CL,"callback_ADAS_PROFILE_SHORT_ARADAS_ProfShort_Value1_CL");
	@sysvar::CH_Nodes::CH__PDURECEIPT_SIM_EIS_ADAS_PROFILE_SHORT_AR = 1;
	@sysvar::CH_Nodes::CH__PDURECEIPT_SIM_EIS_ADASLR_POSITION_AR = 1;
	ret_Register = RegisterSignalDriver(ADASLR_ProfLong_MsgTyp_SpdCl,"callback_ADASLR_PROFILE_LONG_ARADASLR_ProfLong_MsgTyp_SpdCl");
	ret_Register = RegisterSignalDriver(ADASLR_ProfLong_Offset_SpdCl,"callback_ADASLR_PROFILE_LONG_ARADASLR_ProfLong_Offset_SpdCl");
	ret_Register = RegisterSignalDriver(ADASLR_ProfLong_PathIdx_SpdCl,"callback_ADASLR_PROFILE_LONG_ARADASLR_ProfLong_PathIdx_SpdCl");
	ret_Register = RegisterSignalDriver(ADASLR_ProfLong_CycCnt_SpdCl,"callback_ADASLR_PROFILE_LONG_ARADASLR_ProfLong_CycCnt_SpdCl");
	ret_Register = RegisterSignalDriver(ADASLR_ProfLong_Updt_SpdCl,"callback_ADASLR_PROFILE_LONG_ARADASLR_ProfLong_Updt_SpdCl");
	ret_Register = RegisterSignalDriver(ADASLR_ProfLong_ReTr_SpdCl,"callback_ADASLR_PROFILE_LONG_ARADASLR_ProfLong_ReTr_SpdCl");
	ret_Register = RegisterSignalDriver(ADASLR_ProfLong_CtrlPnt_SpdCl,"callback_ADASLR_PROFILE_LONG_ARADASLR_ProfLong_CtrlPnt_SpdCl");
	ret_Register = RegisterSignalDriver(ADASLR_ProfLong_Val_SpdCl,"callback_ADASLR_PROFILE_LONG_ARADASLR_ProfLong_Val_SpdCl");
	@sysvar::CH_Nodes::CH__PDURECEIPT_SIM_EIS_ADASLR_PROFILE_LONG_AR = 1;
	@sysvar::CH_Nodes::CH__PDURECEIPT_SIM_EIS_Assyst_Rq_AR2 = 1;
	@sysvar::CH_Nodes::CH__PDURECEIPT_SIM_EIS_BC_F_Disp_Rq_AR = 1;
	@sysvar::CH_Nodes::CH__PDURECEIPT_SIM_EIS_BC_F_Stat1_AR = 1;
	@sysvar::CH_Nodes::CH__PDURECEIPT_SIM_EIS_BC_F_Stat2_AR2 = 1;
	if (@sysvar::CH_Nodes::CH_EISBckl_Sw_3L_SAM_R_TglB_AUTO == 0)
	{
		//Automatisch
		enableControl("BC_R_Stat1_AR", "CH_EISBckl_Sw_3L_SAM_R_TglBC_R__", 0); //1: enable; 0: disable
	}
	else
	{
		//Manuel
		enableControl("BC_R_Stat1_AR", "CH_EISBckl_Sw_3L_SAM_R_TglBC_R__", 1); //1: enable; 0: disable
	}
	if (@sysvar::CH_Nodes::CH_EISBckl_Sw_3R_SAM_R_TglB_AUTO == 0)
	{
		//Automatisch
		enableControl("BC_R_Stat1_AR", "CH_EISBckl_Sw_3R_SAM_R_TglBC_R__", 0); //1: enable; 0: disable
	}
	else
	{
		//Manuel
		enableControl("BC_R_Stat1_AR", "CH_EISBckl_Sw_3R_SAM_R_TglBC_R__", 1); //1: enable; 0: disable
	}
	if (@sysvar::CH_Nodes::CH_EISBckl_Sw_RL_SAM_R_TglB_AUTO == 0)
	{
		//Automatisch
		enableControl("BC_R_Stat1_AR", "CH_EISBckl_Sw_RL_SAM_R_TglBC_R__", 0); //1: enable; 0: disable
	}
	else
	{
		//Manuel
		enableControl("BC_R_Stat1_AR", "CH_EISBckl_Sw_RL_SAM_R_TglBC_R__", 1); //1: enable; 0: disable
	}
	if (@sysvar::CH_Nodes::CH_EISBckl_Sw_RM_SAM_R_TglB_AUTO == 0)
	{
		//Automatisch
		enableControl("BC_R_Stat1_AR", "CH_EISBckl_Sw_RM_SAM_R_TglBC_R__", 0); //1: enable; 0: disable
	}
	else
	{
		//Manuel
		enableControl("BC_R_Stat1_AR", "CH_EISBckl_Sw_RM_SAM_R_TglBC_R__", 1); //1: enable; 0: disable
	}
	if (@sysvar::CH_Nodes::CH_EISBckl_Sw_RR_SAM_R_TglB_AUTO == 0)
	{
		//Automatisch
		enableControl("BC_R_Stat1_AR", "CH_EISBckl_Sw_RR_SAM_R_TglBC_R__", 0); //1: enable; 0: disable
	}
	else
	{
		//Manuel
		enableControl("BC_R_Stat1_AR", "CH_EISBckl_Sw_RR_SAM_R_TglBC_R__", 1); //1: enable; 0: disable
	}
	@sysvar::CH_Nodes::CH__PDURECEIPT_SIM_EIS_BC_R_Stat1_AR = 1;
	@sysvar::CH_Nodes::CH__PDURECEIPT_SIM_EIS_BLSM_Disp_Stat_AR = 1;
	@sysvar::CH_Nodes::CH__PDURECEIPT_SIM_EIS_BODY_CHASSIS_R1_AR = 1;
	@sysvar::CH_Nodes::CH__PDURECEIPT_SIM_EIS_BSM_Disp_Warn_Rq_AR2 = 1;
	if (@sysvar::CH_Nodes::CH_EISCRC_CamLane_Disp_Warn_AUTO == 0)
	{
		//Automatisch
		enableControl("CamLane_Disp_Warn_Rq_AR2", "CH_EISCRC_CamLane_Disp_Warn_Rq__", 0); //1: enable; 0: disable
	}
	else
	{
		//Manuel
		enableControl("CamLane_Disp_Warn_Rq_AR2", "CH_EISCRC_CamLane_Disp_Warn_Rq__", 1); //1: enable; 0: disable
	}
	if (@sysvar::CH_Nodes::CH_EISSQC_CamLane_Disp_Warn_AUTO == 0)
	{
		//Automatisch
		enableControl("CamLane_Disp_Warn_Rq_AR2", "CH_EISSQC_CamLane_Disp_Warn_Rq__", 0); //1: enable; 0: disable
	}
	else
	{
		//Manuel
		enableControl("CamLane_Disp_Warn_Rq_AR2", "CH_EISSQC_CamLane_Disp_Warn_Rq__", 1); //1: enable; 0: disable
	}
	@sysvar::CH_Nodes::CH__PDURECEIPT_SIM_EIS_CamLane_Disp_Warn_Rq_AR2 = 1;
	if (@sysvar::CH_Nodes::CH_EISCRC_CamLane_LaneAttr1_AUTO == 0)
	{
		//Automatisch
		enableControl("CamLane_LaneAttr1_AR2", "CH_EISCRC_CamLane_LaneAttr1_Pr2_", 0); //1: enable; 0: disable
	}
	else
	{
		//Manuel
		enableControl("CamLane_LaneAttr1_AR2", "CH_EISCRC_CamLane_LaneAttr1_Pr2_", 1); //1: enable; 0: disable
	}
	if (@sysvar::CH_Nodes::CH_EISSQC_CamLane_LaneAttr1_AUTO == 0)
	{
		//Automatisch
		enableControl("CamLane_LaneAttr1_AR2", "CH_EISSQC_CamLane_LaneAttr1_Pr2_", 0); //1: enable; 0: disable
	}
	else
	{
		//Manuel
		enableControl("CamLane_LaneAttr1_AR2", "CH_EISSQC_CamLane_LaneAttr1_Pr2_", 1); //1: enable; 0: disable
	}
	@sysvar::CH_Nodes::CH__PDURECEIPT_SIM_EIS_CamLane_LaneAttr1_AR2 = 1;
	if (@sysvar::CH_Nodes::CH_EISCRC_CamLane_LaneAttr2_AUTO == 0)
	{
		//Automatisch
		enableControl("CamLane_LaneAttr2_AR2", "CH_EISCRC_CamLane_LaneAttr2_Pr2_", 0); //1: enable; 0: disable
	}
	else
	{
		//Manuel
		enableControl("CamLane_LaneAttr2_AR2", "CH_EISCRC_CamLane_LaneAttr2_Pr2_", 1); //1: enable; 0: disable
	}
	if (@sysvar::CH_Nodes::CH_EISSQC_CamLane_LaneAttr2_AUTO == 0)
	{
		//Automatisch
		enableControl("CamLane_LaneAttr2_AR2", "CH_EISSQC_CamLane_LaneAttr2_Pr2_", 0); //1: enable; 0: disable
	}
	else
	{
		//Manuel
		enableControl("CamLane_LaneAttr2_AR2", "CH_EISSQC_CamLane_LaneAttr2_Pr2_", 1); //1: enable; 0: disable
	}
	@sysvar::CH_Nodes::CH__PDURECEIPT_SIM_EIS_CamLane_LaneAttr2_AR2 = 1;
	if (@sysvar::CH_Nodes::CH_EISCRC_CamLane_LaneAttr3_AUTO == 0)
	{
		//Automatisch
		enableControl("CamLane_LaneAttr3_AR2", "CH_EISCRC_CamLane_LaneAttr3_Pr2_", 0); //1: enable; 0: disable
	}
	else
	{
		//Manuel
		enableControl("CamLane_LaneAttr3_AR2", "CH_EISCRC_CamLane_LaneAttr3_Pr2_", 1); //1: enable; 0: disable
	}
	if (@sysvar::CH_Nodes::CH_EISSQC_CamLane_LaneAttr3_AUTO == 0)
	{
		//Automatisch
		enableControl("CamLane_LaneAttr3_AR2", "CH_EISSQC_CamLane_LaneAttr3_Pr2_", 0); //1: enable; 0: disable
	}
	else
	{
		//Manuel
		enableControl("CamLane_LaneAttr3_AR2", "CH_EISSQC_CamLane_LaneAttr3_Pr2_", 1); //1: enable; 0: disable
	}
	@sysvar::CH_Nodes::CH__PDURECEIPT_SIM_EIS_CamLane_LaneAttr3_AR2 = 1;
	if (@sysvar::CH_Nodes::CH_EISCRC_CamLane_LaneAttr6_AUTO == 0)
	{
		//Automatisch
		enableControl("CamLane_LaneAttr6_AR2", "CH_EISCRC_CamLane_LaneAttr6_Pr2_", 0); //1: enable; 0: disable
	}
	else
	{
		//Manuel
		enableControl("CamLane_LaneAttr6_AR2", "CH_EISCRC_CamLane_LaneAttr6_Pr2_", 1); //1: enable; 0: disable
	}
	if (@sysvar::CH_Nodes::CH_EISSQC_CamLane_LaneAttr6_AUTO == 0)
	{
		//Automatisch
		enableControl("CamLane_LaneAttr6_AR2", "CH_EISSQC_CamLane_LaneAttr6_Pr2_", 0); //1: enable; 0: disable
	}
	else
	{
		//Manuel
		enableControl("CamLane_LaneAttr6_AR2", "CH_EISSQC_CamLane_LaneAttr6_Pr2_", 1); //1: enable; 0: disable
	}
	@sysvar::CH_Nodes::CH__PDURECEIPT_SIM_EIS_CamLane_LaneAttr6_AR2 = 1;
	if (@sysvar::CH_Nodes::CH_EISCRC_CamLane_LaneAttr7_AUTO == 0)
	{
		//Automatisch
		enableControl("CamLane_LaneAttr7_AR2", "CH_EISCRC_CamLane_LaneAttr7_Pr2_", 0); //1: enable; 0: disable
	}
	else
	{
		//Manuel
		enableControl("CamLane_LaneAttr7_AR2", "CH_EISCRC_CamLane_LaneAttr7_Pr2_", 1); //1: enable; 0: disable
	}
	if (@sysvar::CH_Nodes::CH_EISSQC_CamLane_LaneAttr7_AUTO == 0)
	{
		//Automatisch
		enableControl("CamLane_LaneAttr7_AR2", "CH_EISSQC_CamLane_LaneAttr7_Pr2_", 0); //1: enable; 0: disable
	}
	else
	{
		//Manuel
		enableControl("CamLane_LaneAttr7_AR2", "CH_EISSQC_CamLane_LaneAttr7_Pr2_", 1); //1: enable; 0: disable
	}
	@sysvar::CH_Nodes::CH__PDURECEIPT_SIM_EIS_CamLane_LaneAttr7_AR2 = 1;
	@sysvar::CH_Nodes::CH__PDURECEIPT_SIM_EIS_CLkS_Rq_AR = 1;
	@sysvar::CH_Nodes::CH__PDURECEIPT_SIM_EIS_CLkS_State_AR = 1;
	if (@sysvar::CH_Nodes::CH_EISCRC_ClockSync_Stat_Pr_AUTO == 0)
	{
		//Automatisch
		enableControl("ClockSync_Stat_FR2", "CH_EISCRC_ClockSync_Stat_Pr2Clo_", 0); //1: enable; 0: disable
	}
	else
	{
		//Manuel
		enableControl("ClockSync_Stat_FR2", "CH_EISCRC_ClockSync_Stat_Pr2Clo_", 1); //1: enable; 0: disable
	}
	if (@sysvar::CH_Nodes::CH_EISSQC_ClockSync_Stat_Pr_AUTO == 0)
	{
		//Automatisch
		enableControl("ClockSync_Stat_FR2", "CH_EISSQC_ClockSync_Stat_Pr2Clo_", 0); //1: enable; 0: disable
	}
	else
	{
		//Manuel
		enableControl("ClockSync_Stat_FR2", "CH_EISSQC_ClockSync_Stat_Pr2Clo_", 1); //1: enable; 0: disable
	}
	@sysvar::CH_Nodes::CH__PDURECEIPT_SIM_EIS_ClockSync_Stat_FR2 = 1;
	if (@sysvar::CH_Nodes::CH_EISCRC_CMS_PI_Stat_Pr2CM_AUTO == 0)
	{
		//Automatisch
		enableControl("CMS_PI_State_Gw_AR2", "CH_EISCRC_CMS_PI_Stat_Pr2CMS_PI_", 0); //1: enable; 0: disable
	}
	else
	{
		//Manuel
		enableControl("CMS_PI_State_Gw_AR2", "CH_EISCRC_CMS_PI_Stat_Pr2CMS_PI_", 1); //1: enable; 0: disable
	}
	if (@sysvar::CH_Nodes::CH_EISSQC_CMS_PI_Stat_Pr2CM_AUTO == 0)
	{
		//Automatisch
		enableControl("CMS_PI_State_Gw_AR2", "CH_EISSQC_CMS_PI_Stat_Pr2CMS_PI_", 0); //1: enable; 0: disable
	}
	else
	{
		//Manuel
		enableControl("CMS_PI_State_Gw_AR2", "CH_EISSQC_CMS_PI_Stat_Pr2CMS_PI_", 1); //1: enable; 0: disable
	}
	@sysvar::CH_Nodes::CH__PDURECEIPT_SIM_EIS_CMS_PI_State_Gw_AR2 = 1;
	@sysvar::CH_Nodes::CH__PDURECEIPT_SIM_EIS_Config_HU4_AR2 = 1;
	@sysvar::CH_Nodes::CH__PDURECEIPT_SIM_EIS_Config_HU5_AR2 = 1;
	@sysvar::CH_Nodes::CH__PDURECEIPT_SIM_EIS_CRCM_Stat_AR = 1;
	switch (@sysvar::CH_Nodes::CH_EISOnKey_PsdCTRL_C_St_UB_AUTO)
	{
		case (0):
			enableControl("CTRL_C_Stat1_AR", "CH_EISOnKey_PsdCTRL_C_Stat1__UB__UB", 0); //1: enable; 0: disable
			break;
		case (1):
			enableControl("CTRL_C_Stat1_AR", "CH_EISOnKey_PsdCTRL_C_Stat1__UB__UB", 1); //1: enable; 0: disable
	 		break;
		case (2):
			enableControl("CTRL_C_Stat1_AR", "CH_EISOnKey_PsdCTRL_C_Stat1__UB__UB", 0); //1: enable; 0: disable
			break;
		case (3):
			enableControl("CTRL_C_Stat1_AR", "CH_EISOnKey_PsdCTRL_C_Stat1__UB__UB", 0); //1: enable; 0: disable
			break;
	}
	switch (@sysvar::CH_Nodes::CH_EISPhoneKey_PsdCTRL_C_UB_AUTO)
	{
		case (0):
			enableControl("CTRL_C_Stat1_AR", "CH_EISPhoneKey_PsdCTRL_C_Sta_UB__UB", 0); //1: enable; 0: disable
			break;
		case (1):
			enableControl("CTRL_C_Stat1_AR", "CH_EISPhoneKey_PsdCTRL_C_Sta_UB__UB", 1); //1: enable; 0: disable
	 		break;
		case (2):
			enableControl("CTRL_C_Stat1_AR", "CH_EISPhoneKey_PsdCTRL_C_Sta_UB__UB", 0); //1: enable; 0: disable
			break;
		case (3):
			enableControl("CTRL_C_Stat1_AR", "CH_EISPhoneKey_PsdCTRL_C_Sta_UB__UB", 0); //1: enable; 0: disable
			break;
	}
	switch (@sysvar::CH_Nodes::CH_EISRadioKey_PsdCTRL_C_UB_AUTO)
	{
		case (0):
			enableControl("CTRL_C_Stat1_AR", "CH_EISRadioKey_PsdCTRL_C_Sta_UB__UB", 0); //1: enable; 0: disable
			break;
		case (1):
			enableControl("CTRL_C_Stat1_AR", "CH_EISRadioKey_PsdCTRL_C_Sta_UB__UB", 1); //1: enable; 0: disable
	 		break;
		case (2):
			enableControl("CTRL_C_Stat1_AR", "CH_EISRadioKey_PsdCTRL_C_Sta_UB__UB", 0); //1: enable; 0: disable
			break;
		case (3):
			enableControl("CTRL_C_Stat1_AR", "CH_EISRadioKey_PsdCTRL_C_Sta_UB__UB", 0); //1: enable; 0: disable
			break;
	}
	switch (@sysvar::CH_Nodes::CH_EISSeatKey_PsdCTRL_C__UB_AUTO)
	{
		case (0):
			enableControl("CTRL_C_Stat1_AR", "CH_EISSeatKey_PsdCTRL_C_Stat_UB__UB", 0); //1: enable; 0: disable
			break;
		case (1):
			enableControl("CTRL_C_Stat1_AR", "CH_EISSeatKey_PsdCTRL_C_Stat_UB__UB", 1); //1: enable; 0: disable
	 		break;
		case (2):
			enableControl("CTRL_C_Stat1_AR", "CH_EISSeatKey_PsdCTRL_C_Stat_UB__UB", 0); //1: enable; 0: disable
			break;
		case (3):
			enableControl("CTRL_C_Stat1_AR", "CH_EISSeatKey_PsdCTRL_C_Stat_UB__UB", 0); //1: enable; 0: disable
			break;
	}
	switch (@sysvar::CH_Nodes::CH_EISNaviKey_PsdCTRL_C__UB_AUTO)
	{
		case (0):
			enableControl("CTRL_C_Stat1_AR", "CH_EISNaviKey_PsdCTRL_C_Stat_UB__UB", 0); //1: enable; 0: disable
			break;
		case (1):
			enableControl("CTRL_C_Stat1_AR", "CH_EISNaviKey_PsdCTRL_C_Stat_UB__UB", 1); //1: enable; 0: disable
	 		break;
		case (2):
			enableControl("CTRL_C_Stat1_AR", "CH_EISNaviKey_PsdCTRL_C_Stat_UB__UB", 0); //1: enable; 0: disable
			break;
		case (3):
			enableControl("CTRL_C_Stat1_AR", "CH_EISNaviKey_PsdCTRL_C_Stat_UB__UB", 0); //1: enable; 0: disable
			break;
	}
	switch (@sysvar::CH_Nodes::CH_EISMediaKey_PsdCTRL_C_UB_AUTO)
	{
		case (0):
			enableControl("CTRL_C_Stat1_AR", "CH_EISMediaKey_PsdCTRL_C_Sta_UB__UB", 0); //1: enable; 0: disable
			break;
		case (1):
			enableControl("CTRL_C_Stat1_AR", "CH_EISMediaKey_PsdCTRL_C_Sta_UB__UB", 1); //1: enable; 0: disable
	 		break;
		case (2):
			enableControl("CTRL_C_Stat1_AR", "CH_EISMediaKey_PsdCTRL_C_Sta_UB__UB", 0); //1: enable; 0: disable
			break;
		case (3):
			enableControl("CTRL_C_Stat1_AR", "CH_EISMediaKey_PsdCTRL_C_Sta_UB__UB", 0); //1: enable; 0: disable
			break;
	}
	switch (@sysvar::CH_Nodes::CH_EISCarKey_PsdCTRL_C_S_UB_AUTO)
	{
		case (0):
			enableControl("CTRL_C_Stat1_AR", "CH_EISCarKey_PsdCTRL_C_Stat1_UB__UB", 0); //1: enable; 0: disable
			break;
		case (1):
			enableControl("CTRL_C_Stat1_AR", "CH_EISCarKey_PsdCTRL_C_Stat1_UB__UB", 1); //1: enable; 0: disable
	 		break;
		case (2):
			enableControl("CTRL_C_Stat1_AR", "CH_EISCarKey_PsdCTRL_C_Stat1_UB__UB", 0); //1: enable; 0: disable
			break;
		case (3):
			enableControl("CTRL_C_Stat1_AR", "CH_EISCarKey_PsdCTRL_C_Stat1_UB__UB", 0); //1: enable; 0: disable
			break;
	}
	switch (@sysvar::CH_Nodes::CH_EISReturnKey_PsdCTRL__UB_AUTO)
	{
		case (0):
			enableControl("CTRL_C_Stat1_AR", "CH_EISReturnKey_PsdCTRL_C_St_UB__UB", 0); //1: enable; 0: disable
			break;
		case (1):
			enableControl("CTRL_C_Stat1_AR", "CH_EISReturnKey_PsdCTRL_C_St_UB__UB", 1); //1: enable; 0: disable
	 		break;
		case (2):
			enableControl("CTRL_C_Stat1_AR", "CH_EISReturnKey_PsdCTRL_C_St_UB__UB", 0); //1: enable; 0: disable
			break;
		case (3):
			enableControl("CTRL_C_Stat1_AR", "CH_EISReturnKey_PsdCTRL_C_St_UB__UB", 0); //1: enable; 0: disable
			break;
	}
	switch (@sysvar::CH_Nodes::CH_EISMenuKey_PsdCTRL_C__UB_AUTO)
	{
		case (0):
			enableControl("CTRL_C_Stat1_AR", "CH_EISMenuKey_PsdCTRL_C_Stat_UB__UB", 0); //1: enable; 0: disable
			break;
		case (1):
			enableControl("CTRL_C_Stat1_AR", "CH_EISMenuKey_PsdCTRL_C_Stat_UB__UB", 1); //1: enable; 0: disable
	 		break;
		case (2):
			enableControl("CTRL_C_Stat1_AR", "CH_EISMenuKey_PsdCTRL_C_Stat_UB__UB", 0); //1: enable; 0: disable
			break;
		case (3):
			enableControl("CTRL_C_Stat1_AR", "CH_EISMenuKey_PsdCTRL_C_Stat_UB__UB", 0); //1: enable; 0: disable
			break;
	}
	switch (@sysvar::CH_Nodes::CH_EISMuteKey_PsdCTRL_C__UB_AUTO)
	{
		case (0):
			enableControl("CTRL_C_Stat1_AR", "CH_EISMuteKey_PsdCTRL_C_Stat_UB__UB", 0); //1: enable; 0: disable
			break;
		case (1):
			enableControl("CTRL_C_Stat1_AR", "CH_EISMuteKey_PsdCTRL_C_Stat_UB__UB", 1); //1: enable; 0: disable
	 		break;
		case (2):
			enableControl("CTRL_C_Stat1_AR", "CH_EISMuteKey_PsdCTRL_C_Stat_UB__UB", 0); //1: enable; 0: disable
			break;
		case (3):
			enableControl("CTRL_C_Stat1_AR", "CH_EISMuteKey_PsdCTRL_C_Stat_UB__UB", 0); //1: enable; 0: disable
			break;
	}
	@sysvar::CH_Nodes::CH__PDURECEIPT_SIM_EIS_CTRL_C_Stat1_AR = 1;
	@sysvar::CH_Nodes::CH__PDURECEIPT_SIM_EIS_DAC4_ECM_AR = 1;
	@sysvar::CH_Nodes::CH__PDURECEIPT_SIM_EIS_DAC4_EM2_AR = 1;
	@sysvar::CH_Nodes::CH__PDURECEIPT_SIM_EIS_DAC4_ISM_AR = 1;
	@sysvar::CH_Nodes::CH__PDURECEIPT_SIM_EIS_DAC4_TCM_AR = 1;
	@sysvar::CH_Nodes::CH__PDURECEIPT_SIM_EIS_Dimming_Stat_AR2 = 1;
	if (@sysvar::CH_Nodes::CH_EISCRC_Door_FL_Stat_Pr2D_AUTO == 0)
	{
		//Automatisch
		enableControl("Door_FL_Stat_AR2", "CH_EISCRC_Door_FL_Stat_Pr2Door__", 0); //1: enable; 0: disable
	}
	else
	{
		//Manuel
		enableControl("Door_FL_Stat_AR2", "CH_EISCRC_Door_FL_Stat_Pr2Door__", 1); //1: enable; 0: disable
	}
	if (@sysvar::CH_Nodes::CH_EISSQC_Door_FL_Stat_Pr2D_AUTO == 0)
	{
		//Automatisch
		enableControl("Door_FL_Stat_AR2", "CH_EISSQC_Door_FL_Stat_Pr2Door__", 0); //1: enable; 0: disable
	}
	else
	{
		//Manuel
		enableControl("Door_FL_Stat_AR2", "CH_EISSQC_Door_FL_Stat_Pr2Door__", 1); //1: enable; 0: disable
	}
	@sysvar::CH_Nodes::CH__PDURECEIPT_SIM_EIS_Door_FL_Stat_AR2 = 1;
	if (@sysvar::CH_Nodes::CH_EISCRC_Door_FR_Stat_Pr2D_AUTO == 0)
	{
		//Automatisch
		enableControl("Door_FR_Stat_AR2", "CH_EISCRC_Door_FR_Stat_Pr2Door__", 0); //1: enable; 0: disable
	}
	else
	{
		//Manuel
		enableControl("Door_FR_Stat_AR2", "CH_EISCRC_Door_FR_Stat_Pr2Door__", 1); //1: enable; 0: disable
	}
	if (@sysvar::CH_Nodes::CH_EISSQC_Door_FR_Stat_Pr2D_AUTO == 0)
	{
		//Automatisch
		enableControl("Door_FR_Stat_AR2", "CH_EISSQC_Door_FR_Stat_Pr2Door__", 0); //1: enable; 0: disable
	}
	else
	{
		//Manuel
		enableControl("Door_FR_Stat_AR2", "CH_EISSQC_Door_FR_Stat_Pr2Door__", 1); //1: enable; 0: disable
	}
	@sysvar::CH_Nodes::CH__PDURECEIPT_SIM_EIS_Door_FR_Stat_AR2 = 1;
	if (@sysvar::CH_Nodes::CH_EISCRC_Door_RL_Stat_Pr2D_AUTO == 0)
	{
		//Automatisch
		enableControl("Door_RL_Stat_AR2", "CH_EISCRC_Door_RL_Stat_Pr2Door__", 0); //1: enable; 0: disable
	}
	else
	{
		//Manuel
		enableControl("Door_RL_Stat_AR2", "CH_EISCRC_Door_RL_Stat_Pr2Door__", 1); //1: enable; 0: disable
	}
	if (@sysvar::CH_Nodes::CH_EISSQC_Door_RL_Stat_Pr2D_AUTO == 0)
	{
		//Automatisch
		enableControl("Door_RL_Stat_AR2", "CH_EISSQC_Door_RL_Stat_Pr2Door__", 0); //1: enable; 0: disable
	}
	else
	{
		//Manuel
		enableControl("Door_RL_Stat_AR2", "CH_EISSQC_Door_RL_Stat_Pr2Door__", 1); //1: enable; 0: disable
	}
	@sysvar::CH_Nodes::CH__PDURECEIPT_SIM_EIS_Door_RL_Stat_AR2 = 1;
	if (@sysvar::CH_Nodes::CH_EISCRC_Door_RR_Stat_Pr2D_AUTO == 0)
	{
		//Automatisch
		enableControl("Door_RR_Stat_AR2", "CH_EISCRC_Door_RR_Stat_Pr2Door__", 0); //1: enable; 0: disable
	}
	else
	{
		//Manuel
		enableControl("Door_RR_Stat_AR2", "CH_EISCRC_Door_RR_Stat_Pr2Door__", 1); //1: enable; 0: disable
	}
	if (@sysvar::CH_Nodes::CH_EISSQC_Door_RR_Stat_Pr2D_AUTO == 0)
	{
		//Automatisch
		enableControl("Door_RR_Stat_AR2", "CH_EISSQC_Door_RR_Stat_Pr2Door__", 0); //1: enable; 0: disable
	}
	else
	{
		//Manuel
		enableControl("Door_RR_Stat_AR2", "CH_EISSQC_Door_RR_Stat_Pr2Door__", 1); //1: enable; 0: disable
	}
	@sysvar::CH_Nodes::CH__PDURECEIPT_SIM_EIS_Door_RR_Stat_AR2 = 1;
	@sysvar::CH_Nodes::CH__PDURECEIPT_SIM_EIS_DPC_IndMd_Rq_AR = 1;
	@sysvar::CH_Nodes::CH__PDURECEIPT_SIM_EIS_EAC_Stat_AR = 1;
	if (@sysvar::CH_Nodes::CH_EISCRC_ExtLgt_Lmp_On_Rq__AUTO == 0)
	{
		//Automatisch
		enableControl("EL_Stat_AR2", "CH_EISCRC_ExtLgt_Lmp_On_Rq_Pr2E_", 0); //1: enable; 0: disable
	}
	else
	{
		//Manuel
		enableControl("EL_Stat_AR2", "CH_EISCRC_ExtLgt_Lmp_On_Rq_Pr2E_", 1); //1: enable; 0: disable
	}
	if (@sysvar::CH_Nodes::CH_EISSQC_ExtLgt_Lmp_On_Rq__AUTO == 0)
	{
		//Automatisch
		enableControl("EL_Stat_AR2", "CH_EISSQC_ExtLgt_Lmp_On_Rq_Pr2E_", 0); //1: enable; 0: disable
	}
	else
	{
		//Manuel
		enableControl("EL_Stat_AR2", "CH_EISSQC_ExtLgt_Lmp_On_Rq_Pr2E_", 1); //1: enable; 0: disable
	}
	@sysvar::CH_Nodes::CH__PDURECEIPT_SIM_EIS_EL_Stat_AR2 = 1;
	if (@sysvar::CH_Nodes::CH_EISCRC_EL_TurnInd_On_Rq__AUTO == 0)
	{
		//Automatisch
		enableControl("EL_TurnInd_Rq_AR2", "CH_EISCRC_EL_TurnInd_On_Rq_Pr2E_", 0); //1: enable; 0: disable
	}
	else
	{
		//Manuel
		enableControl("EL_TurnInd_Rq_AR2", "CH_EISCRC_EL_TurnInd_On_Rq_Pr2E_", 1); //1: enable; 0: disable
	}
	if (@sysvar::CH_Nodes::CH_EISSQC_EL_TurnInd_On_Rq__AUTO == 0)
	{
		//Automatisch
		enableControl("EL_TurnInd_Rq_AR2", "CH_EISSQC_EL_TurnInd_On_Rq_Pr2E_", 0); //1: enable; 0: disable
	}
	else
	{
		//Manuel
		enableControl("EL_TurnInd_Rq_AR2", "CH_EISSQC_EL_TurnInd_On_Rq_Pr2E_", 1); //1: enable; 0: disable
	}
	@sysvar::CH_Nodes::CH__PDURECEIPT_SIM_EIS_EL_TurnInd_Rq_AR2 = 1;
	if (@sysvar::CH_Nodes::CH_EISCRC_EPKB_Stat_Pr2EPKB_AUTO == 0)
	{
		//Automatisch
		enableControl("EPKB_Stat_AR2", "CH_EISCRC_EPKB_Stat_Pr2EPKB_Sta_", 0); //1: enable; 0: disable
	}
	else
	{
		//Manuel
		enableControl("EPKB_Stat_AR2", "CH_EISCRC_EPKB_Stat_Pr2EPKB_Sta_", 1); //1: enable; 0: disable
	}
	if (@sysvar::CH_Nodes::CH_EISSQC_EPKB_Stat_Pr2EPKB_AUTO == 0)
	{
		//Automatisch
		enableControl("EPKB_Stat_AR2", "CH_EISSQC_EPKB_Stat_Pr2EPKB_Sta_", 0); //1: enable; 0: disable
	}
	else
	{
		//Manuel
		enableControl("EPKB_Stat_AR2", "CH_EISSQC_EPKB_Stat_Pr2EPKB_Sta_", 1); //1: enable; 0: disable
	}
	@sysvar::CH_Nodes::CH__PDURECEIPT_SIM_EIS_EPKB_Stat_AR2 = 1;
	if (@sysvar::CH_Nodes::CH_EISCRC_EVC_CfgBit_01_32__AUTO == 0)
	{
		//Automatisch
		enableControl("EVC_CfgBit_01_32_AR2", "CH_EISCRC_EVC_CfgBit_01_32_Pr2E_", 0); //1: enable; 0: disable
	}
	else
	{
		//Manuel
		enableControl("EVC_CfgBit_01_32_AR2", "CH_EISCRC_EVC_CfgBit_01_32_Pr2E_", 1); //1: enable; 0: disable
	}
	if (@sysvar::CH_Nodes::CH_EISSQC_EVC_CfgBit_01_32__AUTO == 0)
	{
		//Automatisch
		enableControl("EVC_CfgBit_01_32_AR2", "CH_EISSQC_EVC_CfgBit_01_32_Pr2E_", 0); //1: enable; 0: disable
	}
	else
	{
		//Manuel
		enableControl("EVC_CfgBit_01_32_AR2", "CH_EISSQC_EVC_CfgBit_01_32_Pr2E_", 1); //1: enable; 0: disable
	}
	@sysvar::CH_Nodes::CH__PDURECEIPT_SIM_EIS_EVC_CfgBit_01_32_AR2 = 1;
	if (@sysvar::CH_Nodes::CH_EISCRC_EVC_CfgBit_33_64__AUTO == 0)
	{
		//Automatisch
		enableControl("EVC_CfgBit_33_64_AR2", "CH_EISCRC_EVC_CfgBit_33_64_Pr2E_", 0); //1: enable; 0: disable
	}
	else
	{
		//Manuel
		enableControl("EVC_CfgBit_33_64_AR2", "CH_EISCRC_EVC_CfgBit_33_64_Pr2E_", 1); //1: enable; 0: disable
	}
	if (@sysvar::CH_Nodes::CH_EISSQC_EVC_CfgBit_33_64__AUTO == 0)
	{
		//Automatisch
		enableControl("EVC_CfgBit_33_64_AR2", "CH_EISSQC_EVC_CfgBit_33_64_Pr2E_", 0); //1: enable; 0: disable
	}
	else
	{
		//Manuel
		enableControl("EVC_CfgBit_33_64_AR2", "CH_EISSQC_EVC_CfgBit_33_64_Pr2E_", 1); //1: enable; 0: disable
	}
	@sysvar::CH_Nodes::CH__PDURECEIPT_SIM_EIS_EVC_CfgBit_33_64_AR2 = 1;
	if (@sysvar::CH_Nodes::CH_EISCRC_EVC_CfgBit_65_96__AUTO == 0)
	{
		//Automatisch
		enableControl("EVC_CfgBit_65_96_AR2", "CH_EISCRC_EVC_CfgBit_65_96_Pr2E_", 0); //1: enable; 0: disable
	}
	else
	{
		//Manuel
		enableControl("EVC_CfgBit_65_96_AR2", "CH_EISCRC_EVC_CfgBit_65_96_Pr2E_", 1); //1: enable; 0: disable
	}
	if (@sysvar::CH_Nodes::CH_EISSQC_EVC_CfgBit_65_96__AUTO == 0)
	{
		//Automatisch
		enableControl("EVC_CfgBit_65_96_AR2", "CH_EISSQC_EVC_CfgBit_65_96_Pr2E_", 0); //1: enable; 0: disable
	}
	else
	{
		//Manuel
		enableControl("EVC_CfgBit_65_96_AR2", "CH_EISSQC_EVC_CfgBit_65_96_Pr2E_", 1); //1: enable; 0: disable
	}
	@sysvar::CH_Nodes::CH__PDURECEIPT_SIM_EIS_EVC_CfgBit_65_96_AR2 = 1;
	if (@sysvar::CH_Nodes::CH_EISCRC_EVC_CfgBit_97_C8__AUTO == 0)
	{
		//Automatisch
		enableControl("EVC_CfgBit_97_C8_AR2", "CH_EISCRC_EVC_CfgBit_97_C8_Pr2E_", 0); //1: enable; 0: disable
	}
	else
	{
		//Manuel
		enableControl("EVC_CfgBit_97_C8_AR2", "CH_EISCRC_EVC_CfgBit_97_C8_Pr2E_", 1); //1: enable; 0: disable
	}
	if (@sysvar::CH_Nodes::CH_EISSQC_EVC_CfgBit_97_C8__AUTO == 0)
	{
		//Automatisch
		enableControl("EVC_CfgBit_97_C8_AR2", "CH_EISSQC_EVC_CfgBit_97_C8_Pr2E_", 0); //1: enable; 0: disable
	}
	else
	{
		//Manuel
		enableControl("EVC_CfgBit_97_C8_AR2", "CH_EISSQC_EVC_CfgBit_97_C8_Pr2E_", 1); //1: enable; 0: disable
	}
	@sysvar::CH_Nodes::CH__PDURECEIPT_SIM_EIS_EVC_CfgBit_97_C8_AR2 = 1;
	if (@sysvar::CH_Nodes::CH_EISCRC_EVC_CfgList_01_0C_AUTO == 0)
	{
		//Automatisch
		enableControl("EVC_CfgList_01_0C_AR2", "CH_EISCRC_EVC_CfgList_01_0C_Pr2_", 0); //1: enable; 0: disable
	}
	else
	{
		//Manuel
		enableControl("EVC_CfgList_01_0C_AR2", "CH_EISCRC_EVC_CfgList_01_0C_Pr2_", 1); //1: enable; 0: disable
	}
	if (@sysvar::CH_Nodes::CH_EISSQC_EVC_CfgList_01_0C_AUTO == 0)
	{
		//Automatisch
		enableControl("EVC_CfgList_01_0C_AR2", "CH_EISSQC_EVC_CfgList_01_0C_Pr2_", 0); //1: enable; 0: disable
	}
	else
	{
		//Manuel
		enableControl("EVC_CfgList_01_0C_AR2", "CH_EISSQC_EVC_CfgList_01_0C_Pr2_", 1); //1: enable; 0: disable
	}
	@sysvar::CH_Nodes::CH__PDURECEIPT_SIM_EIS_EVC_CfgList_01_0C_AR2 = 1;
	@sysvar::CH_Nodes::CH__PDURECEIPT_SIM_EIS_FCW_Disp_Rq_AR = 1;
	switch (@sysvar::CH_Nodes::CH_EISPark_Disp_StatHMI__UB_AUTO)
	{
		case (0):
			enableControl("HMI_CHASSIS_R1_AR2", "CH_EISPark_Disp_StatHMI_CHAS_UB__UB", 0); //1: enable; 0: disable
			break;
		case (1):
			enableControl("HMI_CHASSIS_R1_AR2", "CH_EISPark_Disp_StatHMI_CHAS_UB__UB", 1); //1: enable; 0: disable
	 		break;
		case (2):
			enableControl("HMI_CHASSIS_R1_AR2", "CH_EISPark_Disp_StatHMI_CHAS_UB__UB", 0); //1: enable; 0: disable
			break;
		case (3):
			enableControl("HMI_CHASSIS_R1_AR2", "CH_EISPark_Disp_StatHMI_CHAS_UB__UB", 0); //1: enable; 0: disable
			break;
	}
	if (@sysvar::CH_Nodes::CH_EISCRC_CTRL_L_Stat_Pr2HM_AUTO == 0)
	{
		//Automatisch
		enableControl("HMI_CHASSIS_R1_AR2", "CH_EISCRC_CTRL_L_Stat_Pr2HMI_CH_", 0); //1: enable; 0: disable
	}
	else
	{
		//Manuel
		enableControl("HMI_CHASSIS_R1_AR2", "CH_EISCRC_CTRL_L_Stat_Pr2HMI_CH_", 1); //1: enable; 0: disable
	}
	if (@sysvar::CH_Nodes::CH_EISSQC_CTRL_L_Stat_Pr2HM_AUTO == 0)
	{
		//Automatisch
		enableControl("HMI_CHASSIS_R1_AR2", "CH_EISSQC_CTRL_L_Stat_Pr2HMI_CH_", 0); //1: enable; 0: disable
	}
	else
	{
		//Manuel
		enableControl("HMI_CHASSIS_R1_AR2", "CH_EISSQC_CTRL_L_Stat_Pr2HMI_CH_", 1); //1: enable; 0: disable
	}
	if (@sysvar::CH_Nodes::CH_EISCRC_CTRL_L2_Stat_Pr2H_AUTO == 0)
	{
		//Automatisch
		enableControl("HMI_CHASSIS_R1_AR2", "CH_EISCRC_CTRL_L2_Stat_Pr2HMI_C_", 0); //1: enable; 0: disable
	}
	else
	{
		//Manuel
		enableControl("HMI_CHASSIS_R1_AR2", "CH_EISCRC_CTRL_L2_Stat_Pr2HMI_C_", 1); //1: enable; 0: disable
	}
	if (@sysvar::CH_Nodes::CH_EISSQC_CTRL_L2_Stat_Pr2H_AUTO == 0)
	{
		//Automatisch
		enableControl("HMI_CHASSIS_R1_AR2", "CH_EISSQC_CTRL_L2_Stat_Pr2HMI_C_", 0); //1: enable; 0: disable
	}
	else
	{
		//Manuel
		enableControl("HMI_CHASSIS_R1_AR2", "CH_EISSQC_CTRL_L2_Stat_Pr2HMI_C_", 1); //1: enable; 0: disable
	}
	@sysvar::CH_Nodes::CH__PDURECEIPT_SIM_EIS_HMI_CHASSIS_R1_AR2 = 1;
	@sysvar::CH_Nodes::CH__PDURECEIPT_SIM_EIS_HU_Comf_Rq_AR2 = 1;
	@sysvar::CH_Nodes::CH__PDURECEIPT_SIM_EIS_HU_State_AR = 1;
	@sysvar::CH_Nodes::CH__PDURECEIPT_SIM_EIS_HVAC_Disp_Stat1_AR = 1;
	@sysvar::CH_Nodes::CH__PDURECEIPT_SIM_EIS_HVAC_OBD_DTC_AR = 1;
	@sysvar::CH_Nodes::CH__PDURECEIPT_SIM_EIS_HVAC_Rs2_AR = 1;
	@sysvar::CH_Nodes::CH__PDURECEIPT_SIM_EIS_HVAC_Rs3_AR2 = 1;
	if (@sysvar::CH_Nodes::CH_EISCRC_HVAC_CompTrq_Pr2H_AUTO == 0)
	{
		//Automatisch
		enableControl("HVAC_Rs_AR2", "CH_EISCRC_HVAC_CompTrq_Pr2HVAC__", 0); //1: enable; 0: disable
	}
	else
	{
		//Manuel
		enableControl("HVAC_Rs_AR2", "CH_EISCRC_HVAC_CompTrq_Pr2HVAC__", 1); //1: enable; 0: disable
	}
	if (@sysvar::CH_Nodes::CH_EISSQC_HVAC_CompTrq_Pr2H_AUTO == 0)
	{
		//Automatisch
		enableControl("HVAC_Rs_AR2", "CH_EISSQC_HVAC_CompTrq_Pr2HVAC__", 0); //1: enable; 0: disable
	}
	else
	{
		//Manuel
		enableControl("HVAC_Rs_AR2", "CH_EISSQC_HVAC_CompTrq_Pr2HVAC__", 1); //1: enable; 0: disable
	}
	@sysvar::CH_Nodes::CH__PDURECEIPT_SIM_EIS_HVAC_Rs_AR2 = 1;
	@sysvar::CH_Nodes::CH__PDURECEIPT_SIM_EIS_HVAC_State1_AR = 1;
	@sysvar::CH_Nodes::CH__PDURECEIPT_SIM_EIS_IC_BasicInfo_AR2 = 1;
	@sysvar::CH_Nodes::CH__PDURECEIPT_SIM_EIS_IC_DriveAssistSys_AR2 = 1;
	@sysvar::CH_Nodes::CH__PDURECEIPT_SIM_EIS_IC_Settings_AR2 = 1;
	@sysvar::CH_Nodes::CH__PDURECEIPT_SIM_EIS_ICH_Stat_AR = 1;
	if (@sysvar::CH_Nodes::CH_EISCRC_Ign_Stat_Pr2Ign_V_AUTO == 0)
	{
		//Automatisch
		enableControl("Ign_Veh_Stat_AR2", "CH_EISCRC_Ign_Stat_Pr2Ign_Veh_S_", 0); //1: enable; 0: disable
	}
	else
	{
		//Manuel
		enableControl("Ign_Veh_Stat_AR2", "CH_EISCRC_Ign_Stat_Pr2Ign_Veh_S_", 1); //1: enable; 0: disable
	}
	if (@sysvar::CH_Nodes::CH_EISSQC_Ign_Stat_Pr2Ign_V_AUTO == 0)
	{
		//Automatisch
		enableControl("Ign_Veh_Stat_AR2", "CH_EISSQC_Ign_Stat_Pr2Ign_Veh_S_", 0); //1: enable; 0: disable
	}
	else
	{
		//Manuel
		enableControl("Ign_Veh_Stat_AR2", "CH_EISSQC_Ign_Stat_Pr2Ign_Veh_S_", 1); //1: enable; 0: disable
	}
	@sysvar::CH_Nodes::CH__PDURECEIPT_SIM_EIS_Ign_Veh_Stat_AR2 = 1;
	@sysvar::CH_Nodes::CH__PDURECEIPT_SIM_EIS_IHC_Lgt_Stat_HLI_2_AR2 = 1;
	if (@sysvar::CH_Nodes::CH_EISCRC_IHC_Lgt_Stat_HLI__AUTO == 0)
	{
		//Automatisch
		enableControl("IHC_Lgt_Stat_HLI_AR2", "CH_EISCRC_IHC_Lgt_Stat_HLI_Pr2I_", 0); //1: enable; 0: disable
	}
	else
	{
		//Manuel
		enableControl("IHC_Lgt_Stat_HLI_AR2", "CH_EISCRC_IHC_Lgt_Stat_HLI_Pr2I_", 1); //1: enable; 0: disable
	}
	if (@sysvar::CH_Nodes::CH_EISSQC_IHC_Lgt_Stat_HLI__AUTO == 0)
	{
		//Automatisch
		enableControl("IHC_Lgt_Stat_HLI_AR2", "CH_EISSQC_IHC_Lgt_Stat_HLI_Pr2I_", 0); //1: enable; 0: disable
	}
	else
	{
		//Manuel
		enableControl("IHC_Lgt_Stat_HLI_AR2", "CH_EISSQC_IHC_Lgt_Stat_HLI_Pr2I_", 1); //1: enable; 0: disable
	}
	@sysvar::CH_Nodes::CH__PDURECEIPT_SIM_EIS_IHC_Lgt_Stat_HLI_AR2 = 1;
	if (@sysvar::CH_Nodes::CH_EISCRC_RemPark_Stat_KG_P_AUTO == 0)
	{
		//Automatisch
		enableControl("KG_State_AR2", "CH_EISCRC_RemPark_Stat_KG_Pr2KG_", 0); //1: enable; 0: disable
	}
	else
	{
		//Manuel
		enableControl("KG_State_AR2", "CH_EISCRC_RemPark_Stat_KG_Pr2KG_", 1); //1: enable; 0: disable
	}
	if (@sysvar::CH_Nodes::CH_EISSQC_RemPark_Stat_KG_P_AUTO == 0)
	{
		//Automatisch
		enableControl("KG_State_AR2", "CH_EISSQC_RemPark_Stat_KG_Pr2KG_", 0); //1: enable; 0: disable
	}
	else
	{
		//Manuel
		enableControl("KG_State_AR2", "CH_EISSQC_RemPark_Stat_KG_Pr2KG_", 1); //1: enable; 0: disable
	}
	@sysvar::CH_Nodes::CH__PDURECEIPT_SIM_EIS_KG_State_AR2 = 1;
	@sysvar::CH_Nodes::CH__PDURECEIPT_SIM_EIS_LDC_Disp_Stat_IC_AR2 = 1;
	@sysvar::CH_Nodes::CH__PDURECEIPT_SIM_EIS_LgtSens_State_AR = 1;
	@sysvar::CH_Nodes::CH__PDURECEIPT_SIM_EIS_Mirr_Adj_Lt_Rq_AR = 1;
	@sysvar::CH_Nodes::CH__PDURECEIPT_SIM_EIS_Mirr_Adj_Rt_Rq_AR = 1;
	@sysvar::CH_Nodes::CH__PDURECEIPT_SIM_EIS_NAVI_Pos1_AR = 1;
	@sysvar::CH_Nodes::CH__PDURECEIPT_SIM_EIS_NAVI_Pos2_AR = 1;
	@sysvar::CH_Nodes::CH__PDURECEIPT_SIM_EIS_NAVI_Pos3_AR = 1;
	@sysvar::CH_Nodes::CH__PDURECEIPT_SIM_EIS_NAVI_Pos4_AR = 1;
	@sysvar::CH_Nodes::CH__PDURECEIPT_SIM_EIS_NAVI_Pos5_AR = 1;
	if (@sysvar::CH_Nodes::CH_EISCRC_NVP_Stat1_Pr2NVP__AUTO == 0)
	{
		//Automatisch
		enableControl("NVP_Stat1_AR2", "CH_EISCRC_NVP_Stat1_Pr2NVP_Stat_", 0); //1: enable; 0: disable
	}
	else
	{
		//Manuel
		enableControl("NVP_Stat1_AR2", "CH_EISCRC_NVP_Stat1_Pr2NVP_Stat_", 1); //1: enable; 0: disable
	}
	if (@sysvar::CH_Nodes::CH_EISSQC_NVP_Stat1_Pr2NVP__AUTO == 0)
	{
		//Automatisch
		enableControl("NVP_Stat1_AR2", "CH_EISSQC_NVP_Stat1_Pr2NVP_Stat_", 0); //1: enable; 0: disable
	}
	else
	{
		//Manuel
		enableControl("NVP_Stat1_AR2", "CH_EISSQC_NVP_Stat1_Pr2NVP_Stat_", 1); //1: enable; 0: disable
	}
	@sysvar::CH_Nodes::CH__PDURECEIPT_SIM_EIS_NVP_Stat1_AR2 = 1;
	@sysvar::CH_Nodes::CH__PDURECEIPT_SIM_EIS_OHCM_Stat_AR2 = 1;
	if (@sysvar::CH_Nodes::CH_EISCRC_Bckl_Sw_Ft_Stat_P_AUTO == 0)
	{
		//Automatisch
		enableControl("ORC_Disp_Stat_AR2", "CH_EISCRC_Bckl_Sw_Ft_Stat_Pr2OR_", 0); //1: enable; 0: disable
	}
	else
	{
		//Manuel
		enableControl("ORC_Disp_Stat_AR2", "CH_EISCRC_Bckl_Sw_Ft_Stat_Pr2OR_", 1); //1: enable; 0: disable
	}
	if (@sysvar::CH_Nodes::CH_EISSQC_Bckl_Sw_Ft_Stat_P_AUTO == 0)
	{
		//Automatisch
		enableControl("ORC_Disp_Stat_AR2", "CH_EISSQC_Bckl_Sw_Ft_Stat_Pr2OR_", 0); //1: enable; 0: disable
	}
	else
	{
		//Manuel
		enableControl("ORC_Disp_Stat_AR2", "CH_EISSQC_Bckl_Sw_Ft_Stat_Pr2OR_", 1); //1: enable; 0: disable
	}
	@sysvar::CH_Nodes::CH__PDURECEIPT_SIM_EIS_ORC_Disp_Stat_AR2 = 1;
	if (@sysvar::CH_Nodes::CH_EISCRC_Impact_Pr2ORC_Imp_AUTO == 0)
	{
		//Automatisch
		enableControl("ORC_Impact_AR2", "CH_EISCRC_Impact_Pr2ORC_Impact__", 0); //1: enable; 0: disable
	}
	else
	{
		//Manuel
		enableControl("ORC_Impact_AR2", "CH_EISCRC_Impact_Pr2ORC_Impact__", 1); //1: enable; 0: disable
	}
	if (@sysvar::CH_Nodes::CH_EISSQC_Impact_Pr2ORC_Imp_AUTO == 0)
	{
		//Automatisch
		enableControl("ORC_Impact_AR2", "CH_EISSQC_Impact_Pr2ORC_Impact__", 0); //1: enable; 0: disable
	}
	else
	{
		//Manuel
		enableControl("ORC_Impact_AR2", "CH_EISSQC_Impact_Pr2ORC_Impact__", 1); //1: enable; 0: disable
	}
	if (@sysvar::CH_Nodes::CH_EISImpact_TglORC_Impact__AUTO == 0)
	{
		//Automatisch
		enableControl("ORC_Impact_AR2", "CH_EISImpact_TglORC_Impact_AR2_", 0); //1: enable; 0: disable
	}
	else
	{
		//Manuel
		enableControl("ORC_Impact_AR2", "CH_EISImpact_TglORC_Impact_AR2_", 1); //1: enable; 0: disable
	}
	@sysvar::CH_Nodes::CH__PDURECEIPT_SIM_EIS_ORC_Impact_AR2 = 1;
	@sysvar::CH_Nodes::CH__PDURECEIPT_SIM_EIS_Park_Disp_Rs_AR2 = 1;
	if (@sysvar::CH_Nodes::CH_EISCRC_PHB_IHC_Plus_Tunn_AUTO == 0)
	{
		//Automatisch
		enableControl("PHB_IHC_Plus_Tunnel_3_4_AR2", "CH_EISCRC_PHB_IHC_Plus_Tunnel_3_", 0); //1: enable; 0: disable
	}
	else
	{
		//Manuel
		enableControl("PHB_IHC_Plus_Tunnel_3_4_AR2", "CH_EISCRC_PHB_IHC_Plus_Tunnel_3_", 1); //1: enable; 0: disable
	}
	if (@sysvar::CH_Nodes::CH_EISSQC_PHB_IHC_Plus_Tunn_AUTO == 0)
	{
		//Automatisch
		enableControl("PHB_IHC_Plus_Tunnel_3_4_AR2", "CH_EISSQC_PHB_IHC_Plus_Tunnel_3_", 0); //1: enable; 0: disable
	}
	else
	{
		//Manuel
		enableControl("PHB_IHC_Plus_Tunnel_3_4_AR2", "CH_EISSQC_PHB_IHC_Plus_Tunnel_3_", 1); //1: enable; 0: disable
	}
	@sysvar::CH_Nodes::CH__PDURECEIPT_SIM_EIS_PHB_IHC_Plus_Tunnel_3_4_AR2 = 1;
	if (@sysvar::CH_Nodes::CH_EISCRC_PHB_IHC_Plus_Tunn_A_01 == 0)
	{
		//Automatisch
		enableControl("PHB_IHC_Plus_Tunnel_AR2", "CH_EISCRC_PHB_IHC_Plus_Tunnel_P_", 0); //1: enable; 0: disable
	}
	else
	{
		//Manuel
		enableControl("PHB_IHC_Plus_Tunnel_AR2", "CH_EISCRC_PHB_IHC_Plus_Tunnel_P_", 1); //1: enable; 0: disable
	}
	if (@sysvar::CH_Nodes::CH_EISSQC_PHB_IHC_Plus_Tunn_A_01 == 0)
	{
		//Automatisch
		enableControl("PHB_IHC_Plus_Tunnel_AR2", "CH_EISSQC_PHB_IHC_Plus_Tunnel_P_", 0); //1: enable; 0: disable
	}
	else
	{
		//Manuel
		enableControl("PHB_IHC_Plus_Tunnel_AR2", "CH_EISSQC_PHB_IHC_Plus_Tunnel_P_", 1); //1: enable; 0: disable
	}
	@sysvar::CH_Nodes::CH__PDURECEIPT_SIM_EIS_PHB_IHC_Plus_Tunnel_AR2 = 1;
	@sysvar::CH_Nodes::CH__PDURECEIPT_SIM_EIS_PN14_Disp_Rq_AR = 1;
	if (@sysvar::CH_Nodes::CH_EISCRC_PN14_Rs1_Pr2PN14__AUTO == 0)
	{
		//Automatisch
		enableControl("PN14_Rs1_AR2", "CH_EISCRC_PN14_Rs1_Pr2PN14_Rs1__", 0); //1: enable; 0: disable
	}
	else
	{
		//Manuel
		enableControl("PN14_Rs1_AR2", "CH_EISCRC_PN14_Rs1_Pr2PN14_Rs1__", 1); //1: enable; 0: disable
	}
	if (@sysvar::CH_Nodes::CH_EISSQC_PN14_Rs1_Pr2PN14__AUTO == 0)
	{
		//Automatisch
		enableControl("PN14_Rs1_AR2", "CH_EISSQC_PN14_Rs1_Pr2PN14_Rs1__", 0); //1: enable; 0: disable
	}
	else
	{
		//Manuel
		enableControl("PN14_Rs1_AR2", "CH_EISSQC_PN14_Rs1_Pr2PN14_Rs1__", 1); //1: enable; 0: disable
	}
	@sysvar::CH_Nodes::CH__PDURECEIPT_SIM_EIS_PN14_Rs1_AR2 = 1;
	@sysvar::CH_Nodes::CH__PDURECEIPT_SIM_EIS_PN14_Rs2_AR = 1;
	@sysvar::CH_Nodes::CH__PDURECEIPT_SIM_EIS_PN14_Stat2_AR2 = 1;
	@sysvar::CH_Nodes::CH__PDURECEIPT_SIM_EIS_PN14_Stat_AR = 1;
	@sysvar::CH_Nodes::CH__PDURECEIPT_SIM_EIS_PN48_Bat_Stat2_AR2 = 1;
	@sysvar::CH_Nodes::CH__PDURECEIPT_SIM_EIS_PN48_Bat_Stat_AR = 1;
	@sysvar::CH_Nodes::CH__PDURECEIPT_SIM_EIS_PN48_BatLim_Stat_AR = 1;
	@sysvar::CH_Nodes::CH__PDURECEIPT_SIM_EIS_PN48_DCDC48_LISB48_Stat_AR = 1;
	@sysvar::CH_Nodes::CH__PDURECEIPT_SIM_EIS_PN48_Stat_AR = 1;
	@sysvar::CH_Nodes::CH__PDURECEIPT_SIM_EIS_PNHV_WeekDepTmTbl_Rq_HU_AR2 = 1;
	@sysvar::CH_Nodes::CH__PDURECEIPT_SIM_EIS_PreCond_On_Rq_AR = 1;
	@sysvar::CH_Nodes::CH__PDURECEIPT_SIM_EIS_PreCond_Rq_HU_AR2 = 1;
	@sysvar::CH_Nodes::CH__PDURECEIPT_SIM_EIS_PreCond_Stat_AR = 1;
	if (@sysvar::CH_Nodes::CH_EISCRC_PT_ObjIntrst_Pr2P_AUTO == 0)
	{
		//Automatisch
		enableControl("PT_ObjIntrst_Gw_AR2", "CH_EISCRC_PT_ObjIntrst_Pr2PT_Ob_", 0); //1: enable; 0: disable
	}
	else
	{
		//Manuel
		enableControl("PT_ObjIntrst_Gw_AR2", "CH_EISCRC_PT_ObjIntrst_Pr2PT_Ob_", 1); //1: enable; 0: disable
	}
	if (@sysvar::CH_Nodes::CH_EISSQC_PT_ObjIntrst_Pr2P_AUTO == 0)
	{
		//Automatisch
		enableControl("PT_ObjIntrst_Gw_AR2", "CH_EISSQC_PT_ObjIntrst_Pr2PT_Ob_", 0); //1: enable; 0: disable
	}
	else
	{
		//Manuel
		enableControl("PT_ObjIntrst_Gw_AR2", "CH_EISSQC_PT_ObjIntrst_Pr2PT_Ob_", 1); //1: enable; 0: disable
	}
	@sysvar::CH_Nodes::CH__PDURECEIPT_SIM_EIS_PT_ObjIntrst_Gw_AR2 = 1;
	if (@sysvar::CH_Nodes::CH_EISCRC_RemPark_Auth_Rs_P_AUTO == 0)
	{
		//Automatisch
		enableControl("RemPark_Auth_Rs_AR2", "CH_EISCRC_RemPark_Auth_Rs_Pr2Re_", 0); //1: enable; 0: disable
	}
	else
	{
		//Manuel
		enableControl("RemPark_Auth_Rs_AR2", "CH_EISCRC_RemPark_Auth_Rs_Pr2Re_", 1); //1: enable; 0: disable
	}
	if (@sysvar::CH_Nodes::CH_EISSQC_RemPark_Auth_Rs_P_AUTO == 0)
	{
		//Automatisch
		enableControl("RemPark_Auth_Rs_AR2", "CH_EISSQC_RemPark_Auth_Rs_Pr2Re_", 0); //1: enable; 0: disable
	}
	else
	{
		//Manuel
		enableControl("RemPark_Auth_Rs_AR2", "CH_EISSQC_RemPark_Auth_Rs_Pr2Re_", 1); //1: enable; 0: disable
	}
	@sysvar::CH_Nodes::CH__PDURECEIPT_SIM_EIS_RemPark_Auth_Rs_AR2 = 1;
	if (@sysvar::CH_Nodes::CH_EISCRC_RemPark_Stat_EIS__AUTO == 0)
	{
		//Automatisch
		enableControl("RemPark_Stat_EIS_AR2", "CH_EISCRC_RemPark_Stat_EIS_Pr2R_", 0); //1: enable; 0: disable
	}
	else
	{
		//Manuel
		enableControl("RemPark_Stat_EIS_AR2", "CH_EISCRC_RemPark_Stat_EIS_Pr2R_", 1); //1: enable; 0: disable
	}
	if (@sysvar::CH_Nodes::CH_EISSQC_RemPark_Stat_EIS__AUTO == 0)
	{
		//Automatisch
		enableControl("RemPark_Stat_EIS_AR2", "CH_EISSQC_RemPark_Stat_EIS_Pr2R_", 0); //1: enable; 0: disable
	}
	else
	{
		//Manuel
		enableControl("RemPark_Stat_EIS_AR2", "CH_EISSQC_RemPark_Stat_EIS_Pr2R_", 1); //1: enable; 0: disable
	}
	@sysvar::CH_Nodes::CH__PDURECEIPT_SIM_EIS_RemPark_Stat_EIS_AR2 = 1;
	@sysvar::CH_Nodes::CH__PDURECEIPT_SIM_EIS_RTC_Date_Time_AR2 = 1;
	@sysvar::CH_Nodes::CH__PDURECEIPT_SIM_EIS_RTC_Stat1_AR2 = 1;
	if (@sysvar::CH_Nodes::CH_EISCRC_SADR_Trgr_FCW_Pr2_AUTO == 0)
	{
		//Automatisch
		enableControl("SADR_Trgr_FCW_AR2", "CH_EISCRC_SADR_Trgr_FCW_Pr2SADR_", 0); //1: enable; 0: disable
	}
	else
	{
		//Manuel
		enableControl("SADR_Trgr_FCW_AR2", "CH_EISCRC_SADR_Trgr_FCW_Pr2SADR_", 1); //1: enable; 0: disable
	}
	if (@sysvar::CH_Nodes::CH_EISSQC_SADR_Trgr_FCW_Pr2_AUTO == 0)
	{
		//Automatisch
		enableControl("SADR_Trgr_FCW_AR2", "CH_EISSQC_SADR_Trgr_FCW_Pr2SADR_", 0); //1: enable; 0: disable
	}
	else
	{
		//Manuel
		enableControl("SADR_Trgr_FCW_AR2", "CH_EISSQC_SADR_Trgr_FCW_Pr2SADR_", 1); //1: enable; 0: disable
	}
	@sysvar::CH_Nodes::CH__PDURECEIPT_SIM_EIS_SADR_Trgr_FCW_AR2 = 1;
	if (@sysvar::CH_Nodes::CH_EISSeat_FL_TglSeatAdj_FL_AUTO == 0)
	{
		//Automatisch
		enableControl("SeatAdj_FL_Rq_AR", "CH_EISSeat_FL_TglSeatAdj_FL_Rq__", 0); //1: enable; 0: disable
	}
	else
	{
		//Manuel
		enableControl("SeatAdj_FL_Rq_AR", "CH_EISSeat_FL_TglSeatAdj_FL_Rq__", 1); //1: enable; 0: disable
	}
	@sysvar::CH_Nodes::CH__PDURECEIPT_SIM_EIS_SeatAdj_FL_Rq_AR = 1;
	if (@sysvar::CH_Nodes::CH_EISSeat_FR_TglSeatAdj_FR_AUTO == 0)
	{
		//Automatisch
		enableControl("SeatAdj_FR_Rq_AR", "CH_EISSeat_FR_TglSeatAdj_FR_Rq__", 0); //1: enable; 0: disable
	}
	else
	{
		//Manuel
		enableControl("SeatAdj_FR_Rq_AR", "CH_EISSeat_FR_TglSeatAdj_FR_Rq__", 1); //1: enable; 0: disable
	}
	@sysvar::CH_Nodes::CH__PDURECEIPT_SIM_EIS_SeatAdj_FR_Rq_AR = 1;
	if (@sysvar::CH_Nodes::CH_EISCRC_SPCR_Stat_BC_F_Pr_AUTO == 0)
	{
		//Automatisch
		enableControl("SPCR_Stat_BC_F_AR2", "CH_EISCRC_SPCR_Stat_BC_F_Pr2SPC_", 0); //1: enable; 0: disable
	}
	else
	{
		//Manuel
		enableControl("SPCR_Stat_BC_F_AR2", "CH_EISCRC_SPCR_Stat_BC_F_Pr2SPC_", 1); //1: enable; 0: disable
	}
	if (@sysvar::CH_Nodes::CH_EISSQC_SPCR_Stat_BC_F_Pr_AUTO == 0)
	{
		//Automatisch
		enableControl("SPCR_Stat_BC_F_AR2", "CH_EISSQC_SPCR_Stat_BC_F_Pr2SPC_", 0); //1: enable; 0: disable
	}
	else
	{
		//Manuel
		enableControl("SPCR_Stat_BC_F_AR2", "CH_EISSQC_SPCR_Stat_BC_F_Pr2SPC_", 1); //1: enable; 0: disable
	}
	@sysvar::CH_Nodes::CH__PDURECEIPT_SIM_EIS_SPCR_Stat_BC_F_AR2 = 1;
	if (@sysvar::CH_Nodes::CH_EISCRC_SPL_Obj1_Obj2_NV__AUTO == 0)
	{
		//Automatisch
		enableControl("SPL_Obj1_Obj2_NV_AR2", "CH_EISCRC_SPL_Obj1_Obj2_NV_Pr2S_", 0); //1: enable; 0: disable
	}
	else
	{
		//Manuel
		enableControl("SPL_Obj1_Obj2_NV_AR2", "CH_EISCRC_SPL_Obj1_Obj2_NV_Pr2S_", 1); //1: enable; 0: disable
	}
	if (@sysvar::CH_Nodes::CH_EISSQC_SPL_Obj1_Obj2_NV__AUTO == 0)
	{
		//Automatisch
		enableControl("SPL_Obj1_Obj2_NV_AR2", "CH_EISSQC_SPL_Obj1_Obj2_NV_Pr2S_", 0); //1: enable; 0: disable
	}
	else
	{
		//Manuel
		enableControl("SPL_Obj1_Obj2_NV_AR2", "CH_EISSQC_SPL_Obj1_Obj2_NV_Pr2S_", 1); //1: enable; 0: disable
	}
	@sysvar::CH_Nodes::CH__PDURECEIPT_SIM_EIS_SPL_Obj1_Obj2_NV_AR2 = 1;
	if (@sysvar::CH_Nodes::CH_EISCRC_SPV_ExtLgt_Rq_Pr2_AUTO == 0)
	{
		//Automatisch
		enableControl("SPV_Actn_Rq_AR2", "CH_EISCRC_SPV_ExtLgt_Rq_Pr2SPV__", 0); //1: enable; 0: disable
	}
	else
	{
		//Manuel
		enableControl("SPV_Actn_Rq_AR2", "CH_EISCRC_SPV_ExtLgt_Rq_Pr2SPV__", 1); //1: enable; 0: disable
	}
	if (@sysvar::CH_Nodes::CH_EISSQC_SPV_ExtLgt_Rq_Pr2_AUTO == 0)
	{
		//Automatisch
		enableControl("SPV_Actn_Rq_AR2", "CH_EISSQC_SPV_ExtLgt_Rq_Pr2SPV__", 0); //1: enable; 0: disable
	}
	else
	{
		//Manuel
		enableControl("SPV_Actn_Rq_AR2", "CH_EISSQC_SPV_ExtLgt_Rq_Pr2SPV__", 1); //1: enable; 0: disable
	}
	if (@sysvar::CH_Nodes::CH_EISCRC_SPV_WprWash_Rq_Pr_AUTO == 0)
	{
		//Automatisch
		enableControl("SPV_Actn_Rq_AR2", "CH_EISCRC_SPV_WprWash_Rq_Pr2SPV_", 0); //1: enable; 0: disable
	}
	else
	{
		//Manuel
		enableControl("SPV_Actn_Rq_AR2", "CH_EISCRC_SPV_WprWash_Rq_Pr2SPV_", 1); //1: enable; 0: disable
	}
	if (@sysvar::CH_Nodes::CH_EISSQC_SPV_WprWash_Rq_Pr_AUTO == 0)
	{
		//Automatisch
		enableControl("SPV_Actn_Rq_AR2", "CH_EISSQC_SPV_WprWash_Rq_Pr2SPV_", 0); //1: enable; 0: disable
	}
	else
	{
		//Manuel
		enableControl("SPV_Actn_Rq_AR2", "CH_EISSQC_SPV_WprWash_Rq_Pr2SPV_", 1); //1: enable; 0: disable
	}
	@sysvar::CH_Nodes::CH__PDURECEIPT_SIM_EIS_SPV_Actn_Rq_AR2 = 1;
	@sysvar::CH_Nodes::CH__PDURECEIPT_SIM_EIS_SPV_Alm_Rq_AR = 1;
	@sysvar::CH_Nodes::CH__PDURECEIPT_SIM_EIS_SPV_Stat_AR2 = 1;
	@sysvar::CH_Nodes::CH__PDURECEIPT_SIM_EIS_SVS_Rq_HU_AR2 = 1;
	@sysvar::CH_Nodes::CH__PDURECEIPT_SIM_EIS_TBCSC_DAC_EPS_AR2 = 1;
	@sysvar::CH_Nodes::CH__PDURECEIPT_SIM_EIS_TBCSC_DAC_ESP_AR2 = 1;
	if (@sysvar::CH_Nodes::CH_EISCRC_TBCSC_Hi_Rq1_Pr2T_AUTO == 0)
	{
		//Automatisch
		enableControl("TBCSC_Hi_Rq1_AR2", "CH_EISCRC_TBCSC_Hi_Rq1_Pr2TBCSC_", 0); //1: enable; 0: disable
	}
	else
	{
		//Manuel
		enableControl("TBCSC_Hi_Rq1_AR2", "CH_EISCRC_TBCSC_Hi_Rq1_Pr2TBCSC_", 1); //1: enable; 0: disable
	}
	if (@sysvar::CH_Nodes::CH_EISSQC_TBCSC_Hi_Rq1_Pr2T_AUTO == 0)
	{
		//Automatisch
		enableControl("TBCSC_Hi_Rq1_AR2", "CH_EISSQC_TBCSC_Hi_Rq1_Pr2TBCSC_", 0); //1: enable; 0: disable
	}
	else
	{
		//Manuel
		enableControl("TBCSC_Hi_Rq1_AR2", "CH_EISSQC_TBCSC_Hi_Rq1_Pr2TBCSC_", 1); //1: enable; 0: disable
	}
	@sysvar::CH_Nodes::CH__PDURECEIPT_SIM_EIS_TBCSC_Hi_Rq1_AR2 = 1;
	if (@sysvar::CH_Nodes::CH_EISCRC_TBCSC_Hi_Rq2_Pr2T_AUTO == 0)
	{
		//Automatisch
		enableControl("TBCSC_Hi_Rq2_AR2", "CH_EISCRC_TBCSC_Hi_Rq2_Pr2TBCSC_", 0); //1: enable; 0: disable
	}
	else
	{
		//Manuel
		enableControl("TBCSC_Hi_Rq2_AR2", "CH_EISCRC_TBCSC_Hi_Rq2_Pr2TBCSC_", 1); //1: enable; 0: disable
	}
	if (@sysvar::CH_Nodes::CH_EISSQC_TBCSC_Hi_Rq2_Pr2T_AUTO == 0)
	{
		//Automatisch
		enableControl("TBCSC_Hi_Rq2_AR2", "CH_EISSQC_TBCSC_Hi_Rq2_Pr2TBCSC_", 0); //1: enable; 0: disable
	}
	else
	{
		//Manuel
		enableControl("TBCSC_Hi_Rq2_AR2", "CH_EISSQC_TBCSC_Hi_Rq2_Pr2TBCSC_", 1); //1: enable; 0: disable
	}
	@sysvar::CH_Nodes::CH__PDURECEIPT_SIM_EIS_TBCSC_Hi_Rq2_AR2 = 1;
	if (@sysvar::CH_Nodes::CH_EISCRC_TBCSC_Lo_Rq1_Pr2T_AUTO == 0)
	{
		//Automatisch
		enableControl("TBCSC_Lo_Rq1_AR2", "CH_EISCRC_TBCSC_Lo_Rq1_Pr2TBCSC_", 0); //1: enable; 0: disable
	}
	else
	{
		//Manuel
		enableControl("TBCSC_Lo_Rq1_AR2", "CH_EISCRC_TBCSC_Lo_Rq1_Pr2TBCSC_", 1); //1: enable; 0: disable
	}
	if (@sysvar::CH_Nodes::CH_EISSQC_TBCSC_Lo_Rq1_Pr2T_AUTO == 0)
	{
		//Automatisch
		enableControl("TBCSC_Lo_Rq1_AR2", "CH_EISSQC_TBCSC_Lo_Rq1_Pr2TBCSC_", 0); //1: enable; 0: disable
	}
	else
	{
		//Manuel
		enableControl("TBCSC_Lo_Rq1_AR2", "CH_EISSQC_TBCSC_Lo_Rq1_Pr2TBCSC_", 1); //1: enable; 0: disable
	}
	@sysvar::CH_Nodes::CH__PDURECEIPT_SIM_EIS_TBCSC_Lo_Rq1_AR2 = 1;
	if (@sysvar::CH_Nodes::CH_EISCRC_TBCSC_Lo_Rq2_Pr2T_AUTO == 0)
	{
		//Automatisch
		enableControl("TBCSC_Lo_Rq2_AR2", "CH_EISCRC_TBCSC_Lo_Rq2_Pr2TBCSC_", 0); //1: enable; 0: disable
	}
	else
	{
		//Manuel
		enableControl("TBCSC_Lo_Rq2_AR2", "CH_EISCRC_TBCSC_Lo_Rq2_Pr2TBCSC_", 1); //1: enable; 0: disable
	}
	if (@sysvar::CH_Nodes::CH_EISSQC_TBCSC_Lo_Rq2_Pr2T_AUTO == 0)
	{
		//Automatisch
		enableControl("TBCSC_Lo_Rq2_AR2", "CH_EISSQC_TBCSC_Lo_Rq2_Pr2TBCSC_", 0); //1: enable; 0: disable
	}
	else
	{
		//Manuel
		enableControl("TBCSC_Lo_Rq2_AR2", "CH_EISSQC_TBCSC_Lo_Rq2_Pr2TBCSC_", 1); //1: enable; 0: disable
	}
	@sysvar::CH_Nodes::CH__PDURECEIPT_SIM_EIS_TBCSC_Lo_Rq2_AR2 = 1;
	ret_Register = RegisterSignalDriver(TC_GasFuelTankLvl,"callback_TC_Distance_ARTC_GasFuelTankLvl");
	ret_Register = RegisterSignalDriver(TC_GasFuelDist_Reset,"callback_TC_Distance_ARTC_GasFuelDist_Reset");
	ret_Register = RegisterSignalDriver(TC_GasFuelDist_Start,"callback_TC_Distance_ARTC_GasFuelDist_Start");
	@sysvar::CH_Nodes::CH__PDURECEIPT_SIM_EIS_TC_Distance_AR = 1;
	@sysvar::CH_Nodes::CH__PDURECEIPT_SIM_EIS_TGW_DateTm_Stat_AR = 1;
	@sysvar::CH_Nodes::CH__PDURECEIPT_SIM_EIS_Tire_State_AR2 = 1;
	@sysvar::CH_Nodes::CH__PDURECEIPT_SIM_EIS_TrafficInfo_AR = 1;
	if (@sysvar::CH_Nodes::CH_EISCRC_ElecTrlrHtch_Stat_AUTO == 0)
	{
		//Automatisch
		enableControl("Trailer_Stat_AR2", "CH_EISCRC_ElecTrlrHtch_Stat_Pr2_", 0); //1: enable; 0: disable
	}
	else
	{
		//Manuel
		enableControl("Trailer_Stat_AR2", "CH_EISCRC_ElecTrlrHtch_Stat_Pr2_", 1); //1: enable; 0: disable
	}
	if (@sysvar::CH_Nodes::CH_EISSQC_ElecTrlrHtch_Stat_AUTO == 0)
	{
		//Automatisch
		enableControl("Trailer_Stat_AR2", "CH_EISSQC_ElecTrlrHtch_Stat_Pr2_", 0); //1: enable; 0: disable
	}
	else
	{
		//Manuel
		enableControl("Trailer_Stat_AR2", "CH_EISSQC_ElecTrlrHtch_Stat_Pr2_", 1); //1: enable; 0: disable
	}
	@sysvar::CH_Nodes::CH__PDURECEIPT_SIM_EIS_Trailer_Stat_AR2 = 1;
	@sysvar::CH_Nodes::CH__PDURECEIPT_SIM_EIS_TSA_Disp_Rq1_AR2 = 1;
	@sysvar::CH_Nodes::CH__PDURECEIPT_SIM_EIS_TSA_Disp_Rq2_AR = 1;
	@sysvar::CH_Nodes::CH__PDURECEIPT_SIM_EIS_TSA_Disp_Rq3_AR = 1;
	if (@sysvar::CH_Nodes::CH_EISCRC_VehAccel_X_Rq_Pr2_AUTO == 0)
	{
		//Automatisch
		enableControl("VehAccel_X_Rq_Gw_AR2", "CH_EISCRC_VehAccel_X_Rq_Pr2VehA_", 0); //1: enable; 0: disable
	}
	else
	{
		//Manuel
		enableControl("VehAccel_X_Rq_Gw_AR2", "CH_EISCRC_VehAccel_X_Rq_Pr2VehA_", 1); //1: enable; 0: disable
	}
	if (@sysvar::CH_Nodes::CH_EISSQC_VehAccel_X_Rq_Pr2_AUTO == 0)
	{
		//Automatisch
		enableControl("VehAccel_X_Rq_Gw_AR2", "CH_EISSQC_VehAccel_X_Rq_Pr2VehA_", 0); //1: enable; 0: disable
	}
	else
	{
		//Manuel
		enableControl("VehAccel_X_Rq_Gw_AR2", "CH_EISSQC_VehAccel_X_Rq_Pr2VehA_", 1); //1: enable; 0: disable
	}
	@sysvar::CH_Nodes::CH__PDURECEIPT_SIM_EIS_VehAccel_X_Rq_Gw_AR2 = 1;
	@sysvar::CH_Nodes::CH__PDURECEIPT_SIM_EIS_VIN_AR = 1;
	@sysvar::CH_Nodes::CH__PDURECEIPT_SIM_EIS_Wiper_Stat_AR = 1;
	@sysvar::CH_Nodes::CH__PDURECEIPT_SIM_EIS_WUDOP_EIS_FR = 1;
	if (@sysvar::CH_Nodes::CH_EISCRC_YMAS_Rq_MPC_Pr2YM_AUTO == 0)
	{
		//Automatisch
		enableControl("YMAS_Rq_MPC_AR2", "CH_EISCRC_YMAS_Rq_MPC_Pr2YMAS_R_", 0); //1: enable; 0: disable
	}
	else
	{
		//Manuel
		enableControl("YMAS_Rq_MPC_AR2", "CH_EISCRC_YMAS_Rq_MPC_Pr2YMAS_R_", 1); //1: enable; 0: disable
	}
	if (@sysvar::CH_Nodes::CH_EISSQC_YMAS_Rq_MPC_Pr2YM_AUTO == 0)
	{
		//Automatisch
		enableControl("YMAS_Rq_MPC_AR2", "CH_EISSQC_YMAS_Rq_MPC_Pr2YMAS_R_", 0); //1: enable; 0: disable
	}
	else
	{
		//Manuel
		enableControl("YMAS_Rq_MPC_AR2", "CH_EISSQC_YMAS_Rq_MPC_Pr2YMAS_R_", 1); //1: enable; 0: disable
	}
	@sysvar::CH_Nodes::CH__PDURECEIPT_SIM_EIS_YMAS_Rq_MPC_AR2 = 1;
	// netzwerk management

	enableControl("CHASSIS_FR Netzmanagement", "CH__NMActive_EIS", 1);
}

on preStart
{

	FrSetSendPDU(PDU_ADAS_PREDICTION_AR);
	FrSetSendPDU(PDU_ADAS_PROFILE_LONG_AR);
	FrSetSendPDU(PDU_ADAS_PROFILE_SHORT_AR);
	FrSetSendPDU(PDU_ADASLR_PROFILE_LONG_AR);
	FrSetSendPDU(PDU_TC_Distance_AR);

}

on timer Timer_EIS_ActvComf_Rq_AR2
{
	@sysvar::CH_Nodes::CH__STPDU_EIS_ActvComf_Rq_AR2 = 0;
}

on timer Timer_EIS_ADAS_CURRENT_ATTRIBUTES_AR
{
	@sysvar::CH_Nodes::CH__STPDU_EIS_ADAS_CURRENT_ATTRIBUTES_AR = 0;
}

on timer Timer_EIS_ADAS_POSITION_AR
{
	@sysvar::CH_Nodes::CH__STPDU_EIS_ADAS_POSITION_AR = 0;
}

on timer Timer_EIS_ADAS_PREDICTION_AR
{
	@sysvar::CH_Nodes::CH__STPDU_EIS_ADAS_PREDICTION_AR = 0;
}

on timer Timer_EIS_ADAS_PROFILE_LONG_AR
{
	@sysvar::CH_Nodes::CH__STPDU_EIS_ADAS_PROFILE_LONG_AR = 0;
}

on timer Timer_EIS_ADAS_PROFILE_SHORT_AR
{
	@sysvar::CH_Nodes::CH__STPDU_EIS_ADAS_PROFILE_SHORT_AR = 0;
}

on timer Timer_EIS_ADASLR_POSITION_AR
{
	@sysvar::CH_Nodes::CH__STPDU_EIS_ADASLR_POSITION_AR = 0;
}

on timer Timer_EIS_ADASLR_PROFILE_LONG_AR
{
	@sysvar::CH_Nodes::CH__STPDU_EIS_ADASLR_PROFILE_LONG_AR = 0;
}

on timer Timer_EIS_Assyst_Rq_AR2
{
	@sysvar::CH_Nodes::CH__STPDU_EIS_Assyst_Rq_AR2 = 0;
}

on timer Timer_EIS_BC_F_Disp_Rq_AR
{
	@sysvar::CH_Nodes::CH__STPDU_EIS_BC_F_Disp_Rq_AR = 0;
}

on timer Timer_EIS_BC_F_Stat1_AR
{
	@sysvar::CH_Nodes::CH__STPDU_EIS_BC_F_Stat1_AR = 0;
}

on timer Timer_EIS_BC_F_Stat2_AR2
{
	@sysvar::CH_Nodes::CH__STPDU_EIS_BC_F_Stat2_AR2 = 0;
}

on timer Timer_EIS_BC_R_Stat1_AR
{
	@sysvar::CH_Nodes::CH__STPDU_EIS_BC_R_Stat1_AR = 0;
}

on timer Timer_EIS_BLSM_Disp_Stat_AR
{
	@sysvar::CH_Nodes::CH__STPDU_EIS_BLSM_Disp_Stat_AR = 0;
}

on timer Timer_EIS_BODY_CHASSIS_R1_AR
{
	@sysvar::CH_Nodes::CH__STPDU_EIS_BODY_CHASSIS_R1_AR = 0;
}

on timer Timer_EIS_BSM_Disp_Warn_Rq_AR2
{
	@sysvar::CH_Nodes::CH__STPDU_EIS_BSM_Disp_Warn_Rq_AR2 = 0;
}

on timer Timer_EIS_CamLane_Disp_Warn_Rq_AR2
{
	@sysvar::CH_Nodes::CH__STPDU_EIS_CamLane_Disp_Warn_Rq_AR2 = 0;
}

on timer Timer_EIS_CamLane_LaneAttr1_AR2
{
	@sysvar::CH_Nodes::CH__STPDU_EIS_CamLane_LaneAttr1_AR2 = 0;
}

on timer Timer_EIS_CamLane_LaneAttr2_AR2
{
	@sysvar::CH_Nodes::CH__STPDU_EIS_CamLane_LaneAttr2_AR2 = 0;
}

on timer Timer_EIS_CamLane_LaneAttr3_AR2
{
	@sysvar::CH_Nodes::CH__STPDU_EIS_CamLane_LaneAttr3_AR2 = 0;
}

on timer Timer_EIS_CamLane_LaneAttr6_AR2
{
	@sysvar::CH_Nodes::CH__STPDU_EIS_CamLane_LaneAttr6_AR2 = 0;
}

on timer Timer_EIS_CamLane_LaneAttr7_AR2
{
	@sysvar::CH_Nodes::CH__STPDU_EIS_CamLane_LaneAttr7_AR2 = 0;
}

on timer Timer_EIS_CLkS_Rq_AR
{
	@sysvar::CH_Nodes::CH__STPDU_EIS_CLkS_Rq_AR = 0;
}

on timer Timer_EIS_CLkS_State_AR
{
	@sysvar::CH_Nodes::CH__STPDU_EIS_CLkS_State_AR = 0;
}

on timer Timer_EIS_ClockSync_Stat_FR2
{
	@sysvar::CH_Nodes::CH__STPDU_EIS_ClockSync_Stat_FR2 = 0;
}

on timer Timer_EIS_CMS_PI_State_Gw_AR2
{
	@sysvar::CH_Nodes::CH__STPDU_EIS_CMS_PI_State_Gw_AR2 = 0;
}

on timer Timer_EIS_Config_HU4_AR2
{
	@sysvar::CH_Nodes::CH__STPDU_EIS_Config_HU4_AR2 = 0;
}

on timer Timer_EIS_Config_HU5_AR2
{
	@sysvar::CH_Nodes::CH__STPDU_EIS_Config_HU5_AR2 = 0;
}

on timer Timer_EIS_CRCM_Stat_AR
{
	@sysvar::CH_Nodes::CH__STPDU_EIS_CRCM_Stat_AR = 0;
}

on timer Timer_EIS_CTRL_C_Stat1_AR
{
	@sysvar::CH_Nodes::CH__STPDU_EIS_CTRL_C_Stat1_AR = 0;
}

on timer Timer_EIS_DAC4_ECM_AR
{
	@sysvar::CH_Nodes::CH__STPDU_EIS_DAC4_ECM_AR = 0;
}

on timer Timer_EIS_DAC4_EM2_AR
{
	@sysvar::CH_Nodes::CH__STPDU_EIS_DAC4_EM2_AR = 0;
}

on timer Timer_EIS_DAC4_ISM_AR
{
	@sysvar::CH_Nodes::CH__STPDU_EIS_DAC4_ISM_AR = 0;
}

on timer Timer_EIS_DAC4_TCM_AR
{
	@sysvar::CH_Nodes::CH__STPDU_EIS_DAC4_TCM_AR = 0;
}

on timer Timer_EIS_Dimming_Stat_AR2
{
	@sysvar::CH_Nodes::CH__STPDU_EIS_Dimming_Stat_AR2 = 0;
}

on timer Timer_EIS_Door_FL_Stat_AR2
{
	@sysvar::CH_Nodes::CH__STPDU_EIS_Door_FL_Stat_AR2 = 0;
}

on timer Timer_EIS_Door_FR_Stat_AR2
{
	@sysvar::CH_Nodes::CH__STPDU_EIS_Door_FR_Stat_AR2 = 0;
}

on timer Timer_EIS_Door_RL_Stat_AR2
{
	@sysvar::CH_Nodes::CH__STPDU_EIS_Door_RL_Stat_AR2 = 0;
}

on timer Timer_EIS_Door_RR_Stat_AR2
{
	@sysvar::CH_Nodes::CH__STPDU_EIS_Door_RR_Stat_AR2 = 0;
}

on timer Timer_EIS_DPC_IndMd_Rq_AR
{
	@sysvar::CH_Nodes::CH__STPDU_EIS_DPC_IndMd_Rq_AR = 0;
}

on timer Timer_EIS_EAC_Stat_AR
{
	@sysvar::CH_Nodes::CH__STPDU_EIS_EAC_Stat_AR = 0;
}

on timer Timer_EIS_EL_Stat_AR2
{
	@sysvar::CH_Nodes::CH__STPDU_EIS_EL_Stat_AR2 = 0;
}

on timer Timer_EIS_EL_TurnInd_Rq_AR2
{
	@sysvar::CH_Nodes::CH__STPDU_EIS_EL_TurnInd_Rq_AR2 = 0;
}

on timer Timer_EIS_EPKB_Stat_AR2
{
	@sysvar::CH_Nodes::CH__STPDU_EIS_EPKB_Stat_AR2 = 0;
}

on timer Timer_EIS_EVC_CfgBit_01_32_AR2
{
	@sysvar::CH_Nodes::CH__STPDU_EIS_EVC_CfgBit_01_32_AR2 = 0;
}

on timer Timer_EIS_EVC_CfgBit_33_64_AR2
{
	@sysvar::CH_Nodes::CH__STPDU_EIS_EVC_CfgBit_33_64_AR2 = 0;
}

on timer Timer_EIS_EVC_CfgBit_65_96_AR2
{
	@sysvar::CH_Nodes::CH__STPDU_EIS_EVC_CfgBit_65_96_AR2 = 0;
}

on timer Timer_EIS_EVC_CfgBit_97_C8_AR2
{
	@sysvar::CH_Nodes::CH__STPDU_EIS_EVC_CfgBit_97_C8_AR2 = 0;
}

on timer Timer_EIS_EVC_CfgList_01_0C_AR2
{
	@sysvar::CH_Nodes::CH__STPDU_EIS_EVC_CfgList_01_0C_AR2 = 0;
}

on timer Timer_EIS_FCW_Disp_Rq_AR
{
	@sysvar::CH_Nodes::CH__STPDU_EIS_FCW_Disp_Rq_AR = 0;
}

on timer Timer_EIS_HMI_CHASSIS_R1_AR2
{
	@sysvar::CH_Nodes::CH__STPDU_EIS_HMI_CHASSIS_R1_AR2 = 0;
}

on timer Timer_EIS_HU_Comf_Rq_AR2
{
	@sysvar::CH_Nodes::CH__STPDU_EIS_HU_Comf_Rq_AR2 = 0;
}

on timer Timer_EIS_HU_State_AR
{
	@sysvar::CH_Nodes::CH__STPDU_EIS_HU_State_AR = 0;
}

on timer Timer_EIS_HVAC_Disp_Stat1_AR
{
	@sysvar::CH_Nodes::CH__STPDU_EIS_HVAC_Disp_Stat1_AR = 0;
}

on timer Timer_EIS_HVAC_OBD_DTC_AR
{
	@sysvar::CH_Nodes::CH__STPDU_EIS_HVAC_OBD_DTC_AR = 0;
}

on timer Timer_EIS_HVAC_Rs2_AR
{
	@sysvar::CH_Nodes::CH__STPDU_EIS_HVAC_Rs2_AR = 0;
}

on timer Timer_EIS_HVAC_Rs3_AR2
{
	@sysvar::CH_Nodes::CH__STPDU_EIS_HVAC_Rs3_AR2 = 0;
}

on timer Timer_EIS_HVAC_Rs_AR2
{
	@sysvar::CH_Nodes::CH__STPDU_EIS_HVAC_Rs_AR2 = 0;
}

on timer Timer_EIS_HVAC_State1_AR
{
	@sysvar::CH_Nodes::CH__STPDU_EIS_HVAC_State1_AR = 0;
}

on timer Timer_EIS_IC_BasicInfo_AR2
{
	@sysvar::CH_Nodes::CH__STPDU_EIS_IC_BasicInfo_AR2 = 0;
}

on timer Timer_EIS_IC_DriveAssistSys_AR2
{
	@sysvar::CH_Nodes::CH__STPDU_EIS_IC_DriveAssistSys_AR2 = 0;
}

on timer Timer_EIS_IC_Settings_AR2
{
	@sysvar::CH_Nodes::CH__STPDU_EIS_IC_Settings_AR2 = 0;
}

on timer Timer_EIS_ICH_Stat_AR
{
	@sysvar::CH_Nodes::CH__STPDU_EIS_ICH_Stat_AR = 0;
}

on timer Timer_EIS_Ign_Veh_Stat_AR2
{
	@sysvar::CH_Nodes::CH__STPDU_EIS_Ign_Veh_Stat_AR2 = 0;
}

on timer Timer_EIS_IHC_Lgt_Stat_HLI_2_AR2
{
	@sysvar::CH_Nodes::CH__STPDU_EIS_IHC_Lgt_Stat_HLI_2_AR2 = 0;
}

on timer Timer_EIS_IHC_Lgt_Stat_HLI_AR2
{
	@sysvar::CH_Nodes::CH__STPDU_EIS_IHC_Lgt_Stat_HLI_AR2 = 0;
}

on timer Timer_EIS_KG_State_AR2
{
	@sysvar::CH_Nodes::CH__STPDU_EIS_KG_State_AR2 = 0;
}

on timer Timer_EIS_LDC_Disp_Stat_IC_AR2
{
	@sysvar::CH_Nodes::CH__STPDU_EIS_LDC_Disp_Stat_IC_AR2 = 0;
}

on timer Timer_EIS_LgtSens_State_AR
{
	@sysvar::CH_Nodes::CH__STPDU_EIS_LgtSens_State_AR = 0;
}

on timer Timer_EIS_Mirr_Adj_Lt_Rq_AR
{
	@sysvar::CH_Nodes::CH__STPDU_EIS_Mirr_Adj_Lt_Rq_AR = 0;
}

on timer Timer_EIS_Mirr_Adj_Rt_Rq_AR
{
	@sysvar::CH_Nodes::CH__STPDU_EIS_Mirr_Adj_Rt_Rq_AR = 0;
}

on timer Timer_EIS_NAVI_Pos1_AR
{
	@sysvar::CH_Nodes::CH__STPDU_EIS_NAVI_Pos1_AR = 0;
}

on timer Timer_EIS_NAVI_Pos2_AR
{
	@sysvar::CH_Nodes::CH__STPDU_EIS_NAVI_Pos2_AR = 0;
}

on timer Timer_EIS_NAVI_Pos3_AR
{
	@sysvar::CH_Nodes::CH__STPDU_EIS_NAVI_Pos3_AR = 0;
}

on timer Timer_EIS_NAVI_Pos4_AR
{
	@sysvar::CH_Nodes::CH__STPDU_EIS_NAVI_Pos4_AR = 0;
}

on timer Timer_EIS_NAVI_Pos5_AR
{
	@sysvar::CH_Nodes::CH__STPDU_EIS_NAVI_Pos5_AR = 0;
}

on timer Timer_EIS_NVP_Stat1_AR2
{
	@sysvar::CH_Nodes::CH__STPDU_EIS_NVP_Stat1_AR2 = 0;
}

on timer Timer_EIS_OHCM_Stat_AR2
{
	@sysvar::CH_Nodes::CH__STPDU_EIS_OHCM_Stat_AR2 = 0;
}

on timer Timer_EIS_ORC_Disp_Stat_AR2
{
	@sysvar::CH_Nodes::CH__STPDU_EIS_ORC_Disp_Stat_AR2 = 0;
}

on timer Timer_EIS_ORC_Impact_AR2
{
	@sysvar::CH_Nodes::CH__STPDU_EIS_ORC_Impact_AR2 = 0;
}

on timer Timer_EIS_Park_Disp_Rs_AR2
{
	@sysvar::CH_Nodes::CH__STPDU_EIS_Park_Disp_Rs_AR2 = 0;
}

on timer Timer_EIS_PHB_IHC_Plus_Tunnel_3_4_AR2
{
	@sysvar::CH_Nodes::CH__STPDU_EIS_PHB_IHC_Plus_Tunnel_3_4_AR2 = 0;
}

on timer Timer_EIS_PHB_IHC_Plus_Tunnel_AR2
{
	@sysvar::CH_Nodes::CH__STPDU_EIS_PHB_IHC_Plus_Tunnel_AR2 = 0;
}

on timer Timer_EIS_PN14_Disp_Rq_AR
{
	@sysvar::CH_Nodes::CH__STPDU_EIS_PN14_Disp_Rq_AR = 0;
}

on timer Timer_EIS_PN14_Rs1_AR2
{
	@sysvar::CH_Nodes::CH__STPDU_EIS_PN14_Rs1_AR2 = 0;
}

on timer Timer_EIS_PN14_Rs2_AR
{
	@sysvar::CH_Nodes::CH__STPDU_EIS_PN14_Rs2_AR = 0;
}

on timer Timer_EIS_PN14_Stat2_AR2
{
	@sysvar::CH_Nodes::CH__STPDU_EIS_PN14_Stat2_AR2 = 0;
}

on timer Timer_EIS_PN14_Stat_AR
{
	@sysvar::CH_Nodes::CH__STPDU_EIS_PN14_Stat_AR = 0;
}

on timer Timer_EIS_PN48_Bat_Stat2_AR2
{
	@sysvar::CH_Nodes::CH__STPDU_EIS_PN48_Bat_Stat2_AR2 = 0;
}

on timer Timer_EIS_PN48_Bat_Stat_AR
{
	@sysvar::CH_Nodes::CH__STPDU_EIS_PN48_Bat_Stat_AR = 0;
}

on timer Timer_EIS_PN48_BatLim_Stat_AR
{
	@sysvar::CH_Nodes::CH__STPDU_EIS_PN48_BatLim_Stat_AR = 0;
}

on timer Timer_EIS_PN48_DCDC48_LISB48_Stat_AR
{
	@sysvar::CH_Nodes::CH__STPDU_EIS_PN48_DCDC48_LISB48_Stat_AR = 0;
}

on timer Timer_EIS_PN48_Stat_AR
{
	@sysvar::CH_Nodes::CH__STPDU_EIS_PN48_Stat_AR = 0;
}

on timer Timer_EIS_PNHV_WeekDepTmTbl_Rq_HU_AR2
{
	@sysvar::CH_Nodes::CH__STPDU_EIS_PNHV_WeekDepTmTbl_Rq_HU_AR2 = 0;
}

on timer Timer_EIS_PreCond_On_Rq_AR
{
	@sysvar::CH_Nodes::CH__STPDU_EIS_PreCond_On_Rq_AR = 0;
}

on timer Timer_EIS_PreCond_Rq_HU_AR2
{
	@sysvar::CH_Nodes::CH__STPDU_EIS_PreCond_Rq_HU_AR2 = 0;
}

on timer Timer_EIS_PreCond_Stat_AR
{
	@sysvar::CH_Nodes::CH__STPDU_EIS_PreCond_Stat_AR = 0;
}

on timer Timer_EIS_PT_ObjIntrst_Gw_AR2
{
	@sysvar::CH_Nodes::CH__STPDU_EIS_PT_ObjIntrst_Gw_AR2 = 0;
}

on timer Timer_EIS_RemPark_Auth_Rs_AR2
{
	@sysvar::CH_Nodes::CH__STPDU_EIS_RemPark_Auth_Rs_AR2 = 0;
}

on timer Timer_EIS_RemPark_Stat_EIS_AR2
{
	@sysvar::CH_Nodes::CH__STPDU_EIS_RemPark_Stat_EIS_AR2 = 0;
}

on timer Timer_EIS_RTC_Date_Time_AR2
{
	@sysvar::CH_Nodes::CH__STPDU_EIS_RTC_Date_Time_AR2 = 0;
}

on timer Timer_EIS_RTC_Stat1_AR2
{
	@sysvar::CH_Nodes::CH__STPDU_EIS_RTC_Stat1_AR2 = 0;
}

on timer Timer_EIS_SADR_Trgr_FCW_AR2
{
	@sysvar::CH_Nodes::CH__STPDU_EIS_SADR_Trgr_FCW_AR2 = 0;
}

on timer Timer_EIS_SeatAdj_FL_Rq_AR
{
	@sysvar::CH_Nodes::CH__STPDU_EIS_SeatAdj_FL_Rq_AR = 0;
}

on timer Timer_EIS_SeatAdj_FR_Rq_AR
{
	@sysvar::CH_Nodes::CH__STPDU_EIS_SeatAdj_FR_Rq_AR = 0;
}

on timer Timer_EIS_SPCR_Stat_BC_F_AR2
{
	@sysvar::CH_Nodes::CH__STPDU_EIS_SPCR_Stat_BC_F_AR2 = 0;
}

on timer Timer_EIS_SPL_Obj1_Obj2_NV_AR2
{
	@sysvar::CH_Nodes::CH__STPDU_EIS_SPL_Obj1_Obj2_NV_AR2 = 0;
}

on timer Timer_EIS_SPV_Actn_Rq_AR2
{
	@sysvar::CH_Nodes::CH__STPDU_EIS_SPV_Actn_Rq_AR2 = 0;
}

on timer Timer_EIS_SPV_Alm_Rq_AR
{
	@sysvar::CH_Nodes::CH__STPDU_EIS_SPV_Alm_Rq_AR = 0;
}

on timer Timer_EIS_SPV_Stat_AR2
{
	@sysvar::CH_Nodes::CH__STPDU_EIS_SPV_Stat_AR2 = 0;
}

on timer Timer_EIS_SVS_Rq_HU_AR2
{
	@sysvar::CH_Nodes::CH__STPDU_EIS_SVS_Rq_HU_AR2 = 0;
}

on timer Timer_EIS_TBCSC_DAC_EPS_AR2
{
	@sysvar::CH_Nodes::CH__STPDU_EIS_TBCSC_DAC_EPS_AR2 = 0;
}

on timer Timer_EIS_TBCSC_DAC_ESP_AR2
{
	@sysvar::CH_Nodes::CH__STPDU_EIS_TBCSC_DAC_ESP_AR2 = 0;
}

on timer Timer_EIS_TBCSC_Hi_Rq1_AR2
{
	@sysvar::CH_Nodes::CH__STPDU_EIS_TBCSC_Hi_Rq1_AR2 = 0;
}

on timer Timer_EIS_TBCSC_Hi_Rq2_AR2
{
	@sysvar::CH_Nodes::CH__STPDU_EIS_TBCSC_Hi_Rq2_AR2 = 0;
}

on timer Timer_EIS_TBCSC_Lo_Rq1_AR2
{
	@sysvar::CH_Nodes::CH__STPDU_EIS_TBCSC_Lo_Rq1_AR2 = 0;
}

on timer Timer_EIS_TBCSC_Lo_Rq2_AR2
{
	@sysvar::CH_Nodes::CH__STPDU_EIS_TBCSC_Lo_Rq2_AR2 = 0;
}

on timer Timer_EIS_TC_Distance_AR
{
	@sysvar::CH_Nodes::CH__STPDU_EIS_TC_Distance_AR = 0;
}

on timer Timer_EIS_TGW_DateTm_Stat_AR
{
	@sysvar::CH_Nodes::CH__STPDU_EIS_TGW_DateTm_Stat_AR = 0;
}

on timer Timer_EIS_Tire_State_AR2
{
	@sysvar::CH_Nodes::CH__STPDU_EIS_Tire_State_AR2 = 0;
}

on timer Timer_EIS_TrafficInfo_AR
{
	@sysvar::CH_Nodes::CH__STPDU_EIS_TrafficInfo_AR = 0;
}

on timer Timer_EIS_Trailer_Stat_AR2
{
	@sysvar::CH_Nodes::CH__STPDU_EIS_Trailer_Stat_AR2 = 0;
}

on timer Timer_EIS_TSA_Disp_Rq1_AR2
{
	@sysvar::CH_Nodes::CH__STPDU_EIS_TSA_Disp_Rq1_AR2 = 0;
}

on timer Timer_EIS_TSA_Disp_Rq2_AR
{
	@sysvar::CH_Nodes::CH__STPDU_EIS_TSA_Disp_Rq2_AR = 0;
}

on timer Timer_EIS_TSA_Disp_Rq3_AR
{
	@sysvar::CH_Nodes::CH__STPDU_EIS_TSA_Disp_Rq3_AR = 0;
}

on timer Timer_EIS_VehAccel_X_Rq_Gw_AR2
{
	@sysvar::CH_Nodes::CH__STPDU_EIS_VehAccel_X_Rq_Gw_AR2 = 0;
}

on timer Timer_EIS_VIN_AR
{
	@sysvar::CH_Nodes::CH__STPDU_EIS_VIN_AR = 0;
}

on timer Timer_EIS_Wiper_Stat_AR
{
	@sysvar::CH_Nodes::CH__STPDU_EIS_Wiper_Stat_AR = 0;
}

on timer Timer_EIS_WUDOP_EIS_FR
{
	@sysvar::CH_Nodes::CH__STPDU_EIS_WUDOP_EIS_FR = 0;
}

on timer Timer_EIS_YMAS_Rq_MPC_AR2
{
	@sysvar::CH_Nodes::CH__STPDU_EIS_YMAS_Rq_MPC_AR2 = 0;
}


on timer Timer_EIS_ClockSync_Stat_FR2_1
{
  int64 t_0F;
  int64 Time_Second;
  
  if (ClockSync_DeltaCalculated == 0)
  {
    if (ClockSync_Backup_ns == 0)
    {
      // don't start synchronous with SimTime (-> get timeNow)
      // and start with randomized NanoSecond (-> reduce up to one second, which is available through SimStart)
      ClockSync_DeltaSimTime_ns = timeNowInt64() - random(1E9);
    }
    else
    {
      ClockSync_DeltaSimTime_ns = slot1_passed_Time_ns - ClockSync_Backup_ns; //continue with old counter
    }
    ClockSync_DeltaCalculated = 1;
  }
  
  //Don't even think about using $ClockSync_Second48_Hi!
  // 1 cycle = 5 ms = 5E6 ns, 1 cycle = 3359 MT, 1 static slot = 24 MT
  t_0F = slot1_passed_Time_ns - ClockSync_DeltaSimTime_ns - (24 * 5E6/3359) + ((64 - slot1_Cycle) * 5E6);
  Time_Second = _floor(t_0F / 1E9);
  $ClockSync_Second48 = Time_Second;
  $ClockSync_NanoSecond = t_0F - (Time_Second * 1E9);
  $ClockSync_FR_TxCycle = slot1_Cycle;

  setTimer (Timer_EIS_ClockSync_Stat_FR2_1, 1000);
}

on timer TimerVIN
{
// Simulation der VIN-Botschaft
// Teil Null senden (erste 7 Stellen)
// Pause 20ms
// Teil eins senden (nächsten 7 Stellen)
// Pause 20ms
// Teil zwei senden (nächsten letzten 3 Stellen; Rest 0xFF)
// Pause 960ms
// Teil Null senden (erste 7 Stellen)
// usw.

int TimerVal = 1;

	SysGetVariableString(sysvar::CH_Nodes::CH__EIS_VIN, EIS_VINBuffer, elcount(EIS_VINBuffer));

	if (@sysvar::CH_Nodes::CH__STPDU_EIS_VIN_AR == 0)
	{
		switch ($VIN_AR::VIN_MsgPart)
		{
			case (0):
				$VIN_AR::VIN_MsgPart = 1;
				$VIN_AR::VIN_Data1 = EIS_VINBuffer[7];
				$VIN_AR::VIN_Data2 = EIS_VINBuffer[8];
				$VIN_AR::VIN_Data3 = EIS_VINBuffer[9];
				$VIN_AR::VIN_Data4 = EIS_VINBuffer[10];
				$VIN_AR::VIN_Data5 = EIS_VINBuffer[11];
				$VIN_AR::VIN_Data6 = EIS_VINBuffer[12];
				$VIN_AR::VIN_Data7 = EIS_VINBuffer[13];
				TimerVal = 20;
				break;
			case (1):
				$VIN_AR::VIN_MsgPart = 2;
				$VIN_AR::VIN_Data1 = EIS_VINBuffer[14];
				$VIN_AR::VIN_Data2 = EIS_VINBuffer[15];
				$VIN_AR::VIN_Data3 = EIS_VINBuffer[16];
				$VIN_AR::VIN_Data4 = 0xFF;
				$VIN_AR::VIN_Data5 = 0xFF;
				$VIN_AR::VIN_Data6 = 0xFF;
				$VIN_AR::VIN_Data7 = 0xFF;
				TimerVal = 960;
				break;
			case (2):
				$VIN_AR::VIN_MsgPart = 0;
				$VIN_AR::VIN_Data1 = EIS_VINBuffer[0];
				$VIN_AR::VIN_Data2 = EIS_VINBuffer[1];
				$VIN_AR::VIN_Data3 = EIS_VINBuffer[2];
				$VIN_AR::VIN_Data4 = EIS_VINBuffer[3];
				$VIN_AR::VIN_Data5 = EIS_VINBuffer[4];
				$VIN_AR::VIN_Data6 = EIS_VINBuffer[5];
				$VIN_AR::VIN_Data7 = EIS_VINBuffer[6];
				TimerVal = 20;
				break;
			default:
				$VIN_AR::VIN_MsgPart = 0;
				TimerVal = 1;
				break;
		}
	}
  if (isTimerActive(TimerVIN) == 0)
	{
    setTimer(TimerVIN, TimerVal);
  }
}

on frSlot 1
{
  // additional for ClockSync_Stat_FR2
  slot1_passed_Time_ns = this.Time_ns;  //time after slot 1 is passed in every cycle
  slot1_Cycle = this.FR_Cycle;          //got in this cycle
}

on sysvar sysvar::CH_Nodes::CH__STPDU_EIS_ActvComf_Rq_AR2
{
	long res;
	long tDelay;
	switch (@this)
	{
		case (0):
			res = ResetTimingCyclic("ActvComf_Rq_AR2");
			res = ResetTimingEvtTrg("ActvComf_Rq_AR2");
			res = EnableTimingCyclic("ActvComf_Rq_AR2", 1);
			res = EnableTimingEvtTrg("ActvComf_Rq_AR2", 1);
			break;
		case (1):
			tDelay = @sysvar::CH_Nodes::CH__STPDU_T_EIS_ActvComf_Rq_AR2;
			if (tDelay > 0)
			{
				if (isTimerActive(Timer_EIS_ActvComf_Rq_AR2) == 0)
				{
					res = SetTimingCyclic("ActvComf_Rq_AR2", 1, tDelay, 1);
					setTimer (Timer_EIS_ActvComf_Rq_AR2, tDelay);
					@sysvar::CH_Nodes::CH__STPDU_EIS_ActvComf_Rq_AR2 = 2;
				}
			}
			else if (tDelay == 0)
			{
				if (isTimerActive(Timer_EIS_ActvComf_Rq_AR2) == 0)
				{
					res = EnableTimingCyclic("ActvComf_Rq_AR2", 0);
					res = EnableTimingEvtTrg("ActvComf_Rq_AR2", 0);
				}
			}
			break;
		case (2):
			break;
		default:
			Write("error: wrong parameter (%d)", @this);
			stop();
			break;
	}
}

on sysvar sysvar::CH_Nodes::CH__STPDU_EIS_ADAS_CURRENT_ATTRIBUTES_AR
{
	long res;
	long tDelay;
	switch (@this)
	{
		case (0):
			res = ResetTimingCyclic("ADAS_CURRENT_ATTRIBUTES_AR");
			res = ResetTimingEvtTrg("ADAS_CURRENT_ATTRIBUTES_AR");
			res = EnableTimingCyclic("ADAS_CURRENT_ATTRIBUTES_AR", 1);
			res = EnableTimingEvtTrg("ADAS_CURRENT_ATTRIBUTES_AR", 1);
			break;
		case (1):
			tDelay = @sysvar::CH_Nodes::CH__STPDU_T_EIS_ADAS_CURRENT_ATTRIBUTES_AR;
			if (tDelay > 0)
			{
				if (isTimerActive(Timer_EIS_ADAS_CURRENT_ATTRIBUTES_AR) == 0)
				{
					res = SetTimingCyclic("ADAS_CURRENT_ATTRIBUTES_AR", 1, tDelay, 1);
					setTimer (Timer_EIS_ADAS_CURRENT_ATTRIBUTES_AR, tDelay);
					@sysvar::CH_Nodes::CH__STPDU_EIS_ADAS_CURRENT_ATTRIBUTES_AR = 2;
				}
			}
			else if (tDelay == 0)
			{
				if (isTimerActive(Timer_EIS_ADAS_CURRENT_ATTRIBUTES_AR) == 0)
				{
					res = EnableTimingCyclic("ADAS_CURRENT_ATTRIBUTES_AR", 0);
					res = EnableTimingEvtTrg("ADAS_CURRENT_ATTRIBUTES_AR", 0);
				}
			}
			break;
		case (2):
			break;
		default:
			Write("error: wrong parameter (%d)", @this);
			stop();
			break;
	}
}

on sysvar sysvar::CH_Nodes::CH__STPDU_EIS_ADAS_POSITION_AR
{
	long res;
	long tDelay;
	switch (@this)
	{
		case (0):
			res = ResetTimingCyclic("ADAS_POSITION_AR");
			res = ResetTimingEvtTrg("ADAS_POSITION_AR");
			res = EnableTimingCyclic("ADAS_POSITION_AR", 1);
			res = EnableTimingEvtTrg("ADAS_POSITION_AR", 1);
			break;
		case (1):
			tDelay = @sysvar::CH_Nodes::CH__STPDU_T_EIS_ADAS_POSITION_AR;
			if (tDelay > 0)
			{
				if (isTimerActive(Timer_EIS_ADAS_POSITION_AR) == 0)
				{
					res = SetTimingCyclic("ADAS_POSITION_AR", 1, tDelay, 1);
					setTimer (Timer_EIS_ADAS_POSITION_AR, tDelay);
					@sysvar::CH_Nodes::CH__STPDU_EIS_ADAS_POSITION_AR = 2;
				}
			}
			else if (tDelay == 0)
			{
				if (isTimerActive(Timer_EIS_ADAS_POSITION_AR) == 0)
				{
					res = EnableTimingCyclic("ADAS_POSITION_AR", 0);
					res = EnableTimingEvtTrg("ADAS_POSITION_AR", 0);
				}
			}
			break;
		case (2):
			break;
		default:
			Write("error: wrong parameter (%d)", @this);
			stop();
			break;
	}
}

on sysvar sysvar::CH_Nodes::CH__STPDU_EIS_ADAS_PREDICTION_AR
{
	long res;
	long tDelay;
	switch (@this)
	{
		case (0):
			res = ResetTimingCyclic("ADAS_PREDICTION_AR");
			res = ResetTimingEvtTrg("ADAS_PREDICTION_AR");
			res = EnableTimingCyclic("ADAS_PREDICTION_AR", 1);
			res = EnableTimingEvtTrg("ADAS_PREDICTION_AR", 1);
			break;
		case (1):
			tDelay = @sysvar::CH_Nodes::CH__STPDU_T_EIS_ADAS_PREDICTION_AR;
			if (tDelay > 0)
			{
				if (isTimerActive(Timer_EIS_ADAS_PREDICTION_AR) == 0)
				{
					res = SetTimingCyclic("ADAS_PREDICTION_AR", 1, tDelay, 1);
					setTimer (Timer_EIS_ADAS_PREDICTION_AR, tDelay);
					@sysvar::CH_Nodes::CH__STPDU_EIS_ADAS_PREDICTION_AR = 2;
				}
			}
			else if (tDelay == 0)
			{
				if (isTimerActive(Timer_EIS_ADAS_PREDICTION_AR) == 0)
				{
					res = EnableTimingCyclic("ADAS_PREDICTION_AR", 0);
					res = EnableTimingEvtTrg("ADAS_PREDICTION_AR", 0);
				}
			}
			break;
		case (2):
			break;
		default:
			Write("error: wrong parameter (%d)", @this);
			stop();
			break;
	}
}

on sysvar sysvar::CH_Nodes::CH__STPDU_EIS_ADAS_PROFILE_LONG_AR
{
	long res;
	long tDelay;
	switch (@this)
	{
		case (0):
			res = ResetTimingCyclic("ADAS_PROFILE_LONG_AR");
			res = ResetTimingEvtTrg("ADAS_PROFILE_LONG_AR");
			res = EnableTimingCyclic("ADAS_PROFILE_LONG_AR", 1);
			res = EnableTimingEvtTrg("ADAS_PROFILE_LONG_AR", 1);
			break;
		case (1):
			tDelay = @sysvar::CH_Nodes::CH__STPDU_T_EIS_ADAS_PROFILE_LONG_AR;
			if (tDelay > 0)
			{
				if (isTimerActive(Timer_EIS_ADAS_PROFILE_LONG_AR) == 0)
				{
					res = SetTimingCyclic("ADAS_PROFILE_LONG_AR", 1, tDelay, 1);
					setTimer (Timer_EIS_ADAS_PROFILE_LONG_AR, tDelay);
					@sysvar::CH_Nodes::CH__STPDU_EIS_ADAS_PROFILE_LONG_AR = 2;
				}
			}
			else if (tDelay == 0)
			{
				if (isTimerActive(Timer_EIS_ADAS_PROFILE_LONG_AR) == 0)
				{
					res = EnableTimingCyclic("ADAS_PROFILE_LONG_AR", 0);
					res = EnableTimingEvtTrg("ADAS_PROFILE_LONG_AR", 0);
				}
			}
			break;
		case (2):
			break;
		default:
			Write("error: wrong parameter (%d)", @this);
			stop();
			break;
	}
}

on sysvar sysvar::CH_Nodes::CH__STPDU_EIS_ADAS_PROFILE_SHORT_AR
{
	long res;
	long tDelay;
	switch (@this)
	{
		case (0):
			res = ResetTimingCyclic("ADAS_PROFILE_SHORT_AR");
			res = ResetTimingEvtTrg("ADAS_PROFILE_SHORT_AR");
			res = EnableTimingCyclic("ADAS_PROFILE_SHORT_AR", 1);
			res = EnableTimingEvtTrg("ADAS_PROFILE_SHORT_AR", 1);
			break;
		case (1):
			tDelay = @sysvar::CH_Nodes::CH__STPDU_T_EIS_ADAS_PROFILE_SHORT_AR;
			if (tDelay > 0)
			{
				if (isTimerActive(Timer_EIS_ADAS_PROFILE_SHORT_AR) == 0)
				{
					res = SetTimingCyclic("ADAS_PROFILE_SHORT_AR", 1, tDelay, 1);
					setTimer (Timer_EIS_ADAS_PROFILE_SHORT_AR, tDelay);
					@sysvar::CH_Nodes::CH__STPDU_EIS_ADAS_PROFILE_SHORT_AR = 2;
				}
			}
			else if (tDelay == 0)
			{
				if (isTimerActive(Timer_EIS_ADAS_PROFILE_SHORT_AR) == 0)
				{
					res = EnableTimingCyclic("ADAS_PROFILE_SHORT_AR", 0);
					res = EnableTimingEvtTrg("ADAS_PROFILE_SHORT_AR", 0);
				}
			}
			break;
		case (2):
			break;
		default:
			Write("error: wrong parameter (%d)", @this);
			stop();
			break;
	}
}

on sysvar sysvar::CH_Nodes::CH__STPDU_EIS_ADASLR_POSITION_AR
{
	long res;
	long tDelay;
	switch (@this)
	{
		case (0):
			res = ResetTimingCyclic("ADASLR_POSITION_AR");
			res = ResetTimingEvtTrg("ADASLR_POSITION_AR");
			res = EnableTimingCyclic("ADASLR_POSITION_AR", 1);
			res = EnableTimingEvtTrg("ADASLR_POSITION_AR", 1);
			break;
		case (1):
			tDelay = @sysvar::CH_Nodes::CH__STPDU_T_EIS_ADASLR_POSITION_AR;
			if (tDelay > 0)
			{
				if (isTimerActive(Timer_EIS_ADASLR_POSITION_AR) == 0)
				{
					res = SetTimingCyclic("ADASLR_POSITION_AR", 1, tDelay, 1);
					setTimer (Timer_EIS_ADASLR_POSITION_AR, tDelay);
					@sysvar::CH_Nodes::CH__STPDU_EIS_ADASLR_POSITION_AR = 2;
				}
			}
			else if (tDelay == 0)
			{
				if (isTimerActive(Timer_EIS_ADASLR_POSITION_AR) == 0)
				{
					res = EnableTimingCyclic("ADASLR_POSITION_AR", 0);
					res = EnableTimingEvtTrg("ADASLR_POSITION_AR", 0);
				}
			}
			break;
		case (2):
			break;
		default:
			Write("error: wrong parameter (%d)", @this);
			stop();
			break;
	}
}

on sysvar sysvar::CH_Nodes::CH__STPDU_EIS_ADASLR_PROFILE_LONG_AR
{
	long res;
	long tDelay;
	switch (@this)
	{
		case (0):
			res = ResetTimingCyclic("ADASLR_PROFILE_LONG_AR");
			res = ResetTimingEvtTrg("ADASLR_PROFILE_LONG_AR");
			res = EnableTimingCyclic("ADASLR_PROFILE_LONG_AR", 1);
			res = EnableTimingEvtTrg("ADASLR_PROFILE_LONG_AR", 1);
			break;
		case (1):
			tDelay = @sysvar::CH_Nodes::CH__STPDU_T_EIS_ADASLR_PROFILE_LONG_AR;
			if (tDelay > 0)
			{
				if (isTimerActive(Timer_EIS_ADASLR_PROFILE_LONG_AR) == 0)
				{
					res = SetTimingCyclic("ADASLR_PROFILE_LONG_AR", 1, tDelay, 1);
					setTimer (Timer_EIS_ADASLR_PROFILE_LONG_AR, tDelay);
					@sysvar::CH_Nodes::CH__STPDU_EIS_ADASLR_PROFILE_LONG_AR = 2;
				}
			}
			else if (tDelay == 0)
			{
				if (isTimerActive(Timer_EIS_ADASLR_PROFILE_LONG_AR) == 0)
				{
					res = EnableTimingCyclic("ADASLR_PROFILE_LONG_AR", 0);
					res = EnableTimingEvtTrg("ADASLR_PROFILE_LONG_AR", 0);
				}
			}
			break;
		case (2):
			break;
		default:
			Write("error: wrong parameter (%d)", @this);
			stop();
			break;
	}
}

on sysvar sysvar::CH_Nodes::CH__STPDU_EIS_Assyst_Rq_AR2
{
	long res;
	long tDelay;
	switch (@this)
	{
		case (0):
			res = ResetTimingCyclic("Assyst_Rq_AR2");
			res = ResetTimingEvtTrg("Assyst_Rq_AR2");
			res = EnableTimingCyclic("Assyst_Rq_AR2", 1);
			res = EnableTimingEvtTrg("Assyst_Rq_AR2", 1);
			break;
		case (1):
			tDelay = @sysvar::CH_Nodes::CH__STPDU_T_EIS_Assyst_Rq_AR2;
			if (tDelay > 0)
			{
				if (isTimerActive(Timer_EIS_Assyst_Rq_AR2) == 0)
				{
					res = SetTimingCyclic("Assyst_Rq_AR2", 1, tDelay, 1);
					setTimer (Timer_EIS_Assyst_Rq_AR2, tDelay);
					@sysvar::CH_Nodes::CH__STPDU_EIS_Assyst_Rq_AR2 = 2;
				}
			}
			else if (tDelay == 0)
			{
				if (isTimerActive(Timer_EIS_Assyst_Rq_AR2) == 0)
				{
					res = EnableTimingCyclic("Assyst_Rq_AR2", 0);
					res = EnableTimingEvtTrg("Assyst_Rq_AR2", 0);
				}
			}
			break;
		case (2):
			break;
		default:
			Write("error: wrong parameter (%d)", @this);
			stop();
			break;
	}
}

on sysvar sysvar::CH_Nodes::CH__STPDU_EIS_BC_F_Disp_Rq_AR
{
	long res;
	long tDelay;
	switch (@this)
	{
		case (0):
			res = ResetTimingCyclic("BC_F_Disp_Rq_AR");
			res = ResetTimingEvtTrg("BC_F_Disp_Rq_AR");
			res = EnableTimingCyclic("BC_F_Disp_Rq_AR", 1);
			res = EnableTimingEvtTrg("BC_F_Disp_Rq_AR", 1);
			break;
		case (1):
			tDelay = @sysvar::CH_Nodes::CH__STPDU_T_EIS_BC_F_Disp_Rq_AR;
			if (tDelay > 0)
			{
				if (isTimerActive(Timer_EIS_BC_F_Disp_Rq_AR) == 0)
				{
					res = SetTimingCyclic("BC_F_Disp_Rq_AR", 1, tDelay, 1);
					setTimer (Timer_EIS_BC_F_Disp_Rq_AR, tDelay);
					@sysvar::CH_Nodes::CH__STPDU_EIS_BC_F_Disp_Rq_AR = 2;
				}
			}
			else if (tDelay == 0)
			{
				if (isTimerActive(Timer_EIS_BC_F_Disp_Rq_AR) == 0)
				{
					res = EnableTimingCyclic("BC_F_Disp_Rq_AR", 0);
					res = EnableTimingEvtTrg("BC_F_Disp_Rq_AR", 0);
				}
			}
			break;
		case (2):
			break;
		default:
			Write("error: wrong parameter (%d)", @this);
			stop();
			break;
	}
}

on sysvar sysvar::CH_Nodes::CH__STPDU_EIS_BC_F_Stat1_AR
{
	long res;
	long tDelay;
	switch (@this)
	{
		case (0):
			res = ResetTimingCyclic("BC_F_Stat1_AR");
			res = ResetTimingEvtTrg("BC_F_Stat1_AR");
			res = EnableTimingCyclic("BC_F_Stat1_AR", 1);
			res = EnableTimingEvtTrg("BC_F_Stat1_AR", 1);
			break;
		case (1):
			tDelay = @sysvar::CH_Nodes::CH__STPDU_T_EIS_BC_F_Stat1_AR;
			if (tDelay > 0)
			{
				if (isTimerActive(Timer_EIS_BC_F_Stat1_AR) == 0)
				{
					res = SetTimingCyclic("BC_F_Stat1_AR", 1, tDelay, 1);
					setTimer (Timer_EIS_BC_F_Stat1_AR, tDelay);
					@sysvar::CH_Nodes::CH__STPDU_EIS_BC_F_Stat1_AR = 2;
				}
			}
			else if (tDelay == 0)
			{
				if (isTimerActive(Timer_EIS_BC_F_Stat1_AR) == 0)
				{
					res = EnableTimingCyclic("BC_F_Stat1_AR", 0);
					res = EnableTimingEvtTrg("BC_F_Stat1_AR", 0);
				}
			}
			break;
		case (2):
			break;
		default:
			Write("error: wrong parameter (%d)", @this);
			stop();
			break;
	}
}

on sysvar sysvar::CH_Nodes::CH__STPDU_EIS_BC_F_Stat2_AR2
{
	long res;
	long tDelay;
	switch (@this)
	{
		case (0):
			res = ResetTimingCyclic("BC_F_Stat2_AR2");
			res = ResetTimingEvtTrg("BC_F_Stat2_AR2");
			res = EnableTimingCyclic("BC_F_Stat2_AR2", 1);
			res = EnableTimingEvtTrg("BC_F_Stat2_AR2", 1);
			break;
		case (1):
			tDelay = @sysvar::CH_Nodes::CH__STPDU_T_EIS_BC_F_Stat2_AR2;
			if (tDelay > 0)
			{
				if (isTimerActive(Timer_EIS_BC_F_Stat2_AR2) == 0)
				{
					res = SetTimingCyclic("BC_F_Stat2_AR2", 1, tDelay, 1);
					setTimer (Timer_EIS_BC_F_Stat2_AR2, tDelay);
					@sysvar::CH_Nodes::CH__STPDU_EIS_BC_F_Stat2_AR2 = 2;
				}
			}
			else if (tDelay == 0)
			{
				if (isTimerActive(Timer_EIS_BC_F_Stat2_AR2) == 0)
				{
					res = EnableTimingCyclic("BC_F_Stat2_AR2", 0);
					res = EnableTimingEvtTrg("BC_F_Stat2_AR2", 0);
				}
			}
			break;
		case (2):
			break;
		default:
			Write("error: wrong parameter (%d)", @this);
			stop();
			break;
	}
}

on sysvar sysvar::CH_Nodes::CH__STPDU_EIS_BC_R_Stat1_AR
{
	long res;
	long tDelay;
	switch (@this)
	{
		case (0):
			res = ResetTimingCyclic("BC_R_Stat1_AR");
			res = ResetTimingEvtTrg("BC_R_Stat1_AR");
			res = EnableTimingCyclic("BC_R_Stat1_AR", 1);
			res = EnableTimingEvtTrg("BC_R_Stat1_AR", 1);
			break;
		case (1):
			tDelay = @sysvar::CH_Nodes::CH__STPDU_T_EIS_BC_R_Stat1_AR;
			if (tDelay > 0)
			{
				if (isTimerActive(Timer_EIS_BC_R_Stat1_AR) == 0)
				{
					res = SetTimingCyclic("BC_R_Stat1_AR", 1, tDelay, 1);
					setTimer (Timer_EIS_BC_R_Stat1_AR, tDelay);
					@sysvar::CH_Nodes::CH__STPDU_EIS_BC_R_Stat1_AR = 2;
				}
			}
			else if (tDelay == 0)
			{
				if (isTimerActive(Timer_EIS_BC_R_Stat1_AR) == 0)
				{
					res = EnableTimingCyclic("BC_R_Stat1_AR", 0);
					res = EnableTimingEvtTrg("BC_R_Stat1_AR", 0);
				}
			}
			break;
		case (2):
			break;
		default:
			Write("error: wrong parameter (%d)", @this);
			stop();
			break;
	}
}

on sysvar sysvar::CH_Nodes::CH__STPDU_EIS_BLSM_Disp_Stat_AR
{
	long res;
	long tDelay;
	switch (@this)
	{
		case (0):
			res = ResetTimingCyclic("BLSM_Disp_Stat_AR");
			res = ResetTimingEvtTrg("BLSM_Disp_Stat_AR");
			res = EnableTimingCyclic("BLSM_Disp_Stat_AR", 1);
			res = EnableTimingEvtTrg("BLSM_Disp_Stat_AR", 1);
			break;
		case (1):
			tDelay = @sysvar::CH_Nodes::CH__STPDU_T_EIS_BLSM_Disp_Stat_AR;
			if (tDelay > 0)
			{
				if (isTimerActive(Timer_EIS_BLSM_Disp_Stat_AR) == 0)
				{
					res = SetTimingCyclic("BLSM_Disp_Stat_AR", 1, tDelay, 1);
					setTimer (Timer_EIS_BLSM_Disp_Stat_AR, tDelay);
					@sysvar::CH_Nodes::CH__STPDU_EIS_BLSM_Disp_Stat_AR = 2;
				}
			}
			else if (tDelay == 0)
			{
				if (isTimerActive(Timer_EIS_BLSM_Disp_Stat_AR) == 0)
				{
					res = EnableTimingCyclic("BLSM_Disp_Stat_AR", 0);
					res = EnableTimingEvtTrg("BLSM_Disp_Stat_AR", 0);
				}
			}
			break;
		case (2):
			break;
		default:
			Write("error: wrong parameter (%d)", @this);
			stop();
			break;
	}
}

on sysvar sysvar::CH_Nodes::CH__STPDU_EIS_BODY_CHASSIS_R1_AR
{
	long res;
	long tDelay;
	switch (@this)
	{
		case (0):
			res = ResetTimingCyclic("BODY_CHASSIS_R1_AR");
			res = ResetTimingEvtTrg("BODY_CHASSIS_R1_AR");
			res = EnableTimingCyclic("BODY_CHASSIS_R1_AR", 1);
			res = EnableTimingEvtTrg("BODY_CHASSIS_R1_AR", 1);
			break;
		case (1):
			tDelay = @sysvar::CH_Nodes::CH__STPDU_T_EIS_BODY_CHASSIS_R1_AR;
			if (tDelay > 0)
			{
				if (isTimerActive(Timer_EIS_BODY_CHASSIS_R1_AR) == 0)
				{
					res = SetTimingCyclic("BODY_CHASSIS_R1_AR", 1, tDelay, 1);
					setTimer (Timer_EIS_BODY_CHASSIS_R1_AR, tDelay);
					@sysvar::CH_Nodes::CH__STPDU_EIS_BODY_CHASSIS_R1_AR = 2;
				}
			}
			else if (tDelay == 0)
			{
				if (isTimerActive(Timer_EIS_BODY_CHASSIS_R1_AR) == 0)
				{
					res = EnableTimingCyclic("BODY_CHASSIS_R1_AR", 0);
					res = EnableTimingEvtTrg("BODY_CHASSIS_R1_AR", 0);
				}
			}
			break;
		case (2):
			break;
		default:
			Write("error: wrong parameter (%d)", @this);
			stop();
			break;
	}
}

on sysvar sysvar::CH_Nodes::CH__STPDU_EIS_BSM_Disp_Warn_Rq_AR2
{
	long res;
	long tDelay;
	switch (@this)
	{
		case (0):
			res = ResetTimingCyclic("BSM_Disp_Warn_Rq_AR2");
			res = ResetTimingEvtTrg("BSM_Disp_Warn_Rq_AR2");
			res = EnableTimingCyclic("BSM_Disp_Warn_Rq_AR2", 1);
			res = EnableTimingEvtTrg("BSM_Disp_Warn_Rq_AR2", 1);
			break;
		case (1):
			tDelay = @sysvar::CH_Nodes::CH__STPDU_T_EIS_BSM_Disp_Warn_Rq_AR2;
			if (tDelay > 0)
			{
				if (isTimerActive(Timer_EIS_BSM_Disp_Warn_Rq_AR2) == 0)
				{
					res = SetTimingCyclic("BSM_Disp_Warn_Rq_AR2", 1, tDelay, 1);
					setTimer (Timer_EIS_BSM_Disp_Warn_Rq_AR2, tDelay);
					@sysvar::CH_Nodes::CH__STPDU_EIS_BSM_Disp_Warn_Rq_AR2 = 2;
				}
			}
			else if (tDelay == 0)
			{
				if (isTimerActive(Timer_EIS_BSM_Disp_Warn_Rq_AR2) == 0)
				{
					res = EnableTimingCyclic("BSM_Disp_Warn_Rq_AR2", 0);
					res = EnableTimingEvtTrg("BSM_Disp_Warn_Rq_AR2", 0);
				}
			}
			break;
		case (2):
			break;
		default:
			Write("error: wrong parameter (%d)", @this);
			stop();
			break;
	}
}

on sysvar sysvar::CH_Nodes::CH__STPDU_EIS_CamLane_Disp_Warn_Rq_AR2
{
	long res;
	long tDelay;
	switch (@this)
	{
		case (0):
			res = ResetTimingCyclic("CamLane_Disp_Warn_Rq_AR2");
			res = ResetTimingEvtTrg("CamLane_Disp_Warn_Rq_AR2");
			res = EnableTimingCyclic("CamLane_Disp_Warn_Rq_AR2", 1);
			res = EnableTimingEvtTrg("CamLane_Disp_Warn_Rq_AR2", 1);
			break;
		case (1):
			tDelay = @sysvar::CH_Nodes::CH__STPDU_T_EIS_CamLane_Disp_Warn_Rq_AR2;
			if (tDelay > 0)
			{
				if (isTimerActive(Timer_EIS_CamLane_Disp_Warn_Rq_AR2) == 0)
				{
					res = SetTimingCyclic("CamLane_Disp_Warn_Rq_AR2", 1, tDelay, 1);
					setTimer (Timer_EIS_CamLane_Disp_Warn_Rq_AR2, tDelay);
					@sysvar::CH_Nodes::CH__STPDU_EIS_CamLane_Disp_Warn_Rq_AR2 = 2;
				}
			}
			else if (tDelay == 0)
			{
				if (isTimerActive(Timer_EIS_CamLane_Disp_Warn_Rq_AR2) == 0)
				{
					res = EnableTimingCyclic("CamLane_Disp_Warn_Rq_AR2", 0);
					res = EnableTimingEvtTrg("CamLane_Disp_Warn_Rq_AR2", 0);
				}
			}
			break;
		case (2):
			break;
		default:
			Write("error: wrong parameter (%d)", @this);
			stop();
			break;
	}
}

on sysvar sysvar::CH_Nodes::CH__STPDU_EIS_CamLane_LaneAttr1_AR2
{
	long res;
	long tDelay;
	switch (@this)
	{
		case (0):
			res = ResetTimingCyclic("CamLane_LaneAttr1_AR2");
			res = ResetTimingEvtTrg("CamLane_LaneAttr1_AR2");
			res = EnableTimingCyclic("CamLane_LaneAttr1_AR2", 1);
			res = EnableTimingEvtTrg("CamLane_LaneAttr1_AR2", 1);
			break;
		case (1):
			tDelay = @sysvar::CH_Nodes::CH__STPDU_T_EIS_CamLane_LaneAttr1_AR2;
			if (tDelay > 0)
			{
				if (isTimerActive(Timer_EIS_CamLane_LaneAttr1_AR2) == 0)
				{
					res = SetTimingCyclic("CamLane_LaneAttr1_AR2", 1, tDelay, 1);
					setTimer (Timer_EIS_CamLane_LaneAttr1_AR2, tDelay);
					@sysvar::CH_Nodes::CH__STPDU_EIS_CamLane_LaneAttr1_AR2 = 2;
				}
			}
			else if (tDelay == 0)
			{
				if (isTimerActive(Timer_EIS_CamLane_LaneAttr1_AR2) == 0)
				{
					res = EnableTimingCyclic("CamLane_LaneAttr1_AR2", 0);
					res = EnableTimingEvtTrg("CamLane_LaneAttr1_AR2", 0);
				}
			}
			break;
		case (2):
			break;
		default:
			Write("error: wrong parameter (%d)", @this);
			stop();
			break;
	}
}

on sysvar sysvar::CH_Nodes::CH__STPDU_EIS_CamLane_LaneAttr2_AR2
{
	long res;
	long tDelay;
	switch (@this)
	{
		case (0):
			res = ResetTimingCyclic("CamLane_LaneAttr2_AR2");
			res = ResetTimingEvtTrg("CamLane_LaneAttr2_AR2");
			res = EnableTimingCyclic("CamLane_LaneAttr2_AR2", 1);
			res = EnableTimingEvtTrg("CamLane_LaneAttr2_AR2", 1);
			break;
		case (1):
			tDelay = @sysvar::CH_Nodes::CH__STPDU_T_EIS_CamLane_LaneAttr2_AR2;
			if (tDelay > 0)
			{
				if (isTimerActive(Timer_EIS_CamLane_LaneAttr2_AR2) == 0)
				{
					res = SetTimingCyclic("CamLane_LaneAttr2_AR2", 1, tDelay, 1);
					setTimer (Timer_EIS_CamLane_LaneAttr2_AR2, tDelay);
					@sysvar::CH_Nodes::CH__STPDU_EIS_CamLane_LaneAttr2_AR2 = 2;
				}
			}
			else if (tDelay == 0)
			{
				if (isTimerActive(Timer_EIS_CamLane_LaneAttr2_AR2) == 0)
				{
					res = EnableTimingCyclic("CamLane_LaneAttr2_AR2", 0);
					res = EnableTimingEvtTrg("CamLane_LaneAttr2_AR2", 0);
				}
			}
			break;
		case (2):
			break;
		default:
			Write("error: wrong parameter (%d)", @this);
			stop();
			break;
	}
}

on sysvar sysvar::CH_Nodes::CH__STPDU_EIS_CamLane_LaneAttr3_AR2
{
	long res;
	long tDelay;
	switch (@this)
	{
		case (0):
			res = ResetTimingCyclic("CamLane_LaneAttr3_AR2");
			res = ResetTimingEvtTrg("CamLane_LaneAttr3_AR2");
			res = EnableTimingCyclic("CamLane_LaneAttr3_AR2", 1);
			res = EnableTimingEvtTrg("CamLane_LaneAttr3_AR2", 1);
			break;
		case (1):
			tDelay = @sysvar::CH_Nodes::CH__STPDU_T_EIS_CamLane_LaneAttr3_AR2;
			if (tDelay > 0)
			{
				if (isTimerActive(Timer_EIS_CamLane_LaneAttr3_AR2) == 0)
				{
					res = SetTimingCyclic("CamLane_LaneAttr3_AR2", 1, tDelay, 1);
					setTimer (Timer_EIS_CamLane_LaneAttr3_AR2, tDelay);
					@sysvar::CH_Nodes::CH__STPDU_EIS_CamLane_LaneAttr3_AR2 = 2;
				}
			}
			else if (tDelay == 0)
			{
				if (isTimerActive(Timer_EIS_CamLane_LaneAttr3_AR2) == 0)
				{
					res = EnableTimingCyclic("CamLane_LaneAttr3_AR2", 0);
					res = EnableTimingEvtTrg("CamLane_LaneAttr3_AR2", 0);
				}
			}
			break;
		case (2):
			break;
		default:
			Write("error: wrong parameter (%d)", @this);
			stop();
			break;
	}
}

on sysvar sysvar::CH_Nodes::CH__STPDU_EIS_CamLane_LaneAttr6_AR2
{
	long res;
	long tDelay;
	switch (@this)
	{
		case (0):
			res = ResetTimingCyclic("CamLane_LaneAttr6_AR2");
			res = ResetTimingEvtTrg("CamLane_LaneAttr6_AR2");
			res = EnableTimingCyclic("CamLane_LaneAttr6_AR2", 1);
			res = EnableTimingEvtTrg("CamLane_LaneAttr6_AR2", 1);
			break;
		case (1):
			tDelay = @sysvar::CH_Nodes::CH__STPDU_T_EIS_CamLane_LaneAttr6_AR2;
			if (tDelay > 0)
			{
				if (isTimerActive(Timer_EIS_CamLane_LaneAttr6_AR2) == 0)
				{
					res = SetTimingCyclic("CamLane_LaneAttr6_AR2", 1, tDelay, 1);
					setTimer (Timer_EIS_CamLane_LaneAttr6_AR2, tDelay);
					@sysvar::CH_Nodes::CH__STPDU_EIS_CamLane_LaneAttr6_AR2 = 2;
				}
			}
			else if (tDelay == 0)
			{
				if (isTimerActive(Timer_EIS_CamLane_LaneAttr6_AR2) == 0)
				{
					res = EnableTimingCyclic("CamLane_LaneAttr6_AR2", 0);
					res = EnableTimingEvtTrg("CamLane_LaneAttr6_AR2", 0);
				}
			}
			break;
		case (2):
			break;
		default:
			Write("error: wrong parameter (%d)", @this);
			stop();
			break;
	}
}

on sysvar sysvar::CH_Nodes::CH__STPDU_EIS_CamLane_LaneAttr7_AR2
{
	long res;
	long tDelay;
	switch (@this)
	{
		case (0):
			res = ResetTimingCyclic("CamLane_LaneAttr7_AR2");
			res = ResetTimingEvtTrg("CamLane_LaneAttr7_AR2");
			res = EnableTimingCyclic("CamLane_LaneAttr7_AR2", 1);
			res = EnableTimingEvtTrg("CamLane_LaneAttr7_AR2", 1);
			break;
		case (1):
			tDelay = @sysvar::CH_Nodes::CH__STPDU_T_EIS_CamLane_LaneAttr7_AR2;
			if (tDelay > 0)
			{
				if (isTimerActive(Timer_EIS_CamLane_LaneAttr7_AR2) == 0)
				{
					res = SetTimingCyclic("CamLane_LaneAttr7_AR2", 1, tDelay, 1);
					setTimer (Timer_EIS_CamLane_LaneAttr7_AR2, tDelay);
					@sysvar::CH_Nodes::CH__STPDU_EIS_CamLane_LaneAttr7_AR2 = 2;
				}
			}
			else if (tDelay == 0)
			{
				if (isTimerActive(Timer_EIS_CamLane_LaneAttr7_AR2) == 0)
				{
					res = EnableTimingCyclic("CamLane_LaneAttr7_AR2", 0);
					res = EnableTimingEvtTrg("CamLane_LaneAttr7_AR2", 0);
				}
			}
			break;
		case (2):
			break;
		default:
			Write("error: wrong parameter (%d)", @this);
			stop();
			break;
	}
}

on sysvar sysvar::CH_Nodes::CH__STPDU_EIS_CLkS_Rq_AR
{
	long res;
	long tDelay;
	switch (@this)
	{
		case (0):
			res = ResetTimingCyclic("CLkS_Rq_AR");
			res = ResetTimingEvtTrg("CLkS_Rq_AR");
			res = EnableTimingCyclic("CLkS_Rq_AR", 1);
			res = EnableTimingEvtTrg("CLkS_Rq_AR", 1);
			break;
		case (1):
			tDelay = @sysvar::CH_Nodes::CH__STPDU_T_EIS_CLkS_Rq_AR;
			if (tDelay > 0)
			{
				if (isTimerActive(Timer_EIS_CLkS_Rq_AR) == 0)
				{
					res = SetTimingCyclic("CLkS_Rq_AR", 1, tDelay, 1);
					setTimer (Timer_EIS_CLkS_Rq_AR, tDelay);
					@sysvar::CH_Nodes::CH__STPDU_EIS_CLkS_Rq_AR = 2;
				}
			}
			else if (tDelay == 0)
			{
				if (isTimerActive(Timer_EIS_CLkS_Rq_AR) == 0)
				{
					res = EnableTimingCyclic("CLkS_Rq_AR", 0);
					res = EnableTimingEvtTrg("CLkS_Rq_AR", 0);
				}
			}
			break;
		case (2):
			break;
		default:
			Write("error: wrong parameter (%d)", @this);
			stop();
			break;
	}
}

on sysvar sysvar::CH_Nodes::CH__STPDU_EIS_CLkS_State_AR
{
	long res;
	long tDelay;
	switch (@this)
	{
		case (0):
			res = ResetTimingCyclic("CLkS_State_AR");
			res = ResetTimingEvtTrg("CLkS_State_AR");
			res = EnableTimingCyclic("CLkS_State_AR", 1);
			res = EnableTimingEvtTrg("CLkS_State_AR", 1);
			break;
		case (1):
			tDelay = @sysvar::CH_Nodes::CH__STPDU_T_EIS_CLkS_State_AR;
			if (tDelay > 0)
			{
				if (isTimerActive(Timer_EIS_CLkS_State_AR) == 0)
				{
					res = SetTimingCyclic("CLkS_State_AR", 1, tDelay, 1);
					setTimer (Timer_EIS_CLkS_State_AR, tDelay);
					@sysvar::CH_Nodes::CH__STPDU_EIS_CLkS_State_AR = 2;
				}
			}
			else if (tDelay == 0)
			{
				if (isTimerActive(Timer_EIS_CLkS_State_AR) == 0)
				{
					res = EnableTimingCyclic("CLkS_State_AR", 0);
					res = EnableTimingEvtTrg("CLkS_State_AR", 0);
				}
			}
			break;
		case (2):
			break;
		default:
			Write("error: wrong parameter (%d)", @this);
			stop();
			break;
	}
}

on sysvar sysvar::CH_Nodes::CH__STPDU_EIS_ClockSync_Stat_FR2
{
	long res;
	long tDelay;
	switch (@this)
	{
		case (0):
			res = ResetTimingCyclic("ClockSync_Stat_FR2");
			res = ResetTimingEvtTrg("ClockSync_Stat_FR2");
			res = EnableTimingCyclic("ClockSync_Stat_FR2", 1);
			res = EnableTimingEvtTrg("ClockSync_Stat_FR2", 1);
			break;
		case (1):
			tDelay = @sysvar::CH_Nodes::CH__STPDU_T_EIS_ClockSync_Stat_FR2;
			if (tDelay > 0)
			{
				if (isTimerActive(Timer_EIS_ClockSync_Stat_FR2) == 0)
				{
					res = SetTimingCyclic("ClockSync_Stat_FR2", 1, tDelay, 1);
					setTimer (Timer_EIS_ClockSync_Stat_FR2, tDelay);
					@sysvar::CH_Nodes::CH__STPDU_EIS_ClockSync_Stat_FR2 = 2;
				}
			}
			else if (tDelay == 0)
			{
				if (isTimerActive(Timer_EIS_ClockSync_Stat_FR2) == 0)
				{
					res = EnableTimingCyclic("ClockSync_Stat_FR2", 0);
					res = EnableTimingEvtTrg("ClockSync_Stat_FR2", 0);
				}
			}
			break;
		case (2):
			break;
		default:
			Write("error: wrong parameter (%d)", @this);
			stop();
			break;
	}
}

on sysvar sysvar::CH_Nodes::CH__STPDU_EIS_CMS_PI_State_Gw_AR2
{
	long res;
	long tDelay;
	switch (@this)
	{
		case (0):
			res = ResetTimingCyclic("CMS_PI_State_Gw_AR2");
			res = ResetTimingEvtTrg("CMS_PI_State_Gw_AR2");
			res = EnableTimingCyclic("CMS_PI_State_Gw_AR2", 1);
			res = EnableTimingEvtTrg("CMS_PI_State_Gw_AR2", 1);
			break;
		case (1):
			tDelay = @sysvar::CH_Nodes::CH__STPDU_T_EIS_CMS_PI_State_Gw_AR2;
			if (tDelay > 0)
			{
				if (isTimerActive(Timer_EIS_CMS_PI_State_Gw_AR2) == 0)
				{
					res = SetTimingCyclic("CMS_PI_State_Gw_AR2", 1, tDelay, 1);
					setTimer (Timer_EIS_CMS_PI_State_Gw_AR2, tDelay);
					@sysvar::CH_Nodes::CH__STPDU_EIS_CMS_PI_State_Gw_AR2 = 2;
				}
			}
			else if (tDelay == 0)
			{
				if (isTimerActive(Timer_EIS_CMS_PI_State_Gw_AR2) == 0)
				{
					res = EnableTimingCyclic("CMS_PI_State_Gw_AR2", 0);
					res = EnableTimingEvtTrg("CMS_PI_State_Gw_AR2", 0);
				}
			}
			break;
		case (2):
			break;
		default:
			Write("error: wrong parameter (%d)", @this);
			stop();
			break;
	}
}

on sysvar sysvar::CH_Nodes::CH__STPDU_EIS_Config_HU4_AR2
{
	long res;
	long tDelay;
	switch (@this)
	{
		case (0):
			res = ResetTimingCyclic("Config_HU4_AR2");
			res = ResetTimingEvtTrg("Config_HU4_AR2");
			res = EnableTimingCyclic("Config_HU4_AR2", 1);
			res = EnableTimingEvtTrg("Config_HU4_AR2", 1);
			break;
		case (1):
			tDelay = @sysvar::CH_Nodes::CH__STPDU_T_EIS_Config_HU4_AR2;
			if (tDelay > 0)
			{
				if (isTimerActive(Timer_EIS_Config_HU4_AR2) == 0)
				{
					res = SetTimingCyclic("Config_HU4_AR2", 1, tDelay, 1);
					setTimer (Timer_EIS_Config_HU4_AR2, tDelay);
					@sysvar::CH_Nodes::CH__STPDU_EIS_Config_HU4_AR2 = 2;
				}
			}
			else if (tDelay == 0)
			{
				if (isTimerActive(Timer_EIS_Config_HU4_AR2) == 0)
				{
					res = EnableTimingCyclic("Config_HU4_AR2", 0);
					res = EnableTimingEvtTrg("Config_HU4_AR2", 0);
				}
			}
			break;
		case (2):
			break;
		default:
			Write("error: wrong parameter (%d)", @this);
			stop();
			break;
	}
}

on sysvar sysvar::CH_Nodes::CH__STPDU_EIS_Config_HU5_AR2
{
	long res;
	long tDelay;
	switch (@this)
	{
		case (0):
			res = ResetTimingCyclic("Config_HU5_AR2");
			res = ResetTimingEvtTrg("Config_HU5_AR2");
			res = EnableTimingCyclic("Config_HU5_AR2", 1);
			res = EnableTimingEvtTrg("Config_HU5_AR2", 1);
			break;
		case (1):
			tDelay = @sysvar::CH_Nodes::CH__STPDU_T_EIS_Config_HU5_AR2;
			if (tDelay > 0)
			{
				if (isTimerActive(Timer_EIS_Config_HU5_AR2) == 0)
				{
					res = SetTimingCyclic("Config_HU5_AR2", 1, tDelay, 1);
					setTimer (Timer_EIS_Config_HU5_AR2, tDelay);
					@sysvar::CH_Nodes::CH__STPDU_EIS_Config_HU5_AR2 = 2;
				}
			}
			else if (tDelay == 0)
			{
				if (isTimerActive(Timer_EIS_Config_HU5_AR2) == 0)
				{
					res = EnableTimingCyclic("Config_HU5_AR2", 0);
					res = EnableTimingEvtTrg("Config_HU5_AR2", 0);
				}
			}
			break;
		case (2):
			break;
		default:
			Write("error: wrong parameter (%d)", @this);
			stop();
			break;
	}
}

on sysvar sysvar::CH_Nodes::CH__STPDU_EIS_CRCM_Stat_AR
{
	long res;
	long tDelay;
	switch (@this)
	{
		case (0):
			res = ResetTimingCyclic("CRCM_Stat_AR");
			res = ResetTimingEvtTrg("CRCM_Stat_AR");
			res = EnableTimingCyclic("CRCM_Stat_AR", 1);
			res = EnableTimingEvtTrg("CRCM_Stat_AR", 1);
			break;
		case (1):
			tDelay = @sysvar::CH_Nodes::CH__STPDU_T_EIS_CRCM_Stat_AR;
			if (tDelay > 0)
			{
				if (isTimerActive(Timer_EIS_CRCM_Stat_AR) == 0)
				{
					res = SetTimingCyclic("CRCM_Stat_AR", 1, tDelay, 1);
					setTimer (Timer_EIS_CRCM_Stat_AR, tDelay);
					@sysvar::CH_Nodes::CH__STPDU_EIS_CRCM_Stat_AR = 2;
				}
			}
			else if (tDelay == 0)
			{
				if (isTimerActive(Timer_EIS_CRCM_Stat_AR) == 0)
				{
					res = EnableTimingCyclic("CRCM_Stat_AR", 0);
					res = EnableTimingEvtTrg("CRCM_Stat_AR", 0);
				}
			}
			break;
		case (2):
			break;
		default:
			Write("error: wrong parameter (%d)", @this);
			stop();
			break;
	}
}

on sysvar sysvar::CH_Nodes::CH__STPDU_EIS_CTRL_C_Stat1_AR
{
	long res;
	long tDelay;
	switch (@this)
	{
		case (0):
			res = ResetTimingCyclic("CTRL_C_Stat1_AR");
			res = ResetTimingEvtTrg("CTRL_C_Stat1_AR");
			res = EnableTimingCyclic("CTRL_C_Stat1_AR", 1);
			res = EnableTimingEvtTrg("CTRL_C_Stat1_AR", 1);
			break;
		case (1):
			tDelay = @sysvar::CH_Nodes::CH__STPDU_T_EIS_CTRL_C_Stat1_AR;
			if (tDelay > 0)
			{
				if (isTimerActive(Timer_EIS_CTRL_C_Stat1_AR) == 0)
				{
					res = SetTimingCyclic("CTRL_C_Stat1_AR", 1, tDelay, 1);
					setTimer (Timer_EIS_CTRL_C_Stat1_AR, tDelay);
					@sysvar::CH_Nodes::CH__STPDU_EIS_CTRL_C_Stat1_AR = 2;
				}
			}
			else if (tDelay == 0)
			{
				if (isTimerActive(Timer_EIS_CTRL_C_Stat1_AR) == 0)
				{
					res = EnableTimingCyclic("CTRL_C_Stat1_AR", 0);
					res = EnableTimingEvtTrg("CTRL_C_Stat1_AR", 0);
				}
			}
			break;
		case (2):
			break;
		default:
			Write("error: wrong parameter (%d)", @this);
			stop();
			break;
	}
}

on sysvar sysvar::CH_Nodes::CH__STPDU_EIS_DAC4_ECM_AR
{
	long res;
	long tDelay;
	switch (@this)
	{
		case (0):
			res = ResetTimingCyclic("DAC4_ECM_AR");
			res = ResetTimingEvtTrg("DAC4_ECM_AR");
			res = EnableTimingCyclic("DAC4_ECM_AR", 1);
			res = EnableTimingEvtTrg("DAC4_ECM_AR", 1);
			break;
		case (1):
			tDelay = @sysvar::CH_Nodes::CH__STPDU_T_EIS_DAC4_ECM_AR;
			if (tDelay > 0)
			{
				if (isTimerActive(Timer_EIS_DAC4_ECM_AR) == 0)
				{
					res = SetTimingCyclic("DAC4_ECM_AR", 1, tDelay, 1);
					setTimer (Timer_EIS_DAC4_ECM_AR, tDelay);
					@sysvar::CH_Nodes::CH__STPDU_EIS_DAC4_ECM_AR = 2;
				}
			}
			else if (tDelay == 0)
			{
				if (isTimerActive(Timer_EIS_DAC4_ECM_AR) == 0)
				{
					res = EnableTimingCyclic("DAC4_ECM_AR", 0);
					res = EnableTimingEvtTrg("DAC4_ECM_AR", 0);
				}
			}
			break;
		case (2):
			break;
		default:
			Write("error: wrong parameter (%d)", @this);
			stop();
			break;
	}
}

on sysvar sysvar::CH_Nodes::CH__STPDU_EIS_DAC4_EM2_AR
{
	long res;
	long tDelay;
	switch (@this)
	{
		case (0):
			res = ResetTimingCyclic("DAC4_EM2_AR");
			res = ResetTimingEvtTrg("DAC4_EM2_AR");
			res = EnableTimingCyclic("DAC4_EM2_AR", 1);
			res = EnableTimingEvtTrg("DAC4_EM2_AR", 1);
			break;
		case (1):
			tDelay = @sysvar::CH_Nodes::CH__STPDU_T_EIS_DAC4_EM2_AR;
			if (tDelay > 0)
			{
				if (isTimerActive(Timer_EIS_DAC4_EM2_AR) == 0)
				{
					res = SetTimingCyclic("DAC4_EM2_AR", 1, tDelay, 1);
					setTimer (Timer_EIS_DAC4_EM2_AR, tDelay);
					@sysvar::CH_Nodes::CH__STPDU_EIS_DAC4_EM2_AR = 2;
				}
			}
			else if (tDelay == 0)
			{
				if (isTimerActive(Timer_EIS_DAC4_EM2_AR) == 0)
				{
					res = EnableTimingCyclic("DAC4_EM2_AR", 0);
					res = EnableTimingEvtTrg("DAC4_EM2_AR", 0);
				}
			}
			break;
		case (2):
			break;
		default:
			Write("error: wrong parameter (%d)", @this);
			stop();
			break;
	}
}

on sysvar sysvar::CH_Nodes::CH__STPDU_EIS_DAC4_ISM_AR
{
	long res;
	long tDelay;
	switch (@this)
	{
		case (0):
			res = ResetTimingCyclic("DAC4_ISM_AR");
			res = ResetTimingEvtTrg("DAC4_ISM_AR");
			res = EnableTimingCyclic("DAC4_ISM_AR", 1);
			res = EnableTimingEvtTrg("DAC4_ISM_AR", 1);
			break;
		case (1):
			tDelay = @sysvar::CH_Nodes::CH__STPDU_T_EIS_DAC4_ISM_AR;
			if (tDelay > 0)
			{
				if (isTimerActive(Timer_EIS_DAC4_ISM_AR) == 0)
				{
					res = SetTimingCyclic("DAC4_ISM_AR", 1, tDelay, 1);
					setTimer (Timer_EIS_DAC4_ISM_AR, tDelay);
					@sysvar::CH_Nodes::CH__STPDU_EIS_DAC4_ISM_AR = 2;
				}
			}
			else if (tDelay == 0)
			{
				if (isTimerActive(Timer_EIS_DAC4_ISM_AR) == 0)
				{
					res = EnableTimingCyclic("DAC4_ISM_AR", 0);
					res = EnableTimingEvtTrg("DAC4_ISM_AR", 0);
				}
			}
			break;
		case (2):
			break;
		default:
			Write("error: wrong parameter (%d)", @this);
			stop();
			break;
	}
}

on sysvar sysvar::CH_Nodes::CH__STPDU_EIS_DAC4_TCM_AR
{
	long res;
	long tDelay;
	switch (@this)
	{
		case (0):
			res = ResetTimingCyclic("DAC4_TCM_AR");
			res = ResetTimingEvtTrg("DAC4_TCM_AR");
			res = EnableTimingCyclic("DAC4_TCM_AR", 1);
			res = EnableTimingEvtTrg("DAC4_TCM_AR", 1);
			break;
		case (1):
			tDelay = @sysvar::CH_Nodes::CH__STPDU_T_EIS_DAC4_TCM_AR;
			if (tDelay > 0)
			{
				if (isTimerActive(Timer_EIS_DAC4_TCM_AR) == 0)
				{
					res = SetTimingCyclic("DAC4_TCM_AR", 1, tDelay, 1);
					setTimer (Timer_EIS_DAC4_TCM_AR, tDelay);
					@sysvar::CH_Nodes::CH__STPDU_EIS_DAC4_TCM_AR = 2;
				}
			}
			else if (tDelay == 0)
			{
				if (isTimerActive(Timer_EIS_DAC4_TCM_AR) == 0)
				{
					res = EnableTimingCyclic("DAC4_TCM_AR", 0);
					res = EnableTimingEvtTrg("DAC4_TCM_AR", 0);
				}
			}
			break;
		case (2):
			break;
		default:
			Write("error: wrong parameter (%d)", @this);
			stop();
			break;
	}
}

on sysvar sysvar::CH_Nodes::CH__STPDU_EIS_Dimming_Stat_AR2
{
	long res;
	long tDelay;
	switch (@this)
	{
		case (0):
			res = ResetTimingCyclic("Dimming_Stat_AR2");
			res = ResetTimingEvtTrg("Dimming_Stat_AR2");
			res = EnableTimingCyclic("Dimming_Stat_AR2", 1);
			res = EnableTimingEvtTrg("Dimming_Stat_AR2", 1);
			break;
		case (1):
			tDelay = @sysvar::CH_Nodes::CH__STPDU_T_EIS_Dimming_Stat_AR2;
			if (tDelay > 0)
			{
				if (isTimerActive(Timer_EIS_Dimming_Stat_AR2) == 0)
				{
					res = SetTimingCyclic("Dimming_Stat_AR2", 1, tDelay, 1);
					setTimer (Timer_EIS_Dimming_Stat_AR2, tDelay);
					@sysvar::CH_Nodes::CH__STPDU_EIS_Dimming_Stat_AR2 = 2;
				}
			}
			else if (tDelay == 0)
			{
				if (isTimerActive(Timer_EIS_Dimming_Stat_AR2) == 0)
				{
					res = EnableTimingCyclic("Dimming_Stat_AR2", 0);
					res = EnableTimingEvtTrg("Dimming_Stat_AR2", 0);
				}
			}
			break;
		case (2):
			break;
		default:
			Write("error: wrong parameter (%d)", @this);
			stop();
			break;
	}
}

on sysvar sysvar::CH_Nodes::CH__STPDU_EIS_Door_FL_Stat_AR2
{
	long res;
	long tDelay;
	switch (@this)
	{
		case (0):
			res = ResetTimingCyclic("Door_FL_Stat_AR2");
			res = ResetTimingEvtTrg("Door_FL_Stat_AR2");
			res = EnableTimingCyclic("Door_FL_Stat_AR2", 1);
			res = EnableTimingEvtTrg("Door_FL_Stat_AR2", 1);
			break;
		case (1):
			tDelay = @sysvar::CH_Nodes::CH__STPDU_T_EIS_Door_FL_Stat_AR2;
			if (tDelay > 0)
			{
				if (isTimerActive(Timer_EIS_Door_FL_Stat_AR2) == 0)
				{
					res = SetTimingCyclic("Door_FL_Stat_AR2", 1, tDelay, 1);
					setTimer (Timer_EIS_Door_FL_Stat_AR2, tDelay);
					@sysvar::CH_Nodes::CH__STPDU_EIS_Door_FL_Stat_AR2 = 2;
				}
			}
			else if (tDelay == 0)
			{
				if (isTimerActive(Timer_EIS_Door_FL_Stat_AR2) == 0)
				{
					res = EnableTimingCyclic("Door_FL_Stat_AR2", 0);
					res = EnableTimingEvtTrg("Door_FL_Stat_AR2", 0);
				}
			}
			break;
		case (2):
			break;
		default:
			Write("error: wrong parameter (%d)", @this);
			stop();
			break;
	}
}

on sysvar sysvar::CH_Nodes::CH__STPDU_EIS_Door_FR_Stat_AR2
{
	long res;
	long tDelay;
	switch (@this)
	{
		case (0):
			res = ResetTimingCyclic("Door_FR_Stat_AR2");
			res = ResetTimingEvtTrg("Door_FR_Stat_AR2");
			res = EnableTimingCyclic("Door_FR_Stat_AR2", 1);
			res = EnableTimingEvtTrg("Door_FR_Stat_AR2", 1);
			break;
		case (1):
			tDelay = @sysvar::CH_Nodes::CH__STPDU_T_EIS_Door_FR_Stat_AR2;
			if (tDelay > 0)
			{
				if (isTimerActive(Timer_EIS_Door_FR_Stat_AR2) == 0)
				{
					res = SetTimingCyclic("Door_FR_Stat_AR2", 1, tDelay, 1);
					setTimer (Timer_EIS_Door_FR_Stat_AR2, tDelay);
					@sysvar::CH_Nodes::CH__STPDU_EIS_Door_FR_Stat_AR2 = 2;
				}
			}
			else if (tDelay == 0)
			{
				if (isTimerActive(Timer_EIS_Door_FR_Stat_AR2) == 0)
				{
					res = EnableTimingCyclic("Door_FR_Stat_AR2", 0);
					res = EnableTimingEvtTrg("Door_FR_Stat_AR2", 0);
				}
			}
			break;
		case (2):
			break;
		default:
			Write("error: wrong parameter (%d)", @this);
			stop();
			break;
	}
}

on sysvar sysvar::CH_Nodes::CH__STPDU_EIS_Door_RL_Stat_AR2
{
	long res;
	long tDelay;
	switch (@this)
	{
		case (0):
			res = ResetTimingCyclic("Door_RL_Stat_AR2");
			res = ResetTimingEvtTrg("Door_RL_Stat_AR2");
			res = EnableTimingCyclic("Door_RL_Stat_AR2", 1);
			res = EnableTimingEvtTrg("Door_RL_Stat_AR2", 1);
			break;
		case (1):
			tDelay = @sysvar::CH_Nodes::CH__STPDU_T_EIS_Door_RL_Stat_AR2;
			if (tDelay > 0)
			{
				if (isTimerActive(Timer_EIS_Door_RL_Stat_AR2) == 0)
				{
					res = SetTimingCyclic("Door_RL_Stat_AR2", 1, tDelay, 1);
					setTimer (Timer_EIS_Door_RL_Stat_AR2, tDelay);
					@sysvar::CH_Nodes::CH__STPDU_EIS_Door_RL_Stat_AR2 = 2;
				}
			}
			else if (tDelay == 0)
			{
				if (isTimerActive(Timer_EIS_Door_RL_Stat_AR2) == 0)
				{
					res = EnableTimingCyclic("Door_RL_Stat_AR2", 0);
					res = EnableTimingEvtTrg("Door_RL_Stat_AR2", 0);
				}
			}
			break;
		case (2):
			break;
		default:
			Write("error: wrong parameter (%d)", @this);
			stop();
			break;
	}
}

on sysvar sysvar::CH_Nodes::CH__STPDU_EIS_Door_RR_Stat_AR2
{
	long res;
	long tDelay;
	switch (@this)
	{
		case (0):
			res = ResetTimingCyclic("Door_RR_Stat_AR2");
			res = ResetTimingEvtTrg("Door_RR_Stat_AR2");
			res = EnableTimingCyclic("Door_RR_Stat_AR2", 1);
			res = EnableTimingEvtTrg("Door_RR_Stat_AR2", 1);
			break;
		case (1):
			tDelay = @sysvar::CH_Nodes::CH__STPDU_T_EIS_Door_RR_Stat_AR2;
			if (tDelay > 0)
			{
				if (isTimerActive(Timer_EIS_Door_RR_Stat_AR2) == 0)
				{
					res = SetTimingCyclic("Door_RR_Stat_AR2", 1, tDelay, 1);
					setTimer (Timer_EIS_Door_RR_Stat_AR2, tDelay);
					@sysvar::CH_Nodes::CH__STPDU_EIS_Door_RR_Stat_AR2 = 2;
				}
			}
			else if (tDelay == 0)
			{
				if (isTimerActive(Timer_EIS_Door_RR_Stat_AR2) == 0)
				{
					res = EnableTimingCyclic("Door_RR_Stat_AR2", 0);
					res = EnableTimingEvtTrg("Door_RR_Stat_AR2", 0);
				}
			}
			break;
		case (2):
			break;
		default:
			Write("error: wrong parameter (%d)", @this);
			stop();
			break;
	}
}

on sysvar sysvar::CH_Nodes::CH__STPDU_EIS_DPC_IndMd_Rq_AR
{
	long res;
	long tDelay;
	switch (@this)
	{
		case (0):
			res = ResetTimingCyclic("DPC_IndMd_Rq_AR");
			res = ResetTimingEvtTrg("DPC_IndMd_Rq_AR");
			res = EnableTimingCyclic("DPC_IndMd_Rq_AR", 1);
			res = EnableTimingEvtTrg("DPC_IndMd_Rq_AR", 1);
			break;
		case (1):
			tDelay = @sysvar::CH_Nodes::CH__STPDU_T_EIS_DPC_IndMd_Rq_AR;
			if (tDelay > 0)
			{
				if (isTimerActive(Timer_EIS_DPC_IndMd_Rq_AR) == 0)
				{
					res = SetTimingCyclic("DPC_IndMd_Rq_AR", 1, tDelay, 1);
					setTimer (Timer_EIS_DPC_IndMd_Rq_AR, tDelay);
					@sysvar::CH_Nodes::CH__STPDU_EIS_DPC_IndMd_Rq_AR = 2;
				}
			}
			else if (tDelay == 0)
			{
				if (isTimerActive(Timer_EIS_DPC_IndMd_Rq_AR) == 0)
				{
					res = EnableTimingCyclic("DPC_IndMd_Rq_AR", 0);
					res = EnableTimingEvtTrg("DPC_IndMd_Rq_AR", 0);
				}
			}
			break;
		case (2):
			break;
		default:
			Write("error: wrong parameter (%d)", @this);
			stop();
			break;
	}
}

on sysvar sysvar::CH_Nodes::CH__STPDU_EIS_EAC_Stat_AR
{
	long res;
	long tDelay;
	switch (@this)
	{
		case (0):
			res = ResetTimingCyclic("EAC_Stat_AR");
			res = ResetTimingEvtTrg("EAC_Stat_AR");
			res = EnableTimingCyclic("EAC_Stat_AR", 1);
			res = EnableTimingEvtTrg("EAC_Stat_AR", 1);
			break;
		case (1):
			tDelay = @sysvar::CH_Nodes::CH__STPDU_T_EIS_EAC_Stat_AR;
			if (tDelay > 0)
			{
				if (isTimerActive(Timer_EIS_EAC_Stat_AR) == 0)
				{
					res = SetTimingCyclic("EAC_Stat_AR", 1, tDelay, 1);
					setTimer (Timer_EIS_EAC_Stat_AR, tDelay);
					@sysvar::CH_Nodes::CH__STPDU_EIS_EAC_Stat_AR = 2;
				}
			}
			else if (tDelay == 0)
			{
				if (isTimerActive(Timer_EIS_EAC_Stat_AR) == 0)
				{
					res = EnableTimingCyclic("EAC_Stat_AR", 0);
					res = EnableTimingEvtTrg("EAC_Stat_AR", 0);
				}
			}
			break;
		case (2):
			break;
		default:
			Write("error: wrong parameter (%d)", @this);
			stop();
			break;
	}
}

on sysvar sysvar::CH_Nodes::CH__STPDU_EIS_EL_Stat_AR2
{
	long res;
	long tDelay;
	switch (@this)
	{
		case (0):
			res = ResetTimingCyclic("EL_Stat_AR2");
			res = ResetTimingEvtTrg("EL_Stat_AR2");
			res = EnableTimingCyclic("EL_Stat_AR2", 1);
			res = EnableTimingEvtTrg("EL_Stat_AR2", 1);
			break;
		case (1):
			tDelay = @sysvar::CH_Nodes::CH__STPDU_T_EIS_EL_Stat_AR2;
			if (tDelay > 0)
			{
				if (isTimerActive(Timer_EIS_EL_Stat_AR2) == 0)
				{
					res = SetTimingCyclic("EL_Stat_AR2", 1, tDelay, 1);
					setTimer (Timer_EIS_EL_Stat_AR2, tDelay);
					@sysvar::CH_Nodes::CH__STPDU_EIS_EL_Stat_AR2 = 2;
				}
			}
			else if (tDelay == 0)
			{
				if (isTimerActive(Timer_EIS_EL_Stat_AR2) == 0)
				{
					res = EnableTimingCyclic("EL_Stat_AR2", 0);
					res = EnableTimingEvtTrg("EL_Stat_AR2", 0);
				}
			}
			break;
		case (2):
			break;
		default:
			Write("error: wrong parameter (%d)", @this);
			stop();
			break;
	}
}

on sysvar sysvar::CH_Nodes::CH__STPDU_EIS_EL_TurnInd_Rq_AR2
{
	long res;
	long tDelay;
	switch (@this)
	{
		case (0):
			res = ResetTimingCyclic("EL_TurnInd_Rq_AR2");
			res = ResetTimingEvtTrg("EL_TurnInd_Rq_AR2");
			res = EnableTimingCyclic("EL_TurnInd_Rq_AR2", 1);
			res = EnableTimingEvtTrg("EL_TurnInd_Rq_AR2", 1);
			break;
		case (1):
			tDelay = @sysvar::CH_Nodes::CH__STPDU_T_EIS_EL_TurnInd_Rq_AR2;
			if (tDelay > 0)
			{
				if (isTimerActive(Timer_EIS_EL_TurnInd_Rq_AR2) == 0)
				{
					res = SetTimingCyclic("EL_TurnInd_Rq_AR2", 1, tDelay, 1);
					setTimer (Timer_EIS_EL_TurnInd_Rq_AR2, tDelay);
					@sysvar::CH_Nodes::CH__STPDU_EIS_EL_TurnInd_Rq_AR2 = 2;
				}
			}
			else if (tDelay == 0)
			{
				if (isTimerActive(Timer_EIS_EL_TurnInd_Rq_AR2) == 0)
				{
					res = EnableTimingCyclic("EL_TurnInd_Rq_AR2", 0);
					res = EnableTimingEvtTrg("EL_TurnInd_Rq_AR2", 0);
				}
			}
			break;
		case (2):
			break;
		default:
			Write("error: wrong parameter (%d)", @this);
			stop();
			break;
	}
}

on sysvar sysvar::CH_Nodes::CH__STPDU_EIS_EPKB_Stat_AR2
{
	long res;
	long tDelay;
	switch (@this)
	{
		case (0):
			res = ResetTimingCyclic("EPKB_Stat_AR2");
			res = ResetTimingEvtTrg("EPKB_Stat_AR2");
			res = EnableTimingCyclic("EPKB_Stat_AR2", 1);
			res = EnableTimingEvtTrg("EPKB_Stat_AR2", 1);
			break;
		case (1):
			tDelay = @sysvar::CH_Nodes::CH__STPDU_T_EIS_EPKB_Stat_AR2;
			if (tDelay > 0)
			{
				if (isTimerActive(Timer_EIS_EPKB_Stat_AR2) == 0)
				{
					res = SetTimingCyclic("EPKB_Stat_AR2", 1, tDelay, 1);
					setTimer (Timer_EIS_EPKB_Stat_AR2, tDelay);
					@sysvar::CH_Nodes::CH__STPDU_EIS_EPKB_Stat_AR2 = 2;
				}
			}
			else if (tDelay == 0)
			{
				if (isTimerActive(Timer_EIS_EPKB_Stat_AR2) == 0)
				{
					res = EnableTimingCyclic("EPKB_Stat_AR2", 0);
					res = EnableTimingEvtTrg("EPKB_Stat_AR2", 0);
				}
			}
			break;
		case (2):
			break;
		default:
			Write("error: wrong parameter (%d)", @this);
			stop();
			break;
	}
}

on sysvar sysvar::CH_Nodes::CH__STPDU_EIS_EVC_CfgBit_01_32_AR2
{
	long res;
	long tDelay;
	switch (@this)
	{
		case (0):
			res = ResetTimingCyclic("EVC_CfgBit_01_32_AR2");
			res = ResetTimingEvtTrg("EVC_CfgBit_01_32_AR2");
			res = EnableTimingCyclic("EVC_CfgBit_01_32_AR2", 1);
			res = EnableTimingEvtTrg("EVC_CfgBit_01_32_AR2", 1);
			break;
		case (1):
			tDelay = @sysvar::CH_Nodes::CH__STPDU_T_EIS_EVC_CfgBit_01_32_AR2;
			if (tDelay > 0)
			{
				if (isTimerActive(Timer_EIS_EVC_CfgBit_01_32_AR2) == 0)
				{
					res = SetTimingCyclic("EVC_CfgBit_01_32_AR2", 1, tDelay, 1);
					setTimer (Timer_EIS_EVC_CfgBit_01_32_AR2, tDelay);
					@sysvar::CH_Nodes::CH__STPDU_EIS_EVC_CfgBit_01_32_AR2 = 2;
				}
			}
			else if (tDelay == 0)
			{
				if (isTimerActive(Timer_EIS_EVC_CfgBit_01_32_AR2) == 0)
				{
					res = EnableTimingCyclic("EVC_CfgBit_01_32_AR2", 0);
					res = EnableTimingEvtTrg("EVC_CfgBit_01_32_AR2", 0);
				}
			}
			break;
		case (2):
			break;
		default:
			Write("error: wrong parameter (%d)", @this);
			stop();
			break;
	}
}

on sysvar sysvar::CH_Nodes::CH__STPDU_EIS_EVC_CfgBit_33_64_AR2
{
	long res;
	long tDelay;
	switch (@this)
	{
		case (0):
			res = ResetTimingCyclic("EVC_CfgBit_33_64_AR2");
			res = ResetTimingEvtTrg("EVC_CfgBit_33_64_AR2");
			res = EnableTimingCyclic("EVC_CfgBit_33_64_AR2", 1);
			res = EnableTimingEvtTrg("EVC_CfgBit_33_64_AR2", 1);
			break;
		case (1):
			tDelay = @sysvar::CH_Nodes::CH__STPDU_T_EIS_EVC_CfgBit_33_64_AR2;
			if (tDelay > 0)
			{
				if (isTimerActive(Timer_EIS_EVC_CfgBit_33_64_AR2) == 0)
				{
					res = SetTimingCyclic("EVC_CfgBit_33_64_AR2", 1, tDelay, 1);
					setTimer (Timer_EIS_EVC_CfgBit_33_64_AR2, tDelay);
					@sysvar::CH_Nodes::CH__STPDU_EIS_EVC_CfgBit_33_64_AR2 = 2;
				}
			}
			else if (tDelay == 0)
			{
				if (isTimerActive(Timer_EIS_EVC_CfgBit_33_64_AR2) == 0)
				{
					res = EnableTimingCyclic("EVC_CfgBit_33_64_AR2", 0);
					res = EnableTimingEvtTrg("EVC_CfgBit_33_64_AR2", 0);
				}
			}
			break;
		case (2):
			break;
		default:
			Write("error: wrong parameter (%d)", @this);
			stop();
			break;
	}
}

on sysvar sysvar::CH_Nodes::CH__STPDU_EIS_EVC_CfgBit_65_96_AR2
{
	long res;
	long tDelay;
	switch (@this)
	{
		case (0):
			res = ResetTimingCyclic("EVC_CfgBit_65_96_AR2");
			res = ResetTimingEvtTrg("EVC_CfgBit_65_96_AR2");
			res = EnableTimingCyclic("EVC_CfgBit_65_96_AR2", 1);
			res = EnableTimingEvtTrg("EVC_CfgBit_65_96_AR2", 1);
			break;
		case (1):
			tDelay = @sysvar::CH_Nodes::CH__STPDU_T_EIS_EVC_CfgBit_65_96_AR2;
			if (tDelay > 0)
			{
				if (isTimerActive(Timer_EIS_EVC_CfgBit_65_96_AR2) == 0)
				{
					res = SetTimingCyclic("EVC_CfgBit_65_96_AR2", 1, tDelay, 1);
					setTimer (Timer_EIS_EVC_CfgBit_65_96_AR2, tDelay);
					@sysvar::CH_Nodes::CH__STPDU_EIS_EVC_CfgBit_65_96_AR2 = 2;
				}
			}
			else if (tDelay == 0)
			{
				if (isTimerActive(Timer_EIS_EVC_CfgBit_65_96_AR2) == 0)
				{
					res = EnableTimingCyclic("EVC_CfgBit_65_96_AR2", 0);
					res = EnableTimingEvtTrg("EVC_CfgBit_65_96_AR2", 0);
				}
			}
			break;
		case (2):
			break;
		default:
			Write("error: wrong parameter (%d)", @this);
			stop();
			break;
	}
}

on sysvar sysvar::CH_Nodes::CH__STPDU_EIS_EVC_CfgBit_97_C8_AR2
{
	long res;
	long tDelay;
	switch (@this)
	{
		case (0):
			res = ResetTimingCyclic("EVC_CfgBit_97_C8_AR2");
			res = ResetTimingEvtTrg("EVC_CfgBit_97_C8_AR2");
			res = EnableTimingCyclic("EVC_CfgBit_97_C8_AR2", 1);
			res = EnableTimingEvtTrg("EVC_CfgBit_97_C8_AR2", 1);
			break;
		case (1):
			tDelay = @sysvar::CH_Nodes::CH__STPDU_T_EIS_EVC_CfgBit_97_C8_AR2;
			if (tDelay > 0)
			{
				if (isTimerActive(Timer_EIS_EVC_CfgBit_97_C8_AR2) == 0)
				{
					res = SetTimingCyclic("EVC_CfgBit_97_C8_AR2", 1, tDelay, 1);
					setTimer (Timer_EIS_EVC_CfgBit_97_C8_AR2, tDelay);
					@sysvar::CH_Nodes::CH__STPDU_EIS_EVC_CfgBit_97_C8_AR2 = 2;
				}
			}
			else if (tDelay == 0)
			{
				if (isTimerActive(Timer_EIS_EVC_CfgBit_97_C8_AR2) == 0)
				{
					res = EnableTimingCyclic("EVC_CfgBit_97_C8_AR2", 0);
					res = EnableTimingEvtTrg("EVC_CfgBit_97_C8_AR2", 0);
				}
			}
			break;
		case (2):
			break;
		default:
			Write("error: wrong parameter (%d)", @this);
			stop();
			break;
	}
}

on sysvar sysvar::CH_Nodes::CH__STPDU_EIS_EVC_CfgList_01_0C_AR2
{
	long res;
	long tDelay;
	switch (@this)
	{
		case (0):
			res = ResetTimingCyclic("EVC_CfgList_01_0C_AR2");
			res = ResetTimingEvtTrg("EVC_CfgList_01_0C_AR2");
			res = EnableTimingCyclic("EVC_CfgList_01_0C_AR2", 1);
			res = EnableTimingEvtTrg("EVC_CfgList_01_0C_AR2", 1);
			break;
		case (1):
			tDelay = @sysvar::CH_Nodes::CH__STPDU_T_EIS_EVC_CfgList_01_0C_AR2;
			if (tDelay > 0)
			{
				if (isTimerActive(Timer_EIS_EVC_CfgList_01_0C_AR2) == 0)
				{
					res = SetTimingCyclic("EVC_CfgList_01_0C_AR2", 1, tDelay, 1);
					setTimer (Timer_EIS_EVC_CfgList_01_0C_AR2, tDelay);
					@sysvar::CH_Nodes::CH__STPDU_EIS_EVC_CfgList_01_0C_AR2 = 2;
				}
			}
			else if (tDelay == 0)
			{
				if (isTimerActive(Timer_EIS_EVC_CfgList_01_0C_AR2) == 0)
				{
					res = EnableTimingCyclic("EVC_CfgList_01_0C_AR2", 0);
					res = EnableTimingEvtTrg("EVC_CfgList_01_0C_AR2", 0);
				}
			}
			break;
		case (2):
			break;
		default:
			Write("error: wrong parameter (%d)", @this);
			stop();
			break;
	}
}

on sysvar sysvar::CH_Nodes::CH__STPDU_EIS_FCW_Disp_Rq_AR
{
	long res;
	long tDelay;
	switch (@this)
	{
		case (0):
			res = ResetTimingCyclic("FCW_Disp_Rq_AR");
			res = ResetTimingEvtTrg("FCW_Disp_Rq_AR");
			res = EnableTimingCyclic("FCW_Disp_Rq_AR", 1);
			res = EnableTimingEvtTrg("FCW_Disp_Rq_AR", 1);
			break;
		case (1):
			tDelay = @sysvar::CH_Nodes::CH__STPDU_T_EIS_FCW_Disp_Rq_AR;
			if (tDelay > 0)
			{
				if (isTimerActive(Timer_EIS_FCW_Disp_Rq_AR) == 0)
				{
					res = SetTimingCyclic("FCW_Disp_Rq_AR", 1, tDelay, 1);
					setTimer (Timer_EIS_FCW_Disp_Rq_AR, tDelay);
					@sysvar::CH_Nodes::CH__STPDU_EIS_FCW_Disp_Rq_AR = 2;
				}
			}
			else if (tDelay == 0)
			{
				if (isTimerActive(Timer_EIS_FCW_Disp_Rq_AR) == 0)
				{
					res = EnableTimingCyclic("FCW_Disp_Rq_AR", 0);
					res = EnableTimingEvtTrg("FCW_Disp_Rq_AR", 0);
				}
			}
			break;
		case (2):
			break;
		default:
			Write("error: wrong parameter (%d)", @this);
			stop();
			break;
	}
}

on sysvar sysvar::CH_Nodes::CH__STPDU_EIS_HMI_CHASSIS_R1_AR2
{
	long res;
	long tDelay;
	switch (@this)
	{
		case (0):
			res = ResetTimingCyclic("HMI_CHASSIS_R1_AR2");
			res = ResetTimingEvtTrg("HMI_CHASSIS_R1_AR2");
			res = EnableTimingCyclic("HMI_CHASSIS_R1_AR2", 1);
			res = EnableTimingEvtTrg("HMI_CHASSIS_R1_AR2", 1);
			break;
		case (1):
			tDelay = @sysvar::CH_Nodes::CH__STPDU_T_EIS_HMI_CHASSIS_R1_AR2;
			if (tDelay > 0)
			{
				if (isTimerActive(Timer_EIS_HMI_CHASSIS_R1_AR2) == 0)
				{
					res = SetTimingCyclic("HMI_CHASSIS_R1_AR2", 1, tDelay, 1);
					setTimer (Timer_EIS_HMI_CHASSIS_R1_AR2, tDelay);
					@sysvar::CH_Nodes::CH__STPDU_EIS_HMI_CHASSIS_R1_AR2 = 2;
				}
			}
			else if (tDelay == 0)
			{
				if (isTimerActive(Timer_EIS_HMI_CHASSIS_R1_AR2) == 0)
				{
					res = EnableTimingCyclic("HMI_CHASSIS_R1_AR2", 0);
					res = EnableTimingEvtTrg("HMI_CHASSIS_R1_AR2", 0);
				}
			}
			break;
		case (2):
			break;
		default:
			Write("error: wrong parameter (%d)", @this);
			stop();
			break;
	}
}

on sysvar sysvar::CH_Nodes::CH__STPDU_EIS_HU_Comf_Rq_AR2
{
	long res;
	long tDelay;
	switch (@this)
	{
		case (0):
			res = ResetTimingCyclic("HU_Comf_Rq_AR2");
			res = ResetTimingEvtTrg("HU_Comf_Rq_AR2");
			res = EnableTimingCyclic("HU_Comf_Rq_AR2", 1);
			res = EnableTimingEvtTrg("HU_Comf_Rq_AR2", 1);
			break;
		case (1):
			tDelay = @sysvar::CH_Nodes::CH__STPDU_T_EIS_HU_Comf_Rq_AR2;
			if (tDelay > 0)
			{
				if (isTimerActive(Timer_EIS_HU_Comf_Rq_AR2) == 0)
				{
					res = SetTimingCyclic("HU_Comf_Rq_AR2", 1, tDelay, 1);
					setTimer (Timer_EIS_HU_Comf_Rq_AR2, tDelay);
					@sysvar::CH_Nodes::CH__STPDU_EIS_HU_Comf_Rq_AR2 = 2;
				}
			}
			else if (tDelay == 0)
			{
				if (isTimerActive(Timer_EIS_HU_Comf_Rq_AR2) == 0)
				{
					res = EnableTimingCyclic("HU_Comf_Rq_AR2", 0);
					res = EnableTimingEvtTrg("HU_Comf_Rq_AR2", 0);
				}
			}
			break;
		case (2):
			break;
		default:
			Write("error: wrong parameter (%d)", @this);
			stop();
			break;
	}
}

on sysvar sysvar::CH_Nodes::CH__STPDU_EIS_HU_State_AR
{
	long res;
	long tDelay;
	switch (@this)
	{
		case (0):
			res = ResetTimingCyclic("HU_State_AR");
			res = ResetTimingEvtTrg("HU_State_AR");
			res = EnableTimingCyclic("HU_State_AR", 1);
			res = EnableTimingEvtTrg("HU_State_AR", 1);
			break;
		case (1):
			tDelay = @sysvar::CH_Nodes::CH__STPDU_T_EIS_HU_State_AR;
			if (tDelay > 0)
			{
				if (isTimerActive(Timer_EIS_HU_State_AR) == 0)
				{
					res = SetTimingCyclic("HU_State_AR", 1, tDelay, 1);
					setTimer (Timer_EIS_HU_State_AR, tDelay);
					@sysvar::CH_Nodes::CH__STPDU_EIS_HU_State_AR = 2;
				}
			}
			else if (tDelay == 0)
			{
				if (isTimerActive(Timer_EIS_HU_State_AR) == 0)
				{
					res = EnableTimingCyclic("HU_State_AR", 0);
					res = EnableTimingEvtTrg("HU_State_AR", 0);
				}
			}
			break;
		case (2):
			break;
		default:
			Write("error: wrong parameter (%d)", @this);
			stop();
			break;
	}
}

on sysvar sysvar::CH_Nodes::CH__STPDU_EIS_HVAC_Disp_Stat1_AR
{
	long res;
	long tDelay;
	switch (@this)
	{
		case (0):
			res = ResetTimingCyclic("HVAC_Disp_Stat1_AR");
			res = ResetTimingEvtTrg("HVAC_Disp_Stat1_AR");
			res = EnableTimingCyclic("HVAC_Disp_Stat1_AR", 1);
			res = EnableTimingEvtTrg("HVAC_Disp_Stat1_AR", 1);
			break;
		case (1):
			tDelay = @sysvar::CH_Nodes::CH__STPDU_T_EIS_HVAC_Disp_Stat1_AR;
			if (tDelay > 0)
			{
				if (isTimerActive(Timer_EIS_HVAC_Disp_Stat1_AR) == 0)
				{
					res = SetTimingCyclic("HVAC_Disp_Stat1_AR", 1, tDelay, 1);
					setTimer (Timer_EIS_HVAC_Disp_Stat1_AR, tDelay);
					@sysvar::CH_Nodes::CH__STPDU_EIS_HVAC_Disp_Stat1_AR = 2;
				}
			}
			else if (tDelay == 0)
			{
				if (isTimerActive(Timer_EIS_HVAC_Disp_Stat1_AR) == 0)
				{
					res = EnableTimingCyclic("HVAC_Disp_Stat1_AR", 0);
					res = EnableTimingEvtTrg("HVAC_Disp_Stat1_AR", 0);
				}
			}
			break;
		case (2):
			break;
		default:
			Write("error: wrong parameter (%d)", @this);
			stop();
			break;
	}
}

on sysvar sysvar::CH_Nodes::CH__STPDU_EIS_HVAC_OBD_DTC_AR
{
	long res;
	long tDelay;
	switch (@this)
	{
		case (0):
			res = ResetTimingCyclic("HVAC_OBD_DTC_AR");
			res = ResetTimingEvtTrg("HVAC_OBD_DTC_AR");
			res = EnableTimingCyclic("HVAC_OBD_DTC_AR", 1);
			res = EnableTimingEvtTrg("HVAC_OBD_DTC_AR", 1);
			break;
		case (1):
			tDelay = @sysvar::CH_Nodes::CH__STPDU_T_EIS_HVAC_OBD_DTC_AR;
			if (tDelay > 0)
			{
				if (isTimerActive(Timer_EIS_HVAC_OBD_DTC_AR) == 0)
				{
					res = SetTimingCyclic("HVAC_OBD_DTC_AR", 1, tDelay, 1);
					setTimer (Timer_EIS_HVAC_OBD_DTC_AR, tDelay);
					@sysvar::CH_Nodes::CH__STPDU_EIS_HVAC_OBD_DTC_AR = 2;
				}
			}
			else if (tDelay == 0)
			{
				if (isTimerActive(Timer_EIS_HVAC_OBD_DTC_AR) == 0)
				{
					res = EnableTimingCyclic("HVAC_OBD_DTC_AR", 0);
					res = EnableTimingEvtTrg("HVAC_OBD_DTC_AR", 0);
				}
			}
			break;
		case (2):
			break;
		default:
			Write("error: wrong parameter (%d)", @this);
			stop();
			break;
	}
}

on sysvar sysvar::CH_Nodes::CH__STPDU_EIS_HVAC_Rs2_AR
{
	long res;
	long tDelay;
	switch (@this)
	{
		case (0):
			res = ResetTimingCyclic("HVAC_Rs2_AR");
			res = ResetTimingEvtTrg("HVAC_Rs2_AR");
			res = EnableTimingCyclic("HVAC_Rs2_AR", 1);
			res = EnableTimingEvtTrg("HVAC_Rs2_AR", 1);
			break;
		case (1):
			tDelay = @sysvar::CH_Nodes::CH__STPDU_T_EIS_HVAC_Rs2_AR;
			if (tDelay > 0)
			{
				if (isTimerActive(Timer_EIS_HVAC_Rs2_AR) == 0)
				{
					res = SetTimingCyclic("HVAC_Rs2_AR", 1, tDelay, 1);
					setTimer (Timer_EIS_HVAC_Rs2_AR, tDelay);
					@sysvar::CH_Nodes::CH__STPDU_EIS_HVAC_Rs2_AR = 2;
				}
			}
			else if (tDelay == 0)
			{
				if (isTimerActive(Timer_EIS_HVAC_Rs2_AR) == 0)
				{
					res = EnableTimingCyclic("HVAC_Rs2_AR", 0);
					res = EnableTimingEvtTrg("HVAC_Rs2_AR", 0);
				}
			}
			break;
		case (2):
			break;
		default:
			Write("error: wrong parameter (%d)", @this);
			stop();
			break;
	}
}

on sysvar sysvar::CH_Nodes::CH__STPDU_EIS_HVAC_Rs3_AR2
{
	long res;
	long tDelay;
	switch (@this)
	{
		case (0):
			res = ResetTimingCyclic("HVAC_Rs3_AR2");
			res = ResetTimingEvtTrg("HVAC_Rs3_AR2");
			res = EnableTimingCyclic("HVAC_Rs3_AR2", 1);
			res = EnableTimingEvtTrg("HVAC_Rs3_AR2", 1);
			break;
		case (1):
			tDelay = @sysvar::CH_Nodes::CH__STPDU_T_EIS_HVAC_Rs3_AR2;
			if (tDelay > 0)
			{
				if (isTimerActive(Timer_EIS_HVAC_Rs3_AR2) == 0)
				{
					res = SetTimingCyclic("HVAC_Rs3_AR2", 1, tDelay, 1);
					setTimer (Timer_EIS_HVAC_Rs3_AR2, tDelay);
					@sysvar::CH_Nodes::CH__STPDU_EIS_HVAC_Rs3_AR2 = 2;
				}
			}
			else if (tDelay == 0)
			{
				if (isTimerActive(Timer_EIS_HVAC_Rs3_AR2) == 0)
				{
					res = EnableTimingCyclic("HVAC_Rs3_AR2", 0);
					res = EnableTimingEvtTrg("HVAC_Rs3_AR2", 0);
				}
			}
			break;
		case (2):
			break;
		default:
			Write("error: wrong parameter (%d)", @this);
			stop();
			break;
	}
}

on sysvar sysvar::CH_Nodes::CH__STPDU_EIS_HVAC_Rs_AR2
{
	long res;
	long tDelay;
	switch (@this)
	{
		case (0):
			res = ResetTimingCyclic("HVAC_Rs_AR2");
			res = ResetTimingEvtTrg("HVAC_Rs_AR2");
			res = EnableTimingCyclic("HVAC_Rs_AR2", 1);
			res = EnableTimingEvtTrg("HVAC_Rs_AR2", 1);
			break;
		case (1):
			tDelay = @sysvar::CH_Nodes::CH__STPDU_T_EIS_HVAC_Rs_AR2;
			if (tDelay > 0)
			{
				if (isTimerActive(Timer_EIS_HVAC_Rs_AR2) == 0)
				{
					res = SetTimingCyclic("HVAC_Rs_AR2", 1, tDelay, 1);
					setTimer (Timer_EIS_HVAC_Rs_AR2, tDelay);
					@sysvar::CH_Nodes::CH__STPDU_EIS_HVAC_Rs_AR2 = 2;
				}
			}
			else if (tDelay == 0)
			{
				if (isTimerActive(Timer_EIS_HVAC_Rs_AR2) == 0)
				{
					res = EnableTimingCyclic("HVAC_Rs_AR2", 0);
					res = EnableTimingEvtTrg("HVAC_Rs_AR2", 0);
				}
			}
			break;
		case (2):
			break;
		default:
			Write("error: wrong parameter (%d)", @this);
			stop();
			break;
	}
}

on sysvar sysvar::CH_Nodes::CH__STPDU_EIS_HVAC_State1_AR
{
	long res;
	long tDelay;
	switch (@this)
	{
		case (0):
			res = ResetTimingCyclic("HVAC_State1_AR");
			res = ResetTimingEvtTrg("HVAC_State1_AR");
			res = EnableTimingCyclic("HVAC_State1_AR", 1);
			res = EnableTimingEvtTrg("HVAC_State1_AR", 1);
			break;
		case (1):
			tDelay = @sysvar::CH_Nodes::CH__STPDU_T_EIS_HVAC_State1_AR;
			if (tDelay > 0)
			{
				if (isTimerActive(Timer_EIS_HVAC_State1_AR) == 0)
				{
					res = SetTimingCyclic("HVAC_State1_AR", 1, tDelay, 1);
					setTimer (Timer_EIS_HVAC_State1_AR, tDelay);
					@sysvar::CH_Nodes::CH__STPDU_EIS_HVAC_State1_AR = 2;
				}
			}
			else if (tDelay == 0)
			{
				if (isTimerActive(Timer_EIS_HVAC_State1_AR) == 0)
				{
					res = EnableTimingCyclic("HVAC_State1_AR", 0);
					res = EnableTimingEvtTrg("HVAC_State1_AR", 0);
				}
			}
			break;
		case (2):
			break;
		default:
			Write("error: wrong parameter (%d)", @this);
			stop();
			break;
	}
}

on sysvar sysvar::CH_Nodes::CH__STPDU_EIS_IC_BasicInfo_AR2
{
	long res;
	long tDelay;
	switch (@this)
	{
		case (0):
			res = ResetTimingCyclic("IC_BasicInfo_AR2");
			res = ResetTimingEvtTrg("IC_BasicInfo_AR2");
			res = EnableTimingCyclic("IC_BasicInfo_AR2", 1);
			res = EnableTimingEvtTrg("IC_BasicInfo_AR2", 1);
			break;
		case (1):
			tDelay = @sysvar::CH_Nodes::CH__STPDU_T_EIS_IC_BasicInfo_AR2;
			if (tDelay > 0)
			{
				if (isTimerActive(Timer_EIS_IC_BasicInfo_AR2) == 0)
				{
					res = SetTimingCyclic("IC_BasicInfo_AR2", 1, tDelay, 1);
					setTimer (Timer_EIS_IC_BasicInfo_AR2, tDelay);
					@sysvar::CH_Nodes::CH__STPDU_EIS_IC_BasicInfo_AR2 = 2;
				}
			}
			else if (tDelay == 0)
			{
				if (isTimerActive(Timer_EIS_IC_BasicInfo_AR2) == 0)
				{
					res = EnableTimingCyclic("IC_BasicInfo_AR2", 0);
					res = EnableTimingEvtTrg("IC_BasicInfo_AR2", 0);
				}
			}
			break;
		case (2):
			break;
		default:
			Write("error: wrong parameter (%d)", @this);
			stop();
			break;
	}
}

on sysvar sysvar::CH_Nodes::CH__STPDU_EIS_IC_DriveAssistSys_AR2
{
	long res;
	long tDelay;
	switch (@this)
	{
		case (0):
			res = ResetTimingCyclic("IC_DriveAssistSys_AR2");
			res = ResetTimingEvtTrg("IC_DriveAssistSys_AR2");
			res = EnableTimingCyclic("IC_DriveAssistSys_AR2", 1);
			res = EnableTimingEvtTrg("IC_DriveAssistSys_AR2", 1);
			break;
		case (1):
			tDelay = @sysvar::CH_Nodes::CH__STPDU_T_EIS_IC_DriveAssistSys_AR2;
			if (tDelay > 0)
			{
				if (isTimerActive(Timer_EIS_IC_DriveAssistSys_AR2) == 0)
				{
					res = SetTimingCyclic("IC_DriveAssistSys_AR2", 1, tDelay, 1);
					setTimer (Timer_EIS_IC_DriveAssistSys_AR2, tDelay);
					@sysvar::CH_Nodes::CH__STPDU_EIS_IC_DriveAssistSys_AR2 = 2;
				}
			}
			else if (tDelay == 0)
			{
				if (isTimerActive(Timer_EIS_IC_DriveAssistSys_AR2) == 0)
				{
					res = EnableTimingCyclic("IC_DriveAssistSys_AR2", 0);
					res = EnableTimingEvtTrg("IC_DriveAssistSys_AR2", 0);
				}
			}
			break;
		case (2):
			break;
		default:
			Write("error: wrong parameter (%d)", @this);
			stop();
			break;
	}
}

on sysvar sysvar::CH_Nodes::CH__STPDU_EIS_IC_Settings_AR2
{
	long res;
	long tDelay;
	switch (@this)
	{
		case (0):
			res = ResetTimingCyclic("IC_Settings_AR2");
			res = ResetTimingEvtTrg("IC_Settings_AR2");
			res = EnableTimingCyclic("IC_Settings_AR2", 1);
			res = EnableTimingEvtTrg("IC_Settings_AR2", 1);
			break;
		case (1):
			tDelay = @sysvar::CH_Nodes::CH__STPDU_T_EIS_IC_Settings_AR2;
			if (tDelay > 0)
			{
				if (isTimerActive(Timer_EIS_IC_Settings_AR2) == 0)
				{
					res = SetTimingCyclic("IC_Settings_AR2", 1, tDelay, 1);
					setTimer (Timer_EIS_IC_Settings_AR2, tDelay);
					@sysvar::CH_Nodes::CH__STPDU_EIS_IC_Settings_AR2 = 2;
				}
			}
			else if (tDelay == 0)
			{
				if (isTimerActive(Timer_EIS_IC_Settings_AR2) == 0)
				{
					res = EnableTimingCyclic("IC_Settings_AR2", 0);
					res = EnableTimingEvtTrg("IC_Settings_AR2", 0);
				}
			}
			break;
		case (2):
			break;
		default:
			Write("error: wrong parameter (%d)", @this);
			stop();
			break;
	}
}

on sysvar sysvar::CH_Nodes::CH__STPDU_EIS_ICH_Stat_AR
{
	long res;
	long tDelay;
	switch (@this)
	{
		case (0):
			res = ResetTimingCyclic("ICH_Stat_AR");
			res = ResetTimingEvtTrg("ICH_Stat_AR");
			res = EnableTimingCyclic("ICH_Stat_AR", 1);
			res = EnableTimingEvtTrg("ICH_Stat_AR", 1);
			break;
		case (1):
			tDelay = @sysvar::CH_Nodes::CH__STPDU_T_EIS_ICH_Stat_AR;
			if (tDelay > 0)
			{
				if (isTimerActive(Timer_EIS_ICH_Stat_AR) == 0)
				{
					res = SetTimingCyclic("ICH_Stat_AR", 1, tDelay, 1);
					setTimer (Timer_EIS_ICH_Stat_AR, tDelay);
					@sysvar::CH_Nodes::CH__STPDU_EIS_ICH_Stat_AR = 2;
				}
			}
			else if (tDelay == 0)
			{
				if (isTimerActive(Timer_EIS_ICH_Stat_AR) == 0)
				{
					res = EnableTimingCyclic("ICH_Stat_AR", 0);
					res = EnableTimingEvtTrg("ICH_Stat_AR", 0);
				}
			}
			break;
		case (2):
			break;
		default:
			Write("error: wrong parameter (%d)", @this);
			stop();
			break;
	}
}

on sysvar sysvar::CH_Nodes::CH__STPDU_EIS_Ign_Veh_Stat_AR2
{
	long res;
	long tDelay;
	switch (@this)
	{
		case (0):
			res = ResetTimingCyclic("Ign_Veh_Stat_AR2");
			res = ResetTimingEvtTrg("Ign_Veh_Stat_AR2");
			res = EnableTimingCyclic("Ign_Veh_Stat_AR2", 1);
			res = EnableTimingEvtTrg("Ign_Veh_Stat_AR2", 1);
			break;
		case (1):
			tDelay = @sysvar::CH_Nodes::CH__STPDU_T_EIS_Ign_Veh_Stat_AR2;
			if (tDelay > 0)
			{
				if (isTimerActive(Timer_EIS_Ign_Veh_Stat_AR2) == 0)
				{
					res = SetTimingCyclic("Ign_Veh_Stat_AR2", 1, tDelay, 1);
					setTimer (Timer_EIS_Ign_Veh_Stat_AR2, tDelay);
					@sysvar::CH_Nodes::CH__STPDU_EIS_Ign_Veh_Stat_AR2 = 2;
				}
			}
			else if (tDelay == 0)
			{
				if (isTimerActive(Timer_EIS_Ign_Veh_Stat_AR2) == 0)
				{
					res = EnableTimingCyclic("Ign_Veh_Stat_AR2", 0);
					res = EnableTimingEvtTrg("Ign_Veh_Stat_AR2", 0);
				}
			}
			break;
		case (2):
			break;
		default:
			Write("error: wrong parameter (%d)", @this);
			stop();
			break;
	}
}

on sysvar sysvar::CH_Nodes::CH__STPDU_EIS_IHC_Lgt_Stat_HLI_2_AR2
{
	long res;
	long tDelay;
	switch (@this)
	{
		case (0):
			res = ResetTimingCyclic("IHC_Lgt_Stat_HLI_2_AR2");
			res = ResetTimingEvtTrg("IHC_Lgt_Stat_HLI_2_AR2");
			res = EnableTimingCyclic("IHC_Lgt_Stat_HLI_2_AR2", 1);
			res = EnableTimingEvtTrg("IHC_Lgt_Stat_HLI_2_AR2", 1);
			break;
		case (1):
			tDelay = @sysvar::CH_Nodes::CH__STPDU_T_EIS_IHC_Lgt_Stat_HLI_2_AR2;
			if (tDelay > 0)
			{
				if (isTimerActive(Timer_EIS_IHC_Lgt_Stat_HLI_2_AR2) == 0)
				{
					res = SetTimingCyclic("IHC_Lgt_Stat_HLI_2_AR2", 1, tDelay, 1);
					setTimer (Timer_EIS_IHC_Lgt_Stat_HLI_2_AR2, tDelay);
					@sysvar::CH_Nodes::CH__STPDU_EIS_IHC_Lgt_Stat_HLI_2_AR2 = 2;
				}
			}
			else if (tDelay == 0)
			{
				if (isTimerActive(Timer_EIS_IHC_Lgt_Stat_HLI_2_AR2) == 0)
				{
					res = EnableTimingCyclic("IHC_Lgt_Stat_HLI_2_AR2", 0);
					res = EnableTimingEvtTrg("IHC_Lgt_Stat_HLI_2_AR2", 0);
				}
			}
			break;
		case (2):
			break;
		default:
			Write("error: wrong parameter (%d)", @this);
			stop();
			break;
	}
}

on sysvar sysvar::CH_Nodes::CH__STPDU_EIS_IHC_Lgt_Stat_HLI_AR2
{
	long res;
	long tDelay;
	switch (@this)
	{
		case (0):
			res = ResetTimingCyclic("IHC_Lgt_Stat_HLI_AR2");
			res = ResetTimingEvtTrg("IHC_Lgt_Stat_HLI_AR2");
			res = EnableTimingCyclic("IHC_Lgt_Stat_HLI_AR2", 1);
			res = EnableTimingEvtTrg("IHC_Lgt_Stat_HLI_AR2", 1);
			break;
		case (1):
			tDelay = @sysvar::CH_Nodes::CH__STPDU_T_EIS_IHC_Lgt_Stat_HLI_AR2;
			if (tDelay > 0)
			{
				if (isTimerActive(Timer_EIS_IHC_Lgt_Stat_HLI_AR2) == 0)
				{
					res = SetTimingCyclic("IHC_Lgt_Stat_HLI_AR2", 1, tDelay, 1);
					setTimer (Timer_EIS_IHC_Lgt_Stat_HLI_AR2, tDelay);
					@sysvar::CH_Nodes::CH__STPDU_EIS_IHC_Lgt_Stat_HLI_AR2 = 2;
				}
			}
			else if (tDelay == 0)
			{
				if (isTimerActive(Timer_EIS_IHC_Lgt_Stat_HLI_AR2) == 0)
				{
					res = EnableTimingCyclic("IHC_Lgt_Stat_HLI_AR2", 0);
					res = EnableTimingEvtTrg("IHC_Lgt_Stat_HLI_AR2", 0);
				}
			}
			break;
		case (2):
			break;
		default:
			Write("error: wrong parameter (%d)", @this);
			stop();
			break;
	}
}

on sysvar sysvar::CH_Nodes::CH__STPDU_EIS_KG_State_AR2
{
	long res;
	long tDelay;
	switch (@this)
	{
		case (0):
			res = ResetTimingCyclic("KG_State_AR2");
			res = ResetTimingEvtTrg("KG_State_AR2");
			res = EnableTimingCyclic("KG_State_AR2", 1);
			res = EnableTimingEvtTrg("KG_State_AR2", 1);
			break;
		case (1):
			tDelay = @sysvar::CH_Nodes::CH__STPDU_T_EIS_KG_State_AR2;
			if (tDelay > 0)
			{
				if (isTimerActive(Timer_EIS_KG_State_AR2) == 0)
				{
					res = SetTimingCyclic("KG_State_AR2", 1, tDelay, 1);
					setTimer (Timer_EIS_KG_State_AR2, tDelay);
					@sysvar::CH_Nodes::CH__STPDU_EIS_KG_State_AR2 = 2;
				}
			}
			else if (tDelay == 0)
			{
				if (isTimerActive(Timer_EIS_KG_State_AR2) == 0)
				{
					res = EnableTimingCyclic("KG_State_AR2", 0);
					res = EnableTimingEvtTrg("KG_State_AR2", 0);
				}
			}
			break;
		case (2):
			break;
		default:
			Write("error: wrong parameter (%d)", @this);
			stop();
			break;
	}
}

on sysvar sysvar::CH_Nodes::CH__STPDU_EIS_LDC_Disp_Stat_IC_AR2
{
	long res;
	long tDelay;
	switch (@this)
	{
		case (0):
			res = ResetTimingCyclic("LDC_Disp_Stat_IC_AR2");
			res = ResetTimingEvtTrg("LDC_Disp_Stat_IC_AR2");
			res = EnableTimingCyclic("LDC_Disp_Stat_IC_AR2", 1);
			res = EnableTimingEvtTrg("LDC_Disp_Stat_IC_AR2", 1);
			break;
		case (1):
			tDelay = @sysvar::CH_Nodes::CH__STPDU_T_EIS_LDC_Disp_Stat_IC_AR2;
			if (tDelay > 0)
			{
				if (isTimerActive(Timer_EIS_LDC_Disp_Stat_IC_AR2) == 0)
				{
					res = SetTimingCyclic("LDC_Disp_Stat_IC_AR2", 1, tDelay, 1);
					setTimer (Timer_EIS_LDC_Disp_Stat_IC_AR2, tDelay);
					@sysvar::CH_Nodes::CH__STPDU_EIS_LDC_Disp_Stat_IC_AR2 = 2;
				}
			}
			else if (tDelay == 0)
			{
				if (isTimerActive(Timer_EIS_LDC_Disp_Stat_IC_AR2) == 0)
				{
					res = EnableTimingCyclic("LDC_Disp_Stat_IC_AR2", 0);
					res = EnableTimingEvtTrg("LDC_Disp_Stat_IC_AR2", 0);
				}
			}
			break;
		case (2):
			break;
		default:
			Write("error: wrong parameter (%d)", @this);
			stop();
			break;
	}
}

on sysvar sysvar::CH_Nodes::CH__STPDU_EIS_LgtSens_State_AR
{
	long res;
	long tDelay;
	switch (@this)
	{
		case (0):
			res = ResetTimingCyclic("LgtSens_State_AR");
			res = ResetTimingEvtTrg("LgtSens_State_AR");
			res = EnableTimingCyclic("LgtSens_State_AR", 1);
			res = EnableTimingEvtTrg("LgtSens_State_AR", 1);
			break;
		case (1):
			tDelay = @sysvar::CH_Nodes::CH__STPDU_T_EIS_LgtSens_State_AR;
			if (tDelay > 0)
			{
				if (isTimerActive(Timer_EIS_LgtSens_State_AR) == 0)
				{
					res = SetTimingCyclic("LgtSens_State_AR", 1, tDelay, 1);
					setTimer (Timer_EIS_LgtSens_State_AR, tDelay);
					@sysvar::CH_Nodes::CH__STPDU_EIS_LgtSens_State_AR = 2;
				}
			}
			else if (tDelay == 0)
			{
				if (isTimerActive(Timer_EIS_LgtSens_State_AR) == 0)
				{
					res = EnableTimingCyclic("LgtSens_State_AR", 0);
					res = EnableTimingEvtTrg("LgtSens_State_AR", 0);
				}
			}
			break;
		case (2):
			break;
		default:
			Write("error: wrong parameter (%d)", @this);
			stop();
			break;
	}
}

on sysvar sysvar::CH_Nodes::CH__STPDU_EIS_Mirr_Adj_Lt_Rq_AR
{
	long res;
	long tDelay;
	switch (@this)
	{
		case (0):
			res = ResetTimingCyclic("Mirr_Adj_Lt_Rq_AR");
			res = ResetTimingEvtTrg("Mirr_Adj_Lt_Rq_AR");
			res = EnableTimingCyclic("Mirr_Adj_Lt_Rq_AR", 1);
			res = EnableTimingEvtTrg("Mirr_Adj_Lt_Rq_AR", 1);
			break;
		case (1):
			tDelay = @sysvar::CH_Nodes::CH__STPDU_T_EIS_Mirr_Adj_Lt_Rq_AR;
			if (tDelay > 0)
			{
				if (isTimerActive(Timer_EIS_Mirr_Adj_Lt_Rq_AR) == 0)
				{
					res = SetTimingCyclic("Mirr_Adj_Lt_Rq_AR", 1, tDelay, 1);
					setTimer (Timer_EIS_Mirr_Adj_Lt_Rq_AR, tDelay);
					@sysvar::CH_Nodes::CH__STPDU_EIS_Mirr_Adj_Lt_Rq_AR = 2;
				}
			}
			else if (tDelay == 0)
			{
				if (isTimerActive(Timer_EIS_Mirr_Adj_Lt_Rq_AR) == 0)
				{
					res = EnableTimingCyclic("Mirr_Adj_Lt_Rq_AR", 0);
					res = EnableTimingEvtTrg("Mirr_Adj_Lt_Rq_AR", 0);
				}
			}
			break;
		case (2):
			break;
		default:
			Write("error: wrong parameter (%d)", @this);
			stop();
			break;
	}
}

on sysvar sysvar::CH_Nodes::CH__STPDU_EIS_Mirr_Adj_Rt_Rq_AR
{
	long res;
	long tDelay;
	switch (@this)
	{
		case (0):
			res = ResetTimingCyclic("Mirr_Adj_Rt_Rq_AR");
			res = ResetTimingEvtTrg("Mirr_Adj_Rt_Rq_AR");
			res = EnableTimingCyclic("Mirr_Adj_Rt_Rq_AR", 1);
			res = EnableTimingEvtTrg("Mirr_Adj_Rt_Rq_AR", 1);
			break;
		case (1):
			tDelay = @sysvar::CH_Nodes::CH__STPDU_T_EIS_Mirr_Adj_Rt_Rq_AR;
			if (tDelay > 0)
			{
				if (isTimerActive(Timer_EIS_Mirr_Adj_Rt_Rq_AR) == 0)
				{
					res = SetTimingCyclic("Mirr_Adj_Rt_Rq_AR", 1, tDelay, 1);
					setTimer (Timer_EIS_Mirr_Adj_Rt_Rq_AR, tDelay);
					@sysvar::CH_Nodes::CH__STPDU_EIS_Mirr_Adj_Rt_Rq_AR = 2;
				}
			}
			else if (tDelay == 0)
			{
				if (isTimerActive(Timer_EIS_Mirr_Adj_Rt_Rq_AR) == 0)
				{
					res = EnableTimingCyclic("Mirr_Adj_Rt_Rq_AR", 0);
					res = EnableTimingEvtTrg("Mirr_Adj_Rt_Rq_AR", 0);
				}
			}
			break;
		case (2):
			break;
		default:
			Write("error: wrong parameter (%d)", @this);
			stop();
			break;
	}
}

on sysvar sysvar::CH_Nodes::CH__STPDU_EIS_NAVI_Pos1_AR
{
	long res;
	long tDelay;
	switch (@this)
	{
		case (0):
			res = ResetTimingCyclic("NAVI_Pos1_AR");
			res = ResetTimingEvtTrg("NAVI_Pos1_AR");
			res = EnableTimingCyclic("NAVI_Pos1_AR", 1);
			res = EnableTimingEvtTrg("NAVI_Pos1_AR", 1);
			break;
		case (1):
			tDelay = @sysvar::CH_Nodes::CH__STPDU_T_EIS_NAVI_Pos1_AR;
			if (tDelay > 0)
			{
				if (isTimerActive(Timer_EIS_NAVI_Pos1_AR) == 0)
				{
					res = SetTimingCyclic("NAVI_Pos1_AR", 1, tDelay, 1);
					setTimer (Timer_EIS_NAVI_Pos1_AR, tDelay);
					@sysvar::CH_Nodes::CH__STPDU_EIS_NAVI_Pos1_AR = 2;
				}
			}
			else if (tDelay == 0)
			{
				if (isTimerActive(Timer_EIS_NAVI_Pos1_AR) == 0)
				{
					res = EnableTimingCyclic("NAVI_Pos1_AR", 0);
					res = EnableTimingEvtTrg("NAVI_Pos1_AR", 0);
				}
			}
			break;
		case (2):
			break;
		default:
			Write("error: wrong parameter (%d)", @this);
			stop();
			break;
	}
}

on sysvar sysvar::CH_Nodes::CH__STPDU_EIS_NAVI_Pos2_AR
{
	long res;
	long tDelay;
	switch (@this)
	{
		case (0):
			res = ResetTimingCyclic("NAVI_Pos2_AR");
			res = ResetTimingEvtTrg("NAVI_Pos2_AR");
			res = EnableTimingCyclic("NAVI_Pos2_AR", 1);
			res = EnableTimingEvtTrg("NAVI_Pos2_AR", 1);
			break;
		case (1):
			tDelay = @sysvar::CH_Nodes::CH__STPDU_T_EIS_NAVI_Pos2_AR;
			if (tDelay > 0)
			{
				if (isTimerActive(Timer_EIS_NAVI_Pos2_AR) == 0)
				{
					res = SetTimingCyclic("NAVI_Pos2_AR", 1, tDelay, 1);
					setTimer (Timer_EIS_NAVI_Pos2_AR, tDelay);
					@sysvar::CH_Nodes::CH__STPDU_EIS_NAVI_Pos2_AR = 2;
				}
			}
			else if (tDelay == 0)
			{
				if (isTimerActive(Timer_EIS_NAVI_Pos2_AR) == 0)
				{
					res = EnableTimingCyclic("NAVI_Pos2_AR", 0);
					res = EnableTimingEvtTrg("NAVI_Pos2_AR", 0);
				}
			}
			break;
		case (2):
			break;
		default:
			Write("error: wrong parameter (%d)", @this);
			stop();
			break;
	}
}

on sysvar sysvar::CH_Nodes::CH__STPDU_EIS_NAVI_Pos3_AR
{
	long res;
	long tDelay;
	switch (@this)
	{
		case (0):
			res = ResetTimingCyclic("NAVI_Pos3_AR");
			res = ResetTimingEvtTrg("NAVI_Pos3_AR");
			res = EnableTimingCyclic("NAVI_Pos3_AR", 1);
			res = EnableTimingEvtTrg("NAVI_Pos3_AR", 1);
			break;
		case (1):
			tDelay = @sysvar::CH_Nodes::CH__STPDU_T_EIS_NAVI_Pos3_AR;
			if (tDelay > 0)
			{
				if (isTimerActive(Timer_EIS_NAVI_Pos3_AR) == 0)
				{
					res = SetTimingCyclic("NAVI_Pos3_AR", 1, tDelay, 1);
					setTimer (Timer_EIS_NAVI_Pos3_AR, tDelay);
					@sysvar::CH_Nodes::CH__STPDU_EIS_NAVI_Pos3_AR = 2;
				}
			}
			else if (tDelay == 0)
			{
				if (isTimerActive(Timer_EIS_NAVI_Pos3_AR) == 0)
				{
					res = EnableTimingCyclic("NAVI_Pos3_AR", 0);
					res = EnableTimingEvtTrg("NAVI_Pos3_AR", 0);
				}
			}
			break;
		case (2):
			break;
		default:
			Write("error: wrong parameter (%d)", @this);
			stop();
			break;
	}
}

on sysvar sysvar::CH_Nodes::CH__STPDU_EIS_NAVI_Pos4_AR
{
	long res;
	long tDelay;
	switch (@this)
	{
		case (0):
			res = ResetTimingCyclic("NAVI_Pos4_AR");
			res = ResetTimingEvtTrg("NAVI_Pos4_AR");
			res = EnableTimingCyclic("NAVI_Pos4_AR", 1);
			res = EnableTimingEvtTrg("NAVI_Pos4_AR", 1);
			break;
		case (1):
			tDelay = @sysvar::CH_Nodes::CH__STPDU_T_EIS_NAVI_Pos4_AR;
			if (tDelay > 0)
			{
				if (isTimerActive(Timer_EIS_NAVI_Pos4_AR) == 0)
				{
					res = SetTimingCyclic("NAVI_Pos4_AR", 1, tDelay, 1);
					setTimer (Timer_EIS_NAVI_Pos4_AR, tDelay);
					@sysvar::CH_Nodes::CH__STPDU_EIS_NAVI_Pos4_AR = 2;
				}
			}
			else if (tDelay == 0)
			{
				if (isTimerActive(Timer_EIS_NAVI_Pos4_AR) == 0)
				{
					res = EnableTimingCyclic("NAVI_Pos4_AR", 0);
					res = EnableTimingEvtTrg("NAVI_Pos4_AR", 0);
				}
			}
			break;
		case (2):
			break;
		default:
			Write("error: wrong parameter (%d)", @this);
			stop();
			break;
	}
}

on sysvar sysvar::CH_Nodes::CH__STPDU_EIS_NAVI_Pos5_AR
{
	long res;
	long tDelay;
	switch (@this)
	{
		case (0):
			res = ResetTimingCyclic("NAVI_Pos5_AR");
			res = ResetTimingEvtTrg("NAVI_Pos5_AR");
			res = EnableTimingCyclic("NAVI_Pos5_AR", 1);
			res = EnableTimingEvtTrg("NAVI_Pos5_AR", 1);
			break;
		case (1):
			tDelay = @sysvar::CH_Nodes::CH__STPDU_T_EIS_NAVI_Pos5_AR;
			if (tDelay > 0)
			{
				if (isTimerActive(Timer_EIS_NAVI_Pos5_AR) == 0)
				{
					res = SetTimingCyclic("NAVI_Pos5_AR", 1, tDelay, 1);
					setTimer (Timer_EIS_NAVI_Pos5_AR, tDelay);
					@sysvar::CH_Nodes::CH__STPDU_EIS_NAVI_Pos5_AR = 2;
				}
			}
			else if (tDelay == 0)
			{
				if (isTimerActive(Timer_EIS_NAVI_Pos5_AR) == 0)
				{
					res = EnableTimingCyclic("NAVI_Pos5_AR", 0);
					res = EnableTimingEvtTrg("NAVI_Pos5_AR", 0);
				}
			}
			break;
		case (2):
			break;
		default:
			Write("error: wrong parameter (%d)", @this);
			stop();
			break;
	}
}

on sysvar sysvar::CH_Nodes::CH__STPDU_EIS_NVP_Stat1_AR2
{
	long res;
	long tDelay;
	switch (@this)
	{
		case (0):
			res = ResetTimingCyclic("NVP_Stat1_AR2");
			res = ResetTimingEvtTrg("NVP_Stat1_AR2");
			res = EnableTimingCyclic("NVP_Stat1_AR2", 1);
			res = EnableTimingEvtTrg("NVP_Stat1_AR2", 1);
			break;
		case (1):
			tDelay = @sysvar::CH_Nodes::CH__STPDU_T_EIS_NVP_Stat1_AR2;
			if (tDelay > 0)
			{
				if (isTimerActive(Timer_EIS_NVP_Stat1_AR2) == 0)
				{
					res = SetTimingCyclic("NVP_Stat1_AR2", 1, tDelay, 1);
					setTimer (Timer_EIS_NVP_Stat1_AR2, tDelay);
					@sysvar::CH_Nodes::CH__STPDU_EIS_NVP_Stat1_AR2 = 2;
				}
			}
			else if (tDelay == 0)
			{
				if (isTimerActive(Timer_EIS_NVP_Stat1_AR2) == 0)
				{
					res = EnableTimingCyclic("NVP_Stat1_AR2", 0);
					res = EnableTimingEvtTrg("NVP_Stat1_AR2", 0);
				}
			}
			break;
		case (2):
			break;
		default:
			Write("error: wrong parameter (%d)", @this);
			stop();
			break;
	}
}

on sysvar sysvar::CH_Nodes::CH__STPDU_EIS_OHCM_Stat_AR2
{
	long res;
	long tDelay;
	switch (@this)
	{
		case (0):
			res = ResetTimingCyclic("OHCM_Stat_AR2");
			res = ResetTimingEvtTrg("OHCM_Stat_AR2");
			res = EnableTimingCyclic("OHCM_Stat_AR2", 1);
			res = EnableTimingEvtTrg("OHCM_Stat_AR2", 1);
			break;
		case (1):
			tDelay = @sysvar::CH_Nodes::CH__STPDU_T_EIS_OHCM_Stat_AR2;
			if (tDelay > 0)
			{
				if (isTimerActive(Timer_EIS_OHCM_Stat_AR2) == 0)
				{
					res = SetTimingCyclic("OHCM_Stat_AR2", 1, tDelay, 1);
					setTimer (Timer_EIS_OHCM_Stat_AR2, tDelay);
					@sysvar::CH_Nodes::CH__STPDU_EIS_OHCM_Stat_AR2 = 2;
				}
			}
			else if (tDelay == 0)
			{
				if (isTimerActive(Timer_EIS_OHCM_Stat_AR2) == 0)
				{
					res = EnableTimingCyclic("OHCM_Stat_AR2", 0);
					res = EnableTimingEvtTrg("OHCM_Stat_AR2", 0);
				}
			}
			break;
		case (2):
			break;
		default:
			Write("error: wrong parameter (%d)", @this);
			stop();
			break;
	}
}

on sysvar sysvar::CH_Nodes::CH__STPDU_EIS_ORC_Disp_Stat_AR2
{
	long res;
	long tDelay;
	switch (@this)
	{
		case (0):
			res = ResetTimingCyclic("ORC_Disp_Stat_AR2");
			res = ResetTimingEvtTrg("ORC_Disp_Stat_AR2");
			res = EnableTimingCyclic("ORC_Disp_Stat_AR2", 1);
			res = EnableTimingEvtTrg("ORC_Disp_Stat_AR2", 1);
			break;
		case (1):
			tDelay = @sysvar::CH_Nodes::CH__STPDU_T_EIS_ORC_Disp_Stat_AR2;
			if (tDelay > 0)
			{
				if (isTimerActive(Timer_EIS_ORC_Disp_Stat_AR2) == 0)
				{
					res = SetTimingCyclic("ORC_Disp_Stat_AR2", 1, tDelay, 1);
					setTimer (Timer_EIS_ORC_Disp_Stat_AR2, tDelay);
					@sysvar::CH_Nodes::CH__STPDU_EIS_ORC_Disp_Stat_AR2 = 2;
				}
			}
			else if (tDelay == 0)
			{
				if (isTimerActive(Timer_EIS_ORC_Disp_Stat_AR2) == 0)
				{
					res = EnableTimingCyclic("ORC_Disp_Stat_AR2", 0);
					res = EnableTimingEvtTrg("ORC_Disp_Stat_AR2", 0);
				}
			}
			break;
		case (2):
			break;
		default:
			Write("error: wrong parameter (%d)", @this);
			stop();
			break;
	}
}

on sysvar sysvar::CH_Nodes::CH__STPDU_EIS_ORC_Impact_AR2
{
	long res;
	long tDelay;
	switch (@this)
	{
		case (0):
			res = ResetTimingCyclic("ORC_Impact_AR2");
			res = ResetTimingEvtTrg("ORC_Impact_AR2");
			res = EnableTimingCyclic("ORC_Impact_AR2", 1);
			res = EnableTimingEvtTrg("ORC_Impact_AR2", 1);
			break;
		case (1):
			tDelay = @sysvar::CH_Nodes::CH__STPDU_T_EIS_ORC_Impact_AR2;
			if (tDelay > 0)
			{
				if (isTimerActive(Timer_EIS_ORC_Impact_AR2) == 0)
				{
					res = SetTimingCyclic("ORC_Impact_AR2", 1, tDelay, 1);
					setTimer (Timer_EIS_ORC_Impact_AR2, tDelay);
					@sysvar::CH_Nodes::CH__STPDU_EIS_ORC_Impact_AR2 = 2;
				}
			}
			else if (tDelay == 0)
			{
				if (isTimerActive(Timer_EIS_ORC_Impact_AR2) == 0)
				{
					res = EnableTimingCyclic("ORC_Impact_AR2", 0);
					res = EnableTimingEvtTrg("ORC_Impact_AR2", 0);
				}
			}
			break;
		case (2):
			break;
		default:
			Write("error: wrong parameter (%d)", @this);
			stop();
			break;
	}
}

on sysvar sysvar::CH_Nodes::CH__STPDU_EIS_Park_Disp_Rs_AR2
{
	long res;
	long tDelay;
	switch (@this)
	{
		case (0):
			res = ResetTimingCyclic("Park_Disp_Rs_AR2");
			res = ResetTimingEvtTrg("Park_Disp_Rs_AR2");
			res = EnableTimingCyclic("Park_Disp_Rs_AR2", 1);
			res = EnableTimingEvtTrg("Park_Disp_Rs_AR2", 1);
			break;
		case (1):
			tDelay = @sysvar::CH_Nodes::CH__STPDU_T_EIS_Park_Disp_Rs_AR2;
			if (tDelay > 0)
			{
				if (isTimerActive(Timer_EIS_Park_Disp_Rs_AR2) == 0)
				{
					res = SetTimingCyclic("Park_Disp_Rs_AR2", 1, tDelay, 1);
					setTimer (Timer_EIS_Park_Disp_Rs_AR2, tDelay);
					@sysvar::CH_Nodes::CH__STPDU_EIS_Park_Disp_Rs_AR2 = 2;
				}
			}
			else if (tDelay == 0)
			{
				if (isTimerActive(Timer_EIS_Park_Disp_Rs_AR2) == 0)
				{
					res = EnableTimingCyclic("Park_Disp_Rs_AR2", 0);
					res = EnableTimingEvtTrg("Park_Disp_Rs_AR2", 0);
				}
			}
			break;
		case (2):
			break;
		default:
			Write("error: wrong parameter (%d)", @this);
			stop();
			break;
	}
}

on sysvar sysvar::CH_Nodes::CH__STPDU_EIS_PHB_IHC_Plus_Tunnel_3_4_AR2
{
	long res;
	long tDelay;
	switch (@this)
	{
		case (0):
			res = ResetTimingCyclic("PHB_IHC_Plus_Tunnel_3_4_AR2");
			res = ResetTimingEvtTrg("PHB_IHC_Plus_Tunnel_3_4_AR2");
			res = EnableTimingCyclic("PHB_IHC_Plus_Tunnel_3_4_AR2", 1);
			res = EnableTimingEvtTrg("PHB_IHC_Plus_Tunnel_3_4_AR2", 1);
			break;
		case (1):
			tDelay = @sysvar::CH_Nodes::CH__STPDU_T_EIS_PHB_IHC_Plus_Tunnel_3_4_AR2;
			if (tDelay > 0)
			{
				if (isTimerActive(Timer_EIS_PHB_IHC_Plus_Tunnel_3_4_AR2) == 0)
				{
					res = SetTimingCyclic("PHB_IHC_Plus_Tunnel_3_4_AR2", 1, tDelay, 1);
					setTimer (Timer_EIS_PHB_IHC_Plus_Tunnel_3_4_AR2, tDelay);
					@sysvar::CH_Nodes::CH__STPDU_EIS_PHB_IHC_Plus_Tunnel_3_4_AR2 = 2;
				}
			}
			else if (tDelay == 0)
			{
				if (isTimerActive(Timer_EIS_PHB_IHC_Plus_Tunnel_3_4_AR2) == 0)
				{
					res = EnableTimingCyclic("PHB_IHC_Plus_Tunnel_3_4_AR2", 0);
					res = EnableTimingEvtTrg("PHB_IHC_Plus_Tunnel_3_4_AR2", 0);
				}
			}
			break;
		case (2):
			break;
		default:
			Write("error: wrong parameter (%d)", @this);
			stop();
			break;
	}
}

on sysvar sysvar::CH_Nodes::CH__STPDU_EIS_PHB_IHC_Plus_Tunnel_AR2
{
	long res;
	long tDelay;
	switch (@this)
	{
		case (0):
			res = ResetTimingCyclic("PHB_IHC_Plus_Tunnel_AR2");
			res = ResetTimingEvtTrg("PHB_IHC_Plus_Tunnel_AR2");
			res = EnableTimingCyclic("PHB_IHC_Plus_Tunnel_AR2", 1);
			res = EnableTimingEvtTrg("PHB_IHC_Plus_Tunnel_AR2", 1);
			break;
		case (1):
			tDelay = @sysvar::CH_Nodes::CH__STPDU_T_EIS_PHB_IHC_Plus_Tunnel_AR2;
			if (tDelay > 0)
			{
				if (isTimerActive(Timer_EIS_PHB_IHC_Plus_Tunnel_AR2) == 0)
				{
					res = SetTimingCyclic("PHB_IHC_Plus_Tunnel_AR2", 1, tDelay, 1);
					setTimer (Timer_EIS_PHB_IHC_Plus_Tunnel_AR2, tDelay);
					@sysvar::CH_Nodes::CH__STPDU_EIS_PHB_IHC_Plus_Tunnel_AR2 = 2;
				}
			}
			else if (tDelay == 0)
			{
				if (isTimerActive(Timer_EIS_PHB_IHC_Plus_Tunnel_AR2) == 0)
				{
					res = EnableTimingCyclic("PHB_IHC_Plus_Tunnel_AR2", 0);
					res = EnableTimingEvtTrg("PHB_IHC_Plus_Tunnel_AR2", 0);
				}
			}
			break;
		case (2):
			break;
		default:
			Write("error: wrong parameter (%d)", @this);
			stop();
			break;
	}
}

on sysvar sysvar::CH_Nodes::CH__STPDU_EIS_PN14_Disp_Rq_AR
{
	long res;
	long tDelay;
	switch (@this)
	{
		case (0):
			res = ResetTimingCyclic("PN14_Disp_Rq_AR");
			res = ResetTimingEvtTrg("PN14_Disp_Rq_AR");
			res = EnableTimingCyclic("PN14_Disp_Rq_AR", 1);
			res = EnableTimingEvtTrg("PN14_Disp_Rq_AR", 1);
			break;
		case (1):
			tDelay = @sysvar::CH_Nodes::CH__STPDU_T_EIS_PN14_Disp_Rq_AR;
			if (tDelay > 0)
			{
				if (isTimerActive(Timer_EIS_PN14_Disp_Rq_AR) == 0)
				{
					res = SetTimingCyclic("PN14_Disp_Rq_AR", 1, tDelay, 1);
					setTimer (Timer_EIS_PN14_Disp_Rq_AR, tDelay);
					@sysvar::CH_Nodes::CH__STPDU_EIS_PN14_Disp_Rq_AR = 2;
				}
			}
			else if (tDelay == 0)
			{
				if (isTimerActive(Timer_EIS_PN14_Disp_Rq_AR) == 0)
				{
					res = EnableTimingCyclic("PN14_Disp_Rq_AR", 0);
					res = EnableTimingEvtTrg("PN14_Disp_Rq_AR", 0);
				}
			}
			break;
		case (2):
			break;
		default:
			Write("error: wrong parameter (%d)", @this);
			stop();
			break;
	}
}

on sysvar sysvar::CH_Nodes::CH__STPDU_EIS_PN14_Rs1_AR2
{
	long res;
	long tDelay;
	switch (@this)
	{
		case (0):
			res = ResetTimingCyclic("PN14_Rs1_AR2");
			res = ResetTimingEvtTrg("PN14_Rs1_AR2");
			res = EnableTimingCyclic("PN14_Rs1_AR2", 1);
			res = EnableTimingEvtTrg("PN14_Rs1_AR2", 1);
			break;
		case (1):
			tDelay = @sysvar::CH_Nodes::CH__STPDU_T_EIS_PN14_Rs1_AR2;
			if (tDelay > 0)
			{
				if (isTimerActive(Timer_EIS_PN14_Rs1_AR2) == 0)
				{
					res = SetTimingCyclic("PN14_Rs1_AR2", 1, tDelay, 1);
					setTimer (Timer_EIS_PN14_Rs1_AR2, tDelay);
					@sysvar::CH_Nodes::CH__STPDU_EIS_PN14_Rs1_AR2 = 2;
				}
			}
			else if (tDelay == 0)
			{
				if (isTimerActive(Timer_EIS_PN14_Rs1_AR2) == 0)
				{
					res = EnableTimingCyclic("PN14_Rs1_AR2", 0);
					res = EnableTimingEvtTrg("PN14_Rs1_AR2", 0);
				}
			}
			break;
		case (2):
			break;
		default:
			Write("error: wrong parameter (%d)", @this);
			stop();
			break;
	}
}

on sysvar sysvar::CH_Nodes::CH__STPDU_EIS_PN14_Rs2_AR
{
	long res;
	long tDelay;
	switch (@this)
	{
		case (0):
			res = ResetTimingCyclic("PN14_Rs2_AR");
			res = ResetTimingEvtTrg("PN14_Rs2_AR");
			res = EnableTimingCyclic("PN14_Rs2_AR", 1);
			res = EnableTimingEvtTrg("PN14_Rs2_AR", 1);
			break;
		case (1):
			tDelay = @sysvar::CH_Nodes::CH__STPDU_T_EIS_PN14_Rs2_AR;
			if (tDelay > 0)
			{
				if (isTimerActive(Timer_EIS_PN14_Rs2_AR) == 0)
				{
					res = SetTimingCyclic("PN14_Rs2_AR", 1, tDelay, 1);
					setTimer (Timer_EIS_PN14_Rs2_AR, tDelay);
					@sysvar::CH_Nodes::CH__STPDU_EIS_PN14_Rs2_AR = 2;
				}
			}
			else if (tDelay == 0)
			{
				if (isTimerActive(Timer_EIS_PN14_Rs2_AR) == 0)
				{
					res = EnableTimingCyclic("PN14_Rs2_AR", 0);
					res = EnableTimingEvtTrg("PN14_Rs2_AR", 0);
				}
			}
			break;
		case (2):
			break;
		default:
			Write("error: wrong parameter (%d)", @this);
			stop();
			break;
	}
}

on sysvar sysvar::CH_Nodes::CH__STPDU_EIS_PN14_Stat2_AR2
{
	long res;
	long tDelay;
	switch (@this)
	{
		case (0):
			res = ResetTimingCyclic("PN14_Stat2_AR2");
			res = ResetTimingEvtTrg("PN14_Stat2_AR2");
			res = EnableTimingCyclic("PN14_Stat2_AR2", 1);
			res = EnableTimingEvtTrg("PN14_Stat2_AR2", 1);
			break;
		case (1):
			tDelay = @sysvar::CH_Nodes::CH__STPDU_T_EIS_PN14_Stat2_AR2;
			if (tDelay > 0)
			{
				if (isTimerActive(Timer_EIS_PN14_Stat2_AR2) == 0)
				{
					res = SetTimingCyclic("PN14_Stat2_AR2", 1, tDelay, 1);
					setTimer (Timer_EIS_PN14_Stat2_AR2, tDelay);
					@sysvar::CH_Nodes::CH__STPDU_EIS_PN14_Stat2_AR2 = 2;
				}
			}
			else if (tDelay == 0)
			{
				if (isTimerActive(Timer_EIS_PN14_Stat2_AR2) == 0)
				{
					res = EnableTimingCyclic("PN14_Stat2_AR2", 0);
					res = EnableTimingEvtTrg("PN14_Stat2_AR2", 0);
				}
			}
			break;
		case (2):
			break;
		default:
			Write("error: wrong parameter (%d)", @this);
			stop();
			break;
	}
}

on sysvar sysvar::CH_Nodes::CH__STPDU_EIS_PN14_Stat_AR
{
	long res;
	long tDelay;
	switch (@this)
	{
		case (0):
			res = ResetTimingCyclic("PN14_Stat_AR");
			res = ResetTimingEvtTrg("PN14_Stat_AR");
			res = EnableTimingCyclic("PN14_Stat_AR", 1);
			res = EnableTimingEvtTrg("PN14_Stat_AR", 1);
			break;
		case (1):
			tDelay = @sysvar::CH_Nodes::CH__STPDU_T_EIS_PN14_Stat_AR;
			if (tDelay > 0)
			{
				if (isTimerActive(Timer_EIS_PN14_Stat_AR) == 0)
				{
					res = SetTimingCyclic("PN14_Stat_AR", 1, tDelay, 1);
					setTimer (Timer_EIS_PN14_Stat_AR, tDelay);
					@sysvar::CH_Nodes::CH__STPDU_EIS_PN14_Stat_AR = 2;
				}
			}
			else if (tDelay == 0)
			{
				if (isTimerActive(Timer_EIS_PN14_Stat_AR) == 0)
				{
					res = EnableTimingCyclic("PN14_Stat_AR", 0);
					res = EnableTimingEvtTrg("PN14_Stat_AR", 0);
				}
			}
			break;
		case (2):
			break;
		default:
			Write("error: wrong parameter (%d)", @this);
			stop();
			break;
	}
}

on sysvar sysvar::CH_Nodes::CH__STPDU_EIS_PN48_Bat_Stat2_AR2
{
	long res;
	long tDelay;
	switch (@this)
	{
		case (0):
			res = ResetTimingCyclic("PN48_Bat_Stat2_AR2");
			res = ResetTimingEvtTrg("PN48_Bat_Stat2_AR2");
			res = EnableTimingCyclic("PN48_Bat_Stat2_AR2", 1);
			res = EnableTimingEvtTrg("PN48_Bat_Stat2_AR2", 1);
			break;
		case (1):
			tDelay = @sysvar::CH_Nodes::CH__STPDU_T_EIS_PN48_Bat_Stat2_AR2;
			if (tDelay > 0)
			{
				if (isTimerActive(Timer_EIS_PN48_Bat_Stat2_AR2) == 0)
				{
					res = SetTimingCyclic("PN48_Bat_Stat2_AR2", 1, tDelay, 1);
					setTimer (Timer_EIS_PN48_Bat_Stat2_AR2, tDelay);
					@sysvar::CH_Nodes::CH__STPDU_EIS_PN48_Bat_Stat2_AR2 = 2;
				}
			}
			else if (tDelay == 0)
			{
				if (isTimerActive(Timer_EIS_PN48_Bat_Stat2_AR2) == 0)
				{
					res = EnableTimingCyclic("PN48_Bat_Stat2_AR2", 0);
					res = EnableTimingEvtTrg("PN48_Bat_Stat2_AR2", 0);
				}
			}
			break;
		case (2):
			break;
		default:
			Write("error: wrong parameter (%d)", @this);
			stop();
			break;
	}
}

on sysvar sysvar::CH_Nodes::CH__STPDU_EIS_PN48_Bat_Stat_AR
{
	long res;
	long tDelay;
	switch (@this)
	{
		case (0):
			res = ResetTimingCyclic("PN48_Bat_Stat_AR");
			res = ResetTimingEvtTrg("PN48_Bat_Stat_AR");
			res = EnableTimingCyclic("PN48_Bat_Stat_AR", 1);
			res = EnableTimingEvtTrg("PN48_Bat_Stat_AR", 1);
			break;
		case (1):
			tDelay = @sysvar::CH_Nodes::CH__STPDU_T_EIS_PN48_Bat_Stat_AR;
			if (tDelay > 0)
			{
				if (isTimerActive(Timer_EIS_PN48_Bat_Stat_AR) == 0)
				{
					res = SetTimingCyclic("PN48_Bat_Stat_AR", 1, tDelay, 1);
					setTimer (Timer_EIS_PN48_Bat_Stat_AR, tDelay);
					@sysvar::CH_Nodes::CH__STPDU_EIS_PN48_Bat_Stat_AR = 2;
				}
			}
			else if (tDelay == 0)
			{
				if (isTimerActive(Timer_EIS_PN48_Bat_Stat_AR) == 0)
				{
					res = EnableTimingCyclic("PN48_Bat_Stat_AR", 0);
					res = EnableTimingEvtTrg("PN48_Bat_Stat_AR", 0);
				}
			}
			break;
		case (2):
			break;
		default:
			Write("error: wrong parameter (%d)", @this);
			stop();
			break;
	}
}

on sysvar sysvar::CH_Nodes::CH__STPDU_EIS_PN48_BatLim_Stat_AR
{
	long res;
	long tDelay;
	switch (@this)
	{
		case (0):
			res = ResetTimingCyclic("PN48_BatLim_Stat_AR");
			res = ResetTimingEvtTrg("PN48_BatLim_Stat_AR");
			res = EnableTimingCyclic("PN48_BatLim_Stat_AR", 1);
			res = EnableTimingEvtTrg("PN48_BatLim_Stat_AR", 1);
			break;
		case (1):
			tDelay = @sysvar::CH_Nodes::CH__STPDU_T_EIS_PN48_BatLim_Stat_AR;
			if (tDelay > 0)
			{
				if (isTimerActive(Timer_EIS_PN48_BatLim_Stat_AR) == 0)
				{
					res = SetTimingCyclic("PN48_BatLim_Stat_AR", 1, tDelay, 1);
					setTimer (Timer_EIS_PN48_BatLim_Stat_AR, tDelay);
					@sysvar::CH_Nodes::CH__STPDU_EIS_PN48_BatLim_Stat_AR = 2;
				}
			}
			else if (tDelay == 0)
			{
				if (isTimerActive(Timer_EIS_PN48_BatLim_Stat_AR) == 0)
				{
					res = EnableTimingCyclic("PN48_BatLim_Stat_AR", 0);
					res = EnableTimingEvtTrg("PN48_BatLim_Stat_AR", 0);
				}
			}
			break;
		case (2):
			break;
		default:
			Write("error: wrong parameter (%d)", @this);
			stop();
			break;
	}
}

on sysvar sysvar::CH_Nodes::CH__STPDU_EIS_PN48_DCDC48_LISB48_Stat_AR
{
	long res;
	long tDelay;
	switch (@this)
	{
		case (0):
			res = ResetTimingCyclic("PN48_DCDC48_LISB48_Stat_AR");
			res = ResetTimingEvtTrg("PN48_DCDC48_LISB48_Stat_AR");
			res = EnableTimingCyclic("PN48_DCDC48_LISB48_Stat_AR", 1);
			res = EnableTimingEvtTrg("PN48_DCDC48_LISB48_Stat_AR", 1);
			break;
		case (1):
			tDelay = @sysvar::CH_Nodes::CH__STPDU_T_EIS_PN48_DCDC48_LISB48_Stat_AR;
			if (tDelay > 0)
			{
				if (isTimerActive(Timer_EIS_PN48_DCDC48_LISB48_Stat_AR) == 0)
				{
					res = SetTimingCyclic("PN48_DCDC48_LISB48_Stat_AR", 1, tDelay, 1);
					setTimer (Timer_EIS_PN48_DCDC48_LISB48_Stat_AR, tDelay);
					@sysvar::CH_Nodes::CH__STPDU_EIS_PN48_DCDC48_LISB48_Stat_AR = 2;
				}
			}
			else if (tDelay == 0)
			{
				if (isTimerActive(Timer_EIS_PN48_DCDC48_LISB48_Stat_AR) == 0)
				{
					res = EnableTimingCyclic("PN48_DCDC48_LISB48_Stat_AR", 0);
					res = EnableTimingEvtTrg("PN48_DCDC48_LISB48_Stat_AR", 0);
				}
			}
			break;
		case (2):
			break;
		default:
			Write("error: wrong parameter (%d)", @this);
			stop();
			break;
	}
}

on sysvar sysvar::CH_Nodes::CH__STPDU_EIS_PN48_Stat_AR
{
	long res;
	long tDelay;
	switch (@this)
	{
		case (0):
			res = ResetTimingCyclic("PN48_Stat_AR");
			res = ResetTimingEvtTrg("PN48_Stat_AR");
			res = EnableTimingCyclic("PN48_Stat_AR", 1);
			res = EnableTimingEvtTrg("PN48_Stat_AR", 1);
			break;
		case (1):
			tDelay = @sysvar::CH_Nodes::CH__STPDU_T_EIS_PN48_Stat_AR;
			if (tDelay > 0)
			{
				if (isTimerActive(Timer_EIS_PN48_Stat_AR) == 0)
				{
					res = SetTimingCyclic("PN48_Stat_AR", 1, tDelay, 1);
					setTimer (Timer_EIS_PN48_Stat_AR, tDelay);
					@sysvar::CH_Nodes::CH__STPDU_EIS_PN48_Stat_AR = 2;
				}
			}
			else if (tDelay == 0)
			{
				if (isTimerActive(Timer_EIS_PN48_Stat_AR) == 0)
				{
					res = EnableTimingCyclic("PN48_Stat_AR", 0);
					res = EnableTimingEvtTrg("PN48_Stat_AR", 0);
				}
			}
			break;
		case (2):
			break;
		default:
			Write("error: wrong parameter (%d)", @this);
			stop();
			break;
	}
}

on sysvar sysvar::CH_Nodes::CH__STPDU_EIS_PNHV_WeekDepTmTbl_Rq_HU_AR2
{
	long res;
	long tDelay;
	switch (@this)
	{
		case (0):
			res = ResetTimingCyclic("PNHV_WeekDepTmTbl_Rq_HU_AR2");
			res = ResetTimingEvtTrg("PNHV_WeekDepTmTbl_Rq_HU_AR2");
			res = EnableTimingCyclic("PNHV_WeekDepTmTbl_Rq_HU_AR2", 1);
			res = EnableTimingEvtTrg("PNHV_WeekDepTmTbl_Rq_HU_AR2", 1);
			break;
		case (1):
			tDelay = @sysvar::CH_Nodes::CH__STPDU_T_EIS_PNHV_WeekDepTmTbl_Rq_HU_AR2;
			if (tDelay > 0)
			{
				if (isTimerActive(Timer_EIS_PNHV_WeekDepTmTbl_Rq_HU_AR2) == 0)
				{
					res = SetTimingCyclic("PNHV_WeekDepTmTbl_Rq_HU_AR2", 1, tDelay, 1);
					setTimer (Timer_EIS_PNHV_WeekDepTmTbl_Rq_HU_AR2, tDelay);
					@sysvar::CH_Nodes::CH__STPDU_EIS_PNHV_WeekDepTmTbl_Rq_HU_AR2 = 2;
				}
			}
			else if (tDelay == 0)
			{
				if (isTimerActive(Timer_EIS_PNHV_WeekDepTmTbl_Rq_HU_AR2) == 0)
				{
					res = EnableTimingCyclic("PNHV_WeekDepTmTbl_Rq_HU_AR2", 0);
					res = EnableTimingEvtTrg("PNHV_WeekDepTmTbl_Rq_HU_AR2", 0);
				}
			}
			break;
		case (2):
			break;
		default:
			Write("error: wrong parameter (%d)", @this);
			stop();
			break;
	}
}

on sysvar sysvar::CH_Nodes::CH__STPDU_EIS_PreCond_On_Rq_AR
{
	long res;
	long tDelay;
	switch (@this)
	{
		case (0):
			res = ResetTimingCyclic("PreCond_On_Rq_AR");
			res = ResetTimingEvtTrg("PreCond_On_Rq_AR");
			res = EnableTimingCyclic("PreCond_On_Rq_AR", 1);
			res = EnableTimingEvtTrg("PreCond_On_Rq_AR", 1);
			break;
		case (1):
			tDelay = @sysvar::CH_Nodes::CH__STPDU_T_EIS_PreCond_On_Rq_AR;
			if (tDelay > 0)
			{
				if (isTimerActive(Timer_EIS_PreCond_On_Rq_AR) == 0)
				{
					res = SetTimingCyclic("PreCond_On_Rq_AR", 1, tDelay, 1);
					setTimer (Timer_EIS_PreCond_On_Rq_AR, tDelay);
					@sysvar::CH_Nodes::CH__STPDU_EIS_PreCond_On_Rq_AR = 2;
				}
			}
			else if (tDelay == 0)
			{
				if (isTimerActive(Timer_EIS_PreCond_On_Rq_AR) == 0)
				{
					res = EnableTimingCyclic("PreCond_On_Rq_AR", 0);
					res = EnableTimingEvtTrg("PreCond_On_Rq_AR", 0);
				}
			}
			break;
		case (2):
			break;
		default:
			Write("error: wrong parameter (%d)", @this);
			stop();
			break;
	}
}

on sysvar sysvar::CH_Nodes::CH__STPDU_EIS_PreCond_Rq_HU_AR2
{
	long res;
	long tDelay;
	switch (@this)
	{
		case (0):
			res = ResetTimingCyclic("PreCond_Rq_HU_AR2");
			res = ResetTimingEvtTrg("PreCond_Rq_HU_AR2");
			res = EnableTimingCyclic("PreCond_Rq_HU_AR2", 1);
			res = EnableTimingEvtTrg("PreCond_Rq_HU_AR2", 1);
			break;
		case (1):
			tDelay = @sysvar::CH_Nodes::CH__STPDU_T_EIS_PreCond_Rq_HU_AR2;
			if (tDelay > 0)
			{
				if (isTimerActive(Timer_EIS_PreCond_Rq_HU_AR2) == 0)
				{
					res = SetTimingCyclic("PreCond_Rq_HU_AR2", 1, tDelay, 1);
					setTimer (Timer_EIS_PreCond_Rq_HU_AR2, tDelay);
					@sysvar::CH_Nodes::CH__STPDU_EIS_PreCond_Rq_HU_AR2 = 2;
				}
			}
			else if (tDelay == 0)
			{
				if (isTimerActive(Timer_EIS_PreCond_Rq_HU_AR2) == 0)
				{
					res = EnableTimingCyclic("PreCond_Rq_HU_AR2", 0);
					res = EnableTimingEvtTrg("PreCond_Rq_HU_AR2", 0);
				}
			}
			break;
		case (2):
			break;
		default:
			Write("error: wrong parameter (%d)", @this);
			stop();
			break;
	}
}

on sysvar sysvar::CH_Nodes::CH__STPDU_EIS_PreCond_Stat_AR
{
	long res;
	long tDelay;
	switch (@this)
	{
		case (0):
			res = ResetTimingCyclic("PreCond_Stat_AR");
			res = ResetTimingEvtTrg("PreCond_Stat_AR");
			res = EnableTimingCyclic("PreCond_Stat_AR", 1);
			res = EnableTimingEvtTrg("PreCond_Stat_AR", 1);
			break;
		case (1):
			tDelay = @sysvar::CH_Nodes::CH__STPDU_T_EIS_PreCond_Stat_AR;
			if (tDelay > 0)
			{
				if (isTimerActive(Timer_EIS_PreCond_Stat_AR) == 0)
				{
					res = SetTimingCyclic("PreCond_Stat_AR", 1, tDelay, 1);
					setTimer (Timer_EIS_PreCond_Stat_AR, tDelay);
					@sysvar::CH_Nodes::CH__STPDU_EIS_PreCond_Stat_AR = 2;
				}
			}
			else if (tDelay == 0)
			{
				if (isTimerActive(Timer_EIS_PreCond_Stat_AR) == 0)
				{
					res = EnableTimingCyclic("PreCond_Stat_AR", 0);
					res = EnableTimingEvtTrg("PreCond_Stat_AR", 0);
				}
			}
			break;
		case (2):
			break;
		default:
			Write("error: wrong parameter (%d)", @this);
			stop();
			break;
	}
}

on sysvar sysvar::CH_Nodes::CH__STPDU_EIS_PT_ObjIntrst_Gw_AR2
{
	long res;
	long tDelay;
	switch (@this)
	{
		case (0):
			res = ResetTimingCyclic("PT_ObjIntrst_Gw_AR2");
			res = ResetTimingEvtTrg("PT_ObjIntrst_Gw_AR2");
			res = EnableTimingCyclic("PT_ObjIntrst_Gw_AR2", 1);
			res = EnableTimingEvtTrg("PT_ObjIntrst_Gw_AR2", 1);
			break;
		case (1):
			tDelay = @sysvar::CH_Nodes::CH__STPDU_T_EIS_PT_ObjIntrst_Gw_AR2;
			if (tDelay > 0)
			{
				if (isTimerActive(Timer_EIS_PT_ObjIntrst_Gw_AR2) == 0)
				{
					res = SetTimingCyclic("PT_ObjIntrst_Gw_AR2", 1, tDelay, 1);
					setTimer (Timer_EIS_PT_ObjIntrst_Gw_AR2, tDelay);
					@sysvar::CH_Nodes::CH__STPDU_EIS_PT_ObjIntrst_Gw_AR2 = 2;
				}
			}
			else if (tDelay == 0)
			{
				if (isTimerActive(Timer_EIS_PT_ObjIntrst_Gw_AR2) == 0)
				{
					res = EnableTimingCyclic("PT_ObjIntrst_Gw_AR2", 0);
					res = EnableTimingEvtTrg("PT_ObjIntrst_Gw_AR2", 0);
				}
			}
			break;
		case (2):
			break;
		default:
			Write("error: wrong parameter (%d)", @this);
			stop();
			break;
	}
}

on sysvar sysvar::CH_Nodes::CH__STPDU_EIS_RemPark_Auth_Rs_AR2
{
	long res;
	long tDelay;
	switch (@this)
	{
		case (0):
			res = ResetTimingCyclic("RemPark_Auth_Rs_AR2");
			res = ResetTimingEvtTrg("RemPark_Auth_Rs_AR2");
			res = EnableTimingCyclic("RemPark_Auth_Rs_AR2", 1);
			res = EnableTimingEvtTrg("RemPark_Auth_Rs_AR2", 1);
			break;
		case (1):
			tDelay = @sysvar::CH_Nodes::CH__STPDU_T_EIS_RemPark_Auth_Rs_AR2;
			if (tDelay > 0)
			{
				if (isTimerActive(Timer_EIS_RemPark_Auth_Rs_AR2) == 0)
				{
					res = SetTimingCyclic("RemPark_Auth_Rs_AR2", 1, tDelay, 1);
					setTimer (Timer_EIS_RemPark_Auth_Rs_AR2, tDelay);
					@sysvar::CH_Nodes::CH__STPDU_EIS_RemPark_Auth_Rs_AR2 = 2;
				}
			}
			else if (tDelay == 0)
			{
				if (isTimerActive(Timer_EIS_RemPark_Auth_Rs_AR2) == 0)
				{
					res = EnableTimingCyclic("RemPark_Auth_Rs_AR2", 0);
					res = EnableTimingEvtTrg("RemPark_Auth_Rs_AR2", 0);
				}
			}
			break;
		case (2):
			break;
		default:
			Write("error: wrong parameter (%d)", @this);
			stop();
			break;
	}
}

on sysvar sysvar::CH_Nodes::CH__STPDU_EIS_RemPark_Stat_EIS_AR2
{
	long res;
	long tDelay;
	switch (@this)
	{
		case (0):
			res = ResetTimingCyclic("RemPark_Stat_EIS_AR2");
			res = ResetTimingEvtTrg("RemPark_Stat_EIS_AR2");
			res = EnableTimingCyclic("RemPark_Stat_EIS_AR2", 1);
			res = EnableTimingEvtTrg("RemPark_Stat_EIS_AR2", 1);
			break;
		case (1):
			tDelay = @sysvar::CH_Nodes::CH__STPDU_T_EIS_RemPark_Stat_EIS_AR2;
			if (tDelay > 0)
			{
				if (isTimerActive(Timer_EIS_RemPark_Stat_EIS_AR2) == 0)
				{
					res = SetTimingCyclic("RemPark_Stat_EIS_AR2", 1, tDelay, 1);
					setTimer (Timer_EIS_RemPark_Stat_EIS_AR2, tDelay);
					@sysvar::CH_Nodes::CH__STPDU_EIS_RemPark_Stat_EIS_AR2 = 2;
				}
			}
			else if (tDelay == 0)
			{
				if (isTimerActive(Timer_EIS_RemPark_Stat_EIS_AR2) == 0)
				{
					res = EnableTimingCyclic("RemPark_Stat_EIS_AR2", 0);
					res = EnableTimingEvtTrg("RemPark_Stat_EIS_AR2", 0);
				}
			}
			break;
		case (2):
			break;
		default:
			Write("error: wrong parameter (%d)", @this);
			stop();
			break;
	}
}

on sysvar sysvar::CH_Nodes::CH__STPDU_EIS_RTC_Date_Time_AR2
{
	long res;
	long tDelay;
	switch (@this)
	{
		case (0):
			res = ResetTimingCyclic("RTC_Date_Time_AR2");
			res = ResetTimingEvtTrg("RTC_Date_Time_AR2");
			res = EnableTimingCyclic("RTC_Date_Time_AR2", 1);
			res = EnableTimingEvtTrg("RTC_Date_Time_AR2", 1);
			break;
		case (1):
			tDelay = @sysvar::CH_Nodes::CH__STPDU_T_EIS_RTC_Date_Time_AR2;
			if (tDelay > 0)
			{
				if (isTimerActive(Timer_EIS_RTC_Date_Time_AR2) == 0)
				{
					res = SetTimingCyclic("RTC_Date_Time_AR2", 1, tDelay, 1);
					setTimer (Timer_EIS_RTC_Date_Time_AR2, tDelay);
					@sysvar::CH_Nodes::CH__STPDU_EIS_RTC_Date_Time_AR2 = 2;
				}
			}
			else if (tDelay == 0)
			{
				if (isTimerActive(Timer_EIS_RTC_Date_Time_AR2) == 0)
				{
					res = EnableTimingCyclic("RTC_Date_Time_AR2", 0);
					res = EnableTimingEvtTrg("RTC_Date_Time_AR2", 0);
				}
			}
			break;
		case (2):
			break;
		default:
			Write("error: wrong parameter (%d)", @this);
			stop();
			break;
	}
}

on sysvar sysvar::CH_Nodes::CH__STPDU_EIS_RTC_Stat1_AR2
{
	long res;
	long tDelay;
	switch (@this)
	{
		case (0):
			res = ResetTimingCyclic("RTC_Stat1_AR2");
			res = ResetTimingEvtTrg("RTC_Stat1_AR2");
			res = EnableTimingCyclic("RTC_Stat1_AR2", 1);
			res = EnableTimingEvtTrg("RTC_Stat1_AR2", 1);
			break;
		case (1):
			tDelay = @sysvar::CH_Nodes::CH__STPDU_T_EIS_RTC_Stat1_AR2;
			if (tDelay > 0)
			{
				if (isTimerActive(Timer_EIS_RTC_Stat1_AR2) == 0)
				{
					res = SetTimingCyclic("RTC_Stat1_AR2", 1, tDelay, 1);
					setTimer (Timer_EIS_RTC_Stat1_AR2, tDelay);
					@sysvar::CH_Nodes::CH__STPDU_EIS_RTC_Stat1_AR2 = 2;
				}
			}
			else if (tDelay == 0)
			{
				if (isTimerActive(Timer_EIS_RTC_Stat1_AR2) == 0)
				{
					res = EnableTimingCyclic("RTC_Stat1_AR2", 0);
					res = EnableTimingEvtTrg("RTC_Stat1_AR2", 0);
				}
			}
			break;
		case (2):
			break;
		default:
			Write("error: wrong parameter (%d)", @this);
			stop();
			break;
	}
}

on sysvar sysvar::CH_Nodes::CH__STPDU_EIS_SADR_Trgr_FCW_AR2
{
	long res;
	long tDelay;
	switch (@this)
	{
		case (0):
			res = ResetTimingCyclic("SADR_Trgr_FCW_AR2");
			res = ResetTimingEvtTrg("SADR_Trgr_FCW_AR2");
			res = EnableTimingCyclic("SADR_Trgr_FCW_AR2", 1);
			res = EnableTimingEvtTrg("SADR_Trgr_FCW_AR2", 1);
			break;
		case (1):
			tDelay = @sysvar::CH_Nodes::CH__STPDU_T_EIS_SADR_Trgr_FCW_AR2;
			if (tDelay > 0)
			{
				if (isTimerActive(Timer_EIS_SADR_Trgr_FCW_AR2) == 0)
				{
					res = SetTimingCyclic("SADR_Trgr_FCW_AR2", 1, tDelay, 1);
					setTimer (Timer_EIS_SADR_Trgr_FCW_AR2, tDelay);
					@sysvar::CH_Nodes::CH__STPDU_EIS_SADR_Trgr_FCW_AR2 = 2;
				}
			}
			else if (tDelay == 0)
			{
				if (isTimerActive(Timer_EIS_SADR_Trgr_FCW_AR2) == 0)
				{
					res = EnableTimingCyclic("SADR_Trgr_FCW_AR2", 0);
					res = EnableTimingEvtTrg("SADR_Trgr_FCW_AR2", 0);
				}
			}
			break;
		case (2):
			break;
		default:
			Write("error: wrong parameter (%d)", @this);
			stop();
			break;
	}
}

on sysvar sysvar::CH_Nodes::CH__STPDU_EIS_SeatAdj_FL_Rq_AR
{
	long res;
	long tDelay;
	switch (@this)
	{
		case (0):
			res = ResetTimingCyclic("SeatAdj_FL_Rq_AR");
			res = ResetTimingEvtTrg("SeatAdj_FL_Rq_AR");
			res = EnableTimingCyclic("SeatAdj_FL_Rq_AR", 1);
			res = EnableTimingEvtTrg("SeatAdj_FL_Rq_AR", 1);
			break;
		case (1):
			tDelay = @sysvar::CH_Nodes::CH__STPDU_T_EIS_SeatAdj_FL_Rq_AR;
			if (tDelay > 0)
			{
				if (isTimerActive(Timer_EIS_SeatAdj_FL_Rq_AR) == 0)
				{
					res = SetTimingCyclic("SeatAdj_FL_Rq_AR", 1, tDelay, 1);
					setTimer (Timer_EIS_SeatAdj_FL_Rq_AR, tDelay);
					@sysvar::CH_Nodes::CH__STPDU_EIS_SeatAdj_FL_Rq_AR = 2;
				}
			}
			else if (tDelay == 0)
			{
				if (isTimerActive(Timer_EIS_SeatAdj_FL_Rq_AR) == 0)
				{
					res = EnableTimingCyclic("SeatAdj_FL_Rq_AR", 0);
					res = EnableTimingEvtTrg("SeatAdj_FL_Rq_AR", 0);
				}
			}
			break;
		case (2):
			break;
		default:
			Write("error: wrong parameter (%d)", @this);
			stop();
			break;
	}
}

on sysvar sysvar::CH_Nodes::CH__STPDU_EIS_SeatAdj_FR_Rq_AR
{
	long res;
	long tDelay;
	switch (@this)
	{
		case (0):
			res = ResetTimingCyclic("SeatAdj_FR_Rq_AR");
			res = ResetTimingEvtTrg("SeatAdj_FR_Rq_AR");
			res = EnableTimingCyclic("SeatAdj_FR_Rq_AR", 1);
			res = EnableTimingEvtTrg("SeatAdj_FR_Rq_AR", 1);
			break;
		case (1):
			tDelay = @sysvar::CH_Nodes::CH__STPDU_T_EIS_SeatAdj_FR_Rq_AR;
			if (tDelay > 0)
			{
				if (isTimerActive(Timer_EIS_SeatAdj_FR_Rq_AR) == 0)
				{
					res = SetTimingCyclic("SeatAdj_FR_Rq_AR", 1, tDelay, 1);
					setTimer (Timer_EIS_SeatAdj_FR_Rq_AR, tDelay);
					@sysvar::CH_Nodes::CH__STPDU_EIS_SeatAdj_FR_Rq_AR = 2;
				}
			}
			else if (tDelay == 0)
			{
				if (isTimerActive(Timer_EIS_SeatAdj_FR_Rq_AR) == 0)
				{
					res = EnableTimingCyclic("SeatAdj_FR_Rq_AR", 0);
					res = EnableTimingEvtTrg("SeatAdj_FR_Rq_AR", 0);
				}
			}
			break;
		case (2):
			break;
		default:
			Write("error: wrong parameter (%d)", @this);
			stop();
			break;
	}
}

on sysvar sysvar::CH_Nodes::CH__STPDU_EIS_SPCR_Stat_BC_F_AR2
{
	long res;
	long tDelay;
	switch (@this)
	{
		case (0):
			res = ResetTimingCyclic("SPCR_Stat_BC_F_AR2");
			res = ResetTimingEvtTrg("SPCR_Stat_BC_F_AR2");
			res = EnableTimingCyclic("SPCR_Stat_BC_F_AR2", 1);
			res = EnableTimingEvtTrg("SPCR_Stat_BC_F_AR2", 1);
			break;
		case (1):
			tDelay = @sysvar::CH_Nodes::CH__STPDU_T_EIS_SPCR_Stat_BC_F_AR2;
			if (tDelay > 0)
			{
				if (isTimerActive(Timer_EIS_SPCR_Stat_BC_F_AR2) == 0)
				{
					res = SetTimingCyclic("SPCR_Stat_BC_F_AR2", 1, tDelay, 1);
					setTimer (Timer_EIS_SPCR_Stat_BC_F_AR2, tDelay);
					@sysvar::CH_Nodes::CH__STPDU_EIS_SPCR_Stat_BC_F_AR2 = 2;
				}
			}
			else if (tDelay == 0)
			{
				if (isTimerActive(Timer_EIS_SPCR_Stat_BC_F_AR2) == 0)
				{
					res = EnableTimingCyclic("SPCR_Stat_BC_F_AR2", 0);
					res = EnableTimingEvtTrg("SPCR_Stat_BC_F_AR2", 0);
				}
			}
			break;
		case (2):
			break;
		default:
			Write("error: wrong parameter (%d)", @this);
			stop();
			break;
	}
}

on sysvar sysvar::CH_Nodes::CH__STPDU_EIS_SPL_Obj1_Obj2_NV_AR2
{
	long res;
	long tDelay;
	switch (@this)
	{
		case (0):
			res = ResetTimingCyclic("SPL_Obj1_Obj2_NV_AR2");
			res = ResetTimingEvtTrg("SPL_Obj1_Obj2_NV_AR2");
			res = EnableTimingCyclic("SPL_Obj1_Obj2_NV_AR2", 1);
			res = EnableTimingEvtTrg("SPL_Obj1_Obj2_NV_AR2", 1);
			break;
		case (1):
			tDelay = @sysvar::CH_Nodes::CH__STPDU_T_EIS_SPL_Obj1_Obj2_NV_AR2;
			if (tDelay > 0)
			{
				if (isTimerActive(Timer_EIS_SPL_Obj1_Obj2_NV_AR2) == 0)
				{
					res = SetTimingCyclic("SPL_Obj1_Obj2_NV_AR2", 1, tDelay, 1);
					setTimer (Timer_EIS_SPL_Obj1_Obj2_NV_AR2, tDelay);
					@sysvar::CH_Nodes::CH__STPDU_EIS_SPL_Obj1_Obj2_NV_AR2 = 2;
				}
			}
			else if (tDelay == 0)
			{
				if (isTimerActive(Timer_EIS_SPL_Obj1_Obj2_NV_AR2) == 0)
				{
					res = EnableTimingCyclic("SPL_Obj1_Obj2_NV_AR2", 0);
					res = EnableTimingEvtTrg("SPL_Obj1_Obj2_NV_AR2", 0);
				}
			}
			break;
		case (2):
			break;
		default:
			Write("error: wrong parameter (%d)", @this);
			stop();
			break;
	}
}

on sysvar sysvar::CH_Nodes::CH__STPDU_EIS_SPV_Actn_Rq_AR2
{
	long res;
	long tDelay;
	switch (@this)
	{
		case (0):
			res = ResetTimingCyclic("SPV_Actn_Rq_AR2");
			res = ResetTimingEvtTrg("SPV_Actn_Rq_AR2");
			res = EnableTimingCyclic("SPV_Actn_Rq_AR2", 1);
			res = EnableTimingEvtTrg("SPV_Actn_Rq_AR2", 1);
			break;
		case (1):
			tDelay = @sysvar::CH_Nodes::CH__STPDU_T_EIS_SPV_Actn_Rq_AR2;
			if (tDelay > 0)
			{
				if (isTimerActive(Timer_EIS_SPV_Actn_Rq_AR2) == 0)
				{
					res = SetTimingCyclic("SPV_Actn_Rq_AR2", 1, tDelay, 1);
					setTimer (Timer_EIS_SPV_Actn_Rq_AR2, tDelay);
					@sysvar::CH_Nodes::CH__STPDU_EIS_SPV_Actn_Rq_AR2 = 2;
				}
			}
			else if (tDelay == 0)
			{
				if (isTimerActive(Timer_EIS_SPV_Actn_Rq_AR2) == 0)
				{
					res = EnableTimingCyclic("SPV_Actn_Rq_AR2", 0);
					res = EnableTimingEvtTrg("SPV_Actn_Rq_AR2", 0);
				}
			}
			break;
		case (2):
			break;
		default:
			Write("error: wrong parameter (%d)", @this);
			stop();
			break;
	}
}

on sysvar sysvar::CH_Nodes::CH__STPDU_EIS_SPV_Alm_Rq_AR
{
	long res;
	long tDelay;
	switch (@this)
	{
		case (0):
			res = ResetTimingCyclic("SPV_Alm_Rq_AR");
			res = ResetTimingEvtTrg("SPV_Alm_Rq_AR");
			res = EnableTimingCyclic("SPV_Alm_Rq_AR", 1);
			res = EnableTimingEvtTrg("SPV_Alm_Rq_AR", 1);
			break;
		case (1):
			tDelay = @sysvar::CH_Nodes::CH__STPDU_T_EIS_SPV_Alm_Rq_AR;
			if (tDelay > 0)
			{
				if (isTimerActive(Timer_EIS_SPV_Alm_Rq_AR) == 0)
				{
					res = SetTimingCyclic("SPV_Alm_Rq_AR", 1, tDelay, 1);
					setTimer (Timer_EIS_SPV_Alm_Rq_AR, tDelay);
					@sysvar::CH_Nodes::CH__STPDU_EIS_SPV_Alm_Rq_AR = 2;
				}
			}
			else if (tDelay == 0)
			{
				if (isTimerActive(Timer_EIS_SPV_Alm_Rq_AR) == 0)
				{
					res = EnableTimingCyclic("SPV_Alm_Rq_AR", 0);
					res = EnableTimingEvtTrg("SPV_Alm_Rq_AR", 0);
				}
			}
			break;
		case (2):
			break;
		default:
			Write("error: wrong parameter (%d)", @this);
			stop();
			break;
	}
}

on sysvar sysvar::CH_Nodes::CH__STPDU_EIS_SPV_Stat_AR2
{
	long res;
	long tDelay;
	switch (@this)
	{
		case (0):
			res = ResetTimingCyclic("SPV_Stat_AR2");
			res = ResetTimingEvtTrg("SPV_Stat_AR2");
			res = EnableTimingCyclic("SPV_Stat_AR2", 1);
			res = EnableTimingEvtTrg("SPV_Stat_AR2", 1);
			break;
		case (1):
			tDelay = @sysvar::CH_Nodes::CH__STPDU_T_EIS_SPV_Stat_AR2;
			if (tDelay > 0)
			{
				if (isTimerActive(Timer_EIS_SPV_Stat_AR2) == 0)
				{
					res = SetTimingCyclic("SPV_Stat_AR2", 1, tDelay, 1);
					setTimer (Timer_EIS_SPV_Stat_AR2, tDelay);
					@sysvar::CH_Nodes::CH__STPDU_EIS_SPV_Stat_AR2 = 2;
				}
			}
			else if (tDelay == 0)
			{
				if (isTimerActive(Timer_EIS_SPV_Stat_AR2) == 0)
				{
					res = EnableTimingCyclic("SPV_Stat_AR2", 0);
					res = EnableTimingEvtTrg("SPV_Stat_AR2", 0);
				}
			}
			break;
		case (2):
			break;
		default:
			Write("error: wrong parameter (%d)", @this);
			stop();
			break;
	}
}

on sysvar sysvar::CH_Nodes::CH__STPDU_EIS_SVS_Rq_HU_AR2
{
	long res;
	long tDelay;
	switch (@this)
	{
		case (0):
			res = ResetTimingCyclic("SVS_Rq_HU_AR2");
			res = ResetTimingEvtTrg("SVS_Rq_HU_AR2");
			res = EnableTimingCyclic("SVS_Rq_HU_AR2", 1);
			res = EnableTimingEvtTrg("SVS_Rq_HU_AR2", 1);
			break;
		case (1):
			tDelay = @sysvar::CH_Nodes::CH__STPDU_T_EIS_SVS_Rq_HU_AR2;
			if (tDelay > 0)
			{
				if (isTimerActive(Timer_EIS_SVS_Rq_HU_AR2) == 0)
				{
					res = SetTimingCyclic("SVS_Rq_HU_AR2", 1, tDelay, 1);
					setTimer (Timer_EIS_SVS_Rq_HU_AR2, tDelay);
					@sysvar::CH_Nodes::CH__STPDU_EIS_SVS_Rq_HU_AR2 = 2;
				}
			}
			else if (tDelay == 0)
			{
				if (isTimerActive(Timer_EIS_SVS_Rq_HU_AR2) == 0)
				{
					res = EnableTimingCyclic("SVS_Rq_HU_AR2", 0);
					res = EnableTimingEvtTrg("SVS_Rq_HU_AR2", 0);
				}
			}
			break;
		case (2):
			break;
		default:
			Write("error: wrong parameter (%d)", @this);
			stop();
			break;
	}
}

on sysvar sysvar::CH_Nodes::CH__STPDU_EIS_TBCSC_DAC_EPS_AR2
{
	long res;
	long tDelay;
	switch (@this)
	{
		case (0):
			res = ResetTimingCyclic("TBCSC_DAC_EPS_AR2");
			res = ResetTimingEvtTrg("TBCSC_DAC_EPS_AR2");
			res = EnableTimingCyclic("TBCSC_DAC_EPS_AR2", 1);
			res = EnableTimingEvtTrg("TBCSC_DAC_EPS_AR2", 1);
			break;
		case (1):
			tDelay = @sysvar::CH_Nodes::CH__STPDU_T_EIS_TBCSC_DAC_EPS_AR2;
			if (tDelay > 0)
			{
				if (isTimerActive(Timer_EIS_TBCSC_DAC_EPS_AR2) == 0)
				{
					res = SetTimingCyclic("TBCSC_DAC_EPS_AR2", 1, tDelay, 1);
					setTimer (Timer_EIS_TBCSC_DAC_EPS_AR2, tDelay);
					@sysvar::CH_Nodes::CH__STPDU_EIS_TBCSC_DAC_EPS_AR2 = 2;
				}
			}
			else if (tDelay == 0)
			{
				if (isTimerActive(Timer_EIS_TBCSC_DAC_EPS_AR2) == 0)
				{
					res = EnableTimingCyclic("TBCSC_DAC_EPS_AR2", 0);
					res = EnableTimingEvtTrg("TBCSC_DAC_EPS_AR2", 0);
				}
			}
			break;
		case (2):
			break;
		default:
			Write("error: wrong parameter (%d)", @this);
			stop();
			break;
	}
}

on sysvar sysvar::CH_Nodes::CH__STPDU_EIS_TBCSC_DAC_ESP_AR2
{
	long res;
	long tDelay;
	switch (@this)
	{
		case (0):
			res = ResetTimingCyclic("TBCSC_DAC_ESP_AR2");
			res = ResetTimingEvtTrg("TBCSC_DAC_ESP_AR2");
			res = EnableTimingCyclic("TBCSC_DAC_ESP_AR2", 1);
			res = EnableTimingEvtTrg("TBCSC_DAC_ESP_AR2", 1);
			break;
		case (1):
			tDelay = @sysvar::CH_Nodes::CH__STPDU_T_EIS_TBCSC_DAC_ESP_AR2;
			if (tDelay > 0)
			{
				if (isTimerActive(Timer_EIS_TBCSC_DAC_ESP_AR2) == 0)
				{
					res = SetTimingCyclic("TBCSC_DAC_ESP_AR2", 1, tDelay, 1);
					setTimer (Timer_EIS_TBCSC_DAC_ESP_AR2, tDelay);
					@sysvar::CH_Nodes::CH__STPDU_EIS_TBCSC_DAC_ESP_AR2 = 2;
				}
			}
			else if (tDelay == 0)
			{
				if (isTimerActive(Timer_EIS_TBCSC_DAC_ESP_AR2) == 0)
				{
					res = EnableTimingCyclic("TBCSC_DAC_ESP_AR2", 0);
					res = EnableTimingEvtTrg("TBCSC_DAC_ESP_AR2", 0);
				}
			}
			break;
		case (2):
			break;
		default:
			Write("error: wrong parameter (%d)", @this);
			stop();
			break;
	}
}

on sysvar sysvar::CH_Nodes::CH__STPDU_EIS_TBCSC_Hi_Rq1_AR2
{
	long res;
	long tDelay;
	switch (@this)
	{
		case (0):
			res = ResetTimingCyclic("TBCSC_Hi_Rq1_AR2");
			res = ResetTimingEvtTrg("TBCSC_Hi_Rq1_AR2");
			res = EnableTimingCyclic("TBCSC_Hi_Rq1_AR2", 1);
			res = EnableTimingEvtTrg("TBCSC_Hi_Rq1_AR2", 1);
			break;
		case (1):
			tDelay = @sysvar::CH_Nodes::CH__STPDU_T_EIS_TBCSC_Hi_Rq1_AR2;
			if (tDelay > 0)
			{
				if (isTimerActive(Timer_EIS_TBCSC_Hi_Rq1_AR2) == 0)
				{
					res = SetTimingCyclic("TBCSC_Hi_Rq1_AR2", 1, tDelay, 1);
					setTimer (Timer_EIS_TBCSC_Hi_Rq1_AR2, tDelay);
					@sysvar::CH_Nodes::CH__STPDU_EIS_TBCSC_Hi_Rq1_AR2 = 2;
				}
			}
			else if (tDelay == 0)
			{
				if (isTimerActive(Timer_EIS_TBCSC_Hi_Rq1_AR2) == 0)
				{
					res = EnableTimingCyclic("TBCSC_Hi_Rq1_AR2", 0);
					res = EnableTimingEvtTrg("TBCSC_Hi_Rq1_AR2", 0);
				}
			}
			break;
		case (2):
			break;
		default:
			Write("error: wrong parameter (%d)", @this);
			stop();
			break;
	}
}

on sysvar sysvar::CH_Nodes::CH__STPDU_EIS_TBCSC_Hi_Rq2_AR2
{
	long res;
	long tDelay;
	switch (@this)
	{
		case (0):
			res = ResetTimingCyclic("TBCSC_Hi_Rq2_AR2");
			res = ResetTimingEvtTrg("TBCSC_Hi_Rq2_AR2");
			res = EnableTimingCyclic("TBCSC_Hi_Rq2_AR2", 1);
			res = EnableTimingEvtTrg("TBCSC_Hi_Rq2_AR2", 1);
			break;
		case (1):
			tDelay = @sysvar::CH_Nodes::CH__STPDU_T_EIS_TBCSC_Hi_Rq2_AR2;
			if (tDelay > 0)
			{
				if (isTimerActive(Timer_EIS_TBCSC_Hi_Rq2_AR2) == 0)
				{
					res = SetTimingCyclic("TBCSC_Hi_Rq2_AR2", 1, tDelay, 1);
					setTimer (Timer_EIS_TBCSC_Hi_Rq2_AR2, tDelay);
					@sysvar::CH_Nodes::CH__STPDU_EIS_TBCSC_Hi_Rq2_AR2 = 2;
				}
			}
			else if (tDelay == 0)
			{
				if (isTimerActive(Timer_EIS_TBCSC_Hi_Rq2_AR2) == 0)
				{
					res = EnableTimingCyclic("TBCSC_Hi_Rq2_AR2", 0);
					res = EnableTimingEvtTrg("TBCSC_Hi_Rq2_AR2", 0);
				}
			}
			break;
		case (2):
			break;
		default:
			Write("error: wrong parameter (%d)", @this);
			stop();
			break;
	}
}

on sysvar sysvar::CH_Nodes::CH__STPDU_EIS_TBCSC_Lo_Rq1_AR2
{
	long res;
	long tDelay;
	switch (@this)
	{
		case (0):
			res = ResetTimingCyclic("TBCSC_Lo_Rq1_AR2");
			res = ResetTimingEvtTrg("TBCSC_Lo_Rq1_AR2");
			res = EnableTimingCyclic("TBCSC_Lo_Rq1_AR2", 1);
			res = EnableTimingEvtTrg("TBCSC_Lo_Rq1_AR2", 1);
			break;
		case (1):
			tDelay = @sysvar::CH_Nodes::CH__STPDU_T_EIS_TBCSC_Lo_Rq1_AR2;
			if (tDelay > 0)
			{
				if (isTimerActive(Timer_EIS_TBCSC_Lo_Rq1_AR2) == 0)
				{
					res = SetTimingCyclic("TBCSC_Lo_Rq1_AR2", 1, tDelay, 1);
					setTimer (Timer_EIS_TBCSC_Lo_Rq1_AR2, tDelay);
					@sysvar::CH_Nodes::CH__STPDU_EIS_TBCSC_Lo_Rq1_AR2 = 2;
				}
			}
			else if (tDelay == 0)
			{
				if (isTimerActive(Timer_EIS_TBCSC_Lo_Rq1_AR2) == 0)
				{
					res = EnableTimingCyclic("TBCSC_Lo_Rq1_AR2", 0);
					res = EnableTimingEvtTrg("TBCSC_Lo_Rq1_AR2", 0);
				}
			}
			break;
		case (2):
			break;
		default:
			Write("error: wrong parameter (%d)", @this);
			stop();
			break;
	}
}

on sysvar sysvar::CH_Nodes::CH__STPDU_EIS_TBCSC_Lo_Rq2_AR2
{
	long res;
	long tDelay;
	switch (@this)
	{
		case (0):
			res = ResetTimingCyclic("TBCSC_Lo_Rq2_AR2");
			res = ResetTimingEvtTrg("TBCSC_Lo_Rq2_AR2");
			res = EnableTimingCyclic("TBCSC_Lo_Rq2_AR2", 1);
			res = EnableTimingEvtTrg("TBCSC_Lo_Rq2_AR2", 1);
			break;
		case (1):
			tDelay = @sysvar::CH_Nodes::CH__STPDU_T_EIS_TBCSC_Lo_Rq2_AR2;
			if (tDelay > 0)
			{
				if (isTimerActive(Timer_EIS_TBCSC_Lo_Rq2_AR2) == 0)
				{
					res = SetTimingCyclic("TBCSC_Lo_Rq2_AR2", 1, tDelay, 1);
					setTimer (Timer_EIS_TBCSC_Lo_Rq2_AR2, tDelay);
					@sysvar::CH_Nodes::CH__STPDU_EIS_TBCSC_Lo_Rq2_AR2 = 2;
				}
			}
			else if (tDelay == 0)
			{
				if (isTimerActive(Timer_EIS_TBCSC_Lo_Rq2_AR2) == 0)
				{
					res = EnableTimingCyclic("TBCSC_Lo_Rq2_AR2", 0);
					res = EnableTimingEvtTrg("TBCSC_Lo_Rq2_AR2", 0);
				}
			}
			break;
		case (2):
			break;
		default:
			Write("error: wrong parameter (%d)", @this);
			stop();
			break;
	}
}

on sysvar sysvar::CH_Nodes::CH__STPDU_EIS_TC_Distance_AR
{
	long res;
	long tDelay;
	switch (@this)
	{
		case (0):
			res = ResetTimingCyclic("TC_Distance_AR");
			res = ResetTimingEvtTrg("TC_Distance_AR");
			res = EnableTimingCyclic("TC_Distance_AR", 1);
			res = EnableTimingEvtTrg("TC_Distance_AR", 1);
			break;
		case (1):
			tDelay = @sysvar::CH_Nodes::CH__STPDU_T_EIS_TC_Distance_AR;
			if (tDelay > 0)
			{
				if (isTimerActive(Timer_EIS_TC_Distance_AR) == 0)
				{
					res = SetTimingCyclic("TC_Distance_AR", 1, tDelay, 1);
					setTimer (Timer_EIS_TC_Distance_AR, tDelay);
					@sysvar::CH_Nodes::CH__STPDU_EIS_TC_Distance_AR = 2;
				}
			}
			else if (tDelay == 0)
			{
				if (isTimerActive(Timer_EIS_TC_Distance_AR) == 0)
				{
					res = EnableTimingCyclic("TC_Distance_AR", 0);
					res = EnableTimingEvtTrg("TC_Distance_AR", 0);
				}
			}
			break;
		case (2):
			break;
		default:
			Write("error: wrong parameter (%d)", @this);
			stop();
			break;
	}
}

on sysvar sysvar::CH_Nodes::CH__STPDU_EIS_TGW_DateTm_Stat_AR
{
	long res;
	long tDelay;
	switch (@this)
	{
		case (0):
			res = ResetTimingCyclic("TGW_DateTm_Stat_AR");
			res = ResetTimingEvtTrg("TGW_DateTm_Stat_AR");
			res = EnableTimingCyclic("TGW_DateTm_Stat_AR", 1);
			res = EnableTimingEvtTrg("TGW_DateTm_Stat_AR", 1);
			break;
		case (1):
			tDelay = @sysvar::CH_Nodes::CH__STPDU_T_EIS_TGW_DateTm_Stat_AR;
			if (tDelay > 0)
			{
				if (isTimerActive(Timer_EIS_TGW_DateTm_Stat_AR) == 0)
				{
					res = SetTimingCyclic("TGW_DateTm_Stat_AR", 1, tDelay, 1);
					setTimer (Timer_EIS_TGW_DateTm_Stat_AR, tDelay);
					@sysvar::CH_Nodes::CH__STPDU_EIS_TGW_DateTm_Stat_AR = 2;
				}
			}
			else if (tDelay == 0)
			{
				if (isTimerActive(Timer_EIS_TGW_DateTm_Stat_AR) == 0)
				{
					res = EnableTimingCyclic("TGW_DateTm_Stat_AR", 0);
					res = EnableTimingEvtTrg("TGW_DateTm_Stat_AR", 0);
				}
			}
			break;
		case (2):
			break;
		default:
			Write("error: wrong parameter (%d)", @this);
			stop();
			break;
	}
}

on sysvar sysvar::CH_Nodes::CH__STPDU_EIS_Tire_State_AR2
{
	long res;
	long tDelay;
	switch (@this)
	{
		case (0):
			res = ResetTimingCyclic("Tire_State_AR2");
			res = ResetTimingEvtTrg("Tire_State_AR2");
			res = EnableTimingCyclic("Tire_State_AR2", 1);
			res = EnableTimingEvtTrg("Tire_State_AR2", 1);
			break;
		case (1):
			tDelay = @sysvar::CH_Nodes::CH__STPDU_T_EIS_Tire_State_AR2;
			if (tDelay > 0)
			{
				if (isTimerActive(Timer_EIS_Tire_State_AR2) == 0)
				{
					res = SetTimingCyclic("Tire_State_AR2", 1, tDelay, 1);
					setTimer (Timer_EIS_Tire_State_AR2, tDelay);
					@sysvar::CH_Nodes::CH__STPDU_EIS_Tire_State_AR2 = 2;
				}
			}
			else if (tDelay == 0)
			{
				if (isTimerActive(Timer_EIS_Tire_State_AR2) == 0)
				{
					res = EnableTimingCyclic("Tire_State_AR2", 0);
					res = EnableTimingEvtTrg("Tire_State_AR2", 0);
				}
			}
			break;
		case (2):
			break;
		default:
			Write("error: wrong parameter (%d)", @this);
			stop();
			break;
	}
}

on sysvar sysvar::CH_Nodes::CH__STPDU_EIS_TrafficInfo_AR
{
	long res;
	long tDelay;
	switch (@this)
	{
		case (0):
			res = ResetTimingCyclic("TrafficInfo_AR");
			res = ResetTimingEvtTrg("TrafficInfo_AR");
			res = EnableTimingCyclic("TrafficInfo_AR", 1);
			res = EnableTimingEvtTrg("TrafficInfo_AR", 1);
			break;
		case (1):
			tDelay = @sysvar::CH_Nodes::CH__STPDU_T_EIS_TrafficInfo_AR;
			if (tDelay > 0)
			{
				if (isTimerActive(Timer_EIS_TrafficInfo_AR) == 0)
				{
					res = SetTimingCyclic("TrafficInfo_AR", 1, tDelay, 1);
					setTimer (Timer_EIS_TrafficInfo_AR, tDelay);
					@sysvar::CH_Nodes::CH__STPDU_EIS_TrafficInfo_AR = 2;
				}
			}
			else if (tDelay == 0)
			{
				if (isTimerActive(Timer_EIS_TrafficInfo_AR) == 0)
				{
					res = EnableTimingCyclic("TrafficInfo_AR", 0);
					res = EnableTimingEvtTrg("TrafficInfo_AR", 0);
				}
			}
			break;
		case (2):
			break;
		default:
			Write("error: wrong parameter (%d)", @this);
			stop();
			break;
	}
}

on sysvar sysvar::CH_Nodes::CH__STPDU_EIS_Trailer_Stat_AR2
{
	long res;
	long tDelay;
	switch (@this)
	{
		case (0):
			res = ResetTimingCyclic("Trailer_Stat_AR2");
			res = ResetTimingEvtTrg("Trailer_Stat_AR2");
			res = EnableTimingCyclic("Trailer_Stat_AR2", 1);
			res = EnableTimingEvtTrg("Trailer_Stat_AR2", 1);
			break;
		case (1):
			tDelay = @sysvar::CH_Nodes::CH__STPDU_T_EIS_Trailer_Stat_AR2;
			if (tDelay > 0)
			{
				if (isTimerActive(Timer_EIS_Trailer_Stat_AR2) == 0)
				{
					res = SetTimingCyclic("Trailer_Stat_AR2", 1, tDelay, 1);
					setTimer (Timer_EIS_Trailer_Stat_AR2, tDelay);
					@sysvar::CH_Nodes::CH__STPDU_EIS_Trailer_Stat_AR2 = 2;
				}
			}
			else if (tDelay == 0)
			{
				if (isTimerActive(Timer_EIS_Trailer_Stat_AR2) == 0)
				{
					res = EnableTimingCyclic("Trailer_Stat_AR2", 0);
					res = EnableTimingEvtTrg("Trailer_Stat_AR2", 0);
				}
			}
			break;
		case (2):
			break;
		default:
			Write("error: wrong parameter (%d)", @this);
			stop();
			break;
	}
}

on sysvar sysvar::CH_Nodes::CH__STPDU_EIS_TSA_Disp_Rq1_AR2
{
	long res;
	long tDelay;
	switch (@this)
	{
		case (0):
			res = ResetTimingCyclic("TSA_Disp_Rq1_AR2");
			res = ResetTimingEvtTrg("TSA_Disp_Rq1_AR2");
			res = EnableTimingCyclic("TSA_Disp_Rq1_AR2", 1);
			res = EnableTimingEvtTrg("TSA_Disp_Rq1_AR2", 1);
			break;
		case (1):
			tDelay = @sysvar::CH_Nodes::CH__STPDU_T_EIS_TSA_Disp_Rq1_AR2;
			if (tDelay > 0)
			{
				if (isTimerActive(Timer_EIS_TSA_Disp_Rq1_AR2) == 0)
				{
					res = SetTimingCyclic("TSA_Disp_Rq1_AR2", 1, tDelay, 1);
					setTimer (Timer_EIS_TSA_Disp_Rq1_AR2, tDelay);
					@sysvar::CH_Nodes::CH__STPDU_EIS_TSA_Disp_Rq1_AR2 = 2;
				}
			}
			else if (tDelay == 0)
			{
				if (isTimerActive(Timer_EIS_TSA_Disp_Rq1_AR2) == 0)
				{
					res = EnableTimingCyclic("TSA_Disp_Rq1_AR2", 0);
					res = EnableTimingEvtTrg("TSA_Disp_Rq1_AR2", 0);
				}
			}
			break;
		case (2):
			break;
		default:
			Write("error: wrong parameter (%d)", @this);
			stop();
			break;
	}
}

on sysvar sysvar::CH_Nodes::CH__STPDU_EIS_TSA_Disp_Rq2_AR
{
	long res;
	long tDelay;
	switch (@this)
	{
		case (0):
			res = ResetTimingCyclic("TSA_Disp_Rq2_AR");
			res = ResetTimingEvtTrg("TSA_Disp_Rq2_AR");
			res = EnableTimingCyclic("TSA_Disp_Rq2_AR", 1);
			res = EnableTimingEvtTrg("TSA_Disp_Rq2_AR", 1);
			break;
		case (1):
			tDelay = @sysvar::CH_Nodes::CH__STPDU_T_EIS_TSA_Disp_Rq2_AR;
			if (tDelay > 0)
			{
				if (isTimerActive(Timer_EIS_TSA_Disp_Rq2_AR) == 0)
				{
					res = SetTimingCyclic("TSA_Disp_Rq2_AR", 1, tDelay, 1);
					setTimer (Timer_EIS_TSA_Disp_Rq2_AR, tDelay);
					@sysvar::CH_Nodes::CH__STPDU_EIS_TSA_Disp_Rq2_AR = 2;
				}
			}
			else if (tDelay == 0)
			{
				if (isTimerActive(Timer_EIS_TSA_Disp_Rq2_AR) == 0)
				{
					res = EnableTimingCyclic("TSA_Disp_Rq2_AR", 0);
					res = EnableTimingEvtTrg("TSA_Disp_Rq2_AR", 0);
				}
			}
			break;
		case (2):
			break;
		default:
			Write("error: wrong parameter (%d)", @this);
			stop();
			break;
	}
}

on sysvar sysvar::CH_Nodes::CH__STPDU_EIS_TSA_Disp_Rq3_AR
{
	long res;
	long tDelay;
	switch (@this)
	{
		case (0):
			res = ResetTimingCyclic("TSA_Disp_Rq3_AR");
			res = ResetTimingEvtTrg("TSA_Disp_Rq3_AR");
			res = EnableTimingCyclic("TSA_Disp_Rq3_AR", 1);
			res = EnableTimingEvtTrg("TSA_Disp_Rq3_AR", 1);
			break;
		case (1):
			tDelay = @sysvar::CH_Nodes::CH__STPDU_T_EIS_TSA_Disp_Rq3_AR;
			if (tDelay > 0)
			{
				if (isTimerActive(Timer_EIS_TSA_Disp_Rq3_AR) == 0)
				{
					res = SetTimingCyclic("TSA_Disp_Rq3_AR", 1, tDelay, 1);
					setTimer (Timer_EIS_TSA_Disp_Rq3_AR, tDelay);
					@sysvar::CH_Nodes::CH__STPDU_EIS_TSA_Disp_Rq3_AR = 2;
				}
			}
			else if (tDelay == 0)
			{
				if (isTimerActive(Timer_EIS_TSA_Disp_Rq3_AR) == 0)
				{
					res = EnableTimingCyclic("TSA_Disp_Rq3_AR", 0);
					res = EnableTimingEvtTrg("TSA_Disp_Rq3_AR", 0);
				}
			}
			break;
		case (2):
			break;
		default:
			Write("error: wrong parameter (%d)", @this);
			stop();
			break;
	}
}

on sysvar sysvar::CH_Nodes::CH__STPDU_EIS_VehAccel_X_Rq_Gw_AR2
{
	long res;
	long tDelay;
	switch (@this)
	{
		case (0):
			res = ResetTimingCyclic("VehAccel_X_Rq_Gw_AR2");
			res = ResetTimingEvtTrg("VehAccel_X_Rq_Gw_AR2");
			res = EnableTimingCyclic("VehAccel_X_Rq_Gw_AR2", 1);
			res = EnableTimingEvtTrg("VehAccel_X_Rq_Gw_AR2", 1);
			break;
		case (1):
			tDelay = @sysvar::CH_Nodes::CH__STPDU_T_EIS_VehAccel_X_Rq_Gw_AR2;
			if (tDelay > 0)
			{
				if (isTimerActive(Timer_EIS_VehAccel_X_Rq_Gw_AR2) == 0)
				{
					res = SetTimingCyclic("VehAccel_X_Rq_Gw_AR2", 1, tDelay, 1);
					setTimer (Timer_EIS_VehAccel_X_Rq_Gw_AR2, tDelay);
					@sysvar::CH_Nodes::CH__STPDU_EIS_VehAccel_X_Rq_Gw_AR2 = 2;
				}
			}
			else if (tDelay == 0)
			{
				if (isTimerActive(Timer_EIS_VehAccel_X_Rq_Gw_AR2) == 0)
				{
					res = EnableTimingCyclic("VehAccel_X_Rq_Gw_AR2", 0);
					res = EnableTimingEvtTrg("VehAccel_X_Rq_Gw_AR2", 0);
				}
			}
			break;
		case (2):
			break;
		default:
			Write("error: wrong parameter (%d)", @this);
			stop();
			break;
	}
}

on sysvar sysvar::CH_Nodes::CH__STPDU_EIS_VIN_AR
{
	long res;
	long tDelay;
	switch (@this)
	{
		case (0):
			res = ResetTimingCyclic("VIN_AR");
			res = ResetTimingEvtTrg("VIN_AR");
			res = EnableTimingCyclic("VIN_AR", 1);
			res = EnableTimingEvtTrg("VIN_AR", 1);
			break;
		case (1):
			tDelay = @sysvar::CH_Nodes::CH__STPDU_T_EIS_VIN_AR;
			if (tDelay > 0)
			{
				if (isTimerActive(Timer_EIS_VIN_AR) == 0)
				{
					res = SetTimingCyclic("VIN_AR", 1, tDelay, 1);
					setTimer (Timer_EIS_VIN_AR, tDelay);
					@sysvar::CH_Nodes::CH__STPDU_EIS_VIN_AR = 2;
				}
			}
			else if (tDelay == 0)
			{
				if (isTimerActive(Timer_EIS_VIN_AR) == 0)
				{
					res = EnableTimingCyclic("VIN_AR", 0);
					res = EnableTimingEvtTrg("VIN_AR", 0);
				}
			}
			break;
		case (2):
			break;
		default:
			Write("error: wrong parameter (%d)", @this);
			stop();
			break;
	}
}

on sysvar sysvar::CH_Nodes::CH__STPDU_EIS_Wiper_Stat_AR
{
	long res;
	long tDelay;
	switch (@this)
	{
		case (0):
			res = ResetTimingCyclic("Wiper_Stat_AR");
			res = ResetTimingEvtTrg("Wiper_Stat_AR");
			res = EnableTimingCyclic("Wiper_Stat_AR", 1);
			res = EnableTimingEvtTrg("Wiper_Stat_AR", 1);
			break;
		case (1):
			tDelay = @sysvar::CH_Nodes::CH__STPDU_T_EIS_Wiper_Stat_AR;
			if (tDelay > 0)
			{
				if (isTimerActive(Timer_EIS_Wiper_Stat_AR) == 0)
				{
					res = SetTimingCyclic("Wiper_Stat_AR", 1, tDelay, 1);
					setTimer (Timer_EIS_Wiper_Stat_AR, tDelay);
					@sysvar::CH_Nodes::CH__STPDU_EIS_Wiper_Stat_AR = 2;
				}
			}
			else if (tDelay == 0)
			{
				if (isTimerActive(Timer_EIS_Wiper_Stat_AR) == 0)
				{
					res = EnableTimingCyclic("Wiper_Stat_AR", 0);
					res = EnableTimingEvtTrg("Wiper_Stat_AR", 0);
				}
			}
			break;
		case (2):
			break;
		default:
			Write("error: wrong parameter (%d)", @this);
			stop();
			break;
	}
}

on sysvar sysvar::CH_Nodes::CH__STPDU_EIS_WUDOP_EIS_FR
{
	long res;
	long tDelay;
	switch (@this)
	{
		case (0):
			res = ResetTimingCyclic("WUDOP_EIS_FR");
			res = ResetTimingEvtTrg("WUDOP_EIS_FR");
			res = EnableTimingCyclic("WUDOP_EIS_FR", 1);
			res = EnableTimingEvtTrg("WUDOP_EIS_FR", 1);
			break;
		case (1):
			tDelay = @sysvar::CH_Nodes::CH__STPDU_T_EIS_WUDOP_EIS_FR;
			if (tDelay > 0)
			{
				if (isTimerActive(Timer_EIS_WUDOP_EIS_FR) == 0)
				{
					res = SetTimingCyclic("WUDOP_EIS_FR", 1, tDelay, 1);
					setTimer (Timer_EIS_WUDOP_EIS_FR, tDelay);
					@sysvar::CH_Nodes::CH__STPDU_EIS_WUDOP_EIS_FR = 2;
				}
			}
			else if (tDelay == 0)
			{
				if (isTimerActive(Timer_EIS_WUDOP_EIS_FR) == 0)
				{
					res = EnableTimingCyclic("WUDOP_EIS_FR", 0);
					res = EnableTimingEvtTrg("WUDOP_EIS_FR", 0);
				}
			}
			break;
		case (2):
			break;
		default:
			Write("error: wrong parameter (%d)", @this);
			stop();
			break;
	}
}

on sysvar sysvar::CH_Nodes::CH__STPDU_EIS_YMAS_Rq_MPC_AR2
{
	long res;
	long tDelay;
	switch (@this)
	{
		case (0):
			res = ResetTimingCyclic("YMAS_Rq_MPC_AR2");
			res = ResetTimingEvtTrg("YMAS_Rq_MPC_AR2");
			res = EnableTimingCyclic("YMAS_Rq_MPC_AR2", 1);
			res = EnableTimingEvtTrg("YMAS_Rq_MPC_AR2", 1);
			break;
		case (1):
			tDelay = @sysvar::CH_Nodes::CH__STPDU_T_EIS_YMAS_Rq_MPC_AR2;
			if (tDelay > 0)
			{
				if (isTimerActive(Timer_EIS_YMAS_Rq_MPC_AR2) == 0)
				{
					res = SetTimingCyclic("YMAS_Rq_MPC_AR2", 1, tDelay, 1);
					setTimer (Timer_EIS_YMAS_Rq_MPC_AR2, tDelay);
					@sysvar::CH_Nodes::CH__STPDU_EIS_YMAS_Rq_MPC_AR2 = 2;
				}
			}
			else if (tDelay == 0)
			{
				if (isTimerActive(Timer_EIS_YMAS_Rq_MPC_AR2) == 0)
				{
					res = EnableTimingCyclic("YMAS_Rq_MPC_AR2", 0);
					res = EnableTimingEvtTrg("YMAS_Rq_MPC_AR2", 0);
				}
			}
			break;
		case (2):
			break;
		default:
			Write("error: wrong parameter (%d)", @this);
			stop();
			break;
	}
}


on sysvar sysvar::CH_Nodes::CH__EIS_ISw_Stat
{
	$Ign_Veh_Stat_AR2::ISw_Stat = @sysvar::CH_Nodes::CH__EIS_ISw_Stat;
	if (@sysvar::CH_Nodes::CH__EIS_ISw_Stat == 0)
	{
		@sysvar::CH_Nodes::CH__NMAwake_EIS = 0;
	}
	else
	{
		if (@sysvar::CH_Nodes::CH__EIS_ISw_Stat == 1 & ISw_Stat_Old == 0)
		{
			@sysvar::CH_Nodes::CH__NMAwake_EIS = 0;
		}
		else
		{
			@sysvar::CH_Nodes::CH__NMAwake_EIS = 1;
		}
	}
	ISw_Stat_Old = @sysvar::CH_Nodes::CH__EIS_ISw_Stat;
}

on sysvar sysvar::CH_Nodes::CH_EISActvComf_Rq_AR2_UB_AUTO_01
{
	switch (@sysvar::CH_Nodes::CH_EISActvComf_Rq_AR2_UB_AUTO_01)
	{
		case (0):
			enableControl("ActvComf_Rq_AR2", "CH_EISActvComf_Rq_AR2_UB__01", 0); //1: enable; 0: disable
			@sysvar::CH_Nodes::CH_EISActvComf_Rq_AR2_UB__01 = 1;
			break;
		case (1):
			enableControl("ActvComf_Rq_AR2", "CH_EISActvComf_Rq_AR2_UB__01", 1); //1: enable; 0: disable
			break;
		case (2):
			enableControl("ActvComf_Rq_AR2", "CH_EISActvComf_Rq_AR2_UB__01", 0); //1: enable; 0: disable
			@sysvar::CH_Nodes::CH_EISActvComf_Rq_AR2_UB__01 = 1;
			break;
		case (3):
			enableControl("ActvComf_Rq_AR2", "CH_EISActvComf_Rq_AR2_UB__01", 0); //1: enable; 0: disable
			@sysvar::CH_Nodes::CH_EISActvComf_Rq_AR2_UB__01 = 0;
			break;
	}
}

on sysvar sysvar::CH_Nodes::CH_EISADAS_CURRENT_ATTRI_UB_A_01
{
	switch (@sysvar::CH_Nodes::CH_EISADAS_CURRENT_ATTRI_UB_A_01)
	{
		case (0):
			enableControl("ADAS_CURRENT_ATTRIBUTES_AR", "CH_EISADAS_CURRENT_ATTRIBUTE__01", 0); //1: enable; 0: disable
			@sysvar::CH_Nodes::CH_EISADAS_CURRENT_ATTRIBUTE__01 = 1;
			break;
		case (1):
			enableControl("ADAS_CURRENT_ATTRIBUTES_AR", "CH_EISADAS_CURRENT_ATTRIBUTE__01", 1); //1: enable; 0: disable
			break;
		case (2):
			enableControl("ADAS_CURRENT_ATTRIBUTES_AR", "CH_EISADAS_CURRENT_ATTRIBUTE__01", 0); //1: enable; 0: disable
			@sysvar::CH_Nodes::CH_EISADAS_CURRENT_ATTRIBUTE__01 = 1;
			break;
		case (3):
			enableControl("ADAS_CURRENT_ATTRIBUTES_AR", "CH_EISADAS_CURRENT_ATTRIBUTE__01", 0); //1: enable; 0: disable
			@sysvar::CH_Nodes::CH_EISADAS_CURRENT_ATTRIBUTE__01 = 0;
			break;
	}
}

on sysvar sysvar::CH_Nodes::CH_EISADAS_POSITION_AR_UB_AUT_01
{
	switch (@sysvar::CH_Nodes::CH_EISADAS_POSITION_AR_UB_AUT_01)
	{
		case (0):
			enableControl("ADAS_POSITION_AR", "CH_EISADAS_POSITION_AR_UB__01", 0); //1: enable; 0: disable
			@sysvar::CH_Nodes::CH_EISADAS_POSITION_AR_UB__01 = 1;
			break;
		case (1):
			enableControl("ADAS_POSITION_AR", "CH_EISADAS_POSITION_AR_UB__01", 1); //1: enable; 0: disable
			break;
		case (2):
			enableControl("ADAS_POSITION_AR", "CH_EISADAS_POSITION_AR_UB__01", 0); //1: enable; 0: disable
			@sysvar::CH_Nodes::CH_EISADAS_POSITION_AR_UB__01 = 1;
			break;
		case (3):
			enableControl("ADAS_POSITION_AR", "CH_EISADAS_POSITION_AR_UB__01", 0); //1: enable; 0: disable
			@sysvar::CH_Nodes::CH_EISADAS_POSITION_AR_UB__01 = 0;
			break;
	}
}

on sysvar sysvar::CH_Nodes::CH_EISADAS_PREDICTION_AR_UB_A_03
{
	switch (@sysvar::CH_Nodes::CH_EISADAS_PREDICTION_AR_UB_A_03)
	{
		case (0):
			enableControl("ADAS_PREDICTION_AR", "CH_EISADAS_PREDICTION_AR_2_UB_01", 0); //1: enable; 0: disable
			@sysvar::CH_Nodes::CH_EISADAS_PREDICTION_AR_2_UB_01 = 1;
			break;
		case (1):
			enableControl("ADAS_PREDICTION_AR", "CH_EISADAS_PREDICTION_AR_2_UB_01", 1); //1: enable; 0: disable
			break;
		case (2):
			enableControl("ADAS_PREDICTION_AR", "CH_EISADAS_PREDICTION_AR_2_UB_01", 0); //1: enable; 0: disable
			@sysvar::CH_Nodes::CH_EISADAS_PREDICTION_AR_2_UB_01 = 1;
			break;
		case (3):
			enableControl("ADAS_PREDICTION_AR", "CH_EISADAS_PREDICTION_AR_2_UB_01", 0); //1: enable; 0: disable
			@sysvar::CH_Nodes::CH_EISADAS_PREDICTION_AR_2_UB_01 = 0;
			break;
	}
}

on sysvar sysvar::CH_Nodes::CH_EISADAS_PROFILE_LONG__UB_A_04
{
	switch (@sysvar::CH_Nodes::CH_EISADAS_PROFILE_LONG__UB_A_04)
	{
		case (0):
			enableControl("ADAS_PROFILE_LONG_AR", "CH_EISADAS_PROFILE_LONG_AR_1__03", 0); //1: enable; 0: disable
			@sysvar::CH_Nodes::CH_EISADAS_PROFILE_LONG_AR_1__03 = 1;
			break;
		case (1):
			enableControl("ADAS_PROFILE_LONG_AR", "CH_EISADAS_PROFILE_LONG_AR_1__03", 1); //1: enable; 0: disable
			break;
		case (2):
			enableControl("ADAS_PROFILE_LONG_AR", "CH_EISADAS_PROFILE_LONG_AR_1__03", 0); //1: enable; 0: disable
			@sysvar::CH_Nodes::CH_EISADAS_PROFILE_LONG_AR_1__03 = 1;
			break;
		case (3):
			enableControl("ADAS_PROFILE_LONG_AR", "CH_EISADAS_PROFILE_LONG_AR_1__03", 0); //1: enable; 0: disable
			@sysvar::CH_Nodes::CH_EISADAS_PROFILE_LONG_AR_1__03 = 0;
			break;
	}
}

on sysvar sysvar::CH_Nodes::CH_EISADAS_PROFILE_SHORT_UB_A_09
{
	switch (@sysvar::CH_Nodes::CH_EISADAS_PROFILE_SHORT_UB_A_09)
	{
		case (0):
			enableControl("ADAS_PROFILE_SHORT_AR", "CH_EISADAS_PROFILE_SHORT_AR___09", 0); //1: enable; 0: disable
			@sysvar::CH_Nodes::CH_EISADAS_PROFILE_SHORT_AR___09 = 1;
			break;
		case (1):
			enableControl("ADAS_PROFILE_SHORT_AR", "CH_EISADAS_PROFILE_SHORT_AR___09", 1); //1: enable; 0: disable
			break;
		case (2):
			enableControl("ADAS_PROFILE_SHORT_AR", "CH_EISADAS_PROFILE_SHORT_AR___09", 0); //1: enable; 0: disable
			@sysvar::CH_Nodes::CH_EISADAS_PROFILE_SHORT_AR___09 = 1;
			break;
		case (3):
			enableControl("ADAS_PROFILE_SHORT_AR", "CH_EISADAS_PROFILE_SHORT_AR___09", 0); //1: enable; 0: disable
			@sysvar::CH_Nodes::CH_EISADAS_PROFILE_SHORT_AR___09 = 0;
			break;
	}
}

on sysvar sysvar::CH_Nodes::CH_EISADASLR_POSITION_AR_UB_A_01
{
	switch (@sysvar::CH_Nodes::CH_EISADASLR_POSITION_AR_UB_A_01)
	{
		case (0):
			enableControl("ADASLR_POSITION_AR", "CH_EISADASLR_POSITION_AR_UB__01", 0); //1: enable; 0: disable
			@sysvar::CH_Nodes::CH_EISADASLR_POSITION_AR_UB__01 = 1;
			break;
		case (1):
			enableControl("ADASLR_POSITION_AR", "CH_EISADASLR_POSITION_AR_UB__01", 1); //1: enable; 0: disable
			break;
		case (2):
			enableControl("ADASLR_POSITION_AR", "CH_EISADASLR_POSITION_AR_UB__01", 0); //1: enable; 0: disable
			@sysvar::CH_Nodes::CH_EISADASLR_POSITION_AR_UB__01 = 1;
			break;
		case (3):
			enableControl("ADASLR_POSITION_AR", "CH_EISADASLR_POSITION_AR_UB__01", 0); //1: enable; 0: disable
			@sysvar::CH_Nodes::CH_EISADASLR_POSITION_AR_UB__01 = 0;
			break;
	}
}

on sysvar sysvar::CH_Nodes::CH_EISADASLR_PROFILE_LON_UB_A_04
{
	switch (@sysvar::CH_Nodes::CH_EISADASLR_PROFILE_LON_UB_A_04)
	{
		case (0):
			enableControl("ADASLR_PROFILE_LONG_AR", "CH_EISADASLR_PROFILE_LONG_AR__04", 0); //1: enable; 0: disable
			@sysvar::CH_Nodes::CH_EISADASLR_PROFILE_LONG_AR__04 = 1;
			break;
		case (1):
			enableControl("ADASLR_PROFILE_LONG_AR", "CH_EISADASLR_PROFILE_LONG_AR__04", 1); //1: enable; 0: disable
			break;
		case (2):
			enableControl("ADASLR_PROFILE_LONG_AR", "CH_EISADASLR_PROFILE_LONG_AR__04", 0); //1: enable; 0: disable
			@sysvar::CH_Nodes::CH_EISADASLR_PROFILE_LONG_AR__04 = 1;
			break;
		case (3):
			enableControl("ADASLR_PROFILE_LONG_AR", "CH_EISADASLR_PROFILE_LONG_AR__04", 0); //1: enable; 0: disable
			@sysvar::CH_Nodes::CH_EISADASLR_PROFILE_LONG_AR__04 = 0;
			break;
	}
}

on sysvar sysvar::CH_Nodes::CH_EISBC_F_Stat2_AR2_UB_AUTO
{
	switch (@sysvar::CH_Nodes::CH_EISBC_F_Stat2_AR2_UB_AUTO)
	{
		case (0):
			enableControl("BC_F_Stat2_AR2", "CH_EISBC_F_Stat2_AR2_UB_", 0); //1: enable; 0: disable
			@sysvar::CH_Nodes::CH_EISBC_F_Stat2_AR2_UB_ = 1;
			break;
		case (1):
			enableControl("BC_F_Stat2_AR2", "CH_EISBC_F_Stat2_AR2_UB_", 1); //1: enable; 0: disable
			break;
		case (2):
			enableControl("BC_F_Stat2_AR2", "CH_EISBC_F_Stat2_AR2_UB_", 0); //1: enable; 0: disable
			@sysvar::CH_Nodes::CH_EISBC_F_Stat2_AR2_UB_ = 1;
			break;
		case (3):
			enableControl("BC_F_Stat2_AR2", "CH_EISBC_F_Stat2_AR2_UB_", 0); //1: enable; 0: disable
			@sysvar::CH_Nodes::CH_EISBC_F_Stat2_AR2_UB_ = 0;
			break;
	}
}

on sysvar sysvar::CH_Nodes::CH_EISBC_R_Stat1_AR_UB_AUTO_01
{
	switch (@sysvar::CH_Nodes::CH_EISBC_R_Stat1_AR_UB_AUTO_01)
	{
		case (0):
			enableControl("BC_R_Stat1_AR", "CH_EISBC_R_Stat1_AR_UB__01", 0); //1: enable; 0: disable
			@sysvar::CH_Nodes::CH_EISBC_R_Stat1_AR_UB__01 = 1;
			break;
		case (1):
			enableControl("BC_R_Stat1_AR", "CH_EISBC_R_Stat1_AR_UB__01", 1); //1: enable; 0: disable
			break;
		case (2):
			enableControl("BC_R_Stat1_AR", "CH_EISBC_R_Stat1_AR_UB__01", 0); //1: enable; 0: disable
			@sysvar::CH_Nodes::CH_EISBC_R_Stat1_AR_UB__01 = 1;
			break;
		case (3):
			enableControl("BC_R_Stat1_AR", "CH_EISBC_R_Stat1_AR_UB__01", 0); //1: enable; 0: disable
			@sysvar::CH_Nodes::CH_EISBC_R_Stat1_AR_UB__01 = 0;
			break;
	}
}

on sysvar sysvar::CH_Nodes::CH_EISBckl_Sw_3L_SAM_R_TglB_AUTO
{
//	EnableTGL("BC_R_Stat1_AR",  "ckl_Sw_3L_SAM_R_", !@this); // 1 = on, 0 = off 
	enableControl("BC_R_Stat1_AR", "CH_EISBckl_Sw_3L_SAM_R_TglBC_R__", @this); //1: enable; 0: disable
	TGL_ckl_Sw_3L_SAM_R_ = @sysvar::CH_Nodes::CH_EISBckl_Sw_3L_SAM_R_TglB_AUTO;
}

on sysvar sysvar::CH_Nodes::CH_EISBckl_Sw_3R_SAM_R_TglB_AUTO
{
//	EnableTGL("BC_R_Stat1_AR",  "ckl_Sw_3R_SAM_R_", !@this); // 1 = on, 0 = off 
	enableControl("BC_R_Stat1_AR", "CH_EISBckl_Sw_3R_SAM_R_TglBC_R__", @this); //1: enable; 0: disable
	TGL_ckl_Sw_3R_SAM_R_ = @sysvar::CH_Nodes::CH_EISBckl_Sw_3R_SAM_R_TglB_AUTO;
}

on sysvar sysvar::CH_Nodes::CH_EISBckl_Sw_RL_SAM_R_TglB_AUTO
{
//	EnableTGL("BC_R_Stat1_AR",  "ckl_Sw_RL_SAM_R_", !@this); // 1 = on, 0 = off 
	enableControl("BC_R_Stat1_AR", "CH_EISBckl_Sw_RL_SAM_R_TglBC_R__", @this); //1: enable; 0: disable
	TGL_ckl_Sw_RL_SAM_R_ = @sysvar::CH_Nodes::CH_EISBckl_Sw_RL_SAM_R_TglB_AUTO;
}

on sysvar sysvar::CH_Nodes::CH_EISBckl_Sw_RM_SAM_R_TglB_AUTO
{
//	EnableTGL("BC_R_Stat1_AR",  "ckl_Sw_RM_SAM_R_", !@this); // 1 = on, 0 = off 
	enableControl("BC_R_Stat1_AR", "CH_EISBckl_Sw_RM_SAM_R_TglBC_R__", @this); //1: enable; 0: disable
	TGL_ckl_Sw_RM_SAM_R_ = @sysvar::CH_Nodes::CH_EISBckl_Sw_RM_SAM_R_TglB_AUTO;
}

on sysvar sysvar::CH_Nodes::CH_EISBckl_Sw_RR_SAM_R_TglB_AUTO
{
//	EnableTGL("BC_R_Stat1_AR",  "ckl_Sw_RR_SAM_R_", !@this); // 1 = on, 0 = off 
	enableControl("BC_R_Stat1_AR", "CH_EISBckl_Sw_RR_SAM_R_TglBC_R__", @this); //1: enable; 0: disable
	TGL_ckl_Sw_RR_SAM_R_ = @sysvar::CH_Nodes::CH_EISBckl_Sw_RR_SAM_R_TglB_AUTO;
}

on sysvar sysvar::CH_Nodes::CH_EISBODY_CHASSIS_R1_AR_UB_A_01
{
	switch (@sysvar::CH_Nodes::CH_EISBODY_CHASSIS_R1_AR_UB_A_01)
	{
		case (0):
			enableControl("BODY_CHASSIS_R1_AR", "CH_EISBODY_CHASSIS_R1_AR_UB__01", 0); //1: enable; 0: disable
			@sysvar::CH_Nodes::CH_EISBODY_CHASSIS_R1_AR_UB__01 = 1;
			break;
		case (1):
			enableControl("BODY_CHASSIS_R1_AR", "CH_EISBODY_CHASSIS_R1_AR_UB__01", 1); //1: enable; 0: disable
			break;
		case (2):
			enableControl("BODY_CHASSIS_R1_AR", "CH_EISBODY_CHASSIS_R1_AR_UB__01", 0); //1: enable; 0: disable
			@sysvar::CH_Nodes::CH_EISBODY_CHASSIS_R1_AR_UB__01 = 1;
			break;
		case (3):
			enableControl("BODY_CHASSIS_R1_AR", "CH_EISBODY_CHASSIS_R1_AR_UB__01", 0); //1: enable; 0: disable
			@sysvar::CH_Nodes::CH_EISBODY_CHASSIS_R1_AR_UB__01 = 0;
			break;
	}
}

on sysvar sysvar::CH_Nodes::CH_EISBSM_Disp_Warn_Rq_A_UB_A_01
{
	switch (@sysvar::CH_Nodes::CH_EISBSM_Disp_Warn_Rq_A_UB_A_01)
	{
		case (0):
			enableControl("BSM_Disp_Warn_Rq_AR2", "CH_EISBSM_Disp_Warn_Rq_AR2_UB_01", 0); //1: enable; 0: disable
			@sysvar::CH_Nodes::CH_EISBSM_Disp_Warn_Rq_AR2_UB_01 = 1;
			break;
		case (1):
			enableControl("BSM_Disp_Warn_Rq_AR2", "CH_EISBSM_Disp_Warn_Rq_AR2_UB_01", 1); //1: enable; 0: disable
			break;
		case (2):
			enableControl("BSM_Disp_Warn_Rq_AR2", "CH_EISBSM_Disp_Warn_Rq_AR2_UB_01", 0); //1: enable; 0: disable
			@sysvar::CH_Nodes::CH_EISBSM_Disp_Warn_Rq_AR2_UB_01 = 1;
			break;
		case (3):
			enableControl("BSM_Disp_Warn_Rq_AR2", "CH_EISBSM_Disp_Warn_Rq_AR2_UB_01", 0); //1: enable; 0: disable
			@sysvar::CH_Nodes::CH_EISBSM_Disp_Warn_Rq_AR2_UB_01 = 0;
			break;
	}
}

on sysvar sysvar::CH_Nodes::CH_EISCamLane_Disp_Warn__UB_A_01
{
	switch (@sysvar::CH_Nodes::CH_EISCamLane_Disp_Warn__UB_A_01)
	{
		case (0):
			enableControl("CamLane_Disp_Warn_Rq_AR2", "CH_EISCamLane_Disp_Warn_Rq_A__01", 0); //1: enable; 0: disable
			@sysvar::CH_Nodes::CH_EISCamLane_Disp_Warn_Rq_A__01 = 1;
			break;
		case (1):
			enableControl("CamLane_Disp_Warn_Rq_AR2", "CH_EISCamLane_Disp_Warn_Rq_A__01", 1); //1: enable; 0: disable
			break;
		case (2):
			enableControl("CamLane_Disp_Warn_Rq_AR2", "CH_EISCamLane_Disp_Warn_Rq_A__01", 0); //1: enable; 0: disable
			@sysvar::CH_Nodes::CH_EISCamLane_Disp_Warn_Rq_A__01 = 1;
			break;
		case (3):
			enableControl("CamLane_Disp_Warn_Rq_AR2", "CH_EISCamLane_Disp_Warn_Rq_A__01", 0); //1: enable; 0: disable
			@sysvar::CH_Nodes::CH_EISCamLane_Disp_Warn_Rq_A__01 = 0;
			break;
	}
}

on sysvar sysvar::CH_Nodes::CH_EISCRC_CamLane_Disp_Warn_AUTO
{
//	EnableCRC("CamLane_Disp_Warn_Rq_AR2",  "CamLane_Disp_Warn_Rq_Pr2", !@this); // 1 = on, 0 = off 
	enableControl("CamLane_Disp_Warn_Rq_AR2", "CH_EISCRC_CamLane_Disp_Warn_Rq__", @this); //1: enable; 0: disable
	CRC_CamLane_Disp_Warn_Rq_Pr2 = @sysvar::CH_Nodes::CH_EISCRC_CamLane_Disp_Warn_AUTO;
}

on sysvar sysvar::CH_Nodes::CH_EISSQC_CamLane_Disp_Warn_AUTO
{
//	EnableSQC("CamLane_Disp_Warn_Rq_AR2",  "CamLane_Disp_Warn_Rq_Pr2", !@this); // 1 = on, 0 = off 
	enableControl("CamLane_Disp_Warn_Rq_AR2", "CH_EISSQC_CamLane_Disp_Warn_Rq__", @this); //1: enable; 0: disable
	SQC_CamLane_Disp_Warn_Rq_Pr2 = @sysvar::CH_Nodes::CH_EISSQC_CamLane_Disp_Warn_AUTO;
}

on sysvar sysvar::CH_Nodes::CH_EISCamLane_LaneAttr1__UB_A_01
{
	switch (@sysvar::CH_Nodes::CH_EISCamLane_LaneAttr1__UB_A_01)
	{
		case (0):
			enableControl("CamLane_LaneAttr1_AR2", "CH_EISCamLane_LaneAttr1_AR2_U_01", 0); //1: enable; 0: disable
			@sysvar::CH_Nodes::CH_EISCamLane_LaneAttr1_AR2_U_01 = 1;
			break;
		case (1):
			enableControl("CamLane_LaneAttr1_AR2", "CH_EISCamLane_LaneAttr1_AR2_U_01", 1); //1: enable; 0: disable
			break;
		case (2):
			enableControl("CamLane_LaneAttr1_AR2", "CH_EISCamLane_LaneAttr1_AR2_U_01", 0); //1: enable; 0: disable
			@sysvar::CH_Nodes::CH_EISCamLane_LaneAttr1_AR2_U_01 = 1;
			break;
		case (3):
			enableControl("CamLane_LaneAttr1_AR2", "CH_EISCamLane_LaneAttr1_AR2_U_01", 0); //1: enable; 0: disable
			@sysvar::CH_Nodes::CH_EISCamLane_LaneAttr1_AR2_U_01 = 0;
			break;
	}
}

on sysvar sysvar::CH_Nodes::CH_EISCRC_CamLane_LaneAttr1_AUTO
{
//	EnableCRC("CamLane_LaneAttr1_AR2",  "CamLane_LaneAttr1_Pr2", !@this); // 1 = on, 0 = off 
	enableControl("CamLane_LaneAttr1_AR2", "CH_EISCRC_CamLane_LaneAttr1_Pr2_", @this); //1: enable; 0: disable
	CRC_CamLane_LaneAttr1_Pr2 = @sysvar::CH_Nodes::CH_EISCRC_CamLane_LaneAttr1_AUTO;
}

on sysvar sysvar::CH_Nodes::CH_EISSQC_CamLane_LaneAttr1_AUTO
{
//	EnableSQC("CamLane_LaneAttr1_AR2",  "CamLane_LaneAttr1_Pr2", !@this); // 1 = on, 0 = off 
	enableControl("CamLane_LaneAttr1_AR2", "CH_EISSQC_CamLane_LaneAttr1_Pr2_", @this); //1: enable; 0: disable
	SQC_CamLane_LaneAttr1_Pr2 = @sysvar::CH_Nodes::CH_EISSQC_CamLane_LaneAttr1_AUTO;
}

on sysvar sysvar::CH_Nodes::CH_EISCamLane_LaneAttr2__UB_A_01
{
	switch (@sysvar::CH_Nodes::CH_EISCamLane_LaneAttr2__UB_A_01)
	{
		case (0):
			enableControl("CamLane_LaneAttr2_AR2", "CH_EISCamLane_LaneAttr2_AR2_U_01", 0); //1: enable; 0: disable
			@sysvar::CH_Nodes::CH_EISCamLane_LaneAttr2_AR2_U_01 = 1;
			break;
		case (1):
			enableControl("CamLane_LaneAttr2_AR2", "CH_EISCamLane_LaneAttr2_AR2_U_01", 1); //1: enable; 0: disable
			break;
		case (2):
			enableControl("CamLane_LaneAttr2_AR2", "CH_EISCamLane_LaneAttr2_AR2_U_01", 0); //1: enable; 0: disable
			@sysvar::CH_Nodes::CH_EISCamLane_LaneAttr2_AR2_U_01 = 1;
			break;
		case (3):
			enableControl("CamLane_LaneAttr2_AR2", "CH_EISCamLane_LaneAttr2_AR2_U_01", 0); //1: enable; 0: disable
			@sysvar::CH_Nodes::CH_EISCamLane_LaneAttr2_AR2_U_01 = 0;
			break;
	}
}

on sysvar sysvar::CH_Nodes::CH_EISCRC_CamLane_LaneAttr2_AUTO
{
//	EnableCRC("CamLane_LaneAttr2_AR2",  "CamLane_LaneAttr2_Pr2", !@this); // 1 = on, 0 = off 
	enableControl("CamLane_LaneAttr2_AR2", "CH_EISCRC_CamLane_LaneAttr2_Pr2_", @this); //1: enable; 0: disable
	CRC_CamLane_LaneAttr2_Pr2 = @sysvar::CH_Nodes::CH_EISCRC_CamLane_LaneAttr2_AUTO;
}

on sysvar sysvar::CH_Nodes::CH_EISSQC_CamLane_LaneAttr2_AUTO
{
//	EnableSQC("CamLane_LaneAttr2_AR2",  "CamLane_LaneAttr2_Pr2", !@this); // 1 = on, 0 = off 
	enableControl("CamLane_LaneAttr2_AR2", "CH_EISSQC_CamLane_LaneAttr2_Pr2_", @this); //1: enable; 0: disable
	SQC_CamLane_LaneAttr2_Pr2 = @sysvar::CH_Nodes::CH_EISSQC_CamLane_LaneAttr2_AUTO;
}

on sysvar sysvar::CH_Nodes::CH_EISCamLane_LaneAttr3__UB_A_01
{
	switch (@sysvar::CH_Nodes::CH_EISCamLane_LaneAttr3__UB_A_01)
	{
		case (0):
			enableControl("CamLane_LaneAttr3_AR2", "CH_EISCamLane_LaneAttr3_AR2_U_01", 0); //1: enable; 0: disable
			@sysvar::CH_Nodes::CH_EISCamLane_LaneAttr3_AR2_U_01 = 1;
			break;
		case (1):
			enableControl("CamLane_LaneAttr3_AR2", "CH_EISCamLane_LaneAttr3_AR2_U_01", 1); //1: enable; 0: disable
			break;
		case (2):
			enableControl("CamLane_LaneAttr3_AR2", "CH_EISCamLane_LaneAttr3_AR2_U_01", 0); //1: enable; 0: disable
			@sysvar::CH_Nodes::CH_EISCamLane_LaneAttr3_AR2_U_01 = 1;
			break;
		case (3):
			enableControl("CamLane_LaneAttr3_AR2", "CH_EISCamLane_LaneAttr3_AR2_U_01", 0); //1: enable; 0: disable
			@sysvar::CH_Nodes::CH_EISCamLane_LaneAttr3_AR2_U_01 = 0;
			break;
	}
}

on sysvar sysvar::CH_Nodes::CH_EISCRC_CamLane_LaneAttr3_AUTO
{
//	EnableCRC("CamLane_LaneAttr3_AR2",  "CamLane_LaneAttr3_Pr2", !@this); // 1 = on, 0 = off 
	enableControl("CamLane_LaneAttr3_AR2", "CH_EISCRC_CamLane_LaneAttr3_Pr2_", @this); //1: enable; 0: disable
	CRC_CamLane_LaneAttr3_Pr2 = @sysvar::CH_Nodes::CH_EISCRC_CamLane_LaneAttr3_AUTO;
}

on sysvar sysvar::CH_Nodes::CH_EISSQC_CamLane_LaneAttr3_AUTO
{
//	EnableSQC("CamLane_LaneAttr3_AR2",  "CamLane_LaneAttr3_Pr2", !@this); // 1 = on, 0 = off 
	enableControl("CamLane_LaneAttr3_AR2", "CH_EISSQC_CamLane_LaneAttr3_Pr2_", @this); //1: enable; 0: disable
	SQC_CamLane_LaneAttr3_Pr2 = @sysvar::CH_Nodes::CH_EISSQC_CamLane_LaneAttr3_AUTO;
}

on sysvar sysvar::CH_Nodes::CH_EISCamLane_LaneAttr6__UB_A_01
{
	switch (@sysvar::CH_Nodes::CH_EISCamLane_LaneAttr6__UB_A_01)
	{
		case (0):
			enableControl("CamLane_LaneAttr6_AR2", "CH_EISCamLane_LaneAttr6_AR2_U_01", 0); //1: enable; 0: disable
			@sysvar::CH_Nodes::CH_EISCamLane_LaneAttr6_AR2_U_01 = 1;
			break;
		case (1):
			enableControl("CamLane_LaneAttr6_AR2", "CH_EISCamLane_LaneAttr6_AR2_U_01", 1); //1: enable; 0: disable
			break;
		case (2):
			enableControl("CamLane_LaneAttr6_AR2", "CH_EISCamLane_LaneAttr6_AR2_U_01", 0); //1: enable; 0: disable
			@sysvar::CH_Nodes::CH_EISCamLane_LaneAttr6_AR2_U_01 = 1;
			break;
		case (3):
			enableControl("CamLane_LaneAttr6_AR2", "CH_EISCamLane_LaneAttr6_AR2_U_01", 0); //1: enable; 0: disable
			@sysvar::CH_Nodes::CH_EISCamLane_LaneAttr6_AR2_U_01 = 0;
			break;
	}
}

on sysvar sysvar::CH_Nodes::CH_EISCRC_CamLane_LaneAttr6_AUTO
{
//	EnableCRC("CamLane_LaneAttr6_AR2",  "CamLane_LaneAttr6_Pr2", !@this); // 1 = on, 0 = off 
	enableControl("CamLane_LaneAttr6_AR2", "CH_EISCRC_CamLane_LaneAttr6_Pr2_", @this); //1: enable; 0: disable
	CRC_CamLane_LaneAttr6_Pr2 = @sysvar::CH_Nodes::CH_EISCRC_CamLane_LaneAttr6_AUTO;
}

on sysvar sysvar::CH_Nodes::CH_EISSQC_CamLane_LaneAttr6_AUTO
{
//	EnableSQC("CamLane_LaneAttr6_AR2",  "CamLane_LaneAttr6_Pr2", !@this); // 1 = on, 0 = off 
	enableControl("CamLane_LaneAttr6_AR2", "CH_EISSQC_CamLane_LaneAttr6_Pr2_", @this); //1: enable; 0: disable
	SQC_CamLane_LaneAttr6_Pr2 = @sysvar::CH_Nodes::CH_EISSQC_CamLane_LaneAttr6_AUTO;
}

on sysvar sysvar::CH_Nodes::CH_EISCamLane_LaneAttr7__UB_A_01
{
	switch (@sysvar::CH_Nodes::CH_EISCamLane_LaneAttr7__UB_A_01)
	{
		case (0):
			enableControl("CamLane_LaneAttr7_AR2", "CH_EISCamLane_LaneAttr7_AR2_U_01", 0); //1: enable; 0: disable
			@sysvar::CH_Nodes::CH_EISCamLane_LaneAttr7_AR2_U_01 = 1;
			break;
		case (1):
			enableControl("CamLane_LaneAttr7_AR2", "CH_EISCamLane_LaneAttr7_AR2_U_01", 1); //1: enable; 0: disable
			break;
		case (2):
			enableControl("CamLane_LaneAttr7_AR2", "CH_EISCamLane_LaneAttr7_AR2_U_01", 0); //1: enable; 0: disable
			@sysvar::CH_Nodes::CH_EISCamLane_LaneAttr7_AR2_U_01 = 1;
			break;
		case (3):
			enableControl("CamLane_LaneAttr7_AR2", "CH_EISCamLane_LaneAttr7_AR2_U_01", 0); //1: enable; 0: disable
			@sysvar::CH_Nodes::CH_EISCamLane_LaneAttr7_AR2_U_01 = 0;
			break;
	}
}

on sysvar sysvar::CH_Nodes::CH_EISCRC_CamLane_LaneAttr7_AUTO
{
//	EnableCRC("CamLane_LaneAttr7_AR2",  "CamLane_LaneAttr7_Pr2", !@this); // 1 = on, 0 = off 
	enableControl("CamLane_LaneAttr7_AR2", "CH_EISCRC_CamLane_LaneAttr7_Pr2_", @this); //1: enable; 0: disable
	CRC_CamLane_LaneAttr7_Pr2 = @sysvar::CH_Nodes::CH_EISCRC_CamLane_LaneAttr7_AUTO;
}

on sysvar sysvar::CH_Nodes::CH_EISSQC_CamLane_LaneAttr7_AUTO
{
//	EnableSQC("CamLane_LaneAttr7_AR2",  "CamLane_LaneAttr7_Pr2", !@this); // 1 = on, 0 = off 
	enableControl("CamLane_LaneAttr7_AR2", "CH_EISSQC_CamLane_LaneAttr7_Pr2_", @this); //1: enable; 0: disable
	SQC_CamLane_LaneAttr7_Pr2 = @sysvar::CH_Nodes::CH_EISSQC_CamLane_LaneAttr7_AUTO;
}

on sysvar sysvar::CH_Nodes::CH_EISCLkS_Rq_AR_UB_AUTO_01
{
	switch (@sysvar::CH_Nodes::CH_EISCLkS_Rq_AR_UB_AUTO_01)
	{
		case (0):
			enableControl("CLkS_Rq_AR", "CH_EISCLkS_Rq_AR_UB__01", 0); //1: enable; 0: disable
			@sysvar::CH_Nodes::CH_EISCLkS_Rq_AR_UB__01 = 1;
			break;
		case (1):
			enableControl("CLkS_Rq_AR", "CH_EISCLkS_Rq_AR_UB__01", 1); //1: enable; 0: disable
			break;
		case (2):
			enableControl("CLkS_Rq_AR", "CH_EISCLkS_Rq_AR_UB__01", 0); //1: enable; 0: disable
			@sysvar::CH_Nodes::CH_EISCLkS_Rq_AR_UB__01 = 1;
			break;
		case (3):
			enableControl("CLkS_Rq_AR", "CH_EISCLkS_Rq_AR_UB__01", 0); //1: enable; 0: disable
			@sysvar::CH_Nodes::CH_EISCLkS_Rq_AR_UB__01 = 0;
			break;
	}
}

on sysvar sysvar::CH_Nodes::CH_EISCLkS_State_AR_UB_AUTO_01
{
	switch (@sysvar::CH_Nodes::CH_EISCLkS_State_AR_UB_AUTO_01)
	{
		case (0):
			enableControl("CLkS_State_AR", "CH_EISCLkS_State_AR_UB__01", 0); //1: enable; 0: disable
			@sysvar::CH_Nodes::CH_EISCLkS_State_AR_UB__01 = 1;
			break;
		case (1):
			enableControl("CLkS_State_AR", "CH_EISCLkS_State_AR_UB__01", 1); //1: enable; 0: disable
			break;
		case (2):
			enableControl("CLkS_State_AR", "CH_EISCLkS_State_AR_UB__01", 0); //1: enable; 0: disable
			@sysvar::CH_Nodes::CH_EISCLkS_State_AR_UB__01 = 1;
			break;
		case (3):
			enableControl("CLkS_State_AR", "CH_EISCLkS_State_AR_UB__01", 0); //1: enable; 0: disable
			@sysvar::CH_Nodes::CH_EISCLkS_State_AR_UB__01 = 0;
			break;
	}
}

on sysvar sysvar::CH_Nodes::CH_EISCRC_ClockSync_Stat_Pr_AUTO
{
//	EnableCRC("ClockSync_Stat_FR2",  "ClockSync_Stat_Pr2", !@this); // 1 = on, 0 = off 
	enableControl("ClockSync_Stat_FR2", "CH_EISCRC_ClockSync_Stat_Pr2Clo_", @this); //1: enable; 0: disable
	CRC_ClockSync_Stat_Pr2 = @sysvar::CH_Nodes::CH_EISCRC_ClockSync_Stat_Pr_AUTO;
}

on sysvar sysvar::CH_Nodes::CH_EISSQC_ClockSync_Stat_Pr_AUTO
{
//	EnableSQC("ClockSync_Stat_FR2",  "ClockSync_Stat_Pr2", !@this); // 1 = on, 0 = off 
	enableControl("ClockSync_Stat_FR2", "CH_EISSQC_ClockSync_Stat_Pr2Clo_", @this); //1: enable; 0: disable
	SQC_ClockSync_Stat_Pr2 = @sysvar::CH_Nodes::CH_EISSQC_ClockSync_Stat_Pr_AUTO;
}

on sysvar sysvar::CH_Nodes::CH_EISCMS_PI_State_Gw_AR_UB_A_01
{
	switch (@sysvar::CH_Nodes::CH_EISCMS_PI_State_Gw_AR_UB_A_01)
	{
		case (0):
			enableControl("CMS_PI_State_Gw_AR2", "CH_EISCMS_PI_State_Gw_AR2_UB__01", 0); //1: enable; 0: disable
			@sysvar::CH_Nodes::CH_EISCMS_PI_State_Gw_AR2_UB__01 = 1;
			break;
		case (1):
			enableControl("CMS_PI_State_Gw_AR2", "CH_EISCMS_PI_State_Gw_AR2_UB__01", 1); //1: enable; 0: disable
			break;
		case (2):
			enableControl("CMS_PI_State_Gw_AR2", "CH_EISCMS_PI_State_Gw_AR2_UB__01", 0); //1: enable; 0: disable
			@sysvar::CH_Nodes::CH_EISCMS_PI_State_Gw_AR2_UB__01 = 1;
			break;
		case (3):
			enableControl("CMS_PI_State_Gw_AR2", "CH_EISCMS_PI_State_Gw_AR2_UB__01", 0); //1: enable; 0: disable
			@sysvar::CH_Nodes::CH_EISCMS_PI_State_Gw_AR2_UB__01 = 0;
			break;
	}
}

on sysvar sysvar::CH_Nodes::CH_EISCRC_CMS_PI_Stat_Pr2CM_AUTO
{
//	EnableCRC("CMS_PI_State_Gw_AR2",  "CMS_PI_Stat_Pr2", !@this); // 1 = on, 0 = off 
	enableControl("CMS_PI_State_Gw_AR2", "CH_EISCRC_CMS_PI_Stat_Pr2CMS_PI_", @this); //1: enable; 0: disable
	CRC_CMS_PI_Stat_Pr2 = @sysvar::CH_Nodes::CH_EISCRC_CMS_PI_Stat_Pr2CM_AUTO;
}

on sysvar sysvar::CH_Nodes::CH_EISSQC_CMS_PI_Stat_Pr2CM_AUTO
{
//	EnableSQC("CMS_PI_State_Gw_AR2",  "CMS_PI_Stat_Pr2", !@this); // 1 = on, 0 = off 
	enableControl("CMS_PI_State_Gw_AR2", "CH_EISSQC_CMS_PI_Stat_Pr2CMS_PI_", @this); //1: enable; 0: disable
	SQC_CMS_PI_Stat_Pr2 = @sysvar::CH_Nodes::CH_EISSQC_CMS_PI_Stat_Pr2CM_AUTO;
}

on sysvar sysvar::CH_Nodes::CH_EISCTRL_C_Stat1_AR_UB_AUTO_01
{
	switch (@sysvar::CH_Nodes::CH_EISCTRL_C_Stat1_AR_UB_AUTO_01)
	{
		case (0):
			enableControl("CTRL_C_Stat1_AR", "CH_EISCTRL_C_Stat1_AR_UB__01", 0); //1: enable; 0: disable
			@sysvar::CH_Nodes::CH_EISCTRL_C_Stat1_AR_UB__01 = 1;
			break;
		case (1):
			enableControl("CTRL_C_Stat1_AR", "CH_EISCTRL_C_Stat1_AR_UB__01", 1); //1: enable; 0: disable
			break;
		case (2):
			enableControl("CTRL_C_Stat1_AR", "CH_EISCTRL_C_Stat1_AR_UB__01", 0); //1: enable; 0: disable
			@sysvar::CH_Nodes::CH_EISCTRL_C_Stat1_AR_UB__01 = 1;
			break;
		case (3):
			enableControl("CTRL_C_Stat1_AR", "CH_EISCTRL_C_Stat1_AR_UB__01", 0); //1: enable; 0: disable
			@sysvar::CH_Nodes::CH_EISCTRL_C_Stat1_AR_UB__01 = 0;
			break;
	}
}

on sysvar sysvar::CH_Nodes::CH_EISOnKey_PsdCTRL_C_St_UB_AUTO
{
    switch (@sysvar::CH_Nodes::CH_EISOnKey_PsdCTRL_C_St_UB_AUTO)
    {
		case (0):
        	EnableUB("CTRL_C_Stat1_AR", 1);						// 1 = on, 0 = off
        	DisturbUB("CTRL_C_Stat1_AR", "OnKey_Psd_UB", -1, 0);	//Update-Bit immer gleich 0
					enableControl("CTRL_C_Stat1_AR", "CH_EISOnKey_PsdCTRL_C_Stat1__UB__UB", 0); //1: enable; 0: disable
					break;
		case (1):
        	EnableUB("CTRL_C_Stat1_AR", 0);						// 1 = on, 0 = off
					enableControl("CTRL_C_Stat1_AR", "CH_EISOnKey_PsdCTRL_C_Stat1__UB__UB", 1); //1: enable; 0: disable
					break;
		case (2):
        	EnableUB("CTRL_C_Stat1_AR", 1);						// 1 = on, 0 = off
        	DisturbUB("CTRL_C_Stat1_AR", "OnKey_Psd_UB", -1, 1);	//Update-Bit immer gleich 1
					enableControl("CTRL_C_Stat1_AR", "CH_EISOnKey_PsdCTRL_C_Stat1__UB__UB", 0); //1: enable; 0: disable
					break;
		case (3):
        	EnableUB("CTRL_C_Stat1_AR", 1);						// 1 = on, 0 = off
        	DisturbUB("CTRL_C_Stat1_AR", "OnKey_Psd_UB", -1, 0);	//Update-Bit immer gleich 0
					enableControl("CTRL_C_Stat1_AR", "CH_EISOnKey_PsdCTRL_C_Stat1__UB__UB", 0); //1: enable; 0: disable
					break;
    }
}
on sysvar sysvar::CH_Nodes::CH_EISPhoneKey_PsdCTRL_C_UB_AUTO
{
    switch (@sysvar::CH_Nodes::CH_EISPhoneKey_PsdCTRL_C_UB_AUTO)
    {
		case (0):
        	EnableUB("CTRL_C_Stat1_AR", 1);						// 1 = on, 0 = off
        	DisturbUB("CTRL_C_Stat1_AR", "PhoneKey_Psd_UB", -1, 0);	//Update-Bit immer gleich 0
					enableControl("CTRL_C_Stat1_AR", "CH_EISPhoneKey_PsdCTRL_C_Sta_UB__UB", 0); //1: enable; 0: disable
					break;
		case (1):
        	EnableUB("CTRL_C_Stat1_AR", 0);						// 1 = on, 0 = off
					enableControl("CTRL_C_Stat1_AR", "CH_EISPhoneKey_PsdCTRL_C_Sta_UB__UB", 1); //1: enable; 0: disable
					break;
		case (2):
        	EnableUB("CTRL_C_Stat1_AR", 1);						// 1 = on, 0 = off
        	DisturbUB("CTRL_C_Stat1_AR", "PhoneKey_Psd_UB", -1, 1);	//Update-Bit immer gleich 1
					enableControl("CTRL_C_Stat1_AR", "CH_EISPhoneKey_PsdCTRL_C_Sta_UB__UB", 0); //1: enable; 0: disable
					break;
		case (3):
        	EnableUB("CTRL_C_Stat1_AR", 1);						// 1 = on, 0 = off
        	DisturbUB("CTRL_C_Stat1_AR", "PhoneKey_Psd_UB", -1, 0);	//Update-Bit immer gleich 0
					enableControl("CTRL_C_Stat1_AR", "CH_EISPhoneKey_PsdCTRL_C_Sta_UB__UB", 0); //1: enable; 0: disable
					break;
    }
}
on sysvar sysvar::CH_Nodes::CH_EISRadioKey_PsdCTRL_C_UB_AUTO
{
    switch (@sysvar::CH_Nodes::CH_EISRadioKey_PsdCTRL_C_UB_AUTO)
    {
		case (0):
        	EnableUB("CTRL_C_Stat1_AR", 1);						// 1 = on, 0 = off
        	DisturbUB("CTRL_C_Stat1_AR", "RadioKey_Psd_UB", -1, 0);	//Update-Bit immer gleich 0
					enableControl("CTRL_C_Stat1_AR", "CH_EISRadioKey_PsdCTRL_C_Sta_UB__UB", 0); //1: enable; 0: disable
					break;
		case (1):
        	EnableUB("CTRL_C_Stat1_AR", 0);						// 1 = on, 0 = off
					enableControl("CTRL_C_Stat1_AR", "CH_EISRadioKey_PsdCTRL_C_Sta_UB__UB", 1); //1: enable; 0: disable
					break;
		case (2):
        	EnableUB("CTRL_C_Stat1_AR", 1);						// 1 = on, 0 = off
        	DisturbUB("CTRL_C_Stat1_AR", "RadioKey_Psd_UB", -1, 1);	//Update-Bit immer gleich 1
					enableControl("CTRL_C_Stat1_AR", "CH_EISRadioKey_PsdCTRL_C_Sta_UB__UB", 0); //1: enable; 0: disable
					break;
		case (3):
        	EnableUB("CTRL_C_Stat1_AR", 1);						// 1 = on, 0 = off
        	DisturbUB("CTRL_C_Stat1_AR", "RadioKey_Psd_UB", -1, 0);	//Update-Bit immer gleich 0
					enableControl("CTRL_C_Stat1_AR", "CH_EISRadioKey_PsdCTRL_C_Sta_UB__UB", 0); //1: enable; 0: disable
					break;
    }
}
on sysvar sysvar::CH_Nodes::CH_EISSeatKey_PsdCTRL_C__UB_AUTO
{
    switch (@sysvar::CH_Nodes::CH_EISSeatKey_PsdCTRL_C__UB_AUTO)
    {
		case (0):
        	EnableUB("CTRL_C_Stat1_AR", 1);						// 1 = on, 0 = off
        	DisturbUB("CTRL_C_Stat1_AR", "SeatKey_Psd_UB", -1, 0);	//Update-Bit immer gleich 0
					enableControl("CTRL_C_Stat1_AR", "CH_EISSeatKey_PsdCTRL_C_Stat_UB__UB", 0); //1: enable; 0: disable
					break;
		case (1):
        	EnableUB("CTRL_C_Stat1_AR", 0);						// 1 = on, 0 = off
					enableControl("CTRL_C_Stat1_AR", "CH_EISSeatKey_PsdCTRL_C_Stat_UB__UB", 1); //1: enable; 0: disable
					break;
		case (2):
        	EnableUB("CTRL_C_Stat1_AR", 1);						// 1 = on, 0 = off
        	DisturbUB("CTRL_C_Stat1_AR", "SeatKey_Psd_UB", -1, 1);	//Update-Bit immer gleich 1
					enableControl("CTRL_C_Stat1_AR", "CH_EISSeatKey_PsdCTRL_C_Stat_UB__UB", 0); //1: enable; 0: disable
					break;
		case (3):
        	EnableUB("CTRL_C_Stat1_AR", 1);						// 1 = on, 0 = off
        	DisturbUB("CTRL_C_Stat1_AR", "SeatKey_Psd_UB", -1, 0);	//Update-Bit immer gleich 0
					enableControl("CTRL_C_Stat1_AR", "CH_EISSeatKey_PsdCTRL_C_Stat_UB__UB", 0); //1: enable; 0: disable
					break;
    }
}
on sysvar sysvar::CH_Nodes::CH_EISNaviKey_PsdCTRL_C__UB_AUTO
{
    switch (@sysvar::CH_Nodes::CH_EISNaviKey_PsdCTRL_C__UB_AUTO)
    {
		case (0):
        	EnableUB("CTRL_C_Stat1_AR", 1);						// 1 = on, 0 = off
        	DisturbUB("CTRL_C_Stat1_AR", "NaviKey_Psd_UB", -1, 0);	//Update-Bit immer gleich 0
					enableControl("CTRL_C_Stat1_AR", "CH_EISNaviKey_PsdCTRL_C_Stat_UB__UB", 0); //1: enable; 0: disable
					break;
		case (1):
        	EnableUB("CTRL_C_Stat1_AR", 0);						// 1 = on, 0 = off
					enableControl("CTRL_C_Stat1_AR", "CH_EISNaviKey_PsdCTRL_C_Stat_UB__UB", 1); //1: enable; 0: disable
					break;
		case (2):
        	EnableUB("CTRL_C_Stat1_AR", 1);						// 1 = on, 0 = off
        	DisturbUB("CTRL_C_Stat1_AR", "NaviKey_Psd_UB", -1, 1);	//Update-Bit immer gleich 1
					enableControl("CTRL_C_Stat1_AR", "CH_EISNaviKey_PsdCTRL_C_Stat_UB__UB", 0); //1: enable; 0: disable
					break;
		case (3):
        	EnableUB("CTRL_C_Stat1_AR", 1);						// 1 = on, 0 = off
        	DisturbUB("CTRL_C_Stat1_AR", "NaviKey_Psd_UB", -1, 0);	//Update-Bit immer gleich 0
					enableControl("CTRL_C_Stat1_AR", "CH_EISNaviKey_PsdCTRL_C_Stat_UB__UB", 0); //1: enable; 0: disable
					break;
    }
}
on sysvar sysvar::CH_Nodes::CH_EISMediaKey_PsdCTRL_C_UB_AUTO
{
    switch (@sysvar::CH_Nodes::CH_EISMediaKey_PsdCTRL_C_UB_AUTO)
    {
		case (0):
        	EnableUB("CTRL_C_Stat1_AR", 1);						// 1 = on, 0 = off
        	DisturbUB("CTRL_C_Stat1_AR", "MediaKey_Psd_UB", -1, 0);	//Update-Bit immer gleich 0
					enableControl("CTRL_C_Stat1_AR", "CH_EISMediaKey_PsdCTRL_C_Sta_UB__UB", 0); //1: enable; 0: disable
					break;
		case (1):
        	EnableUB("CTRL_C_Stat1_AR", 0);						// 1 = on, 0 = off
					enableControl("CTRL_C_Stat1_AR", "CH_EISMediaKey_PsdCTRL_C_Sta_UB__UB", 1); //1: enable; 0: disable
					break;
		case (2):
        	EnableUB("CTRL_C_Stat1_AR", 1);						// 1 = on, 0 = off
        	DisturbUB("CTRL_C_Stat1_AR", "MediaKey_Psd_UB", -1, 1);	//Update-Bit immer gleich 1
					enableControl("CTRL_C_Stat1_AR", "CH_EISMediaKey_PsdCTRL_C_Sta_UB__UB", 0); //1: enable; 0: disable
					break;
		case (3):
        	EnableUB("CTRL_C_Stat1_AR", 1);						// 1 = on, 0 = off
        	DisturbUB("CTRL_C_Stat1_AR", "MediaKey_Psd_UB", -1, 0);	//Update-Bit immer gleich 0
					enableControl("CTRL_C_Stat1_AR", "CH_EISMediaKey_PsdCTRL_C_Sta_UB__UB", 0); //1: enable; 0: disable
					break;
    }
}
on sysvar sysvar::CH_Nodes::CH_EISCarKey_PsdCTRL_C_S_UB_AUTO
{
    switch (@sysvar::CH_Nodes::CH_EISCarKey_PsdCTRL_C_S_UB_AUTO)
    {
		case (0):
        	EnableUB("CTRL_C_Stat1_AR", 1);						// 1 = on, 0 = off
        	DisturbUB("CTRL_C_Stat1_AR", "CarKey_Psd_UB", -1, 0);	//Update-Bit immer gleich 0
					enableControl("CTRL_C_Stat1_AR", "CH_EISCarKey_PsdCTRL_C_Stat1_UB__UB", 0); //1: enable; 0: disable
					break;
		case (1):
        	EnableUB("CTRL_C_Stat1_AR", 0);						// 1 = on, 0 = off
					enableControl("CTRL_C_Stat1_AR", "CH_EISCarKey_PsdCTRL_C_Stat1_UB__UB", 1); //1: enable; 0: disable
					break;
		case (2):
        	EnableUB("CTRL_C_Stat1_AR", 1);						// 1 = on, 0 = off
        	DisturbUB("CTRL_C_Stat1_AR", "CarKey_Psd_UB", -1, 1);	//Update-Bit immer gleich 1
					enableControl("CTRL_C_Stat1_AR", "CH_EISCarKey_PsdCTRL_C_Stat1_UB__UB", 0); //1: enable; 0: disable
					break;
		case (3):
        	EnableUB("CTRL_C_Stat1_AR", 1);						// 1 = on, 0 = off
        	DisturbUB("CTRL_C_Stat1_AR", "CarKey_Psd_UB", -1, 0);	//Update-Bit immer gleich 0
					enableControl("CTRL_C_Stat1_AR", "CH_EISCarKey_PsdCTRL_C_Stat1_UB__UB", 0); //1: enable; 0: disable
					break;
    }
}
on sysvar sysvar::CH_Nodes::CH_EISReturnKey_PsdCTRL__UB_AUTO
{
    switch (@sysvar::CH_Nodes::CH_EISReturnKey_PsdCTRL__UB_AUTO)
    {
		case (0):
        	EnableUB("CTRL_C_Stat1_AR", 1);						// 1 = on, 0 = off
        	DisturbUB("CTRL_C_Stat1_AR", "ReturnKey_Psd_UB", -1, 0);	//Update-Bit immer gleich 0
					enableControl("CTRL_C_Stat1_AR", "CH_EISReturnKey_PsdCTRL_C_St_UB__UB", 0); //1: enable; 0: disable
					break;
		case (1):
        	EnableUB("CTRL_C_Stat1_AR", 0);						// 1 = on, 0 = off
					enableControl("CTRL_C_Stat1_AR", "CH_EISReturnKey_PsdCTRL_C_St_UB__UB", 1); //1: enable; 0: disable
					break;
		case (2):
        	EnableUB("CTRL_C_Stat1_AR", 1);						// 1 = on, 0 = off
        	DisturbUB("CTRL_C_Stat1_AR", "ReturnKey_Psd_UB", -1, 1);	//Update-Bit immer gleich 1
					enableControl("CTRL_C_Stat1_AR", "CH_EISReturnKey_PsdCTRL_C_St_UB__UB", 0); //1: enable; 0: disable
					break;
		case (3):
        	EnableUB("CTRL_C_Stat1_AR", 1);						// 1 = on, 0 = off
        	DisturbUB("CTRL_C_Stat1_AR", "ReturnKey_Psd_UB", -1, 0);	//Update-Bit immer gleich 0
					enableControl("CTRL_C_Stat1_AR", "CH_EISReturnKey_PsdCTRL_C_St_UB__UB", 0); //1: enable; 0: disable
					break;
    }
}
on sysvar sysvar::CH_Nodes::CH_EISMenuKey_PsdCTRL_C__UB_AUTO
{
    switch (@sysvar::CH_Nodes::CH_EISMenuKey_PsdCTRL_C__UB_AUTO)
    {
		case (0):
        	EnableUB("CTRL_C_Stat1_AR", 1);						// 1 = on, 0 = off
        	DisturbUB("CTRL_C_Stat1_AR", "MenuKey_Psd_UB", -1, 0);	//Update-Bit immer gleich 0
					enableControl("CTRL_C_Stat1_AR", "CH_EISMenuKey_PsdCTRL_C_Stat_UB__UB", 0); //1: enable; 0: disable
					break;
		case (1):
        	EnableUB("CTRL_C_Stat1_AR", 0);						// 1 = on, 0 = off
					enableControl("CTRL_C_Stat1_AR", "CH_EISMenuKey_PsdCTRL_C_Stat_UB__UB", 1); //1: enable; 0: disable
					break;
		case (2):
        	EnableUB("CTRL_C_Stat1_AR", 1);						// 1 = on, 0 = off
        	DisturbUB("CTRL_C_Stat1_AR", "MenuKey_Psd_UB", -1, 1);	//Update-Bit immer gleich 1
					enableControl("CTRL_C_Stat1_AR", "CH_EISMenuKey_PsdCTRL_C_Stat_UB__UB", 0); //1: enable; 0: disable
					break;
		case (3):
        	EnableUB("CTRL_C_Stat1_AR", 1);						// 1 = on, 0 = off
        	DisturbUB("CTRL_C_Stat1_AR", "MenuKey_Psd_UB", -1, 0);	//Update-Bit immer gleich 0
					enableControl("CTRL_C_Stat1_AR", "CH_EISMenuKey_PsdCTRL_C_Stat_UB__UB", 0); //1: enable; 0: disable
					break;
    }
}
on sysvar sysvar::CH_Nodes::CH_EISMuteKey_PsdCTRL_C__UB_AUTO
{
    switch (@sysvar::CH_Nodes::CH_EISMuteKey_PsdCTRL_C__UB_AUTO)
    {
		case (0):
        	EnableUB("CTRL_C_Stat1_AR", 1);						// 1 = on, 0 = off
        	DisturbUB("CTRL_C_Stat1_AR", "MuteKey_Psd_UB", -1, 0);	//Update-Bit immer gleich 0
					enableControl("CTRL_C_Stat1_AR", "CH_EISMuteKey_PsdCTRL_C_Stat_UB__UB", 0); //1: enable; 0: disable
					break;
		case (1):
        	EnableUB("CTRL_C_Stat1_AR", 0);						// 1 = on, 0 = off
					enableControl("CTRL_C_Stat1_AR", "CH_EISMuteKey_PsdCTRL_C_Stat_UB__UB", 1); //1: enable; 0: disable
					break;
		case (2):
        	EnableUB("CTRL_C_Stat1_AR", 1);						// 1 = on, 0 = off
        	DisturbUB("CTRL_C_Stat1_AR", "MuteKey_Psd_UB", -1, 1);	//Update-Bit immer gleich 1
					enableControl("CTRL_C_Stat1_AR", "CH_EISMuteKey_PsdCTRL_C_Stat_UB__UB", 0); //1: enable; 0: disable
					break;
		case (3):
        	EnableUB("CTRL_C_Stat1_AR", 1);						// 1 = on, 0 = off
        	DisturbUB("CTRL_C_Stat1_AR", "MuteKey_Psd_UB", -1, 0);	//Update-Bit immer gleich 0
					enableControl("CTRL_C_Stat1_AR", "CH_EISMuteKey_PsdCTRL_C_Stat_UB__UB", 0); //1: enable; 0: disable
					break;
    }
}
on sysvar sysvar::CH_Nodes::CH_EISDAC4_ECM_AR_UB_AUTO_01
{
	switch (@sysvar::CH_Nodes::CH_EISDAC4_ECM_AR_UB_AUTO_01)
	{
		case (0):
			enableControl("DAC4_ECM_AR", "CH_EISDAC4_ECM_AR_UB__01", 0); //1: enable; 0: disable
			@sysvar::CH_Nodes::CH_EISDAC4_ECM_AR_UB__01 = 1;
			break;
		case (1):
			enableControl("DAC4_ECM_AR", "CH_EISDAC4_ECM_AR_UB__01", 1); //1: enable; 0: disable
			break;
		case (2):
			enableControl("DAC4_ECM_AR", "CH_EISDAC4_ECM_AR_UB__01", 0); //1: enable; 0: disable
			@sysvar::CH_Nodes::CH_EISDAC4_ECM_AR_UB__01 = 1;
			break;
		case (3):
			enableControl("DAC4_ECM_AR", "CH_EISDAC4_ECM_AR_UB__01", 0); //1: enable; 0: disable
			@sysvar::CH_Nodes::CH_EISDAC4_ECM_AR_UB__01 = 0;
			break;
	}
}

on sysvar sysvar::CH_Nodes::CH_EISDAC4_EM2_AR_UB_AUTO_01
{
	switch (@sysvar::CH_Nodes::CH_EISDAC4_EM2_AR_UB_AUTO_01)
	{
		case (0):
			enableControl("DAC4_EM2_AR", "CH_EISDAC4_EM2_AR_UB__01", 0); //1: enable; 0: disable
			@sysvar::CH_Nodes::CH_EISDAC4_EM2_AR_UB__01 = 1;
			break;
		case (1):
			enableControl("DAC4_EM2_AR", "CH_EISDAC4_EM2_AR_UB__01", 1); //1: enable; 0: disable
			break;
		case (2):
			enableControl("DAC4_EM2_AR", "CH_EISDAC4_EM2_AR_UB__01", 0); //1: enable; 0: disable
			@sysvar::CH_Nodes::CH_EISDAC4_EM2_AR_UB__01 = 1;
			break;
		case (3):
			enableControl("DAC4_EM2_AR", "CH_EISDAC4_EM2_AR_UB__01", 0); //1: enable; 0: disable
			@sysvar::CH_Nodes::CH_EISDAC4_EM2_AR_UB__01 = 0;
			break;
	}
}

on sysvar sysvar::CH_Nodes::CH_EISDAC4_ISM_AR_UB_AUTO_01
{
	switch (@sysvar::CH_Nodes::CH_EISDAC4_ISM_AR_UB_AUTO_01)
	{
		case (0):
			enableControl("DAC4_ISM_AR", "CH_EISDAC4_ISM_AR_UB__01", 0); //1: enable; 0: disable
			@sysvar::CH_Nodes::CH_EISDAC4_ISM_AR_UB__01 = 1;
			break;
		case (1):
			enableControl("DAC4_ISM_AR", "CH_EISDAC4_ISM_AR_UB__01", 1); //1: enable; 0: disable
			break;
		case (2):
			enableControl("DAC4_ISM_AR", "CH_EISDAC4_ISM_AR_UB__01", 0); //1: enable; 0: disable
			@sysvar::CH_Nodes::CH_EISDAC4_ISM_AR_UB__01 = 1;
			break;
		case (3):
			enableControl("DAC4_ISM_AR", "CH_EISDAC4_ISM_AR_UB__01", 0); //1: enable; 0: disable
			@sysvar::CH_Nodes::CH_EISDAC4_ISM_AR_UB__01 = 0;
			break;
	}
}

on sysvar sysvar::CH_Nodes::CH_EISDAC4_TCM_AR_UB_AUTO_01
{
	switch (@sysvar::CH_Nodes::CH_EISDAC4_TCM_AR_UB_AUTO_01)
	{
		case (0):
			enableControl("DAC4_TCM_AR", "CH_EISDAC4_TCM_AR_UB__01", 0); //1: enable; 0: disable
			@sysvar::CH_Nodes::CH_EISDAC4_TCM_AR_UB__01 = 1;
			break;
		case (1):
			enableControl("DAC4_TCM_AR", "CH_EISDAC4_TCM_AR_UB__01", 1); //1: enable; 0: disable
			break;
		case (2):
			enableControl("DAC4_TCM_AR", "CH_EISDAC4_TCM_AR_UB__01", 0); //1: enable; 0: disable
			@sysvar::CH_Nodes::CH_EISDAC4_TCM_AR_UB__01 = 1;
			break;
		case (3):
			enableControl("DAC4_TCM_AR", "CH_EISDAC4_TCM_AR_UB__01", 0); //1: enable; 0: disable
			@sysvar::CH_Nodes::CH_EISDAC4_TCM_AR_UB__01 = 0;
			break;
	}
}

on sysvar sysvar::CH_Nodes::CH_EISDoor_FL_Stat_AR2_UB_AUT_01
{
	switch (@sysvar::CH_Nodes::CH_EISDoor_FL_Stat_AR2_UB_AUT_01)
	{
		case (0):
			enableControl("Door_FL_Stat_AR2", "CH_EISDoor_FL_Stat_AR2_UB__01", 0); //1: enable; 0: disable
			@sysvar::CH_Nodes::CH_EISDoor_FL_Stat_AR2_UB__01 = 1;
			break;
		case (1):
			enableControl("Door_FL_Stat_AR2", "CH_EISDoor_FL_Stat_AR2_UB__01", 1); //1: enable; 0: disable
			break;
		case (2):
			enableControl("Door_FL_Stat_AR2", "CH_EISDoor_FL_Stat_AR2_UB__01", 0); //1: enable; 0: disable
			@sysvar::CH_Nodes::CH_EISDoor_FL_Stat_AR2_UB__01 = 1;
			break;
		case (3):
			enableControl("Door_FL_Stat_AR2", "CH_EISDoor_FL_Stat_AR2_UB__01", 0); //1: enable; 0: disable
			@sysvar::CH_Nodes::CH_EISDoor_FL_Stat_AR2_UB__01 = 0;
			break;
	}
}

on sysvar sysvar::CH_Nodes::CH_EISCRC_Door_FL_Stat_Pr2D_AUTO
{
//	EnableCRC("Door_FL_Stat_AR2",  "Door_FL_Stat_Pr2", !@this); // 1 = on, 0 = off 
	enableControl("Door_FL_Stat_AR2", "CH_EISCRC_Door_FL_Stat_Pr2Door__", @this); //1: enable; 0: disable
	CRC_Door_FL_Stat_Pr2 = @sysvar::CH_Nodes::CH_EISCRC_Door_FL_Stat_Pr2D_AUTO;
}

on sysvar sysvar::CH_Nodes::CH_EISSQC_Door_FL_Stat_Pr2D_AUTO
{
//	EnableSQC("Door_FL_Stat_AR2",  "Door_FL_Stat_Pr2", !@this); // 1 = on, 0 = off 
	enableControl("Door_FL_Stat_AR2", "CH_EISSQC_Door_FL_Stat_Pr2Door__", @this); //1: enable; 0: disable
	SQC_Door_FL_Stat_Pr2 = @sysvar::CH_Nodes::CH_EISSQC_Door_FL_Stat_Pr2D_AUTO;
}

on sysvar sysvar::CH_Nodes::CH_EISDoor_FR_Stat_AR2_UB_AUT_01
{
	switch (@sysvar::CH_Nodes::CH_EISDoor_FR_Stat_AR2_UB_AUT_01)
	{
		case (0):
			enableControl("Door_FR_Stat_AR2", "CH_EISDoor_FR_Stat_AR2_UB__01", 0); //1: enable; 0: disable
			@sysvar::CH_Nodes::CH_EISDoor_FR_Stat_AR2_UB__01 = 1;
			break;
		case (1):
			enableControl("Door_FR_Stat_AR2", "CH_EISDoor_FR_Stat_AR2_UB__01", 1); //1: enable; 0: disable
			break;
		case (2):
			enableControl("Door_FR_Stat_AR2", "CH_EISDoor_FR_Stat_AR2_UB__01", 0); //1: enable; 0: disable
			@sysvar::CH_Nodes::CH_EISDoor_FR_Stat_AR2_UB__01 = 1;
			break;
		case (3):
			enableControl("Door_FR_Stat_AR2", "CH_EISDoor_FR_Stat_AR2_UB__01", 0); //1: enable; 0: disable
			@sysvar::CH_Nodes::CH_EISDoor_FR_Stat_AR2_UB__01 = 0;
			break;
	}
}

on sysvar sysvar::CH_Nodes::CH_EISCRC_Door_FR_Stat_Pr2D_AUTO
{
//	EnableCRC("Door_FR_Stat_AR2",  "Door_FR_Stat_Pr2", !@this); // 1 = on, 0 = off 
	enableControl("Door_FR_Stat_AR2", "CH_EISCRC_Door_FR_Stat_Pr2Door__", @this); //1: enable; 0: disable
	CRC_Door_FR_Stat_Pr2 = @sysvar::CH_Nodes::CH_EISCRC_Door_FR_Stat_Pr2D_AUTO;
}

on sysvar sysvar::CH_Nodes::CH_EISSQC_Door_FR_Stat_Pr2D_AUTO
{
//	EnableSQC("Door_FR_Stat_AR2",  "Door_FR_Stat_Pr2", !@this); // 1 = on, 0 = off 
	enableControl("Door_FR_Stat_AR2", "CH_EISSQC_Door_FR_Stat_Pr2Door__", @this); //1: enable; 0: disable
	SQC_Door_FR_Stat_Pr2 = @sysvar::CH_Nodes::CH_EISSQC_Door_FR_Stat_Pr2D_AUTO;
}

on sysvar sysvar::CH_Nodes::CH_EISDoor_RL_Stat_AR2_UB_AUT_01
{
	switch (@sysvar::CH_Nodes::CH_EISDoor_RL_Stat_AR2_UB_AUT_01)
	{
		case (0):
			enableControl("Door_RL_Stat_AR2", "CH_EISDoor_RL_Stat_AR2_UB__01", 0); //1: enable; 0: disable
			@sysvar::CH_Nodes::CH_EISDoor_RL_Stat_AR2_UB__01 = 1;
			break;
		case (1):
			enableControl("Door_RL_Stat_AR2", "CH_EISDoor_RL_Stat_AR2_UB__01", 1); //1: enable; 0: disable
			break;
		case (2):
			enableControl("Door_RL_Stat_AR2", "CH_EISDoor_RL_Stat_AR2_UB__01", 0); //1: enable; 0: disable
			@sysvar::CH_Nodes::CH_EISDoor_RL_Stat_AR2_UB__01 = 1;
			break;
		case (3):
			enableControl("Door_RL_Stat_AR2", "CH_EISDoor_RL_Stat_AR2_UB__01", 0); //1: enable; 0: disable
			@sysvar::CH_Nodes::CH_EISDoor_RL_Stat_AR2_UB__01 = 0;
			break;
	}
}

on sysvar sysvar::CH_Nodes::CH_EISCRC_Door_RL_Stat_Pr2D_AUTO
{
//	EnableCRC("Door_RL_Stat_AR2",  "Door_RL_Stat_Pr2", !@this); // 1 = on, 0 = off 
	enableControl("Door_RL_Stat_AR2", "CH_EISCRC_Door_RL_Stat_Pr2Door__", @this); //1: enable; 0: disable
	CRC_Door_RL_Stat_Pr2 = @sysvar::CH_Nodes::CH_EISCRC_Door_RL_Stat_Pr2D_AUTO;
}

on sysvar sysvar::CH_Nodes::CH_EISSQC_Door_RL_Stat_Pr2D_AUTO
{
//	EnableSQC("Door_RL_Stat_AR2",  "Door_RL_Stat_Pr2", !@this); // 1 = on, 0 = off 
	enableControl("Door_RL_Stat_AR2", "CH_EISSQC_Door_RL_Stat_Pr2Door__", @this); //1: enable; 0: disable
	SQC_Door_RL_Stat_Pr2 = @sysvar::CH_Nodes::CH_EISSQC_Door_RL_Stat_Pr2D_AUTO;
}

on sysvar sysvar::CH_Nodes::CH_EISDoor_RR_Stat_AR2_UB_AUT_01
{
	switch (@sysvar::CH_Nodes::CH_EISDoor_RR_Stat_AR2_UB_AUT_01)
	{
		case (0):
			enableControl("Door_RR_Stat_AR2", "CH_EISDoor_RR_Stat_AR2_UB__01", 0); //1: enable; 0: disable
			@sysvar::CH_Nodes::CH_EISDoor_RR_Stat_AR2_UB__01 = 1;
			break;
		case (1):
			enableControl("Door_RR_Stat_AR2", "CH_EISDoor_RR_Stat_AR2_UB__01", 1); //1: enable; 0: disable
			break;
		case (2):
			enableControl("Door_RR_Stat_AR2", "CH_EISDoor_RR_Stat_AR2_UB__01", 0); //1: enable; 0: disable
			@sysvar::CH_Nodes::CH_EISDoor_RR_Stat_AR2_UB__01 = 1;
			break;
		case (3):
			enableControl("Door_RR_Stat_AR2", "CH_EISDoor_RR_Stat_AR2_UB__01", 0); //1: enable; 0: disable
			@sysvar::CH_Nodes::CH_EISDoor_RR_Stat_AR2_UB__01 = 0;
			break;
	}
}

on sysvar sysvar::CH_Nodes::CH_EISCRC_Door_RR_Stat_Pr2D_AUTO
{
//	EnableCRC("Door_RR_Stat_AR2",  "Door_RR_Stat_Pr2", !@this); // 1 = on, 0 = off 
	enableControl("Door_RR_Stat_AR2", "CH_EISCRC_Door_RR_Stat_Pr2Door__", @this); //1: enable; 0: disable
	CRC_Door_RR_Stat_Pr2 = @sysvar::CH_Nodes::CH_EISCRC_Door_RR_Stat_Pr2D_AUTO;
}

on sysvar sysvar::CH_Nodes::CH_EISSQC_Door_RR_Stat_Pr2D_AUTO
{
//	EnableSQC("Door_RR_Stat_AR2",  "Door_RR_Stat_Pr2", !@this); // 1 = on, 0 = off 
	enableControl("Door_RR_Stat_AR2", "CH_EISSQC_Door_RR_Stat_Pr2Door__", @this); //1: enable; 0: disable
	SQC_Door_RR_Stat_Pr2 = @sysvar::CH_Nodes::CH_EISSQC_Door_RR_Stat_Pr2D_AUTO;
}

on sysvar sysvar::CH_Nodes::CH_EISDPC_IndMd_Rq_AR_UB_AUTO_01
{
	switch (@sysvar::CH_Nodes::CH_EISDPC_IndMd_Rq_AR_UB_AUTO_01)
	{
		case (0):
			enableControl("DPC_IndMd_Rq_AR", "CH_EISDPC_IndMd_Rq_AR_UB__01", 0); //1: enable; 0: disable
			@sysvar::CH_Nodes::CH_EISDPC_IndMd_Rq_AR_UB__01 = 1;
			break;
		case (1):
			enableControl("DPC_IndMd_Rq_AR", "CH_EISDPC_IndMd_Rq_AR_UB__01", 1); //1: enable; 0: disable
			break;
		case (2):
			enableControl("DPC_IndMd_Rq_AR", "CH_EISDPC_IndMd_Rq_AR_UB__01", 0); //1: enable; 0: disable
			@sysvar::CH_Nodes::CH_EISDPC_IndMd_Rq_AR_UB__01 = 1;
			break;
		case (3):
			enableControl("DPC_IndMd_Rq_AR", "CH_EISDPC_IndMd_Rq_AR_UB__01", 0); //1: enable; 0: disable
			@sysvar::CH_Nodes::CH_EISDPC_IndMd_Rq_AR_UB__01 = 0;
			break;
	}
}

on sysvar sysvar::CH_Nodes::CH_EISEL_Stat_AR2_UB_AUTO_01
{
	switch (@sysvar::CH_Nodes::CH_EISEL_Stat_AR2_UB_AUTO_01)
	{
		case (0):
			enableControl("EL_Stat_AR2", "CH_EISEL_Stat_AR2_UB__01", 0); //1: enable; 0: disable
			@sysvar::CH_Nodes::CH_EISEL_Stat_AR2_UB__01 = 1;
			break;
		case (1):
			enableControl("EL_Stat_AR2", "CH_EISEL_Stat_AR2_UB__01", 1); //1: enable; 0: disable
			break;
		case (2):
			enableControl("EL_Stat_AR2", "CH_EISEL_Stat_AR2_UB__01", 0); //1: enable; 0: disable
			@sysvar::CH_Nodes::CH_EISEL_Stat_AR2_UB__01 = 1;
			break;
		case (3):
			enableControl("EL_Stat_AR2", "CH_EISEL_Stat_AR2_UB__01", 0); //1: enable; 0: disable
			@sysvar::CH_Nodes::CH_EISEL_Stat_AR2_UB__01 = 0;
			break;
	}
}

on sysvar sysvar::CH_Nodes::CH_EISCRC_ExtLgt_Lmp_On_Rq__AUTO
{
//	EnableCRC("EL_Stat_AR2",  "ExtLgt_Lmp_On_Rq_Pr2", !@this); // 1 = on, 0 = off 
	enableControl("EL_Stat_AR2", "CH_EISCRC_ExtLgt_Lmp_On_Rq_Pr2E_", @this); //1: enable; 0: disable
	CRC_ExtLgt_Lmp_On_Rq_Pr2 = @sysvar::CH_Nodes::CH_EISCRC_ExtLgt_Lmp_On_Rq__AUTO;
}

on sysvar sysvar::CH_Nodes::CH_EISSQC_ExtLgt_Lmp_On_Rq__AUTO
{
//	EnableSQC("EL_Stat_AR2",  "ExtLgt_Lmp_On_Rq_Pr2", !@this); // 1 = on, 0 = off 
	enableControl("EL_Stat_AR2", "CH_EISSQC_ExtLgt_Lmp_On_Rq_Pr2E_", @this); //1: enable; 0: disable
	SQC_ExtLgt_Lmp_On_Rq_Pr2 = @sysvar::CH_Nodes::CH_EISSQC_ExtLgt_Lmp_On_Rq__AUTO;
}

on sysvar sysvar::CH_Nodes::CH_EISEL_TurnInd_Rq_AR2_UB_AUTO
{
	switch (@sysvar::CH_Nodes::CH_EISEL_TurnInd_Rq_AR2_UB_AUTO)
	{
		case (0):
			enableControl("EL_TurnInd_Rq_AR2", "CH_EISEL_TurnInd_Rq_AR2_UB_", 0); //1: enable; 0: disable
			@sysvar::CH_Nodes::CH_EISEL_TurnInd_Rq_AR2_UB_ = 1;
			break;
		case (1):
			enableControl("EL_TurnInd_Rq_AR2", "CH_EISEL_TurnInd_Rq_AR2_UB_", 1); //1: enable; 0: disable
			break;
		case (2):
			enableControl("EL_TurnInd_Rq_AR2", "CH_EISEL_TurnInd_Rq_AR2_UB_", 0); //1: enable; 0: disable
			@sysvar::CH_Nodes::CH_EISEL_TurnInd_Rq_AR2_UB_ = 1;
			break;
		case (3):
			enableControl("EL_TurnInd_Rq_AR2", "CH_EISEL_TurnInd_Rq_AR2_UB_", 0); //1: enable; 0: disable
			@sysvar::CH_Nodes::CH_EISEL_TurnInd_Rq_AR2_UB_ = 0;
			break;
	}
}

on sysvar sysvar::CH_Nodes::CH_EISCRC_EL_TurnInd_On_Rq__AUTO
{
//	EnableCRC("EL_TurnInd_Rq_AR2",  "EL_TurnInd_On_Rq_Pr2", !@this); // 1 = on, 0 = off 
	enableControl("EL_TurnInd_Rq_AR2", "CH_EISCRC_EL_TurnInd_On_Rq_Pr2E_", @this); //1: enable; 0: disable
	CRC_EL_TurnInd_On_Rq_Pr2 = @sysvar::CH_Nodes::CH_EISCRC_EL_TurnInd_On_Rq__AUTO;
}

on sysvar sysvar::CH_Nodes::CH_EISSQC_EL_TurnInd_On_Rq__AUTO
{
//	EnableSQC("EL_TurnInd_Rq_AR2",  "EL_TurnInd_On_Rq_Pr2", !@this); // 1 = on, 0 = off 
	enableControl("EL_TurnInd_Rq_AR2", "CH_EISSQC_EL_TurnInd_On_Rq_Pr2E_", @this); //1: enable; 0: disable
	SQC_EL_TurnInd_On_Rq_Pr2 = @sysvar::CH_Nodes::CH_EISSQC_EL_TurnInd_On_Rq__AUTO;
}

on sysvar sysvar::CH_Nodes::CH_EISEPKB_Stat_AR2_UB_AUTO_01
{
	switch (@sysvar::CH_Nodes::CH_EISEPKB_Stat_AR2_UB_AUTO_01)
	{
		case (0):
			enableControl("EPKB_Stat_AR2", "CH_EISEPKB_Stat_AR2_UB__01", 0); //1: enable; 0: disable
			@sysvar::CH_Nodes::CH_EISEPKB_Stat_AR2_UB__01 = 1;
			break;
		case (1):
			enableControl("EPKB_Stat_AR2", "CH_EISEPKB_Stat_AR2_UB__01", 1); //1: enable; 0: disable
			break;
		case (2):
			enableControl("EPKB_Stat_AR2", "CH_EISEPKB_Stat_AR2_UB__01", 0); //1: enable; 0: disable
			@sysvar::CH_Nodes::CH_EISEPKB_Stat_AR2_UB__01 = 1;
			break;
		case (3):
			enableControl("EPKB_Stat_AR2", "CH_EISEPKB_Stat_AR2_UB__01", 0); //1: enable; 0: disable
			@sysvar::CH_Nodes::CH_EISEPKB_Stat_AR2_UB__01 = 0;
			break;
	}
}

on sysvar sysvar::CH_Nodes::CH_EISCRC_EPKB_Stat_Pr2EPKB_AUTO
{
//	EnableCRC("EPKB_Stat_AR2",  "EPKB_Stat_Pr2", !@this); // 1 = on, 0 = off 
	enableControl("EPKB_Stat_AR2", "CH_EISCRC_EPKB_Stat_Pr2EPKB_Sta_", @this); //1: enable; 0: disable
	CRC_EPKB_Stat_Pr2 = @sysvar::CH_Nodes::CH_EISCRC_EPKB_Stat_Pr2EPKB_AUTO;
}

on sysvar sysvar::CH_Nodes::CH_EISSQC_EPKB_Stat_Pr2EPKB_AUTO
{
//	EnableSQC("EPKB_Stat_AR2",  "EPKB_Stat_Pr2", !@this); // 1 = on, 0 = off 
	enableControl("EPKB_Stat_AR2", "CH_EISSQC_EPKB_Stat_Pr2EPKB_Sta_", @this); //1: enable; 0: disable
	SQC_EPKB_Stat_Pr2 = @sysvar::CH_Nodes::CH_EISSQC_EPKB_Stat_Pr2EPKB_AUTO;
}

on sysvar sysvar::CH_Nodes::CH_EISEVC_CfgBit_01_32_A_UB_A_01
{
	switch (@sysvar::CH_Nodes::CH_EISEVC_CfgBit_01_32_A_UB_A_01)
	{
		case (0):
			enableControl("EVC_CfgBit_01_32_AR2", "CH_EISEVC_CfgBit_01_32_AR2_UB_01", 0); //1: enable; 0: disable
			@sysvar::CH_Nodes::CH_EISEVC_CfgBit_01_32_AR2_UB_01 = 1;
			break;
		case (1):
			enableControl("EVC_CfgBit_01_32_AR2", "CH_EISEVC_CfgBit_01_32_AR2_UB_01", 1); //1: enable; 0: disable
			break;
		case (2):
			enableControl("EVC_CfgBit_01_32_AR2", "CH_EISEVC_CfgBit_01_32_AR2_UB_01", 0); //1: enable; 0: disable
			@sysvar::CH_Nodes::CH_EISEVC_CfgBit_01_32_AR2_UB_01 = 1;
			break;
		case (3):
			enableControl("EVC_CfgBit_01_32_AR2", "CH_EISEVC_CfgBit_01_32_AR2_UB_01", 0); //1: enable; 0: disable
			@sysvar::CH_Nodes::CH_EISEVC_CfgBit_01_32_AR2_UB_01 = 0;
			break;
	}
}

on sysvar sysvar::CH_Nodes::CH_EISCRC_EVC_CfgBit_01_32__AUTO
{
//	EnableCRC("EVC_CfgBit_01_32_AR2",  "EVC_CfgBit_01_32_Pr2", !@this); // 1 = on, 0 = off 
	enableControl("EVC_CfgBit_01_32_AR2", "CH_EISCRC_EVC_CfgBit_01_32_Pr2E_", @this); //1: enable; 0: disable
	CRC_EVC_CfgBit_01_32_Pr2 = @sysvar::CH_Nodes::CH_EISCRC_EVC_CfgBit_01_32__AUTO;
}

on sysvar sysvar::CH_Nodes::CH_EISSQC_EVC_CfgBit_01_32__AUTO
{
//	EnableSQC("EVC_CfgBit_01_32_AR2",  "EVC_CfgBit_01_32_Pr2", !@this); // 1 = on, 0 = off 
	enableControl("EVC_CfgBit_01_32_AR2", "CH_EISSQC_EVC_CfgBit_01_32_Pr2E_", @this); //1: enable; 0: disable
	SQC_EVC_CfgBit_01_32_Pr2 = @sysvar::CH_Nodes::CH_EISSQC_EVC_CfgBit_01_32__AUTO;
}

on sysvar sysvar::CH_Nodes::CH_EISEVC_CfgBit_33_64_A_UB_A_01
{
	switch (@sysvar::CH_Nodes::CH_EISEVC_CfgBit_33_64_A_UB_A_01)
	{
		case (0):
			enableControl("EVC_CfgBit_33_64_AR2", "CH_EISEVC_CfgBit_33_64_AR2_UB_01", 0); //1: enable; 0: disable
			@sysvar::CH_Nodes::CH_EISEVC_CfgBit_33_64_AR2_UB_01 = 1;
			break;
		case (1):
			enableControl("EVC_CfgBit_33_64_AR2", "CH_EISEVC_CfgBit_33_64_AR2_UB_01", 1); //1: enable; 0: disable
			break;
		case (2):
			enableControl("EVC_CfgBit_33_64_AR2", "CH_EISEVC_CfgBit_33_64_AR2_UB_01", 0); //1: enable; 0: disable
			@sysvar::CH_Nodes::CH_EISEVC_CfgBit_33_64_AR2_UB_01 = 1;
			break;
		case (3):
			enableControl("EVC_CfgBit_33_64_AR2", "CH_EISEVC_CfgBit_33_64_AR2_UB_01", 0); //1: enable; 0: disable
			@sysvar::CH_Nodes::CH_EISEVC_CfgBit_33_64_AR2_UB_01 = 0;
			break;
	}
}

on sysvar sysvar::CH_Nodes::CH_EISCRC_EVC_CfgBit_33_64__AUTO
{
//	EnableCRC("EVC_CfgBit_33_64_AR2",  "EVC_CfgBit_33_64_Pr2", !@this); // 1 = on, 0 = off 
	enableControl("EVC_CfgBit_33_64_AR2", "CH_EISCRC_EVC_CfgBit_33_64_Pr2E_", @this); //1: enable; 0: disable
	CRC_EVC_CfgBit_33_64_Pr2 = @sysvar::CH_Nodes::CH_EISCRC_EVC_CfgBit_33_64__AUTO;
}

on sysvar sysvar::CH_Nodes::CH_EISSQC_EVC_CfgBit_33_64__AUTO
{
//	EnableSQC("EVC_CfgBit_33_64_AR2",  "EVC_CfgBit_33_64_Pr2", !@this); // 1 = on, 0 = off 
	enableControl("EVC_CfgBit_33_64_AR2", "CH_EISSQC_EVC_CfgBit_33_64_Pr2E_", @this); //1: enable; 0: disable
	SQC_EVC_CfgBit_33_64_Pr2 = @sysvar::CH_Nodes::CH_EISSQC_EVC_CfgBit_33_64__AUTO;
}

on sysvar sysvar::CH_Nodes::CH_EISEVC_CfgBit_65_96_A_UB_A_01
{
	switch (@sysvar::CH_Nodes::CH_EISEVC_CfgBit_65_96_A_UB_A_01)
	{
		case (0):
			enableControl("EVC_CfgBit_65_96_AR2", "CH_EISEVC_CfgBit_65_96_AR2_UB_01", 0); //1: enable; 0: disable
			@sysvar::CH_Nodes::CH_EISEVC_CfgBit_65_96_AR2_UB_01 = 1;
			break;
		case (1):
			enableControl("EVC_CfgBit_65_96_AR2", "CH_EISEVC_CfgBit_65_96_AR2_UB_01", 1); //1: enable; 0: disable
			break;
		case (2):
			enableControl("EVC_CfgBit_65_96_AR2", "CH_EISEVC_CfgBit_65_96_AR2_UB_01", 0); //1: enable; 0: disable
			@sysvar::CH_Nodes::CH_EISEVC_CfgBit_65_96_AR2_UB_01 = 1;
			break;
		case (3):
			enableControl("EVC_CfgBit_65_96_AR2", "CH_EISEVC_CfgBit_65_96_AR2_UB_01", 0); //1: enable; 0: disable
			@sysvar::CH_Nodes::CH_EISEVC_CfgBit_65_96_AR2_UB_01 = 0;
			break;
	}
}

on sysvar sysvar::CH_Nodes::CH_EISCRC_EVC_CfgBit_65_96__AUTO
{
//	EnableCRC("EVC_CfgBit_65_96_AR2",  "EVC_CfgBit_65_96_Pr2", !@this); // 1 = on, 0 = off 
	enableControl("EVC_CfgBit_65_96_AR2", "CH_EISCRC_EVC_CfgBit_65_96_Pr2E_", @this); //1: enable; 0: disable
	CRC_EVC_CfgBit_65_96_Pr2 = @sysvar::CH_Nodes::CH_EISCRC_EVC_CfgBit_65_96__AUTO;
}

on sysvar sysvar::CH_Nodes::CH_EISSQC_EVC_CfgBit_65_96__AUTO
{
//	EnableSQC("EVC_CfgBit_65_96_AR2",  "EVC_CfgBit_65_96_Pr2", !@this); // 1 = on, 0 = off 
	enableControl("EVC_CfgBit_65_96_AR2", "CH_EISSQC_EVC_CfgBit_65_96_Pr2E_", @this); //1: enable; 0: disable
	SQC_EVC_CfgBit_65_96_Pr2 = @sysvar::CH_Nodes::CH_EISSQC_EVC_CfgBit_65_96__AUTO;
}

on sysvar sysvar::CH_Nodes::CH_EISEVC_CfgBit_97_C8_A_UB_AUTO
{
	switch (@sysvar::CH_Nodes::CH_EISEVC_CfgBit_97_C8_A_UB_AUTO)
	{
		case (0):
			enableControl("EVC_CfgBit_97_C8_AR2", "CH_EISEVC_CfgBit_97_C8_AR2_UB_", 0); //1: enable; 0: disable
			@sysvar::CH_Nodes::CH_EISEVC_CfgBit_97_C8_AR2_UB_ = 1;
			break;
		case (1):
			enableControl("EVC_CfgBit_97_C8_AR2", "CH_EISEVC_CfgBit_97_C8_AR2_UB_", 1); //1: enable; 0: disable
			break;
		case (2):
			enableControl("EVC_CfgBit_97_C8_AR2", "CH_EISEVC_CfgBit_97_C8_AR2_UB_", 0); //1: enable; 0: disable
			@sysvar::CH_Nodes::CH_EISEVC_CfgBit_97_C8_AR2_UB_ = 1;
			break;
		case (3):
			enableControl("EVC_CfgBit_97_C8_AR2", "CH_EISEVC_CfgBit_97_C8_AR2_UB_", 0); //1: enable; 0: disable
			@sysvar::CH_Nodes::CH_EISEVC_CfgBit_97_C8_AR2_UB_ = 0;
			break;
	}
}

on sysvar sysvar::CH_Nodes::CH_EISCRC_EVC_CfgBit_97_C8__AUTO
{
//	EnableCRC("EVC_CfgBit_97_C8_AR2",  "EVC_CfgBit_97_C8_Pr2", !@this); // 1 = on, 0 = off 
	enableControl("EVC_CfgBit_97_C8_AR2", "CH_EISCRC_EVC_CfgBit_97_C8_Pr2E_", @this); //1: enable; 0: disable
	CRC_EVC_CfgBit_97_C8_Pr2 = @sysvar::CH_Nodes::CH_EISCRC_EVC_CfgBit_97_C8__AUTO;
}

on sysvar sysvar::CH_Nodes::CH_EISSQC_EVC_CfgBit_97_C8__AUTO
{
//	EnableSQC("EVC_CfgBit_97_C8_AR2",  "EVC_CfgBit_97_C8_Pr2", !@this); // 1 = on, 0 = off 
	enableControl("EVC_CfgBit_97_C8_AR2", "CH_EISSQC_EVC_CfgBit_97_C8_Pr2E_", @this); //1: enable; 0: disable
	SQC_EVC_CfgBit_97_C8_Pr2 = @sysvar::CH_Nodes::CH_EISSQC_EVC_CfgBit_97_C8__AUTO;
}

on sysvar sysvar::CH_Nodes::CH_EISEVC_CfgList_01_0C__UB_A_01
{
	switch (@sysvar::CH_Nodes::CH_EISEVC_CfgList_01_0C__UB_A_01)
	{
		case (0):
			enableControl("EVC_CfgList_01_0C_AR2", "CH_EISEVC_CfgList_01_0C_AR2_U_01", 0); //1: enable; 0: disable
			@sysvar::CH_Nodes::CH_EISEVC_CfgList_01_0C_AR2_U_01 = 1;
			break;
		case (1):
			enableControl("EVC_CfgList_01_0C_AR2", "CH_EISEVC_CfgList_01_0C_AR2_U_01", 1); //1: enable; 0: disable
			break;
		case (2):
			enableControl("EVC_CfgList_01_0C_AR2", "CH_EISEVC_CfgList_01_0C_AR2_U_01", 0); //1: enable; 0: disable
			@sysvar::CH_Nodes::CH_EISEVC_CfgList_01_0C_AR2_U_01 = 1;
			break;
		case (3):
			enableControl("EVC_CfgList_01_0C_AR2", "CH_EISEVC_CfgList_01_0C_AR2_U_01", 0); //1: enable; 0: disable
			@sysvar::CH_Nodes::CH_EISEVC_CfgList_01_0C_AR2_U_01 = 0;
			break;
	}
}

on sysvar sysvar::CH_Nodes::CH_EISCRC_EVC_CfgList_01_0C_AUTO
{
//	EnableCRC("EVC_CfgList_01_0C_AR2",  "EVC_CfgList_01_0C_Pr2", !@this); // 1 = on, 0 = off 
	enableControl("EVC_CfgList_01_0C_AR2", "CH_EISCRC_EVC_CfgList_01_0C_Pr2_", @this); //1: enable; 0: disable
	CRC_EVC_CfgList_01_0C_Pr2 = @sysvar::CH_Nodes::CH_EISCRC_EVC_CfgList_01_0C_AUTO;
}

on sysvar sysvar::CH_Nodes::CH_EISSQC_EVC_CfgList_01_0C_AUTO
{
//	EnableSQC("EVC_CfgList_01_0C_AR2",  "EVC_CfgList_01_0C_Pr2", !@this); // 1 = on, 0 = off 
	enableControl("EVC_CfgList_01_0C_AR2", "CH_EISSQC_EVC_CfgList_01_0C_Pr2_", @this); //1: enable; 0: disable
	SQC_EVC_CfgList_01_0C_Pr2 = @sysvar::CH_Nodes::CH_EISSQC_EVC_CfgList_01_0C_AUTO;
}

on sysvar sysvar::CH_Nodes::CH_EISFCW_Disp_Rq_AR_UB_AUTO
{
	switch (@sysvar::CH_Nodes::CH_EISFCW_Disp_Rq_AR_UB_AUTO)
	{
		case (0):
			enableControl("FCW_Disp_Rq_AR", "CH_EISFCW_Disp_Rq_AR_UB_", 0); //1: enable; 0: disable
			@sysvar::CH_Nodes::CH_EISFCW_Disp_Rq_AR_UB_ = 1;
			break;
		case (1):
			enableControl("FCW_Disp_Rq_AR", "CH_EISFCW_Disp_Rq_AR_UB_", 1); //1: enable; 0: disable
			break;
		case (2):
			enableControl("FCW_Disp_Rq_AR", "CH_EISFCW_Disp_Rq_AR_UB_", 0); //1: enable; 0: disable
			@sysvar::CH_Nodes::CH_EISFCW_Disp_Rq_AR_UB_ = 1;
			break;
		case (3):
			enableControl("FCW_Disp_Rq_AR", "CH_EISFCW_Disp_Rq_AR_UB_", 0); //1: enable; 0: disable
			@sysvar::CH_Nodes::CH_EISFCW_Disp_Rq_AR_UB_ = 0;
			break;
	}
}

on sysvar sysvar::CH_Nodes::CH_EISHMI_CHASSIS_R1_AR2_UB_A_01
{
	switch (@sysvar::CH_Nodes::CH_EISHMI_CHASSIS_R1_AR2_UB_A_01)
	{
		case (0):
			enableControl("HMI_CHASSIS_R1_AR2", "CH_EISHMI_CHASSIS_R1_AR2_UB__01", 0); //1: enable; 0: disable
			@sysvar::CH_Nodes::CH_EISHMI_CHASSIS_R1_AR2_UB__01 = 1;
			break;
		case (1):
			enableControl("HMI_CHASSIS_R1_AR2", "CH_EISHMI_CHASSIS_R1_AR2_UB__01", 1); //1: enable; 0: disable
			break;
		case (2):
			enableControl("HMI_CHASSIS_R1_AR2", "CH_EISHMI_CHASSIS_R1_AR2_UB__01", 0); //1: enable; 0: disable
			@sysvar::CH_Nodes::CH_EISHMI_CHASSIS_R1_AR2_UB__01 = 1;
			break;
		case (3):
			enableControl("HMI_CHASSIS_R1_AR2", "CH_EISHMI_CHASSIS_R1_AR2_UB__01", 0); //1: enable; 0: disable
			@sysvar::CH_Nodes::CH_EISHMI_CHASSIS_R1_AR2_UB__01 = 0;
			break;
	}
}

on sysvar sysvar::CH_Nodes::CH_EISPark_Disp_StatHMI__UB_AUTO
{
    switch (@sysvar::CH_Nodes::CH_EISPark_Disp_StatHMI__UB_AUTO)
    {
		case (0):
        	EnableUB("HMI_CHASSIS_R1_AR2", 1);						// 1 = on, 0 = off
					DisturbUB("HMI_CHASSIS_R1_AR2", "Park_Disp_Stat_UB", -1, 0);	//Update-Bit immer gleich 0
					enableControl("HMI_CHASSIS_R1_AR2", "CH_EISPark_Disp_StatHMI_CHAS_UB__UB", 0); //1: enable; 0: disable
					break;
		case (1):
        	EnableUB("HMI_CHASSIS_R1_AR2", 0);						// 1 = on, 0 = off
					enableControl("HMI_CHASSIS_R1_AR2", "CH_EISPark_Disp_StatHMI_CHAS_UB__UB", 1); //1: enable; 0: disable
					break;
		case (2):
        	EnableUB("HMI_CHASSIS_R1_AR2", 1);						// 1 = on, 0 = off
        	DisturbUB("HMI_CHASSIS_R1_AR2", "Park_Disp_Stat_UB", -1, 1);	//Update-Bit immer gleich 1
					enableControl("HMI_CHASSIS_R1_AR2", "CH_EISPark_Disp_StatHMI_CHAS_UB__UB", 0); //1: enable; 0: disable
					break;
		case (3):
        	EnableUB("HMI_CHASSIS_R1_AR2", 1);						// 1 = on, 0 = off
        	DisturbUB("HMI_CHASSIS_R1_AR2", "Park_Disp_Stat_UB", -1, 0);	//Update-Bit immer gleich 0
					enableControl("HMI_CHASSIS_R1_AR2", "CH_EISPark_Disp_StatHMI_CHAS_UB__UB", 0); //1: enable; 0: disable
					break;
    }
}
on sysvar sysvar::CH_Nodes::CH_EISCRC_CTRL_L_Stat_Pr2HM_AUTO
{
//	EnableCRC("HMI_CHASSIS_R1_AR2",  "CTRL_L_Stat_Pr2", !@this); // 1 = on, 0 = off 
	enableControl("HMI_CHASSIS_R1_AR2", "CH_EISCRC_CTRL_L_Stat_Pr2HMI_CH_", @this); //1: enable; 0: disable
	CRC_CTRL_L_Stat_Pr2 = @sysvar::CH_Nodes::CH_EISCRC_CTRL_L_Stat_Pr2HM_AUTO;
}

on sysvar sysvar::CH_Nodes::CH_EISSQC_CTRL_L_Stat_Pr2HM_AUTO
{
//	EnableSQC("HMI_CHASSIS_R1_AR2",  "CTRL_L_Stat_Pr2", !@this); // 1 = on, 0 = off 
	enableControl("HMI_CHASSIS_R1_AR2", "CH_EISSQC_CTRL_L_Stat_Pr2HMI_CH_", @this); //1: enable; 0: disable
	SQC_CTRL_L_Stat_Pr2 = @sysvar::CH_Nodes::CH_EISSQC_CTRL_L_Stat_Pr2HM_AUTO;
}

on sysvar sysvar::CH_Nodes::CH_EISCRC_CTRL_L2_Stat_Pr2H_AUTO
{
//	EnableCRC("HMI_CHASSIS_R1_AR2",  "CTRL_L2_Stat_Pr2", !@this); // 1 = on, 0 = off 
	enableControl("HMI_CHASSIS_R1_AR2", "CH_EISCRC_CTRL_L2_Stat_Pr2HMI_C_", @this); //1: enable; 0: disable
	CRC_CTRL_L2_Stat_Pr2 = @sysvar::CH_Nodes::CH_EISCRC_CTRL_L2_Stat_Pr2H_AUTO;
}

on sysvar sysvar::CH_Nodes::CH_EISSQC_CTRL_L2_Stat_Pr2H_AUTO
{
//	EnableSQC("HMI_CHASSIS_R1_AR2",  "CTRL_L2_Stat_Pr2", !@this); // 1 = on, 0 = off 
	enableControl("HMI_CHASSIS_R1_AR2", "CH_EISSQC_CTRL_L2_Stat_Pr2HMI_C_", @this); //1: enable; 0: disable
	SQC_CTRL_L2_Stat_Pr2 = @sysvar::CH_Nodes::CH_EISSQC_CTRL_L2_Stat_Pr2H_AUTO;
}

on sysvar sysvar::CH_Nodes::CH_EISHU_State_AR_UB_AUTO
{
	switch (@sysvar::CH_Nodes::CH_EISHU_State_AR_UB_AUTO)
	{
		case (0):
			enableControl("HU_State_AR", "CH_EISHU_State_AR_UB_", 0); //1: enable; 0: disable
			@sysvar::CH_Nodes::CH_EISHU_State_AR_UB_ = 1;
			break;
		case (1):
			enableControl("HU_State_AR", "CH_EISHU_State_AR_UB_", 1); //1: enable; 0: disable
			break;
		case (2):
			enableControl("HU_State_AR", "CH_EISHU_State_AR_UB_", 0); //1: enable; 0: disable
			@sysvar::CH_Nodes::CH_EISHU_State_AR_UB_ = 1;
			break;
		case (3):
			enableControl("HU_State_AR", "CH_EISHU_State_AR_UB_", 0); //1: enable; 0: disable
			@sysvar::CH_Nodes::CH_EISHU_State_AR_UB_ = 0;
			break;
	}
}

on sysvar sysvar::CH_Nodes::CH_EISHVAC_OBD_DTC_AR_UB_AUTO_01
{
	switch (@sysvar::CH_Nodes::CH_EISHVAC_OBD_DTC_AR_UB_AUTO_01)
	{
		case (0):
			enableControl("HVAC_OBD_DTC_AR", "CH_EISHVAC_OBD_DTC_AR_UB__01", 0); //1: enable; 0: disable
			@sysvar::CH_Nodes::CH_EISHVAC_OBD_DTC_AR_UB__01 = 1;
			break;
		case (1):
			enableControl("HVAC_OBD_DTC_AR", "CH_EISHVAC_OBD_DTC_AR_UB__01", 1); //1: enable; 0: disable
			break;
		case (2):
			enableControl("HVAC_OBD_DTC_AR", "CH_EISHVAC_OBD_DTC_AR_UB__01", 0); //1: enable; 0: disable
			@sysvar::CH_Nodes::CH_EISHVAC_OBD_DTC_AR_UB__01 = 1;
			break;
		case (3):
			enableControl("HVAC_OBD_DTC_AR", "CH_EISHVAC_OBD_DTC_AR_UB__01", 0); //1: enable; 0: disable
			@sysvar::CH_Nodes::CH_EISHVAC_OBD_DTC_AR_UB__01 = 0;
			break;
	}
}

on sysvar sysvar::CH_Nodes::CH_EISHVAC_Rs_AR2_UB_AUTO_01
{
	switch (@sysvar::CH_Nodes::CH_EISHVAC_Rs_AR2_UB_AUTO_01)
	{
		case (0):
			enableControl("HVAC_Rs_AR2", "CH_EISHVAC_Rs_AR2_UB__01", 0); //1: enable; 0: disable
			@sysvar::CH_Nodes::CH_EISHVAC_Rs_AR2_UB__01 = 1;
			break;
		case (1):
			enableControl("HVAC_Rs_AR2", "CH_EISHVAC_Rs_AR2_UB__01", 1); //1: enable; 0: disable
			break;
		case (2):
			enableControl("HVAC_Rs_AR2", "CH_EISHVAC_Rs_AR2_UB__01", 0); //1: enable; 0: disable
			@sysvar::CH_Nodes::CH_EISHVAC_Rs_AR2_UB__01 = 1;
			break;
		case (3):
			enableControl("HVAC_Rs_AR2", "CH_EISHVAC_Rs_AR2_UB__01", 0); //1: enable; 0: disable
			@sysvar::CH_Nodes::CH_EISHVAC_Rs_AR2_UB__01 = 0;
			break;
	}
}

on sysvar sysvar::CH_Nodes::CH_EISCRC_HVAC_CompTrq_Pr2H_AUTO
{
//	EnableCRC("HVAC_Rs_AR2",  "HVAC_CompTrq_Pr2", !@this); // 1 = on, 0 = off 
	enableControl("HVAC_Rs_AR2", "CH_EISCRC_HVAC_CompTrq_Pr2HVAC__", @this); //1: enable; 0: disable
	CRC_HVAC_CompTrq_Pr2 = @sysvar::CH_Nodes::CH_EISCRC_HVAC_CompTrq_Pr2H_AUTO;
}

on sysvar sysvar::CH_Nodes::CH_EISSQC_HVAC_CompTrq_Pr2H_AUTO
{
//	EnableSQC("HVAC_Rs_AR2",  "HVAC_CompTrq_Pr2", !@this); // 1 = on, 0 = off 
	enableControl("HVAC_Rs_AR2", "CH_EISSQC_HVAC_CompTrq_Pr2HVAC__", @this); //1: enable; 0: disable
	SQC_HVAC_CompTrq_Pr2 = @sysvar::CH_Nodes::CH_EISSQC_HVAC_CompTrq_Pr2H_AUTO;
}

on sysvar sysvar::CH_Nodes::CH_EISIC_DriveAssistSys__UB_A_01
{
	switch (@sysvar::CH_Nodes::CH_EISIC_DriveAssistSys__UB_A_01)
	{
		case (0):
			enableControl("IC_DriveAssistSys_AR2", "CH_EISIC_DriveAssistSys_AR2_U_01", 0); //1: enable; 0: disable
			@sysvar::CH_Nodes::CH_EISIC_DriveAssistSys_AR2_U_01 = 1;
			break;
		case (1):
			enableControl("IC_DriveAssistSys_AR2", "CH_EISIC_DriveAssistSys_AR2_U_01", 1); //1: enable; 0: disable
			break;
		case (2):
			enableControl("IC_DriveAssistSys_AR2", "CH_EISIC_DriveAssistSys_AR2_U_01", 0); //1: enable; 0: disable
			@sysvar::CH_Nodes::CH_EISIC_DriveAssistSys_AR2_U_01 = 1;
			break;
		case (3):
			enableControl("IC_DriveAssistSys_AR2", "CH_EISIC_DriveAssistSys_AR2_U_01", 0); //1: enable; 0: disable
			@sysvar::CH_Nodes::CH_EISIC_DriveAssistSys_AR2_U_01 = 0;
			break;
	}
}

on sysvar sysvar::CH_Nodes::CH_EISIC_Settings_AR2_UB_AUTO_01
{
	switch (@sysvar::CH_Nodes::CH_EISIC_Settings_AR2_UB_AUTO_01)
	{
		case (0):
			enableControl("IC_Settings_AR2", "CH_EISIC_Settings_AR2_UB__01", 0); //1: enable; 0: disable
			@sysvar::CH_Nodes::CH_EISIC_Settings_AR2_UB__01 = 1;
			break;
		case (1):
			enableControl("IC_Settings_AR2", "CH_EISIC_Settings_AR2_UB__01", 1); //1: enable; 0: disable
			break;
		case (2):
			enableControl("IC_Settings_AR2", "CH_EISIC_Settings_AR2_UB__01", 0); //1: enable; 0: disable
			@sysvar::CH_Nodes::CH_EISIC_Settings_AR2_UB__01 = 1;
			break;
		case (3):
			enableControl("IC_Settings_AR2", "CH_EISIC_Settings_AR2_UB__01", 0); //1: enable; 0: disable
			@sysvar::CH_Nodes::CH_EISIC_Settings_AR2_UB__01 = 0;
			break;
	}
}

on sysvar sysvar::CH_Nodes::CH_EISICH_Stat_AR_UB_AUTO_01
{
	switch (@sysvar::CH_Nodes::CH_EISICH_Stat_AR_UB_AUTO_01)
	{
		case (0):
			enableControl("ICH_Stat_AR", "CH_EISICH_Stat_AR_UB__01", 0); //1: enable; 0: disable
			@sysvar::CH_Nodes::CH_EISICH_Stat_AR_UB__01 = 1;
			break;
		case (1):
			enableControl("ICH_Stat_AR", "CH_EISICH_Stat_AR_UB__01", 1); //1: enable; 0: disable
			break;
		case (2):
			enableControl("ICH_Stat_AR", "CH_EISICH_Stat_AR_UB__01", 0); //1: enable; 0: disable
			@sysvar::CH_Nodes::CH_EISICH_Stat_AR_UB__01 = 1;
			break;
		case (3):
			enableControl("ICH_Stat_AR", "CH_EISICH_Stat_AR_UB__01", 0); //1: enable; 0: disable
			@sysvar::CH_Nodes::CH_EISICH_Stat_AR_UB__01 = 0;
			break;
	}
}

on sysvar sysvar::CH_Nodes::CH_EISIgn_Veh_Stat_AR2_UB_AUT_01
{
	switch (@sysvar::CH_Nodes::CH_EISIgn_Veh_Stat_AR2_UB_AUT_01)
	{
		case (0):
			enableControl("Ign_Veh_Stat_AR2", "CH_EISIgn_Veh_Stat_AR2_UB__01", 0); //1: enable; 0: disable
			@sysvar::CH_Nodes::CH_EISIgn_Veh_Stat_AR2_UB__01 = 1;
			break;
		case (1):
			enableControl("Ign_Veh_Stat_AR2", "CH_EISIgn_Veh_Stat_AR2_UB__01", 1); //1: enable; 0: disable
			break;
		case (2):
			enableControl("Ign_Veh_Stat_AR2", "CH_EISIgn_Veh_Stat_AR2_UB__01", 0); //1: enable; 0: disable
			@sysvar::CH_Nodes::CH_EISIgn_Veh_Stat_AR2_UB__01 = 1;
			break;
		case (3):
			enableControl("Ign_Veh_Stat_AR2", "CH_EISIgn_Veh_Stat_AR2_UB__01", 0); //1: enable; 0: disable
			@sysvar::CH_Nodes::CH_EISIgn_Veh_Stat_AR2_UB__01 = 0;
			break;
	}
}

on sysvar sysvar::CH_Nodes::CH_EISCRC_Ign_Stat_Pr2Ign_V_AUTO
{
//	EnableCRC("Ign_Veh_Stat_AR2",  "Ign_Stat_Pr2", !@this); // 1 = on, 0 = off 
	enableControl("Ign_Veh_Stat_AR2", "CH_EISCRC_Ign_Stat_Pr2Ign_Veh_S_", @this); //1: enable; 0: disable
	CRC_Ign_Stat_Pr2 = @sysvar::CH_Nodes::CH_EISCRC_Ign_Stat_Pr2Ign_V_AUTO;
}

on sysvar sysvar::CH_Nodes::CH_EISSQC_Ign_Stat_Pr2Ign_V_AUTO
{
//	EnableSQC("Ign_Veh_Stat_AR2",  "Ign_Stat_Pr2", !@this); // 1 = on, 0 = off 
	enableControl("Ign_Veh_Stat_AR2", "CH_EISSQC_Ign_Stat_Pr2Ign_Veh_S_", @this); //1: enable; 0: disable
	SQC_Ign_Stat_Pr2 = @sysvar::CH_Nodes::CH_EISSQC_Ign_Stat_Pr2Ign_V_AUTO;
}

on sysvar sysvar::CH_Nodes::CH_EISIHC_Lgt_Stat_HLI_2_UB_AUTO
{
	switch (@sysvar::CH_Nodes::CH_EISIHC_Lgt_Stat_HLI_2_UB_AUTO)
	{
		case (0):
			enableControl("IHC_Lgt_Stat_HLI_2_AR2", "CH_EISIHC_Lgt_Stat_HLI_2_AR2_UB_", 0); //1: enable; 0: disable
			@sysvar::CH_Nodes::CH_EISIHC_Lgt_Stat_HLI_2_AR2_UB_ = 1;
			break;
		case (1):
			enableControl("IHC_Lgt_Stat_HLI_2_AR2", "CH_EISIHC_Lgt_Stat_HLI_2_AR2_UB_", 1); //1: enable; 0: disable
			break;
		case (2):
			enableControl("IHC_Lgt_Stat_HLI_2_AR2", "CH_EISIHC_Lgt_Stat_HLI_2_AR2_UB_", 0); //1: enable; 0: disable
			@sysvar::CH_Nodes::CH_EISIHC_Lgt_Stat_HLI_2_AR2_UB_ = 1;
			break;
		case (3):
			enableControl("IHC_Lgt_Stat_HLI_2_AR2", "CH_EISIHC_Lgt_Stat_HLI_2_AR2_UB_", 0); //1: enable; 0: disable
			@sysvar::CH_Nodes::CH_EISIHC_Lgt_Stat_HLI_2_AR2_UB_ = 0;
			break;
	}
}

on sysvar sysvar::CH_Nodes::CH_EISIHC_Lgt_Stat_HLI_A_UB_A_01
{
	switch (@sysvar::CH_Nodes::CH_EISIHC_Lgt_Stat_HLI_A_UB_A_01)
	{
		case (0):
			enableControl("IHC_Lgt_Stat_HLI_AR2", "CH_EISIHC_Lgt_Stat_HLI_AR2_UB_01", 0); //1: enable; 0: disable
			@sysvar::CH_Nodes::CH_EISIHC_Lgt_Stat_HLI_AR2_UB_01 = 1;
			break;
		case (1):
			enableControl("IHC_Lgt_Stat_HLI_AR2", "CH_EISIHC_Lgt_Stat_HLI_AR2_UB_01", 1); //1: enable; 0: disable
			break;
		case (2):
			enableControl("IHC_Lgt_Stat_HLI_AR2", "CH_EISIHC_Lgt_Stat_HLI_AR2_UB_01", 0); //1: enable; 0: disable
			@sysvar::CH_Nodes::CH_EISIHC_Lgt_Stat_HLI_AR2_UB_01 = 1;
			break;
		case (3):
			enableControl("IHC_Lgt_Stat_HLI_AR2", "CH_EISIHC_Lgt_Stat_HLI_AR2_UB_01", 0); //1: enable; 0: disable
			@sysvar::CH_Nodes::CH_EISIHC_Lgt_Stat_HLI_AR2_UB_01 = 0;
			break;
	}
}

on sysvar sysvar::CH_Nodes::CH_EISCRC_IHC_Lgt_Stat_HLI__AUTO
{
//	EnableCRC("IHC_Lgt_Stat_HLI_AR2",  "IHC_Lgt_Stat_HLI_Pr2", !@this); // 1 = on, 0 = off 
	enableControl("IHC_Lgt_Stat_HLI_AR2", "CH_EISCRC_IHC_Lgt_Stat_HLI_Pr2I_", @this); //1: enable; 0: disable
	CRC_IHC_Lgt_Stat_HLI_Pr2 = @sysvar::CH_Nodes::CH_EISCRC_IHC_Lgt_Stat_HLI__AUTO;
}

on sysvar sysvar::CH_Nodes::CH_EISSQC_IHC_Lgt_Stat_HLI__AUTO
{
//	EnableSQC("IHC_Lgt_Stat_HLI_AR2",  "IHC_Lgt_Stat_HLI_Pr2", !@this); // 1 = on, 0 = off 
	enableControl("IHC_Lgt_Stat_HLI_AR2", "CH_EISSQC_IHC_Lgt_Stat_HLI_Pr2I_", @this); //1: enable; 0: disable
	SQC_IHC_Lgt_Stat_HLI_Pr2 = @sysvar::CH_Nodes::CH_EISSQC_IHC_Lgt_Stat_HLI__AUTO;
}

on sysvar sysvar::CH_Nodes::CH_EISKG_State_AR2_UB_AUTO
{
	switch (@sysvar::CH_Nodes::CH_EISKG_State_AR2_UB_AUTO)
	{
		case (0):
			enableControl("KG_State_AR2", "CH_EISKG_State_AR2_UB_", 0); //1: enable; 0: disable
			@sysvar::CH_Nodes::CH_EISKG_State_AR2_UB_ = 1;
			break;
		case (1):
			enableControl("KG_State_AR2", "CH_EISKG_State_AR2_UB_", 1); //1: enable; 0: disable
			break;
		case (2):
			enableControl("KG_State_AR2", "CH_EISKG_State_AR2_UB_", 0); //1: enable; 0: disable
			@sysvar::CH_Nodes::CH_EISKG_State_AR2_UB_ = 1;
			break;
		case (3):
			enableControl("KG_State_AR2", "CH_EISKG_State_AR2_UB_", 0); //1: enable; 0: disable
			@sysvar::CH_Nodes::CH_EISKG_State_AR2_UB_ = 0;
			break;
	}
}

on sysvar sysvar::CH_Nodes::CH_EISCRC_RemPark_Stat_KG_P_AUTO
{
//	EnableCRC("KG_State_AR2",  "RemPark_Stat_KG_Pr2", !@this); // 1 = on, 0 = off 
	enableControl("KG_State_AR2", "CH_EISCRC_RemPark_Stat_KG_Pr2KG_", @this); //1: enable; 0: disable
	CRC_RemPark_Stat_KG_Pr2 = @sysvar::CH_Nodes::CH_EISCRC_RemPark_Stat_KG_P_AUTO;
}

on sysvar sysvar::CH_Nodes::CH_EISSQC_RemPark_Stat_KG_P_AUTO
{
//	EnableSQC("KG_State_AR2",  "RemPark_Stat_KG_Pr2", !@this); // 1 = on, 0 = off 
	enableControl("KG_State_AR2", "CH_EISSQC_RemPark_Stat_KG_Pr2KG_", @this); //1: enable; 0: disable
	SQC_RemPark_Stat_KG_Pr2 = @sysvar::CH_Nodes::CH_EISSQC_RemPark_Stat_KG_P_AUTO;
}

on sysvar sysvar::CH_Nodes::CH_EISLDC_Disp_Stat_IC_A_UB_A_01
{
	switch (@sysvar::CH_Nodes::CH_EISLDC_Disp_Stat_IC_A_UB_A_01)
	{
		case (0):
			enableControl("LDC_Disp_Stat_IC_AR2", "CH_EISLDC_Disp_Stat_IC_AR2_UB_01", 0); //1: enable; 0: disable
			@sysvar::CH_Nodes::CH_EISLDC_Disp_Stat_IC_AR2_UB_01 = 1;
			break;
		case (1):
			enableControl("LDC_Disp_Stat_IC_AR2", "CH_EISLDC_Disp_Stat_IC_AR2_UB_01", 1); //1: enable; 0: disable
			break;
		case (2):
			enableControl("LDC_Disp_Stat_IC_AR2", "CH_EISLDC_Disp_Stat_IC_AR2_UB_01", 0); //1: enable; 0: disable
			@sysvar::CH_Nodes::CH_EISLDC_Disp_Stat_IC_AR2_UB_01 = 1;
			break;
		case (3):
			enableControl("LDC_Disp_Stat_IC_AR2", "CH_EISLDC_Disp_Stat_IC_AR2_UB_01", 0); //1: enable; 0: disable
			@sysvar::CH_Nodes::CH_EISLDC_Disp_Stat_IC_AR2_UB_01 = 0;
			break;
	}
}

on sysvar sysvar::CH_Nodes::CH_EISLgtSens_State_AR_UB_AUT_01
{
	switch (@sysvar::CH_Nodes::CH_EISLgtSens_State_AR_UB_AUT_01)
	{
		case (0):
			enableControl("LgtSens_State_AR", "CH_EISLgtSens_State_AR_UB__01", 0); //1: enable; 0: disable
			@sysvar::CH_Nodes::CH_EISLgtSens_State_AR_UB__01 = 1;
			break;
		case (1):
			enableControl("LgtSens_State_AR", "CH_EISLgtSens_State_AR_UB__01", 1); //1: enable; 0: disable
			break;
		case (2):
			enableControl("LgtSens_State_AR", "CH_EISLgtSens_State_AR_UB__01", 0); //1: enable; 0: disable
			@sysvar::CH_Nodes::CH_EISLgtSens_State_AR_UB__01 = 1;
			break;
		case (3):
			enableControl("LgtSens_State_AR", "CH_EISLgtSens_State_AR_UB__01", 0); //1: enable; 0: disable
			@sysvar::CH_Nodes::CH_EISLgtSens_State_AR_UB__01 = 0;
			break;
	}
}

on sysvar sysvar::CH_Nodes::CH_EISMirr_Adj_Lt_Rq_AR_UB_AU_01
{
	switch (@sysvar::CH_Nodes::CH_EISMirr_Adj_Lt_Rq_AR_UB_AU_01)
	{
		case (0):
			enableControl("Mirr_Adj_Lt_Rq_AR", "CH_EISMirr_Adj_Lt_Rq_AR_UB__01", 0); //1: enable; 0: disable
			@sysvar::CH_Nodes::CH_EISMirr_Adj_Lt_Rq_AR_UB__01 = 1;
			break;
		case (1):
			enableControl("Mirr_Adj_Lt_Rq_AR", "CH_EISMirr_Adj_Lt_Rq_AR_UB__01", 1); //1: enable; 0: disable
			break;
		case (2):
			enableControl("Mirr_Adj_Lt_Rq_AR", "CH_EISMirr_Adj_Lt_Rq_AR_UB__01", 0); //1: enable; 0: disable
			@sysvar::CH_Nodes::CH_EISMirr_Adj_Lt_Rq_AR_UB__01 = 1;
			break;
		case (3):
			enableControl("Mirr_Adj_Lt_Rq_AR", "CH_EISMirr_Adj_Lt_Rq_AR_UB__01", 0); //1: enable; 0: disable
			@sysvar::CH_Nodes::CH_EISMirr_Adj_Lt_Rq_AR_UB__01 = 0;
			break;
	}
}

on sysvar sysvar::CH_Nodes::CH_EISMirr_Adj_Rt_Rq_AR_UB_AU_01
{
	switch (@sysvar::CH_Nodes::CH_EISMirr_Adj_Rt_Rq_AR_UB_AU_01)
	{
		case (0):
			enableControl("Mirr_Adj_Rt_Rq_AR", "CH_EISMirr_Adj_Rt_Rq_AR_UB__01", 0); //1: enable; 0: disable
			@sysvar::CH_Nodes::CH_EISMirr_Adj_Rt_Rq_AR_UB__01 = 1;
			break;
		case (1):
			enableControl("Mirr_Adj_Rt_Rq_AR", "CH_EISMirr_Adj_Rt_Rq_AR_UB__01", 1); //1: enable; 0: disable
			break;
		case (2):
			enableControl("Mirr_Adj_Rt_Rq_AR", "CH_EISMirr_Adj_Rt_Rq_AR_UB__01", 0); //1: enable; 0: disable
			@sysvar::CH_Nodes::CH_EISMirr_Adj_Rt_Rq_AR_UB__01 = 1;
			break;
		case (3):
			enableControl("Mirr_Adj_Rt_Rq_AR", "CH_EISMirr_Adj_Rt_Rq_AR_UB__01", 0); //1: enable; 0: disable
			@sysvar::CH_Nodes::CH_EISMirr_Adj_Rt_Rq_AR_UB__01 = 0;
			break;
	}
}

on sysvar sysvar::CH_Nodes::CH_EISNAVI_Pos1_AR_UB_AUTO_01
{
	switch (@sysvar::CH_Nodes::CH_EISNAVI_Pos1_AR_UB_AUTO_01)
	{
		case (0):
			enableControl("NAVI_Pos1_AR", "CH_EISNAVI_Pos1_AR_UB__01", 0); //1: enable; 0: disable
			@sysvar::CH_Nodes::CH_EISNAVI_Pos1_AR_UB__01 = 1;
			break;
		case (1):
			enableControl("NAVI_Pos1_AR", "CH_EISNAVI_Pos1_AR_UB__01", 1); //1: enable; 0: disable
			break;
		case (2):
			enableControl("NAVI_Pos1_AR", "CH_EISNAVI_Pos1_AR_UB__01", 0); //1: enable; 0: disable
			@sysvar::CH_Nodes::CH_EISNAVI_Pos1_AR_UB__01 = 1;
			break;
		case (3):
			enableControl("NAVI_Pos1_AR", "CH_EISNAVI_Pos1_AR_UB__01", 0); //1: enable; 0: disable
			@sysvar::CH_Nodes::CH_EISNAVI_Pos1_AR_UB__01 = 0;
			break;
	}
}

on sysvar sysvar::CH_Nodes::CH_EISNAVI_Pos2_AR_UB_AUTO_01
{
	switch (@sysvar::CH_Nodes::CH_EISNAVI_Pos2_AR_UB_AUTO_01)
	{
		case (0):
			enableControl("NAVI_Pos2_AR", "CH_EISNAVI_Pos2_AR_UB__01", 0); //1: enable; 0: disable
			@sysvar::CH_Nodes::CH_EISNAVI_Pos2_AR_UB__01 = 1;
			break;
		case (1):
			enableControl("NAVI_Pos2_AR", "CH_EISNAVI_Pos2_AR_UB__01", 1); //1: enable; 0: disable
			break;
		case (2):
			enableControl("NAVI_Pos2_AR", "CH_EISNAVI_Pos2_AR_UB__01", 0); //1: enable; 0: disable
			@sysvar::CH_Nodes::CH_EISNAVI_Pos2_AR_UB__01 = 1;
			break;
		case (3):
			enableControl("NAVI_Pos2_AR", "CH_EISNAVI_Pos2_AR_UB__01", 0); //1: enable; 0: disable
			@sysvar::CH_Nodes::CH_EISNAVI_Pos2_AR_UB__01 = 0;
			break;
	}
}

on sysvar sysvar::CH_Nodes::CH_EISNAVI_Pos3_AR_UB_AUTO_01
{
	switch (@sysvar::CH_Nodes::CH_EISNAVI_Pos3_AR_UB_AUTO_01)
	{
		case (0):
			enableControl("NAVI_Pos3_AR", "CH_EISNAVI_Pos3_AR_UB__01", 0); //1: enable; 0: disable
			@sysvar::CH_Nodes::CH_EISNAVI_Pos3_AR_UB__01 = 1;
			break;
		case (1):
			enableControl("NAVI_Pos3_AR", "CH_EISNAVI_Pos3_AR_UB__01", 1); //1: enable; 0: disable
			break;
		case (2):
			enableControl("NAVI_Pos3_AR", "CH_EISNAVI_Pos3_AR_UB__01", 0); //1: enable; 0: disable
			@sysvar::CH_Nodes::CH_EISNAVI_Pos3_AR_UB__01 = 1;
			break;
		case (3):
			enableControl("NAVI_Pos3_AR", "CH_EISNAVI_Pos3_AR_UB__01", 0); //1: enable; 0: disable
			@sysvar::CH_Nodes::CH_EISNAVI_Pos3_AR_UB__01 = 0;
			break;
	}
}

on sysvar sysvar::CH_Nodes::CH_EISNAVI_Pos4_AR_UB_AUTO_01
{
	switch (@sysvar::CH_Nodes::CH_EISNAVI_Pos4_AR_UB_AUTO_01)
	{
		case (0):
			enableControl("NAVI_Pos4_AR", "CH_EISNAVI_Pos4_AR_UB__01", 0); //1: enable; 0: disable
			@sysvar::CH_Nodes::CH_EISNAVI_Pos4_AR_UB__01 = 1;
			break;
		case (1):
			enableControl("NAVI_Pos4_AR", "CH_EISNAVI_Pos4_AR_UB__01", 1); //1: enable; 0: disable
			break;
		case (2):
			enableControl("NAVI_Pos4_AR", "CH_EISNAVI_Pos4_AR_UB__01", 0); //1: enable; 0: disable
			@sysvar::CH_Nodes::CH_EISNAVI_Pos4_AR_UB__01 = 1;
			break;
		case (3):
			enableControl("NAVI_Pos4_AR", "CH_EISNAVI_Pos4_AR_UB__01", 0); //1: enable; 0: disable
			@sysvar::CH_Nodes::CH_EISNAVI_Pos4_AR_UB__01 = 0;
			break;
	}
}

on sysvar sysvar::CH_Nodes::CH_EISNAVI_Pos5_AR_UB_AUTO_01
{
	switch (@sysvar::CH_Nodes::CH_EISNAVI_Pos5_AR_UB_AUTO_01)
	{
		case (0):
			enableControl("NAVI_Pos5_AR", "CH_EISNAVI_Pos5_AR_UB__01", 0); //1: enable; 0: disable
			@sysvar::CH_Nodes::CH_EISNAVI_Pos5_AR_UB__01 = 1;
			break;
		case (1):
			enableControl("NAVI_Pos5_AR", "CH_EISNAVI_Pos5_AR_UB__01", 1); //1: enable; 0: disable
			break;
		case (2):
			enableControl("NAVI_Pos5_AR", "CH_EISNAVI_Pos5_AR_UB__01", 0); //1: enable; 0: disable
			@sysvar::CH_Nodes::CH_EISNAVI_Pos5_AR_UB__01 = 1;
			break;
		case (3):
			enableControl("NAVI_Pos5_AR", "CH_EISNAVI_Pos5_AR_UB__01", 0); //1: enable; 0: disable
			@sysvar::CH_Nodes::CH_EISNAVI_Pos5_AR_UB__01 = 0;
			break;
	}
}

on sysvar sysvar::CH_Nodes::CH_EISNVP_Stat1_AR2_UB_AUTO_01
{
	switch (@sysvar::CH_Nodes::CH_EISNVP_Stat1_AR2_UB_AUTO_01)
	{
		case (0):
			enableControl("NVP_Stat1_AR2", "CH_EISNVP_Stat1_AR2_UB__01", 0); //1: enable; 0: disable
			@sysvar::CH_Nodes::CH_EISNVP_Stat1_AR2_UB__01 = 1;
			break;
		case (1):
			enableControl("NVP_Stat1_AR2", "CH_EISNVP_Stat1_AR2_UB__01", 1); //1: enable; 0: disable
			break;
		case (2):
			enableControl("NVP_Stat1_AR2", "CH_EISNVP_Stat1_AR2_UB__01", 0); //1: enable; 0: disable
			@sysvar::CH_Nodes::CH_EISNVP_Stat1_AR2_UB__01 = 1;
			break;
		case (3):
			enableControl("NVP_Stat1_AR2", "CH_EISNVP_Stat1_AR2_UB__01", 0); //1: enable; 0: disable
			@sysvar::CH_Nodes::CH_EISNVP_Stat1_AR2_UB__01 = 0;
			break;
	}
}

on sysvar sysvar::CH_Nodes::CH_EISCRC_NVP_Stat1_Pr2NVP__AUTO
{
//	EnableCRC("NVP_Stat1_AR2",  "NVP_Stat1_Pr2", !@this); // 1 = on, 0 = off 
	enableControl("NVP_Stat1_AR2", "CH_EISCRC_NVP_Stat1_Pr2NVP_Stat_", @this); //1: enable; 0: disable
	CRC_NVP_Stat1_Pr2 = @sysvar::CH_Nodes::CH_EISCRC_NVP_Stat1_Pr2NVP__AUTO;
}

on sysvar sysvar::CH_Nodes::CH_EISSQC_NVP_Stat1_Pr2NVP__AUTO
{
//	EnableSQC("NVP_Stat1_AR2",  "NVP_Stat1_Pr2", !@this); // 1 = on, 0 = off 
	enableControl("NVP_Stat1_AR2", "CH_EISSQC_NVP_Stat1_Pr2NVP_Stat_", @this); //1: enable; 0: disable
	SQC_NVP_Stat1_Pr2 = @sysvar::CH_Nodes::CH_EISSQC_NVP_Stat1_Pr2NVP__AUTO;
}

on sysvar sysvar::CH_Nodes::CH_EISOHCM_Stat_AR2_UB_AUTO_01
{
	switch (@sysvar::CH_Nodes::CH_EISOHCM_Stat_AR2_UB_AUTO_01)
	{
		case (0):
			enableControl("OHCM_Stat_AR2", "CH_EISOHCM_Stat_AR2_UB__01", 0); //1: enable; 0: disable
			@sysvar::CH_Nodes::CH_EISOHCM_Stat_AR2_UB__01 = 1;
			break;
		case (1):
			enableControl("OHCM_Stat_AR2", "CH_EISOHCM_Stat_AR2_UB__01", 1); //1: enable; 0: disable
			break;
		case (2):
			enableControl("OHCM_Stat_AR2", "CH_EISOHCM_Stat_AR2_UB__01", 0); //1: enable; 0: disable
			@sysvar::CH_Nodes::CH_EISOHCM_Stat_AR2_UB__01 = 1;
			break;
		case (3):
			enableControl("OHCM_Stat_AR2", "CH_EISOHCM_Stat_AR2_UB__01", 0); //1: enable; 0: disable
			@sysvar::CH_Nodes::CH_EISOHCM_Stat_AR2_UB__01 = 0;
			break;
	}
}

on sysvar sysvar::CH_Nodes::CH_EISORC_Disp_Stat_AR2_UB_AU_01
{
	switch (@sysvar::CH_Nodes::CH_EISORC_Disp_Stat_AR2_UB_AU_01)
	{
		case (0):
			enableControl("ORC_Disp_Stat_AR2", "CH_EISORC_Disp_Stat_AR2_UB__01", 0); //1: enable; 0: disable
			@sysvar::CH_Nodes::CH_EISORC_Disp_Stat_AR2_UB__01 = 1;
			break;
		case (1):
			enableControl("ORC_Disp_Stat_AR2", "CH_EISORC_Disp_Stat_AR2_UB__01", 1); //1: enable; 0: disable
			break;
		case (2):
			enableControl("ORC_Disp_Stat_AR2", "CH_EISORC_Disp_Stat_AR2_UB__01", 0); //1: enable; 0: disable
			@sysvar::CH_Nodes::CH_EISORC_Disp_Stat_AR2_UB__01 = 1;
			break;
		case (3):
			enableControl("ORC_Disp_Stat_AR2", "CH_EISORC_Disp_Stat_AR2_UB__01", 0); //1: enable; 0: disable
			@sysvar::CH_Nodes::CH_EISORC_Disp_Stat_AR2_UB__01 = 0;
			break;
	}
}

on sysvar sysvar::CH_Nodes::CH_EISCRC_Bckl_Sw_Ft_Stat_P_AUTO
{
//	EnableCRC("ORC_Disp_Stat_AR2",  "Bckl_Sw_Ft_Stat_Pr2", !@this); // 1 = on, 0 = off 
	enableControl("ORC_Disp_Stat_AR2", "CH_EISCRC_Bckl_Sw_Ft_Stat_Pr2OR_", @this); //1: enable; 0: disable
	CRC_Bckl_Sw_Ft_Stat_Pr2 = @sysvar::CH_Nodes::CH_EISCRC_Bckl_Sw_Ft_Stat_P_AUTO;
}

on sysvar sysvar::CH_Nodes::CH_EISSQC_Bckl_Sw_Ft_Stat_P_AUTO
{
//	EnableSQC("ORC_Disp_Stat_AR2",  "Bckl_Sw_Ft_Stat_Pr2", !@this); // 1 = on, 0 = off 
	enableControl("ORC_Disp_Stat_AR2", "CH_EISSQC_Bckl_Sw_Ft_Stat_Pr2OR_", @this); //1: enable; 0: disable
	SQC_Bckl_Sw_Ft_Stat_Pr2 = @sysvar::CH_Nodes::CH_EISSQC_Bckl_Sw_Ft_Stat_P_AUTO;
}

on sysvar sysvar::CH_Nodes::CH_EISORC_Impact_AR2_UB_AUTO_01
{
	switch (@sysvar::CH_Nodes::CH_EISORC_Impact_AR2_UB_AUTO_01)
	{
		case (0):
			enableControl("ORC_Impact_AR2", "CH_EISORC_Impact_AR2_UB__01", 0); //1: enable; 0: disable
			@sysvar::CH_Nodes::CH_EISORC_Impact_AR2_UB__01 = 1;
			break;
		case (1):
			enableControl("ORC_Impact_AR2", "CH_EISORC_Impact_AR2_UB__01", 1); //1: enable; 0: disable
			break;
		case (2):
			enableControl("ORC_Impact_AR2", "CH_EISORC_Impact_AR2_UB__01", 0); //1: enable; 0: disable
			@sysvar::CH_Nodes::CH_EISORC_Impact_AR2_UB__01 = 1;
			break;
		case (3):
			enableControl("ORC_Impact_AR2", "CH_EISORC_Impact_AR2_UB__01", 0); //1: enable; 0: disable
			@sysvar::CH_Nodes::CH_EISORC_Impact_AR2_UB__01 = 0;
			break;
	}
}

on sysvar sysvar::CH_Nodes::CH_EISCRC_Impact_Pr2ORC_Imp_AUTO
{
//	EnableCRC("ORC_Impact_AR2",  "Impact_Pr2", !@this); // 1 = on, 0 = off 
	enableControl("ORC_Impact_AR2", "CH_EISCRC_Impact_Pr2ORC_Impact__", @this); //1: enable; 0: disable
	CRC_Impact_Pr2 = @sysvar::CH_Nodes::CH_EISCRC_Impact_Pr2ORC_Imp_AUTO;
}

on sysvar sysvar::CH_Nodes::CH_EISSQC_Impact_Pr2ORC_Imp_AUTO
{
//	EnableSQC("ORC_Impact_AR2",  "Impact_Pr2", !@this); // 1 = on, 0 = off 
	enableControl("ORC_Impact_AR2", "CH_EISSQC_Impact_Pr2ORC_Impact__", @this); //1: enable; 0: disable
	SQC_Impact_Pr2 = @sysvar::CH_Nodes::CH_EISSQC_Impact_Pr2ORC_Imp_AUTO;
}

on sysvar sysvar::CH_Nodes::CH_EISImpact_TglORC_Impact__AUTO
{
//	EnableTGL("ORC_Impact_AR2",  "mpact_", !@this); // 1 = on, 0 = off 
	enableControl("ORC_Impact_AR2", "CH_EISImpact_TglORC_Impact_AR2_", @this); //1: enable; 0: disable
	TGL_mpact_ = @sysvar::CH_Nodes::CH_EISImpact_TglORC_Impact__AUTO;
}

on sysvar sysvar::CH_Nodes::CH_EISPark_Disp_Rs_AR2_UB_AUT_01
{
	switch (@sysvar::CH_Nodes::CH_EISPark_Disp_Rs_AR2_UB_AUT_01)
	{
		case (0):
			enableControl("Park_Disp_Rs_AR2", "CH_EISPark_Disp_Rs_AR2_UB__01", 0); //1: enable; 0: disable
			@sysvar::CH_Nodes::CH_EISPark_Disp_Rs_AR2_UB__01 = 1;
			break;
		case (1):
			enableControl("Park_Disp_Rs_AR2", "CH_EISPark_Disp_Rs_AR2_UB__01", 1); //1: enable; 0: disable
			break;
		case (2):
			enableControl("Park_Disp_Rs_AR2", "CH_EISPark_Disp_Rs_AR2_UB__01", 0); //1: enable; 0: disable
			@sysvar::CH_Nodes::CH_EISPark_Disp_Rs_AR2_UB__01 = 1;
			break;
		case (3):
			enableControl("Park_Disp_Rs_AR2", "CH_EISPark_Disp_Rs_AR2_UB__01", 0); //1: enable; 0: disable
			@sysvar::CH_Nodes::CH_EISPark_Disp_Rs_AR2_UB__01 = 0;
			break;
	}
}

on sysvar sysvar::CH_Nodes::CH_EISPHB_IHC_Plus_Tunne_UB_AUTO
{
	switch (@sysvar::CH_Nodes::CH_EISPHB_IHC_Plus_Tunne_UB_AUTO)
	{
		case (0):
			enableControl("PHB_IHC_Plus_Tunnel_3_4_AR2", "CH_EISPHB_IHC_Plus_Tunnel_3__UB_", 0); //1: enable; 0: disable
			@sysvar::CH_Nodes::CH_EISPHB_IHC_Plus_Tunnel_3__UB_ = 1;
			break;
		case (1):
			enableControl("PHB_IHC_Plus_Tunnel_3_4_AR2", "CH_EISPHB_IHC_Plus_Tunnel_3__UB_", 1); //1: enable; 0: disable
			break;
		case (2):
			enableControl("PHB_IHC_Plus_Tunnel_3_4_AR2", "CH_EISPHB_IHC_Plus_Tunnel_3__UB_", 0); //1: enable; 0: disable
			@sysvar::CH_Nodes::CH_EISPHB_IHC_Plus_Tunnel_3__UB_ = 1;
			break;
		case (3):
			enableControl("PHB_IHC_Plus_Tunnel_3_4_AR2", "CH_EISPHB_IHC_Plus_Tunnel_3__UB_", 0); //1: enable; 0: disable
			@sysvar::CH_Nodes::CH_EISPHB_IHC_Plus_Tunnel_3__UB_ = 0;
			break;
	}
}

on sysvar sysvar::CH_Nodes::CH_EISCRC_PHB_IHC_Plus_Tunn_AUTO
{
//	EnableCRC("PHB_IHC_Plus_Tunnel_3_4_AR2",  "PHB_IHC_Plus_Tunnel_3_4_Pr2", !@this); // 1 = on, 0 = off 
	enableControl("PHB_IHC_Plus_Tunnel_3_4_AR2", "CH_EISCRC_PHB_IHC_Plus_Tunnel_3_", @this); //1: enable; 0: disable
	CRC_PHB_IHC_Plus_Tunnel_3_4_Pr2 = @sysvar::CH_Nodes::CH_EISCRC_PHB_IHC_Plus_Tunn_AUTO;
}

on sysvar sysvar::CH_Nodes::CH_EISSQC_PHB_IHC_Plus_Tunn_AUTO
{
//	EnableSQC("PHB_IHC_Plus_Tunnel_3_4_AR2",  "PHB_IHC_Plus_Tunnel_3_4_Pr2", !@this); // 1 = on, 0 = off 
	enableControl("PHB_IHC_Plus_Tunnel_3_4_AR2", "CH_EISSQC_PHB_IHC_Plus_Tunnel_3_", @this); //1: enable; 0: disable
	SQC_PHB_IHC_Plus_Tunnel_3_4_Pr2 = @sysvar::CH_Nodes::CH_EISSQC_PHB_IHC_Plus_Tunn_AUTO;
}

on sysvar sysvar::CH_Nodes::CH_EISPHB_IHC_Plus_Tunne_UB_A_01
{
	switch (@sysvar::CH_Nodes::CH_EISPHB_IHC_Plus_Tunne_UB_A_01)
	{
		case (0):
			enableControl("PHB_IHC_Plus_Tunnel_AR2", "CH_EISPHB_IHC_Plus_Tunnel_AR_UB_", 0); //1: enable; 0: disable
			@sysvar::CH_Nodes::CH_EISPHB_IHC_Plus_Tunnel_AR_UB_ = 1;
			break;
		case (1):
			enableControl("PHB_IHC_Plus_Tunnel_AR2", "CH_EISPHB_IHC_Plus_Tunnel_AR_UB_", 1); //1: enable; 0: disable
			break;
		case (2):
			enableControl("PHB_IHC_Plus_Tunnel_AR2", "CH_EISPHB_IHC_Plus_Tunnel_AR_UB_", 0); //1: enable; 0: disable
			@sysvar::CH_Nodes::CH_EISPHB_IHC_Plus_Tunnel_AR_UB_ = 1;
			break;
		case (3):
			enableControl("PHB_IHC_Plus_Tunnel_AR2", "CH_EISPHB_IHC_Plus_Tunnel_AR_UB_", 0); //1: enable; 0: disable
			@sysvar::CH_Nodes::CH_EISPHB_IHC_Plus_Tunnel_AR_UB_ = 0;
			break;
	}
}

on sysvar sysvar::CH_Nodes::CH_EISCRC_PHB_IHC_Plus_Tunn_A_01
{
//	EnableCRC("PHB_IHC_Plus_Tunnel_AR2",  "PHB_IHC_Plus_Tunnel_Pr2", !@this); // 1 = on, 0 = off 
	enableControl("PHB_IHC_Plus_Tunnel_AR2", "CH_EISCRC_PHB_IHC_Plus_Tunnel_P_", @this); //1: enable; 0: disable
	CRC_PHB_IHC_Plus_Tunnel_Pr2 = @sysvar::CH_Nodes::CH_EISCRC_PHB_IHC_Plus_Tunn_A_01;
}

on sysvar sysvar::CH_Nodes::CH_EISSQC_PHB_IHC_Plus_Tunn_A_01
{
//	EnableSQC("PHB_IHC_Plus_Tunnel_AR2",  "PHB_IHC_Plus_Tunnel_Pr2", !@this); // 1 = on, 0 = off 
	enableControl("PHB_IHC_Plus_Tunnel_AR2", "CH_EISSQC_PHB_IHC_Plus_Tunnel_P_", @this); //1: enable; 0: disable
	SQC_PHB_IHC_Plus_Tunnel_Pr2 = @sysvar::CH_Nodes::CH_EISSQC_PHB_IHC_Plus_Tunn_A_01;
}

on sysvar sysvar::CH_Nodes::CH_EISPN14_Rs1_AR2_UB_AUTO_01
{
	switch (@sysvar::CH_Nodes::CH_EISPN14_Rs1_AR2_UB_AUTO_01)
	{
		case (0):
			enableControl("PN14_Rs1_AR2", "CH_EISPN14_Rs1_AR2_UB__01", 0); //1: enable; 0: disable
			@sysvar::CH_Nodes::CH_EISPN14_Rs1_AR2_UB__01 = 1;
			break;
		case (1):
			enableControl("PN14_Rs1_AR2", "CH_EISPN14_Rs1_AR2_UB__01", 1); //1: enable; 0: disable
			break;
		case (2):
			enableControl("PN14_Rs1_AR2", "CH_EISPN14_Rs1_AR2_UB__01", 0); //1: enable; 0: disable
			@sysvar::CH_Nodes::CH_EISPN14_Rs1_AR2_UB__01 = 1;
			break;
		case (3):
			enableControl("PN14_Rs1_AR2", "CH_EISPN14_Rs1_AR2_UB__01", 0); //1: enable; 0: disable
			@sysvar::CH_Nodes::CH_EISPN14_Rs1_AR2_UB__01 = 0;
			break;
	}
}

on sysvar sysvar::CH_Nodes::CH_EISCRC_PN14_Rs1_Pr2PN14__AUTO
{
//	EnableCRC("PN14_Rs1_AR2",  "PN14_Rs1_Pr2", !@this); // 1 = on, 0 = off 
	enableControl("PN14_Rs1_AR2", "CH_EISCRC_PN14_Rs1_Pr2PN14_Rs1__", @this); //1: enable; 0: disable
	CRC_PN14_Rs1_Pr2 = @sysvar::CH_Nodes::CH_EISCRC_PN14_Rs1_Pr2PN14__AUTO;
}

on sysvar sysvar::CH_Nodes::CH_EISSQC_PN14_Rs1_Pr2PN14__AUTO
{
//	EnableSQC("PN14_Rs1_AR2",  "PN14_Rs1_Pr2", !@this); // 1 = on, 0 = off 
	enableControl("PN14_Rs1_AR2", "CH_EISSQC_PN14_Rs1_Pr2PN14_Rs1__", @this); //1: enable; 0: disable
	SQC_PN14_Rs1_Pr2 = @sysvar::CH_Nodes::CH_EISSQC_PN14_Rs1_Pr2PN14__AUTO;
}

on sysvar sysvar::CH_Nodes::CH_EISPN14_Rs2_AR_UB_AUTO_01
{
	switch (@sysvar::CH_Nodes::CH_EISPN14_Rs2_AR_UB_AUTO_01)
	{
		case (0):
			enableControl("PN14_Rs2_AR", "CH_EISPN14_Rs2_AR_UB__01", 0); //1: enable; 0: disable
			@sysvar::CH_Nodes::CH_EISPN14_Rs2_AR_UB__01 = 1;
			break;
		case (1):
			enableControl("PN14_Rs2_AR", "CH_EISPN14_Rs2_AR_UB__01", 1); //1: enable; 0: disable
			break;
		case (2):
			enableControl("PN14_Rs2_AR", "CH_EISPN14_Rs2_AR_UB__01", 0); //1: enable; 0: disable
			@sysvar::CH_Nodes::CH_EISPN14_Rs2_AR_UB__01 = 1;
			break;
		case (3):
			enableControl("PN14_Rs2_AR", "CH_EISPN14_Rs2_AR_UB__01", 0); //1: enable; 0: disable
			@sysvar::CH_Nodes::CH_EISPN14_Rs2_AR_UB__01 = 0;
			break;
	}
}

on sysvar sysvar::CH_Nodes::CH_EISPN14_Stat2_AR2_UB_AUTO_01
{
	switch (@sysvar::CH_Nodes::CH_EISPN14_Stat2_AR2_UB_AUTO_01)
	{
		case (0):
			enableControl("PN14_Stat2_AR2", "CH_EISPN14_Stat2_AR2_UB__01", 0); //1: enable; 0: disable
			@sysvar::CH_Nodes::CH_EISPN14_Stat2_AR2_UB__01 = 1;
			break;
		case (1):
			enableControl("PN14_Stat2_AR2", "CH_EISPN14_Stat2_AR2_UB__01", 1); //1: enable; 0: disable
			break;
		case (2):
			enableControl("PN14_Stat2_AR2", "CH_EISPN14_Stat2_AR2_UB__01", 0); //1: enable; 0: disable
			@sysvar::CH_Nodes::CH_EISPN14_Stat2_AR2_UB__01 = 1;
			break;
		case (3):
			enableControl("PN14_Stat2_AR2", "CH_EISPN14_Stat2_AR2_UB__01", 0); //1: enable; 0: disable
			@sysvar::CH_Nodes::CH_EISPN14_Stat2_AR2_UB__01 = 0;
			break;
	}
}

on sysvar sysvar::CH_Nodes::CH_EISPN14_Stat_AR_UB_AUTO_01
{
	switch (@sysvar::CH_Nodes::CH_EISPN14_Stat_AR_UB_AUTO_01)
	{
		case (0):
			enableControl("PN14_Stat_AR", "CH_EISPN14_Stat_AR_UB__01", 0); //1: enable; 0: disable
			@sysvar::CH_Nodes::CH_EISPN14_Stat_AR_UB__01 = 1;
			break;
		case (1):
			enableControl("PN14_Stat_AR", "CH_EISPN14_Stat_AR_UB__01", 1); //1: enable; 0: disable
			break;
		case (2):
			enableControl("PN14_Stat_AR", "CH_EISPN14_Stat_AR_UB__01", 0); //1: enable; 0: disable
			@sysvar::CH_Nodes::CH_EISPN14_Stat_AR_UB__01 = 1;
			break;
		case (3):
			enableControl("PN14_Stat_AR", "CH_EISPN14_Stat_AR_UB__01", 0); //1: enable; 0: disable
			@sysvar::CH_Nodes::CH_EISPN14_Stat_AR_UB__01 = 0;
			break;
	}
}

on sysvar sysvar::CH_Nodes::CH_EISPN48_Bat_Stat_AR_UB_AUT_01
{
	switch (@sysvar::CH_Nodes::CH_EISPN48_Bat_Stat_AR_UB_AUT_01)
	{
		case (0):
			enableControl("PN48_Bat_Stat_AR", "CH_EISPN48_Bat_Stat_AR_UB__01", 0); //1: enable; 0: disable
			@sysvar::CH_Nodes::CH_EISPN48_Bat_Stat_AR_UB__01 = 1;
			break;
		case (1):
			enableControl("PN48_Bat_Stat_AR", "CH_EISPN48_Bat_Stat_AR_UB__01", 1); //1: enable; 0: disable
			break;
		case (2):
			enableControl("PN48_Bat_Stat_AR", "CH_EISPN48_Bat_Stat_AR_UB__01", 0); //1: enable; 0: disable
			@sysvar::CH_Nodes::CH_EISPN48_Bat_Stat_AR_UB__01 = 1;
			break;
		case (3):
			enableControl("PN48_Bat_Stat_AR", "CH_EISPN48_Bat_Stat_AR_UB__01", 0); //1: enable; 0: disable
			@sysvar::CH_Nodes::CH_EISPN48_Bat_Stat_AR_UB__01 = 0;
			break;
	}
}

on sysvar sysvar::CH_Nodes::CH_EISPN48_BatLim_Stat_A_UB_A_01
{
	switch (@sysvar::CH_Nodes::CH_EISPN48_BatLim_Stat_A_UB_A_01)
	{
		case (0):
			enableControl("PN48_BatLim_Stat_AR", "CH_EISPN48_BatLim_Stat_AR_UB__01", 0); //1: enable; 0: disable
			@sysvar::CH_Nodes::CH_EISPN48_BatLim_Stat_AR_UB__01 = 1;
			break;
		case (1):
			enableControl("PN48_BatLim_Stat_AR", "CH_EISPN48_BatLim_Stat_AR_UB__01", 1); //1: enable; 0: disable
			break;
		case (2):
			enableControl("PN48_BatLim_Stat_AR", "CH_EISPN48_BatLim_Stat_AR_UB__01", 0); //1: enable; 0: disable
			@sysvar::CH_Nodes::CH_EISPN48_BatLim_Stat_AR_UB__01 = 1;
			break;
		case (3):
			enableControl("PN48_BatLim_Stat_AR", "CH_EISPN48_BatLim_Stat_AR_UB__01", 0); //1: enable; 0: disable
			@sysvar::CH_Nodes::CH_EISPN48_BatLim_Stat_AR_UB__01 = 0;
			break;
	}
}

on sysvar sysvar::CH_Nodes::CH_EISPN48_Stat_AR_UB_AUTO_01
{
	switch (@sysvar::CH_Nodes::CH_EISPN48_Stat_AR_UB_AUTO_01)
	{
		case (0):
			enableControl("PN48_Stat_AR", "CH_EISPN48_Stat_AR_UB__01", 0); //1: enable; 0: disable
			@sysvar::CH_Nodes::CH_EISPN48_Stat_AR_UB__01 = 1;
			break;
		case (1):
			enableControl("PN48_Stat_AR", "CH_EISPN48_Stat_AR_UB__01", 1); //1: enable; 0: disable
			break;
		case (2):
			enableControl("PN48_Stat_AR", "CH_EISPN48_Stat_AR_UB__01", 0); //1: enable; 0: disable
			@sysvar::CH_Nodes::CH_EISPN48_Stat_AR_UB__01 = 1;
			break;
		case (3):
			enableControl("PN48_Stat_AR", "CH_EISPN48_Stat_AR_UB__01", 0); //1: enable; 0: disable
			@sysvar::CH_Nodes::CH_EISPN48_Stat_AR_UB__01 = 0;
			break;
	}
}

on sysvar sysvar::CH_Nodes::CH_EISPNHV_WeekDepTmTbl__UB_A_01
{
	switch (@sysvar::CH_Nodes::CH_EISPNHV_WeekDepTmTbl__UB_A_01)
	{
		case (0):
			enableControl("PNHV_WeekDepTmTbl_Rq_HU_AR2", "CH_EISPNHV_WeekDepTmTbl_Rq_H__01", 0); //1: enable; 0: disable
			@sysvar::CH_Nodes::CH_EISPNHV_WeekDepTmTbl_Rq_H__01 = 1;
			break;
		case (1):
			enableControl("PNHV_WeekDepTmTbl_Rq_HU_AR2", "CH_EISPNHV_WeekDepTmTbl_Rq_H__01", 1); //1: enable; 0: disable
			break;
		case (2):
			enableControl("PNHV_WeekDepTmTbl_Rq_HU_AR2", "CH_EISPNHV_WeekDepTmTbl_Rq_H__01", 0); //1: enable; 0: disable
			@sysvar::CH_Nodes::CH_EISPNHV_WeekDepTmTbl_Rq_H__01 = 1;
			break;
		case (3):
			enableControl("PNHV_WeekDepTmTbl_Rq_HU_AR2", "CH_EISPNHV_WeekDepTmTbl_Rq_H__01", 0); //1: enable; 0: disable
			@sysvar::CH_Nodes::CH_EISPNHV_WeekDepTmTbl_Rq_H__01 = 0;
			break;
	}
}

on sysvar sysvar::CH_Nodes::CH_EISPT_ObjIntrst_Gw_AR_UB_AUTO
{
	switch (@sysvar::CH_Nodes::CH_EISPT_ObjIntrst_Gw_AR_UB_AUTO)
	{
		case (0):
			enableControl("PT_ObjIntrst_Gw_AR2", "CH_EISPT_ObjIntrst_Gw_AR2_UB_", 0); //1: enable; 0: disable
			@sysvar::CH_Nodes::CH_EISPT_ObjIntrst_Gw_AR2_UB_ = 1;
			break;
		case (1):
			enableControl("PT_ObjIntrst_Gw_AR2", "CH_EISPT_ObjIntrst_Gw_AR2_UB_", 1); //1: enable; 0: disable
			break;
		case (2):
			enableControl("PT_ObjIntrst_Gw_AR2", "CH_EISPT_ObjIntrst_Gw_AR2_UB_", 0); //1: enable; 0: disable
			@sysvar::CH_Nodes::CH_EISPT_ObjIntrst_Gw_AR2_UB_ = 1;
			break;
		case (3):
			enableControl("PT_ObjIntrst_Gw_AR2", "CH_EISPT_ObjIntrst_Gw_AR2_UB_", 0); //1: enable; 0: disable
			@sysvar::CH_Nodes::CH_EISPT_ObjIntrst_Gw_AR2_UB_ = 0;
			break;
	}
}

on sysvar sysvar::CH_Nodes::CH_EISCRC_PT_ObjIntrst_Pr2P_AUTO
{
//	EnableCRC("PT_ObjIntrst_Gw_AR2",  "PT_ObjIntrst_Pr2", !@this); // 1 = on, 0 = off 
	enableControl("PT_ObjIntrst_Gw_AR2", "CH_EISCRC_PT_ObjIntrst_Pr2PT_Ob_", @this); //1: enable; 0: disable
	CRC_PT_ObjIntrst_Pr2 = @sysvar::CH_Nodes::CH_EISCRC_PT_ObjIntrst_Pr2P_AUTO;
}

on sysvar sysvar::CH_Nodes::CH_EISSQC_PT_ObjIntrst_Pr2P_AUTO
{
//	EnableSQC("PT_ObjIntrst_Gw_AR2",  "PT_ObjIntrst_Pr2", !@this); // 1 = on, 0 = off 
	enableControl("PT_ObjIntrst_Gw_AR2", "CH_EISSQC_PT_ObjIntrst_Pr2PT_Ob_", @this); //1: enable; 0: disable
	SQC_PT_ObjIntrst_Pr2 = @sysvar::CH_Nodes::CH_EISSQC_PT_ObjIntrst_Pr2P_AUTO;
}

on sysvar sysvar::CH_Nodes::CH_EISRemPark_Auth_Rs_AR_UB_A_01
{
	switch (@sysvar::CH_Nodes::CH_EISRemPark_Auth_Rs_AR_UB_A_01)
	{
		case (0):
			enableControl("RemPark_Auth_Rs_AR2", "CH_EISRemPark_Auth_Rs_AR2_UB__01", 0); //1: enable; 0: disable
			@sysvar::CH_Nodes::CH_EISRemPark_Auth_Rs_AR2_UB__01 = 1;
			break;
		case (1):
			enableControl("RemPark_Auth_Rs_AR2", "CH_EISRemPark_Auth_Rs_AR2_UB__01", 1); //1: enable; 0: disable
			break;
		case (2):
			enableControl("RemPark_Auth_Rs_AR2", "CH_EISRemPark_Auth_Rs_AR2_UB__01", 0); //1: enable; 0: disable
			@sysvar::CH_Nodes::CH_EISRemPark_Auth_Rs_AR2_UB__01 = 1;
			break;
		case (3):
			enableControl("RemPark_Auth_Rs_AR2", "CH_EISRemPark_Auth_Rs_AR2_UB__01", 0); //1: enable; 0: disable
			@sysvar::CH_Nodes::CH_EISRemPark_Auth_Rs_AR2_UB__01 = 0;
			break;
	}
}

on sysvar sysvar::CH_Nodes::CH_EISCRC_RemPark_Auth_Rs_P_AUTO
{
//	EnableCRC("RemPark_Auth_Rs_AR2",  "RemPark_Auth_Rs_Pr2", !@this); // 1 = on, 0 = off 
	enableControl("RemPark_Auth_Rs_AR2", "CH_EISCRC_RemPark_Auth_Rs_Pr2Re_", @this); //1: enable; 0: disable
	CRC_RemPark_Auth_Rs_Pr2 = @sysvar::CH_Nodes::CH_EISCRC_RemPark_Auth_Rs_P_AUTO;
}

on sysvar sysvar::CH_Nodes::CH_EISSQC_RemPark_Auth_Rs_P_AUTO
{
//	EnableSQC("RemPark_Auth_Rs_AR2",  "RemPark_Auth_Rs_Pr2", !@this); // 1 = on, 0 = off 
	enableControl("RemPark_Auth_Rs_AR2", "CH_EISSQC_RemPark_Auth_Rs_Pr2Re_", @this); //1: enable; 0: disable
	SQC_RemPark_Auth_Rs_Pr2 = @sysvar::CH_Nodes::CH_EISSQC_RemPark_Auth_Rs_P_AUTO;
}

on sysvar sysvar::CH_Nodes::CH_EISRemPark_Stat_EIS_A_UB_AUTO
{
	switch (@sysvar::CH_Nodes::CH_EISRemPark_Stat_EIS_A_UB_AUTO)
	{
		case (0):
			enableControl("RemPark_Stat_EIS_AR2", "CH_EISRemPark_Stat_EIS_AR2_UB_", 0); //1: enable; 0: disable
			@sysvar::CH_Nodes::CH_EISRemPark_Stat_EIS_AR2_UB_ = 1;
			break;
		case (1):
			enableControl("RemPark_Stat_EIS_AR2", "CH_EISRemPark_Stat_EIS_AR2_UB_", 1); //1: enable; 0: disable
			break;
		case (2):
			enableControl("RemPark_Stat_EIS_AR2", "CH_EISRemPark_Stat_EIS_AR2_UB_", 0); //1: enable; 0: disable
			@sysvar::CH_Nodes::CH_EISRemPark_Stat_EIS_AR2_UB_ = 1;
			break;
		case (3):
			enableControl("RemPark_Stat_EIS_AR2", "CH_EISRemPark_Stat_EIS_AR2_UB_", 0); //1: enable; 0: disable
			@sysvar::CH_Nodes::CH_EISRemPark_Stat_EIS_AR2_UB_ = 0;
			break;
	}
}

on sysvar sysvar::CH_Nodes::CH_EISCRC_RemPark_Stat_EIS__AUTO
{
//	EnableCRC("RemPark_Stat_EIS_AR2",  "RemPark_Stat_EIS_Pr2", !@this); // 1 = on, 0 = off 
	enableControl("RemPark_Stat_EIS_AR2", "CH_EISCRC_RemPark_Stat_EIS_Pr2R_", @this); //1: enable; 0: disable
	CRC_RemPark_Stat_EIS_Pr2 = @sysvar::CH_Nodes::CH_EISCRC_RemPark_Stat_EIS__AUTO;
}

on sysvar sysvar::CH_Nodes::CH_EISSQC_RemPark_Stat_EIS__AUTO
{
//	EnableSQC("RemPark_Stat_EIS_AR2",  "RemPark_Stat_EIS_Pr2", !@this); // 1 = on, 0 = off 
	enableControl("RemPark_Stat_EIS_AR2", "CH_EISSQC_RemPark_Stat_EIS_Pr2R_", @this); //1: enable; 0: disable
	SQC_RemPark_Stat_EIS_Pr2 = @sysvar::CH_Nodes::CH_EISSQC_RemPark_Stat_EIS__AUTO;
}

on sysvar sysvar::CH_Nodes::CH_EISRTC_Date_Time_AR2_UB_AU_01
{
	switch (@sysvar::CH_Nodes::CH_EISRTC_Date_Time_AR2_UB_AU_01)
	{
		case (0):
			enableControl("RTC_Date_Time_AR2", "CH_EISRTC_Date_Time_AR2_UB__01", 0); //1: enable; 0: disable
			@sysvar::CH_Nodes::CH_EISRTC_Date_Time_AR2_UB__01 = 1;
			break;
		case (1):
			enableControl("RTC_Date_Time_AR2", "CH_EISRTC_Date_Time_AR2_UB__01", 1); //1: enable; 0: disable
			break;
		case (2):
			enableControl("RTC_Date_Time_AR2", "CH_EISRTC_Date_Time_AR2_UB__01", 0); //1: enable; 0: disable
			@sysvar::CH_Nodes::CH_EISRTC_Date_Time_AR2_UB__01 = 1;
			break;
		case (3):
			enableControl("RTC_Date_Time_AR2", "CH_EISRTC_Date_Time_AR2_UB__01", 0); //1: enable; 0: disable
			@sysvar::CH_Nodes::CH_EISRTC_Date_Time_AR2_UB__01 = 0;
			break;
	}
}

on sysvar sysvar::CH_Nodes::CH_EISSADR_Trgr_FCW_AR2_UB_AU_01
{
	switch (@sysvar::CH_Nodes::CH_EISSADR_Trgr_FCW_AR2_UB_AU_01)
	{
		case (0):
			enableControl("SADR_Trgr_FCW_AR2", "CH_EISSADR_Trgr_FCW_AR2_UB__01", 0); //1: enable; 0: disable
			@sysvar::CH_Nodes::CH_EISSADR_Trgr_FCW_AR2_UB__01 = 1;
			break;
		case (1):
			enableControl("SADR_Trgr_FCW_AR2", "CH_EISSADR_Trgr_FCW_AR2_UB__01", 1); //1: enable; 0: disable
			break;
		case (2):
			enableControl("SADR_Trgr_FCW_AR2", "CH_EISSADR_Trgr_FCW_AR2_UB__01", 0); //1: enable; 0: disable
			@sysvar::CH_Nodes::CH_EISSADR_Trgr_FCW_AR2_UB__01 = 1;
			break;
		case (3):
			enableControl("SADR_Trgr_FCW_AR2", "CH_EISSADR_Trgr_FCW_AR2_UB__01", 0); //1: enable; 0: disable
			@sysvar::CH_Nodes::CH_EISSADR_Trgr_FCW_AR2_UB__01 = 0;
			break;
	}
}

on sysvar sysvar::CH_Nodes::CH_EISCRC_SADR_Trgr_FCW_Pr2_AUTO
{
//	EnableCRC("SADR_Trgr_FCW_AR2",  "SADR_Trgr_FCW_Pr2", !@this); // 1 = on, 0 = off 
	enableControl("SADR_Trgr_FCW_AR2", "CH_EISCRC_SADR_Trgr_FCW_Pr2SADR_", @this); //1: enable; 0: disable
	CRC_SADR_Trgr_FCW_Pr2 = @sysvar::CH_Nodes::CH_EISCRC_SADR_Trgr_FCW_Pr2_AUTO;
}

on sysvar sysvar::CH_Nodes::CH_EISSQC_SADR_Trgr_FCW_Pr2_AUTO
{
//	EnableSQC("SADR_Trgr_FCW_AR2",  "SADR_Trgr_FCW_Pr2", !@this); // 1 = on, 0 = off 
	enableControl("SADR_Trgr_FCW_AR2", "CH_EISSQC_SADR_Trgr_FCW_Pr2SADR_", @this); //1: enable; 0: disable
	SQC_SADR_Trgr_FCW_Pr2 = @sysvar::CH_Nodes::CH_EISSQC_SADR_Trgr_FCW_Pr2_AUTO;
}

on sysvar sysvar::CH_Nodes::CH_EISSeat_FL_TglSeatAdj_FL_AUTO
{
//	EnableTGL("SeatAdj_FL_Rq_AR",  "eat_FL_", !@this); // 1 = on, 0 = off 
	enableControl("SeatAdj_FL_Rq_AR", "CH_EISSeat_FL_TglSeatAdj_FL_Rq__", @this); //1: enable; 0: disable
	TGL_eat_FL_ = @sysvar::CH_Nodes::CH_EISSeat_FL_TglSeatAdj_FL_AUTO;
}

on sysvar sysvar::CH_Nodes::CH_EISSeat_FR_TglSeatAdj_FR_AUTO
{
//	EnableTGL("SeatAdj_FR_Rq_AR",  "eat_FR_", !@this); // 1 = on, 0 = off 
	enableControl("SeatAdj_FR_Rq_AR", "CH_EISSeat_FR_TglSeatAdj_FR_Rq__", @this); //1: enable; 0: disable
	TGL_eat_FR_ = @sysvar::CH_Nodes::CH_EISSeat_FR_TglSeatAdj_FR_AUTO;
}

on sysvar sysvar::CH_Nodes::CH_EISSPCR_Stat_BC_F_AR2_UB_A_01
{
	switch (@sysvar::CH_Nodes::CH_EISSPCR_Stat_BC_F_AR2_UB_A_01)
	{
		case (0):
			enableControl("SPCR_Stat_BC_F_AR2", "CH_EISSPCR_Stat_BC_F_AR2_UB__01", 0); //1: enable; 0: disable
			@sysvar::CH_Nodes::CH_EISSPCR_Stat_BC_F_AR2_UB__01 = 1;
			break;
		case (1):
			enableControl("SPCR_Stat_BC_F_AR2", "CH_EISSPCR_Stat_BC_F_AR2_UB__01", 1); //1: enable; 0: disable
			break;
		case (2):
			enableControl("SPCR_Stat_BC_F_AR2", "CH_EISSPCR_Stat_BC_F_AR2_UB__01", 0); //1: enable; 0: disable
			@sysvar::CH_Nodes::CH_EISSPCR_Stat_BC_F_AR2_UB__01 = 1;
			break;
		case (3):
			enableControl("SPCR_Stat_BC_F_AR2", "CH_EISSPCR_Stat_BC_F_AR2_UB__01", 0); //1: enable; 0: disable
			@sysvar::CH_Nodes::CH_EISSPCR_Stat_BC_F_AR2_UB__01 = 0;
			break;
	}
}

on sysvar sysvar::CH_Nodes::CH_EISCRC_SPCR_Stat_BC_F_Pr_AUTO
{
//	EnableCRC("SPCR_Stat_BC_F_AR2",  "SPCR_Stat_BC_F_Pr2", !@this); // 1 = on, 0 = off 
	enableControl("SPCR_Stat_BC_F_AR2", "CH_EISCRC_SPCR_Stat_BC_F_Pr2SPC_", @this); //1: enable; 0: disable
	CRC_SPCR_Stat_BC_F_Pr2 = @sysvar::CH_Nodes::CH_EISCRC_SPCR_Stat_BC_F_Pr_AUTO;
}

on sysvar sysvar::CH_Nodes::CH_EISSQC_SPCR_Stat_BC_F_Pr_AUTO
{
//	EnableSQC("SPCR_Stat_BC_F_AR2",  "SPCR_Stat_BC_F_Pr2", !@this); // 1 = on, 0 = off 
	enableControl("SPCR_Stat_BC_F_AR2", "CH_EISSQC_SPCR_Stat_BC_F_Pr2SPC_", @this); //1: enable; 0: disable
	SQC_SPCR_Stat_BC_F_Pr2 = @sysvar::CH_Nodes::CH_EISSQC_SPCR_Stat_BC_F_Pr_AUTO;
}

on sysvar sysvar::CH_Nodes::CH_EISSPL_Obj1_Obj2_NV_A_UB_A_01
{
	switch (@sysvar::CH_Nodes::CH_EISSPL_Obj1_Obj2_NV_A_UB_A_01)
	{
		case (0):
			enableControl("SPL_Obj1_Obj2_NV_AR2", "CH_EISSPL_Obj1_Obj2_NV_AR2_UB_01", 0); //1: enable; 0: disable
			@sysvar::CH_Nodes::CH_EISSPL_Obj1_Obj2_NV_AR2_UB_01 = 1;
			break;
		case (1):
			enableControl("SPL_Obj1_Obj2_NV_AR2", "CH_EISSPL_Obj1_Obj2_NV_AR2_UB_01", 1); //1: enable; 0: disable
			break;
		case (2):
			enableControl("SPL_Obj1_Obj2_NV_AR2", "CH_EISSPL_Obj1_Obj2_NV_AR2_UB_01", 0); //1: enable; 0: disable
			@sysvar::CH_Nodes::CH_EISSPL_Obj1_Obj2_NV_AR2_UB_01 = 1;
			break;
		case (3):
			enableControl("SPL_Obj1_Obj2_NV_AR2", "CH_EISSPL_Obj1_Obj2_NV_AR2_UB_01", 0); //1: enable; 0: disable
			@sysvar::CH_Nodes::CH_EISSPL_Obj1_Obj2_NV_AR2_UB_01 = 0;
			break;
	}
}

on sysvar sysvar::CH_Nodes::CH_EISCRC_SPL_Obj1_Obj2_NV__AUTO
{
//	EnableCRC("SPL_Obj1_Obj2_NV_AR2",  "SPL_Obj1_Obj2_NV_Pr2", !@this); // 1 = on, 0 = off 
	enableControl("SPL_Obj1_Obj2_NV_AR2", "CH_EISCRC_SPL_Obj1_Obj2_NV_Pr2S_", @this); //1: enable; 0: disable
	CRC_SPL_Obj1_Obj2_NV_Pr2 = @sysvar::CH_Nodes::CH_EISCRC_SPL_Obj1_Obj2_NV__AUTO;
}

on sysvar sysvar::CH_Nodes::CH_EISSQC_SPL_Obj1_Obj2_NV__AUTO
{
//	EnableSQC("SPL_Obj1_Obj2_NV_AR2",  "SPL_Obj1_Obj2_NV_Pr2", !@this); // 1 = on, 0 = off 
	enableControl("SPL_Obj1_Obj2_NV_AR2", "CH_EISSQC_SPL_Obj1_Obj2_NV_Pr2S_", @this); //1: enable; 0: disable
	SQC_SPL_Obj1_Obj2_NV_Pr2 = @sysvar::CH_Nodes::CH_EISSQC_SPL_Obj1_Obj2_NV__AUTO;
}

on sysvar sysvar::CH_Nodes::CH_EISSPV_Actn_Rq_AR2_UB_AUTO_01
{
	switch (@sysvar::CH_Nodes::CH_EISSPV_Actn_Rq_AR2_UB_AUTO_01)
	{
		case (0):
			enableControl("SPV_Actn_Rq_AR2", "CH_EISSPV_Actn_Rq_AR2_UB__01", 0); //1: enable; 0: disable
			@sysvar::CH_Nodes::CH_EISSPV_Actn_Rq_AR2_UB__01 = 1;
			break;
		case (1):
			enableControl("SPV_Actn_Rq_AR2", "CH_EISSPV_Actn_Rq_AR2_UB__01", 1); //1: enable; 0: disable
			break;
		case (2):
			enableControl("SPV_Actn_Rq_AR2", "CH_EISSPV_Actn_Rq_AR2_UB__01", 0); //1: enable; 0: disable
			@sysvar::CH_Nodes::CH_EISSPV_Actn_Rq_AR2_UB__01 = 1;
			break;
		case (3):
			enableControl("SPV_Actn_Rq_AR2", "CH_EISSPV_Actn_Rq_AR2_UB__01", 0); //1: enable; 0: disable
			@sysvar::CH_Nodes::CH_EISSPV_Actn_Rq_AR2_UB__01 = 0;
			break;
	}
}

on sysvar sysvar::CH_Nodes::CH_EISCRC_SPV_ExtLgt_Rq_Pr2_AUTO
{
//	EnableCRC("SPV_Actn_Rq_AR2",  "SPV_ExtLgt_Rq_Pr2", !@this); // 1 = on, 0 = off 
	enableControl("SPV_Actn_Rq_AR2", "CH_EISCRC_SPV_ExtLgt_Rq_Pr2SPV__", @this); //1: enable; 0: disable
	CRC_SPV_ExtLgt_Rq_Pr2 = @sysvar::CH_Nodes::CH_EISCRC_SPV_ExtLgt_Rq_Pr2_AUTO;
}

on sysvar sysvar::CH_Nodes::CH_EISSQC_SPV_ExtLgt_Rq_Pr2_AUTO
{
//	EnableSQC("SPV_Actn_Rq_AR2",  "SPV_ExtLgt_Rq_Pr2", !@this); // 1 = on, 0 = off 
	enableControl("SPV_Actn_Rq_AR2", "CH_EISSQC_SPV_ExtLgt_Rq_Pr2SPV__", @this); //1: enable; 0: disable
	SQC_SPV_ExtLgt_Rq_Pr2 = @sysvar::CH_Nodes::CH_EISSQC_SPV_ExtLgt_Rq_Pr2_AUTO;
}

on sysvar sysvar::CH_Nodes::CH_EISCRC_SPV_WprWash_Rq_Pr_AUTO
{
//	EnableCRC("SPV_Actn_Rq_AR2",  "SPV_WprWash_Rq_Pr2", !@this); // 1 = on, 0 = off 
	enableControl("SPV_Actn_Rq_AR2", "CH_EISCRC_SPV_WprWash_Rq_Pr2SPV_", @this); //1: enable; 0: disable
	CRC_SPV_WprWash_Rq_Pr2 = @sysvar::CH_Nodes::CH_EISCRC_SPV_WprWash_Rq_Pr_AUTO;
}

on sysvar sysvar::CH_Nodes::CH_EISSQC_SPV_WprWash_Rq_Pr_AUTO
{
//	EnableSQC("SPV_Actn_Rq_AR2",  "SPV_WprWash_Rq_Pr2", !@this); // 1 = on, 0 = off 
	enableControl("SPV_Actn_Rq_AR2", "CH_EISSQC_SPV_WprWash_Rq_Pr2SPV_", @this); //1: enable; 0: disable
	SQC_SPV_WprWash_Rq_Pr2 = @sysvar::CH_Nodes::CH_EISSQC_SPV_WprWash_Rq_Pr_AUTO;
}

on sysvar sysvar::CH_Nodes::CH_EISSPV_Alm_Rq_AR_UB_AUTO_01
{
	switch (@sysvar::CH_Nodes::CH_EISSPV_Alm_Rq_AR_UB_AUTO_01)
	{
		case (0):
			enableControl("SPV_Alm_Rq_AR", "CH_EISSPV_Alm_Rq_AR_UB__01", 0); //1: enable; 0: disable
			@sysvar::CH_Nodes::CH_EISSPV_Alm_Rq_AR_UB__01 = 1;
			break;
		case (1):
			enableControl("SPV_Alm_Rq_AR", "CH_EISSPV_Alm_Rq_AR_UB__01", 1); //1: enable; 0: disable
			break;
		case (2):
			enableControl("SPV_Alm_Rq_AR", "CH_EISSPV_Alm_Rq_AR_UB__01", 0); //1: enable; 0: disable
			@sysvar::CH_Nodes::CH_EISSPV_Alm_Rq_AR_UB__01 = 1;
			break;
		case (3):
			enableControl("SPV_Alm_Rq_AR", "CH_EISSPV_Alm_Rq_AR_UB__01", 0); //1: enable; 0: disable
			@sysvar::CH_Nodes::CH_EISSPV_Alm_Rq_AR_UB__01 = 0;
			break;
	}
}

on sysvar sysvar::CH_Nodes::CH_EISSVS_Rq_HU_AR2_UB_AUTO
{
	switch (@sysvar::CH_Nodes::CH_EISSVS_Rq_HU_AR2_UB_AUTO)
	{
		case (0):
			enableControl("SVS_Rq_HU_AR2", "CH_EISSVS_Rq_HU_AR2_UB_", 0); //1: enable; 0: disable
			@sysvar::CH_Nodes::CH_EISSVS_Rq_HU_AR2_UB_ = 1;
			break;
		case (1):
			enableControl("SVS_Rq_HU_AR2", "CH_EISSVS_Rq_HU_AR2_UB_", 1); //1: enable; 0: disable
			break;
		case (2):
			enableControl("SVS_Rq_HU_AR2", "CH_EISSVS_Rq_HU_AR2_UB_", 0); //1: enable; 0: disable
			@sysvar::CH_Nodes::CH_EISSVS_Rq_HU_AR2_UB_ = 1;
			break;
		case (3):
			enableControl("SVS_Rq_HU_AR2", "CH_EISSVS_Rq_HU_AR2_UB_", 0); //1: enable; 0: disable
			@sysvar::CH_Nodes::CH_EISSVS_Rq_HU_AR2_UB_ = 0;
			break;
	}
}

on sysvar sysvar::CH_Nodes::CH_EISTBCSC_DAC_EPS_AR2_UB_AU_01
{
	switch (@sysvar::CH_Nodes::CH_EISTBCSC_DAC_EPS_AR2_UB_AU_01)
	{
		case (0):
			enableControl("TBCSC_DAC_EPS_AR2", "CH_EISTBCSC_DAC_EPS_AR2_UB__01", 0); //1: enable; 0: disable
			@sysvar::CH_Nodes::CH_EISTBCSC_DAC_EPS_AR2_UB__01 = 1;
			break;
		case (1):
			enableControl("TBCSC_DAC_EPS_AR2", "CH_EISTBCSC_DAC_EPS_AR2_UB__01", 1); //1: enable; 0: disable
			break;
		case (2):
			enableControl("TBCSC_DAC_EPS_AR2", "CH_EISTBCSC_DAC_EPS_AR2_UB__01", 0); //1: enable; 0: disable
			@sysvar::CH_Nodes::CH_EISTBCSC_DAC_EPS_AR2_UB__01 = 1;
			break;
		case (3):
			enableControl("TBCSC_DAC_EPS_AR2", "CH_EISTBCSC_DAC_EPS_AR2_UB__01", 0); //1: enable; 0: disable
			@sysvar::CH_Nodes::CH_EISTBCSC_DAC_EPS_AR2_UB__01 = 0;
			break;
	}
}

on sysvar sysvar::CH_Nodes::CH_EISTBCSC_DAC_ESP_AR2_UB_AU_01
{
	switch (@sysvar::CH_Nodes::CH_EISTBCSC_DAC_ESP_AR2_UB_AU_01)
	{
		case (0):
			enableControl("TBCSC_DAC_ESP_AR2", "CH_EISTBCSC_DAC_ESP_AR2_UB__01", 0); //1: enable; 0: disable
			@sysvar::CH_Nodes::CH_EISTBCSC_DAC_ESP_AR2_UB__01 = 1;
			break;
		case (1):
			enableControl("TBCSC_DAC_ESP_AR2", "CH_EISTBCSC_DAC_ESP_AR2_UB__01", 1); //1: enable; 0: disable
			break;
		case (2):
			enableControl("TBCSC_DAC_ESP_AR2", "CH_EISTBCSC_DAC_ESP_AR2_UB__01", 0); //1: enable; 0: disable
			@sysvar::CH_Nodes::CH_EISTBCSC_DAC_ESP_AR2_UB__01 = 1;
			break;
		case (3):
			enableControl("TBCSC_DAC_ESP_AR2", "CH_EISTBCSC_DAC_ESP_AR2_UB__01", 0); //1: enable; 0: disable
			@sysvar::CH_Nodes::CH_EISTBCSC_DAC_ESP_AR2_UB__01 = 0;
			break;
	}
}

on sysvar sysvar::CH_Nodes::CH_EISTBCSC_Hi_Rq1_AR2_UB_AUT_01
{
	switch (@sysvar::CH_Nodes::CH_EISTBCSC_Hi_Rq1_AR2_UB_AUT_01)
	{
		case (0):
			enableControl("TBCSC_Hi_Rq1_AR2", "CH_EISTBCSC_Hi_Rq1_AR2_UB__01", 0); //1: enable; 0: disable
			@sysvar::CH_Nodes::CH_EISTBCSC_Hi_Rq1_AR2_UB__01 = 1;
			break;
		case (1):
			enableControl("TBCSC_Hi_Rq1_AR2", "CH_EISTBCSC_Hi_Rq1_AR2_UB__01", 1); //1: enable; 0: disable
			break;
		case (2):
			enableControl("TBCSC_Hi_Rq1_AR2", "CH_EISTBCSC_Hi_Rq1_AR2_UB__01", 0); //1: enable; 0: disable
			@sysvar::CH_Nodes::CH_EISTBCSC_Hi_Rq1_AR2_UB__01 = 1;
			break;
		case (3):
			enableControl("TBCSC_Hi_Rq1_AR2", "CH_EISTBCSC_Hi_Rq1_AR2_UB__01", 0); //1: enable; 0: disable
			@sysvar::CH_Nodes::CH_EISTBCSC_Hi_Rq1_AR2_UB__01 = 0;
			break;
	}
}

on sysvar sysvar::CH_Nodes::CH_EISCRC_TBCSC_Hi_Rq1_Pr2T_AUTO
{
//	EnableCRC("TBCSC_Hi_Rq1_AR2",  "TBCSC_Hi_Rq1_Pr2", !@this); // 1 = on, 0 = off 
	enableControl("TBCSC_Hi_Rq1_AR2", "CH_EISCRC_TBCSC_Hi_Rq1_Pr2TBCSC_", @this); //1: enable; 0: disable
	CRC_TBCSC_Hi_Rq1_Pr2 = @sysvar::CH_Nodes::CH_EISCRC_TBCSC_Hi_Rq1_Pr2T_AUTO;
}

on sysvar sysvar::CH_Nodes::CH_EISSQC_TBCSC_Hi_Rq1_Pr2T_AUTO
{
//	EnableSQC("TBCSC_Hi_Rq1_AR2",  "TBCSC_Hi_Rq1_Pr2", !@this); // 1 = on, 0 = off 
	enableControl("TBCSC_Hi_Rq1_AR2", "CH_EISSQC_TBCSC_Hi_Rq1_Pr2TBCSC_", @this); //1: enable; 0: disable
	SQC_TBCSC_Hi_Rq1_Pr2 = @sysvar::CH_Nodes::CH_EISSQC_TBCSC_Hi_Rq1_Pr2T_AUTO;
}

on sysvar sysvar::CH_Nodes::CH_EISTBCSC_Hi_Rq2_AR2_UB_AUT_01
{
	switch (@sysvar::CH_Nodes::CH_EISTBCSC_Hi_Rq2_AR2_UB_AUT_01)
	{
		case (0):
			enableControl("TBCSC_Hi_Rq2_AR2", "CH_EISTBCSC_Hi_Rq2_AR2_UB__01", 0); //1: enable; 0: disable
			@sysvar::CH_Nodes::CH_EISTBCSC_Hi_Rq2_AR2_UB__01 = 1;
			break;
		case (1):
			enableControl("TBCSC_Hi_Rq2_AR2", "CH_EISTBCSC_Hi_Rq2_AR2_UB__01", 1); //1: enable; 0: disable
			break;
		case (2):
			enableControl("TBCSC_Hi_Rq2_AR2", "CH_EISTBCSC_Hi_Rq2_AR2_UB__01", 0); //1: enable; 0: disable
			@sysvar::CH_Nodes::CH_EISTBCSC_Hi_Rq2_AR2_UB__01 = 1;
			break;
		case (3):
			enableControl("TBCSC_Hi_Rq2_AR2", "CH_EISTBCSC_Hi_Rq2_AR2_UB__01", 0); //1: enable; 0: disable
			@sysvar::CH_Nodes::CH_EISTBCSC_Hi_Rq2_AR2_UB__01 = 0;
			break;
	}
}

on sysvar sysvar::CH_Nodes::CH_EISCRC_TBCSC_Hi_Rq2_Pr2T_AUTO
{
//	EnableCRC("TBCSC_Hi_Rq2_AR2",  "TBCSC_Hi_Rq2_Pr2", !@this); // 1 = on, 0 = off 
	enableControl("TBCSC_Hi_Rq2_AR2", "CH_EISCRC_TBCSC_Hi_Rq2_Pr2TBCSC_", @this); //1: enable; 0: disable
	CRC_TBCSC_Hi_Rq2_Pr2 = @sysvar::CH_Nodes::CH_EISCRC_TBCSC_Hi_Rq2_Pr2T_AUTO;
}

on sysvar sysvar::CH_Nodes::CH_EISSQC_TBCSC_Hi_Rq2_Pr2T_AUTO
{
//	EnableSQC("TBCSC_Hi_Rq2_AR2",  "TBCSC_Hi_Rq2_Pr2", !@this); // 1 = on, 0 = off 
	enableControl("TBCSC_Hi_Rq2_AR2", "CH_EISSQC_TBCSC_Hi_Rq2_Pr2TBCSC_", @this); //1: enable; 0: disable
	SQC_TBCSC_Hi_Rq2_Pr2 = @sysvar::CH_Nodes::CH_EISSQC_TBCSC_Hi_Rq2_Pr2T_AUTO;
}

on sysvar sysvar::CH_Nodes::CH_EISTBCSC_Lo_Rq1_AR2_UB_AUT_01
{
	switch (@sysvar::CH_Nodes::CH_EISTBCSC_Lo_Rq1_AR2_UB_AUT_01)
	{
		case (0):
			enableControl("TBCSC_Lo_Rq1_AR2", "CH_EISTBCSC_Lo_Rq1_AR2_UB__01", 0); //1: enable; 0: disable
			@sysvar::CH_Nodes::CH_EISTBCSC_Lo_Rq1_AR2_UB__01 = 1;
			break;
		case (1):
			enableControl("TBCSC_Lo_Rq1_AR2", "CH_EISTBCSC_Lo_Rq1_AR2_UB__01", 1); //1: enable; 0: disable
			break;
		case (2):
			enableControl("TBCSC_Lo_Rq1_AR2", "CH_EISTBCSC_Lo_Rq1_AR2_UB__01", 0); //1: enable; 0: disable
			@sysvar::CH_Nodes::CH_EISTBCSC_Lo_Rq1_AR2_UB__01 = 1;
			break;
		case (3):
			enableControl("TBCSC_Lo_Rq1_AR2", "CH_EISTBCSC_Lo_Rq1_AR2_UB__01", 0); //1: enable; 0: disable
			@sysvar::CH_Nodes::CH_EISTBCSC_Lo_Rq1_AR2_UB__01 = 0;
			break;
	}
}

on sysvar sysvar::CH_Nodes::CH_EISCRC_TBCSC_Lo_Rq1_Pr2T_AUTO
{
//	EnableCRC("TBCSC_Lo_Rq1_AR2",  "TBCSC_Lo_Rq1_Pr2", !@this); // 1 = on, 0 = off 
	enableControl("TBCSC_Lo_Rq1_AR2", "CH_EISCRC_TBCSC_Lo_Rq1_Pr2TBCSC_", @this); //1: enable; 0: disable
	CRC_TBCSC_Lo_Rq1_Pr2 = @sysvar::CH_Nodes::CH_EISCRC_TBCSC_Lo_Rq1_Pr2T_AUTO;
}

on sysvar sysvar::CH_Nodes::CH_EISSQC_TBCSC_Lo_Rq1_Pr2T_AUTO
{
//	EnableSQC("TBCSC_Lo_Rq1_AR2",  "TBCSC_Lo_Rq1_Pr2", !@this); // 1 = on, 0 = off 
	enableControl("TBCSC_Lo_Rq1_AR2", "CH_EISSQC_TBCSC_Lo_Rq1_Pr2TBCSC_", @this); //1: enable; 0: disable
	SQC_TBCSC_Lo_Rq1_Pr2 = @sysvar::CH_Nodes::CH_EISSQC_TBCSC_Lo_Rq1_Pr2T_AUTO;
}

on sysvar sysvar::CH_Nodes::CH_EISTBCSC_Lo_Rq2_AR2_UB_AUT_01
{
	switch (@sysvar::CH_Nodes::CH_EISTBCSC_Lo_Rq2_AR2_UB_AUT_01)
	{
		case (0):
			enableControl("TBCSC_Lo_Rq2_AR2", "CH_EISTBCSC_Lo_Rq2_AR2_UB__01", 0); //1: enable; 0: disable
			@sysvar::CH_Nodes::CH_EISTBCSC_Lo_Rq2_AR2_UB__01 = 1;
			break;
		case (1):
			enableControl("TBCSC_Lo_Rq2_AR2", "CH_EISTBCSC_Lo_Rq2_AR2_UB__01", 1); //1: enable; 0: disable
			break;
		case (2):
			enableControl("TBCSC_Lo_Rq2_AR2", "CH_EISTBCSC_Lo_Rq2_AR2_UB__01", 0); //1: enable; 0: disable
			@sysvar::CH_Nodes::CH_EISTBCSC_Lo_Rq2_AR2_UB__01 = 1;
			break;
		case (3):
			enableControl("TBCSC_Lo_Rq2_AR2", "CH_EISTBCSC_Lo_Rq2_AR2_UB__01", 0); //1: enable; 0: disable
			@sysvar::CH_Nodes::CH_EISTBCSC_Lo_Rq2_AR2_UB__01 = 0;
			break;
	}
}

on sysvar sysvar::CH_Nodes::CH_EISCRC_TBCSC_Lo_Rq2_Pr2T_AUTO
{
//	EnableCRC("TBCSC_Lo_Rq2_AR2",  "TBCSC_Lo_Rq2_Pr2", !@this); // 1 = on, 0 = off 
	enableControl("TBCSC_Lo_Rq2_AR2", "CH_EISCRC_TBCSC_Lo_Rq2_Pr2TBCSC_", @this); //1: enable; 0: disable
	CRC_TBCSC_Lo_Rq2_Pr2 = @sysvar::CH_Nodes::CH_EISCRC_TBCSC_Lo_Rq2_Pr2T_AUTO;
}

on sysvar sysvar::CH_Nodes::CH_EISSQC_TBCSC_Lo_Rq2_Pr2T_AUTO
{
//	EnableSQC("TBCSC_Lo_Rq2_AR2",  "TBCSC_Lo_Rq2_Pr2", !@this); // 1 = on, 0 = off 
	enableControl("TBCSC_Lo_Rq2_AR2", "CH_EISSQC_TBCSC_Lo_Rq2_Pr2TBCSC_", @this); //1: enable; 0: disable
	SQC_TBCSC_Lo_Rq2_Pr2 = @sysvar::CH_Nodes::CH_EISSQC_TBCSC_Lo_Rq2_Pr2T_AUTO;
}

on sysvar sysvar::CH_Nodes::CH_EISTC_Distance_AR_0_UB_AUT_01
{
	switch (@sysvar::CH_Nodes::CH_EISTC_Distance_AR_0_UB_AUT_01)
	{
		case (0):
			enableControl("TC_Distance_AR", "CH_EISTC_Distance_AR_0_UB__01", 0); //1: enable; 0: disable
			@sysvar::CH_Nodes::CH_EISTC_Distance_AR_0_UB__01 = 1;
			break;
		case (1):
			enableControl("TC_Distance_AR", "CH_EISTC_Distance_AR_0_UB__01", 1); //1: enable; 0: disable
			break;
		case (2):
			enableControl("TC_Distance_AR", "CH_EISTC_Distance_AR_0_UB__01", 0); //1: enable; 0: disable
			@sysvar::CH_Nodes::CH_EISTC_Distance_AR_0_UB__01 = 1;
			break;
		case (3):
			enableControl("TC_Distance_AR", "CH_EISTC_Distance_AR_0_UB__01", 0); //1: enable; 0: disable
			@sysvar::CH_Nodes::CH_EISTC_Distance_AR_0_UB__01 = 0;
			break;
	}
}

on sysvar sysvar::CH_Nodes::CH_EISTGW_DateTm_Stat_AR_UB_A_01
{
	switch (@sysvar::CH_Nodes::CH_EISTGW_DateTm_Stat_AR_UB_A_01)
	{
		case (0):
			enableControl("TGW_DateTm_Stat_AR", "CH_EISTGW_DateTm_Stat_AR_UB__01", 0); //1: enable; 0: disable
			@sysvar::CH_Nodes::CH_EISTGW_DateTm_Stat_AR_UB__01 = 1;
			break;
		case (1):
			enableControl("TGW_DateTm_Stat_AR", "CH_EISTGW_DateTm_Stat_AR_UB__01", 1); //1: enable; 0: disable
			break;
		case (2):
			enableControl("TGW_DateTm_Stat_AR", "CH_EISTGW_DateTm_Stat_AR_UB__01", 0); //1: enable; 0: disable
			@sysvar::CH_Nodes::CH_EISTGW_DateTm_Stat_AR_UB__01 = 1;
			break;
		case (3):
			enableControl("TGW_DateTm_Stat_AR", "CH_EISTGW_DateTm_Stat_AR_UB__01", 0); //1: enable; 0: disable
			@sysvar::CH_Nodes::CH_EISTGW_DateTm_Stat_AR_UB__01 = 0;
			break;
	}
}

on sysvar sysvar::CH_Nodes::CH_EISTire_State_AR2_UB_AUTO_01
{
	switch (@sysvar::CH_Nodes::CH_EISTire_State_AR2_UB_AUTO_01)
	{
		case (0):
			enableControl("Tire_State_AR2", "CH_EISTire_State_AR2_UB__01", 0); //1: enable; 0: disable
			@sysvar::CH_Nodes::CH_EISTire_State_AR2_UB__01 = 1;
			break;
		case (1):
			enableControl("Tire_State_AR2", "CH_EISTire_State_AR2_UB__01", 1); //1: enable; 0: disable
			break;
		case (2):
			enableControl("Tire_State_AR2", "CH_EISTire_State_AR2_UB__01", 0); //1: enable; 0: disable
			@sysvar::CH_Nodes::CH_EISTire_State_AR2_UB__01 = 1;
			break;
		case (3):
			enableControl("Tire_State_AR2", "CH_EISTire_State_AR2_UB__01", 0); //1: enable; 0: disable
			@sysvar::CH_Nodes::CH_EISTire_State_AR2_UB__01 = 0;
			break;
	}
}

on sysvar sysvar::CH_Nodes::CH_EISTrafficInfo_AR_UB_AUTO_01
{
	switch (@sysvar::CH_Nodes::CH_EISTrafficInfo_AR_UB_AUTO_01)
	{
		case (0):
			enableControl("TrafficInfo_AR", "CH_EISTrafficInfo_AR_UB__01", 0); //1: enable; 0: disable
			@sysvar::CH_Nodes::CH_EISTrafficInfo_AR_UB__01 = 1;
			break;
		case (1):
			enableControl("TrafficInfo_AR", "CH_EISTrafficInfo_AR_UB__01", 1); //1: enable; 0: disable
			break;
		case (2):
			enableControl("TrafficInfo_AR", "CH_EISTrafficInfo_AR_UB__01", 0); //1: enable; 0: disable
			@sysvar::CH_Nodes::CH_EISTrafficInfo_AR_UB__01 = 1;
			break;
		case (3):
			enableControl("TrafficInfo_AR", "CH_EISTrafficInfo_AR_UB__01", 0); //1: enable; 0: disable
			@sysvar::CH_Nodes::CH_EISTrafficInfo_AR_UB__01 = 0;
			break;
	}
}

on sysvar sysvar::CH_Nodes::CH_EISTrailer_Stat_AR2_UB_AUT_01
{
	switch (@sysvar::CH_Nodes::CH_EISTrailer_Stat_AR2_UB_AUT_01)
	{
		case (0):
			enableControl("Trailer_Stat_AR2", "CH_EISTrailer_Stat_AR2_UB__01", 0); //1: enable; 0: disable
			@sysvar::CH_Nodes::CH_EISTrailer_Stat_AR2_UB__01 = 1;
			break;
		case (1):
			enableControl("Trailer_Stat_AR2", "CH_EISTrailer_Stat_AR2_UB__01", 1); //1: enable; 0: disable
			break;
		case (2):
			enableControl("Trailer_Stat_AR2", "CH_EISTrailer_Stat_AR2_UB__01", 0); //1: enable; 0: disable
			@sysvar::CH_Nodes::CH_EISTrailer_Stat_AR2_UB__01 = 1;
			break;
		case (3):
			enableControl("Trailer_Stat_AR2", "CH_EISTrailer_Stat_AR2_UB__01", 0); //1: enable; 0: disable
			@sysvar::CH_Nodes::CH_EISTrailer_Stat_AR2_UB__01 = 0;
			break;
	}
}

on sysvar sysvar::CH_Nodes::CH_EISCRC_ElecTrlrHtch_Stat_AUTO
{
//	EnableCRC("Trailer_Stat_AR2",  "ElecTrlrHtch_Stat_Pr2", !@this); // 1 = on, 0 = off 
	enableControl("Trailer_Stat_AR2", "CH_EISCRC_ElecTrlrHtch_Stat_Pr2_", @this); //1: enable; 0: disable
	CRC_ElecTrlrHtch_Stat_Pr2 = @sysvar::CH_Nodes::CH_EISCRC_ElecTrlrHtch_Stat_AUTO;
}

on sysvar sysvar::CH_Nodes::CH_EISSQC_ElecTrlrHtch_Stat_AUTO
{
//	EnableSQC("Trailer_Stat_AR2",  "ElecTrlrHtch_Stat_Pr2", !@this); // 1 = on, 0 = off 
	enableControl("Trailer_Stat_AR2", "CH_EISSQC_ElecTrlrHtch_Stat_Pr2_", @this); //1: enable; 0: disable
	SQC_ElecTrlrHtch_Stat_Pr2 = @sysvar::CH_Nodes::CH_EISSQC_ElecTrlrHtch_Stat_AUTO;
}

on sysvar sysvar::CH_Nodes::CH_EISTSA_Disp_Rq2_AR_UB_AUTO_01
{
	switch (@sysvar::CH_Nodes::CH_EISTSA_Disp_Rq2_AR_UB_AUTO_01)
	{
		case (0):
			enableControl("TSA_Disp_Rq2_AR", "CH_EISTSA_Disp_Rq2_AR_UB__01", 0); //1: enable; 0: disable
			@sysvar::CH_Nodes::CH_EISTSA_Disp_Rq2_AR_UB__01 = 1;
			break;
		case (1):
			enableControl("TSA_Disp_Rq2_AR", "CH_EISTSA_Disp_Rq2_AR_UB__01", 1); //1: enable; 0: disable
			break;
		case (2):
			enableControl("TSA_Disp_Rq2_AR", "CH_EISTSA_Disp_Rq2_AR_UB__01", 0); //1: enable; 0: disable
			@sysvar::CH_Nodes::CH_EISTSA_Disp_Rq2_AR_UB__01 = 1;
			break;
		case (3):
			enableControl("TSA_Disp_Rq2_AR", "CH_EISTSA_Disp_Rq2_AR_UB__01", 0); //1: enable; 0: disable
			@sysvar::CH_Nodes::CH_EISTSA_Disp_Rq2_AR_UB__01 = 0;
			break;
	}
}

on sysvar sysvar::CH_Nodes::CH_EISTSA_Disp_Rq3_AR_UB_AUTO_01
{
	switch (@sysvar::CH_Nodes::CH_EISTSA_Disp_Rq3_AR_UB_AUTO_01)
	{
		case (0):
			enableControl("TSA_Disp_Rq3_AR", "CH_EISTSA_Disp_Rq3_AR_UB__01", 0); //1: enable; 0: disable
			@sysvar::CH_Nodes::CH_EISTSA_Disp_Rq3_AR_UB__01 = 1;
			break;
		case (1):
			enableControl("TSA_Disp_Rq3_AR", "CH_EISTSA_Disp_Rq3_AR_UB__01", 1); //1: enable; 0: disable
			break;
		case (2):
			enableControl("TSA_Disp_Rq3_AR", "CH_EISTSA_Disp_Rq3_AR_UB__01", 0); //1: enable; 0: disable
			@sysvar::CH_Nodes::CH_EISTSA_Disp_Rq3_AR_UB__01 = 1;
			break;
		case (3):
			enableControl("TSA_Disp_Rq3_AR", "CH_EISTSA_Disp_Rq3_AR_UB__01", 0); //1: enable; 0: disable
			@sysvar::CH_Nodes::CH_EISTSA_Disp_Rq3_AR_UB__01 = 0;
			break;
	}
}

on sysvar sysvar::CH_Nodes::CH_EISVehAccel_X_Rq_Gw_A_UB_A_01
{
	switch (@sysvar::CH_Nodes::CH_EISVehAccel_X_Rq_Gw_A_UB_A_01)
	{
		case (0):
			enableControl("VehAccel_X_Rq_Gw_AR2", "CH_EISVehAccel_X_Rq_Gw_AR2_UB_01", 0); //1: enable; 0: disable
			@sysvar::CH_Nodes::CH_EISVehAccel_X_Rq_Gw_AR2_UB_01 = 1;
			break;
		case (1):
			enableControl("VehAccel_X_Rq_Gw_AR2", "CH_EISVehAccel_X_Rq_Gw_AR2_UB_01", 1); //1: enable; 0: disable
			break;
		case (2):
			enableControl("VehAccel_X_Rq_Gw_AR2", "CH_EISVehAccel_X_Rq_Gw_AR2_UB_01", 0); //1: enable; 0: disable
			@sysvar::CH_Nodes::CH_EISVehAccel_X_Rq_Gw_AR2_UB_01 = 1;
			break;
		case (3):
			enableControl("VehAccel_X_Rq_Gw_AR2", "CH_EISVehAccel_X_Rq_Gw_AR2_UB_01", 0); //1: enable; 0: disable
			@sysvar::CH_Nodes::CH_EISVehAccel_X_Rq_Gw_AR2_UB_01 = 0;
			break;
	}
}

on sysvar sysvar::CH_Nodes::CH_EISCRC_VehAccel_X_Rq_Pr2_AUTO
{
//	EnableCRC("VehAccel_X_Rq_Gw_AR2",  "VehAccel_X_Rq_Pr2", !@this); // 1 = on, 0 = off 
	enableControl("VehAccel_X_Rq_Gw_AR2", "CH_EISCRC_VehAccel_X_Rq_Pr2VehA_", @this); //1: enable; 0: disable
	CRC_VehAccel_X_Rq_Pr2 = @sysvar::CH_Nodes::CH_EISCRC_VehAccel_X_Rq_Pr2_AUTO;
}

on sysvar sysvar::CH_Nodes::CH_EISSQC_VehAccel_X_Rq_Pr2_AUTO
{
//	EnableSQC("VehAccel_X_Rq_Gw_AR2",  "VehAccel_X_Rq_Pr2", !@this); // 1 = on, 0 = off 
	enableControl("VehAccel_X_Rq_Gw_AR2", "CH_EISSQC_VehAccel_X_Rq_Pr2VehA_", @this); //1: enable; 0: disable
	SQC_VehAccel_X_Rq_Pr2 = @sysvar::CH_Nodes::CH_EISSQC_VehAccel_X_Rq_Pr2_AUTO;
}

on sysvar sysvar::CH_Nodes::CH_EISYMAS_Rq_MPC_AR2_UB_AUTO_01
{
	switch (@sysvar::CH_Nodes::CH_EISYMAS_Rq_MPC_AR2_UB_AUTO_01)
	{
		case (0):
			enableControl("YMAS_Rq_MPC_AR2", "CH_EISYMAS_Rq_MPC_AR2_UB__01", 0); //1: enable; 0: disable
			@sysvar::CH_Nodes::CH_EISYMAS_Rq_MPC_AR2_UB__01 = 1;
			break;
		case (1):
			enableControl("YMAS_Rq_MPC_AR2", "CH_EISYMAS_Rq_MPC_AR2_UB__01", 1); //1: enable; 0: disable
			break;
		case (2):
			enableControl("YMAS_Rq_MPC_AR2", "CH_EISYMAS_Rq_MPC_AR2_UB__01", 0); //1: enable; 0: disable
			@sysvar::CH_Nodes::CH_EISYMAS_Rq_MPC_AR2_UB__01 = 1;
			break;
		case (3):
			enableControl("YMAS_Rq_MPC_AR2", "CH_EISYMAS_Rq_MPC_AR2_UB__01", 0); //1: enable; 0: disable
			@sysvar::CH_Nodes::CH_EISYMAS_Rq_MPC_AR2_UB__01 = 0;
			break;
	}
}

on sysvar sysvar::CH_Nodes::CH_EISCRC_YMAS_Rq_MPC_Pr2YM_AUTO
{
//	EnableCRC("YMAS_Rq_MPC_AR2",  "YMAS_Rq_MPC_Pr2", !@this); // 1 = on, 0 = off 
	enableControl("YMAS_Rq_MPC_AR2", "CH_EISCRC_YMAS_Rq_MPC_Pr2YMAS_R_", @this); //1: enable; 0: disable
	CRC_YMAS_Rq_MPC_Pr2 = @sysvar::CH_Nodes::CH_EISCRC_YMAS_Rq_MPC_Pr2YM_AUTO;
}

on sysvar sysvar::CH_Nodes::CH_EISSQC_YMAS_Rq_MPC_Pr2YM_AUTO
{
//	EnableSQC("YMAS_Rq_MPC_AR2",  "YMAS_Rq_MPC_Pr2", !@this); // 1 = on, 0 = off 
	enableControl("YMAS_Rq_MPC_AR2", "CH_EISSQC_YMAS_Rq_MPC_Pr2YMAS_R_", @this); //1: enable; 0: disable
	SQC_YMAS_Rq_MPC_Pr2 = @sysvar::CH_Nodes::CH_EISSQC_YMAS_Rq_MPC_Pr2YM_AUTO;
}

CH_EISActvComf_Rq_AR2()
{
	switch (@sysvar::CH_Nodes::CH_EISActvComf_Rq_AR2_UB_AUTO_01)
	{
		case (0):
			//Updatebit wird mit 1 gesendet; entspricht Standard
			break;
		case (1):
			//nur wenn manueller Wert gleich 0 ist, muss was gemacht werden
			if (@sysvar::CH_Nodes::CH_EISActvComf_Rq_AR2_UB_AUTO_01 == 0)
				DisturbPDUUB("ActvComf_Rq_AR2", 1, 0); //Updatebit wird einmal auf Null gesetzt
			break;
		case (2):
			//Updatebit wird mit 1 gesendet; entspricht Standard
			break;
		case (3):
			DisturbPDUUB("ActvComf_Rq_AR2", 1, 0); //Updatebit wird einmal auf Null gesetzt
			break;
	}
}

CH_EISADAS_CURRENT_ATTRIBUTES_AR()
{
	switch (@sysvar::CH_Nodes::CH_EISADAS_CURRENT_ATTRI_UB_A_01)
	{
		case (0):
			//Updatebit wird mit 1 gesendet; entspricht Standard
			break;
		case (1):
			//nur wenn manueller Wert gleich 0 ist, muss was gemacht werden
			if (@sysvar::CH_Nodes::CH_EISADAS_CURRENT_ATTRI_UB_A_01 == 0)
				DisturbPDUUB("ADAS_CURRENT_ATTRIBUTES_AR", 1, 0); //Updatebit wird einmal auf Null gesetzt
			break;
		case (2):
			//Updatebit wird mit 1 gesendet; entspricht Standard
			break;
		case (3):
			DisturbPDUUB("ADAS_CURRENT_ATTRIBUTES_AR", 1, 0); //Updatebit wird einmal auf Null gesetzt
			break;
	}
}

CH_EISADAS_POSITION_AR()
{
	switch (@sysvar::CH_Nodes::CH_EISADAS_POSITION_AR_UB_AUT_01)
	{
		case (0):
			//Updatebit wird mit 1 gesendet; entspricht Standard
			break;
		case (1):
			//nur wenn manueller Wert gleich 0 ist, muss was gemacht werden
			if (@sysvar::CH_Nodes::CH_EISADAS_POSITION_AR_UB_AUT_01 == 0)
				DisturbPDUUB("ADAS_POSITION_AR", 1, 0); //Updatebit wird einmal auf Null gesetzt
			break;
		case (2):
			//Updatebit wird mit 1 gesendet; entspricht Standard
			break;
		case (3):
			DisturbPDUUB("ADAS_POSITION_AR", 1, 0); //Updatebit wird einmal auf Null gesetzt
			break;
	}
}

CH_EISADAS_PREDICTION_AR()
{
	switch (@sysvar::CH_Nodes::CH_EISADAS_PREDICTION_AR_UB_A_03)
	{
		case (0):
			//Updatebit wird mit 1 gesendet; entspricht Standard
			break;
		case (1):
			//nur wenn manueller Wert gleich 0 ist, muss was gemacht werden
			if (@sysvar::CH_Nodes::CH_EISADAS_PREDICTION_AR_UB_A_03 == 0)
				DisturbPDUUB("ADAS_PREDICTION_AR", 1, 0); //Updatebit wird einmal auf Null gesetzt
			break;
		case (2):
			//Updatebit wird mit 1 gesendet; entspricht Standard
			break;
		case (3):
			DisturbPDUUB("ADAS_PREDICTION_AR", 1, 0); //Updatebit wird einmal auf Null gesetzt
			break;
	}
}

CH_EISADAS_PROFILE_LONG_AR()
{
	switch (@sysvar::CH_Nodes::CH_EISADAS_PROFILE_LONG__UB_A_04)
	{
		case (0):
			//Updatebit wird mit 1 gesendet; entspricht Standard
			break;
		case (1):
			//nur wenn manueller Wert gleich 0 ist, muss was gemacht werden
			if (@sysvar::CH_Nodes::CH_EISADAS_PROFILE_LONG__UB_A_04 == 0)
				DisturbPDUUB("ADAS_PROFILE_LONG_AR", 1, 0); //Updatebit wird einmal auf Null gesetzt
			break;
		case (2):
			//Updatebit wird mit 1 gesendet; entspricht Standard
			break;
		case (3):
			DisturbPDUUB("ADAS_PROFILE_LONG_AR", 1, 0); //Updatebit wird einmal auf Null gesetzt
			break;
	}
}

CH_EISADAS_PROFILE_SHORT_AR()
{
	switch (@sysvar::CH_Nodes::CH_EISADAS_PROFILE_SHORT_UB_A_09)
	{
		case (0):
			//Updatebit wird mit 1 gesendet; entspricht Standard
			break;
		case (1):
			//nur wenn manueller Wert gleich 0 ist, muss was gemacht werden
			if (@sysvar::CH_Nodes::CH_EISADAS_PROFILE_SHORT_UB_A_09 == 0)
				DisturbPDUUB("ADAS_PROFILE_SHORT_AR", 1, 0); //Updatebit wird einmal auf Null gesetzt
			break;
		case (2):
			//Updatebit wird mit 1 gesendet; entspricht Standard
			break;
		case (3):
			DisturbPDUUB("ADAS_PROFILE_SHORT_AR", 1, 0); //Updatebit wird einmal auf Null gesetzt
			break;
	}
}

CH_EISADASLR_POSITION_AR()
{
	switch (@sysvar::CH_Nodes::CH_EISADASLR_POSITION_AR_UB_A_01)
	{
		case (0):
			//Updatebit wird mit 1 gesendet; entspricht Standard
			break;
		case (1):
			//nur wenn manueller Wert gleich 0 ist, muss was gemacht werden
			if (@sysvar::CH_Nodes::CH_EISADASLR_POSITION_AR_UB_A_01 == 0)
				DisturbPDUUB("ADASLR_POSITION_AR", 1, 0); //Updatebit wird einmal auf Null gesetzt
			break;
		case (2):
			//Updatebit wird mit 1 gesendet; entspricht Standard
			break;
		case (3):
			DisturbPDUUB("ADASLR_POSITION_AR", 1, 0); //Updatebit wird einmal auf Null gesetzt
			break;
	}
}

CH_EISADASLR_PROFILE_LONG_AR()
{
	switch (@sysvar::CH_Nodes::CH_EISADASLR_PROFILE_LON_UB_A_04)
	{
		case (0):
			//Updatebit wird mit 1 gesendet; entspricht Standard
			break;
		case (1):
			//nur wenn manueller Wert gleich 0 ist, muss was gemacht werden
			if (@sysvar::CH_Nodes::CH_EISADASLR_PROFILE_LON_UB_A_04 == 0)
				DisturbPDUUB("ADASLR_PROFILE_LONG_AR", 1, 0); //Updatebit wird einmal auf Null gesetzt
			break;
		case (2):
			//Updatebit wird mit 1 gesendet; entspricht Standard
			break;
		case (3):
			DisturbPDUUB("ADASLR_PROFILE_LONG_AR", 1, 0); //Updatebit wird einmal auf Null gesetzt
			break;
	}
}

CH_EISBC_F_Stat2_AR2()
{
	switch (@sysvar::CH_Nodes::CH_EISBC_F_Stat2_AR2_UB_AUTO)
	{
		case (0):
			//Updatebit wird mit 1 gesendet; entspricht Standard
			break;
		case (1):
			//nur wenn manueller Wert gleich 0 ist, muss was gemacht werden
			if (@sysvar::CH_Nodes::CH_EISBC_F_Stat2_AR2_UB_AUTO == 0)
				DisturbPDUUB("BC_F_Stat2_AR2", 1, 0); //Updatebit wird einmal auf Null gesetzt
			break;
		case (2):
			//Updatebit wird mit 1 gesendet; entspricht Standard
			break;
		case (3):
			DisturbPDUUB("BC_F_Stat2_AR2", 1, 0); //Updatebit wird einmal auf Null gesetzt
			break;
	}
}

CH_EISBC_R_Stat1_AR()
{
	switch (@sysvar::CH_Nodes::CH_EISBC_R_Stat1_AR_UB_AUTO_01)
	{
		case (0):
			//Updatebit wird mit 1 gesendet; entspricht Standard
			break;
		case (1):
			//nur wenn manueller Wert gleich 0 ist, muss was gemacht werden
			if (@sysvar::CH_Nodes::CH_EISBC_R_Stat1_AR_UB_AUTO_01 == 0)
				DisturbPDUUB("BC_R_Stat1_AR", 1, 0); //Updatebit wird einmal auf Null gesetzt
			break;
		case (2):
			//Updatebit wird mit 1 gesendet; entspricht Standard
			break;
		case (3):
			DisturbPDUUB("BC_R_Stat1_AR", 1, 0); //Updatebit wird einmal auf Null gesetzt
			break;
	}
}

CH_EISBODY_CHASSIS_R1_AR()
{
	switch (@sysvar::CH_Nodes::CH_EISBODY_CHASSIS_R1_AR_UB_A_01)
	{
		case (0):
			//Updatebit wird mit 1 gesendet; entspricht Standard
			break;
		case (1):
			//nur wenn manueller Wert gleich 0 ist, muss was gemacht werden
			if (@sysvar::CH_Nodes::CH_EISBODY_CHASSIS_R1_AR_UB_A_01 == 0)
				DisturbPDUUB("BODY_CHASSIS_R1_AR", 1, 0); //Updatebit wird einmal auf Null gesetzt
			break;
		case (2):
			//Updatebit wird mit 1 gesendet; entspricht Standard
			break;
		case (3):
			DisturbPDUUB("BODY_CHASSIS_R1_AR", 1, 0); //Updatebit wird einmal auf Null gesetzt
			break;
	}
}

CH_EISBSM_Disp_Warn_Rq_AR2()
{
	switch (@sysvar::CH_Nodes::CH_EISBSM_Disp_Warn_Rq_A_UB_A_01)
	{
		case (0):
			//Updatebit wird mit 1 gesendet; entspricht Standard
			break;
		case (1):
			//nur wenn manueller Wert gleich 0 ist, muss was gemacht werden
			if (@sysvar::CH_Nodes::CH_EISBSM_Disp_Warn_Rq_A_UB_A_01 == 0)
				DisturbPDUUB("BSM_Disp_Warn_Rq_AR2", 1, 0); //Updatebit wird einmal auf Null gesetzt
			break;
		case (2):
			//Updatebit wird mit 1 gesendet; entspricht Standard
			break;
		case (3):
			DisturbPDUUB("BSM_Disp_Warn_Rq_AR2", 1, 0); //Updatebit wird einmal auf Null gesetzt
			break;
	}
}

CH_EISCamLane_Disp_Warn_Rq_AR2()
{
	switch (@sysvar::CH_Nodes::CH_EISCamLane_Disp_Warn__UB_A_01)
	{
		case (0):
			//Updatebit wird mit 1 gesendet; entspricht Standard
			break;
		case (1):
			//nur wenn manueller Wert gleich 0 ist, muss was gemacht werden
			if (@sysvar::CH_Nodes::CH_EISCamLane_Disp_Warn__UB_A_01 == 0)
				DisturbPDUUB("CamLane_Disp_Warn_Rq_AR2", 1, 0); //Updatebit wird einmal auf Null gesetzt
			break;
		case (2):
			//Updatebit wird mit 1 gesendet; entspricht Standard
			break;
		case (3):
			DisturbPDUUB("CamLane_Disp_Warn_Rq_AR2", 1, 0); //Updatebit wird einmal auf Null gesetzt
			break;
	}
}

CH_EISCamLane_LaneAttr1_AR2()
{
	switch (@sysvar::CH_Nodes::CH_EISCamLane_LaneAttr1__UB_A_01)
	{
		case (0):
			//Updatebit wird mit 1 gesendet; entspricht Standard
			break;
		case (1):
			//nur wenn manueller Wert gleich 0 ist, muss was gemacht werden
			if (@sysvar::CH_Nodes::CH_EISCamLane_LaneAttr1__UB_A_01 == 0)
				DisturbPDUUB("CamLane_LaneAttr1_AR2", 1, 0); //Updatebit wird einmal auf Null gesetzt
			break;
		case (2):
			//Updatebit wird mit 1 gesendet; entspricht Standard
			break;
		case (3):
			DisturbPDUUB("CamLane_LaneAttr1_AR2", 1, 0); //Updatebit wird einmal auf Null gesetzt
			break;
	}
}

CH_EISCamLane_LaneAttr2_AR2()
{
	switch (@sysvar::CH_Nodes::CH_EISCamLane_LaneAttr2__UB_A_01)
	{
		case (0):
			//Updatebit wird mit 1 gesendet; entspricht Standard
			break;
		case (1):
			//nur wenn manueller Wert gleich 0 ist, muss was gemacht werden
			if (@sysvar::CH_Nodes::CH_EISCamLane_LaneAttr2__UB_A_01 == 0)
				DisturbPDUUB("CamLane_LaneAttr2_AR2", 1, 0); //Updatebit wird einmal auf Null gesetzt
			break;
		case (2):
			//Updatebit wird mit 1 gesendet; entspricht Standard
			break;
		case (3):
			DisturbPDUUB("CamLane_LaneAttr2_AR2", 1, 0); //Updatebit wird einmal auf Null gesetzt
			break;
	}
}

CH_EISCamLane_LaneAttr3_AR2()
{
	switch (@sysvar::CH_Nodes::CH_EISCamLane_LaneAttr3__UB_A_01)
	{
		case (0):
			//Updatebit wird mit 1 gesendet; entspricht Standard
			break;
		case (1):
			//nur wenn manueller Wert gleich 0 ist, muss was gemacht werden
			if (@sysvar::CH_Nodes::CH_EISCamLane_LaneAttr3__UB_A_01 == 0)
				DisturbPDUUB("CamLane_LaneAttr3_AR2", 1, 0); //Updatebit wird einmal auf Null gesetzt
			break;
		case (2):
			//Updatebit wird mit 1 gesendet; entspricht Standard
			break;
		case (3):
			DisturbPDUUB("CamLane_LaneAttr3_AR2", 1, 0); //Updatebit wird einmal auf Null gesetzt
			break;
	}
}

CH_EISCamLane_LaneAttr6_AR2()
{
	switch (@sysvar::CH_Nodes::CH_EISCamLane_LaneAttr6__UB_A_01)
	{
		case (0):
			//Updatebit wird mit 1 gesendet; entspricht Standard
			break;
		case (1):
			//nur wenn manueller Wert gleich 0 ist, muss was gemacht werden
			if (@sysvar::CH_Nodes::CH_EISCamLane_LaneAttr6__UB_A_01 == 0)
				DisturbPDUUB("CamLane_LaneAttr6_AR2", 1, 0); //Updatebit wird einmal auf Null gesetzt
			break;
		case (2):
			//Updatebit wird mit 1 gesendet; entspricht Standard
			break;
		case (3):
			DisturbPDUUB("CamLane_LaneAttr6_AR2", 1, 0); //Updatebit wird einmal auf Null gesetzt
			break;
	}
}

CH_EISCamLane_LaneAttr7_AR2()
{
	switch (@sysvar::CH_Nodes::CH_EISCamLane_LaneAttr7__UB_A_01)
	{
		case (0):
			//Updatebit wird mit 1 gesendet; entspricht Standard
			break;
		case (1):
			//nur wenn manueller Wert gleich 0 ist, muss was gemacht werden
			if (@sysvar::CH_Nodes::CH_EISCamLane_LaneAttr7__UB_A_01 == 0)
				DisturbPDUUB("CamLane_LaneAttr7_AR2", 1, 0); //Updatebit wird einmal auf Null gesetzt
			break;
		case (2):
			//Updatebit wird mit 1 gesendet; entspricht Standard
			break;
		case (3):
			DisturbPDUUB("CamLane_LaneAttr7_AR2", 1, 0); //Updatebit wird einmal auf Null gesetzt
			break;
	}
}

CH_EISCLkS_Rq_AR()
{
	switch (@sysvar::CH_Nodes::CH_EISCLkS_Rq_AR_UB_AUTO_01)
	{
		case (0):
			//Updatebit wird mit 1 gesendet; entspricht Standard
			break;
		case (1):
			//nur wenn manueller Wert gleich 0 ist, muss was gemacht werden
			if (@sysvar::CH_Nodes::CH_EISCLkS_Rq_AR_UB_AUTO_01 == 0)
				DisturbPDUUB("CLkS_Rq_AR", 1, 0); //Updatebit wird einmal auf Null gesetzt
			break;
		case (2):
			//Updatebit wird mit 1 gesendet; entspricht Standard
			break;
		case (3):
			DisturbPDUUB("CLkS_Rq_AR", 1, 0); //Updatebit wird einmal auf Null gesetzt
			break;
	}
}

CH_EISCLkS_State_AR()
{
	switch (@sysvar::CH_Nodes::CH_EISCLkS_State_AR_UB_AUTO_01)
	{
		case (0):
			//Updatebit wird mit 1 gesendet; entspricht Standard
			break;
		case (1):
			//nur wenn manueller Wert gleich 0 ist, muss was gemacht werden
			if (@sysvar::CH_Nodes::CH_EISCLkS_State_AR_UB_AUTO_01 == 0)
				DisturbPDUUB("CLkS_State_AR", 1, 0); //Updatebit wird einmal auf Null gesetzt
			break;
		case (2):
			//Updatebit wird mit 1 gesendet; entspricht Standard
			break;
		case (3):
			DisturbPDUUB("CLkS_State_AR", 1, 0); //Updatebit wird einmal auf Null gesetzt
			break;
	}
}

CH_EISCMS_PI_State_Gw_AR2()
{
	switch (@sysvar::CH_Nodes::CH_EISCMS_PI_State_Gw_AR_UB_A_01)
	{
		case (0):
			//Updatebit wird mit 1 gesendet; entspricht Standard
			break;
		case (1):
			//nur wenn manueller Wert gleich 0 ist, muss was gemacht werden
			if (@sysvar::CH_Nodes::CH_EISCMS_PI_State_Gw_AR_UB_A_01 == 0)
				DisturbPDUUB("CMS_PI_State_Gw_AR2", 1, 0); //Updatebit wird einmal auf Null gesetzt
			break;
		case (2):
			//Updatebit wird mit 1 gesendet; entspricht Standard
			break;
		case (3):
			DisturbPDUUB("CMS_PI_State_Gw_AR2", 1, 0); //Updatebit wird einmal auf Null gesetzt
			break;
	}
}

CH_EISCTRL_C_Stat1_AR()
{
	switch (@sysvar::CH_Nodes::CH_EISCTRL_C_Stat1_AR_UB_AUTO_01)
	{
		case (0):
			//Updatebit wird mit 1 gesendet; entspricht Standard
			break;
		case (1):
			//nur wenn manueller Wert gleich 0 ist, muss was gemacht werden
			if (@sysvar::CH_Nodes::CH_EISCTRL_C_Stat1_AR_UB_AUTO_01 == 0)
				DisturbPDUUB("CTRL_C_Stat1_AR", 1, 0); //Updatebit wird einmal auf Null gesetzt
			break;
		case (2):
			//Updatebit wird mit 1 gesendet; entspricht Standard
			break;
		case (3):
			DisturbPDUUB("CTRL_C_Stat1_AR", 1, 0); //Updatebit wird einmal auf Null gesetzt
			break;
	}
}

CH_EISDAC4_ECM_AR()
{
	switch (@sysvar::CH_Nodes::CH_EISDAC4_ECM_AR_UB_AUTO_01)
	{
		case (0):
			//Updatebit wird mit 1 gesendet; entspricht Standard
			break;
		case (1):
			//nur wenn manueller Wert gleich 0 ist, muss was gemacht werden
			if (@sysvar::CH_Nodes::CH_EISDAC4_ECM_AR_UB_AUTO_01 == 0)
				DisturbPDUUB("DAC4_ECM_AR", 1, 0); //Updatebit wird einmal auf Null gesetzt
			break;
		case (2):
			//Updatebit wird mit 1 gesendet; entspricht Standard
			break;
		case (3):
			DisturbPDUUB("DAC4_ECM_AR", 1, 0); //Updatebit wird einmal auf Null gesetzt
			break;
	}
}

CH_EISDAC4_EM2_AR()
{
	switch (@sysvar::CH_Nodes::CH_EISDAC4_EM2_AR_UB_AUTO_01)
	{
		case (0):
			//Updatebit wird mit 1 gesendet; entspricht Standard
			break;
		case (1):
			//nur wenn manueller Wert gleich 0 ist, muss was gemacht werden
			if (@sysvar::CH_Nodes::CH_EISDAC4_EM2_AR_UB_AUTO_01 == 0)
				DisturbPDUUB("DAC4_EM2_AR", 1, 0); //Updatebit wird einmal auf Null gesetzt
			break;
		case (2):
			//Updatebit wird mit 1 gesendet; entspricht Standard
			break;
		case (3):
			DisturbPDUUB("DAC4_EM2_AR", 1, 0); //Updatebit wird einmal auf Null gesetzt
			break;
	}
}

CH_EISDAC4_ISM_AR()
{
	switch (@sysvar::CH_Nodes::CH_EISDAC4_ISM_AR_UB_AUTO_01)
	{
		case (0):
			//Updatebit wird mit 1 gesendet; entspricht Standard
			break;
		case (1):
			//nur wenn manueller Wert gleich 0 ist, muss was gemacht werden
			if (@sysvar::CH_Nodes::CH_EISDAC4_ISM_AR_UB_AUTO_01 == 0)
				DisturbPDUUB("DAC4_ISM_AR", 1, 0); //Updatebit wird einmal auf Null gesetzt
			break;
		case (2):
			//Updatebit wird mit 1 gesendet; entspricht Standard
			break;
		case (3):
			DisturbPDUUB("DAC4_ISM_AR", 1, 0); //Updatebit wird einmal auf Null gesetzt
			break;
	}
}

CH_EISDAC4_TCM_AR()
{
	switch (@sysvar::CH_Nodes::CH_EISDAC4_TCM_AR_UB_AUTO_01)
	{
		case (0):
			//Updatebit wird mit 1 gesendet; entspricht Standard
			break;
		case (1):
			//nur wenn manueller Wert gleich 0 ist, muss was gemacht werden
			if (@sysvar::CH_Nodes::CH_EISDAC4_TCM_AR_UB_AUTO_01 == 0)
				DisturbPDUUB("DAC4_TCM_AR", 1, 0); //Updatebit wird einmal auf Null gesetzt
			break;
		case (2):
			//Updatebit wird mit 1 gesendet; entspricht Standard
			break;
		case (3):
			DisturbPDUUB("DAC4_TCM_AR", 1, 0); //Updatebit wird einmal auf Null gesetzt
			break;
	}
}

CH_EISDoor_FL_Stat_AR2()
{
	switch (@sysvar::CH_Nodes::CH_EISDoor_FL_Stat_AR2_UB_AUT_01)
	{
		case (0):
			//Updatebit wird mit 1 gesendet; entspricht Standard
			break;
		case (1):
			//nur wenn manueller Wert gleich 0 ist, muss was gemacht werden
			if (@sysvar::CH_Nodes::CH_EISDoor_FL_Stat_AR2_UB_AUT_01 == 0)
				DisturbPDUUB("Door_FL_Stat_AR2", 1, 0); //Updatebit wird einmal auf Null gesetzt
			break;
		case (2):
			//Updatebit wird mit 1 gesendet; entspricht Standard
			break;
		case (3):
			DisturbPDUUB("Door_FL_Stat_AR2", 1, 0); //Updatebit wird einmal auf Null gesetzt
			break;
	}
}

CH_EISDoor_FR_Stat_AR2()
{
	switch (@sysvar::CH_Nodes::CH_EISDoor_FR_Stat_AR2_UB_AUT_01)
	{
		case (0):
			//Updatebit wird mit 1 gesendet; entspricht Standard
			break;
		case (1):
			//nur wenn manueller Wert gleich 0 ist, muss was gemacht werden
			if (@sysvar::CH_Nodes::CH_EISDoor_FR_Stat_AR2_UB_AUT_01 == 0)
				DisturbPDUUB("Door_FR_Stat_AR2", 1, 0); //Updatebit wird einmal auf Null gesetzt
			break;
		case (2):
			//Updatebit wird mit 1 gesendet; entspricht Standard
			break;
		case (3):
			DisturbPDUUB("Door_FR_Stat_AR2", 1, 0); //Updatebit wird einmal auf Null gesetzt
			break;
	}
}

CH_EISDoor_RL_Stat_AR2()
{
	switch (@sysvar::CH_Nodes::CH_EISDoor_RL_Stat_AR2_UB_AUT_01)
	{
		case (0):
			//Updatebit wird mit 1 gesendet; entspricht Standard
			break;
		case (1):
			//nur wenn manueller Wert gleich 0 ist, muss was gemacht werden
			if (@sysvar::CH_Nodes::CH_EISDoor_RL_Stat_AR2_UB_AUT_01 == 0)
				DisturbPDUUB("Door_RL_Stat_AR2", 1, 0); //Updatebit wird einmal auf Null gesetzt
			break;
		case (2):
			//Updatebit wird mit 1 gesendet; entspricht Standard
			break;
		case (3):
			DisturbPDUUB("Door_RL_Stat_AR2", 1, 0); //Updatebit wird einmal auf Null gesetzt
			break;
	}
}

CH_EISDoor_RR_Stat_AR2()
{
	switch (@sysvar::CH_Nodes::CH_EISDoor_RR_Stat_AR2_UB_AUT_01)
	{
		case (0):
			//Updatebit wird mit 1 gesendet; entspricht Standard
			break;
		case (1):
			//nur wenn manueller Wert gleich 0 ist, muss was gemacht werden
			if (@sysvar::CH_Nodes::CH_EISDoor_RR_Stat_AR2_UB_AUT_01 == 0)
				DisturbPDUUB("Door_RR_Stat_AR2", 1, 0); //Updatebit wird einmal auf Null gesetzt
			break;
		case (2):
			//Updatebit wird mit 1 gesendet; entspricht Standard
			break;
		case (3):
			DisturbPDUUB("Door_RR_Stat_AR2", 1, 0); //Updatebit wird einmal auf Null gesetzt
			break;
	}
}

CH_EISDPC_IndMd_Rq_AR()
{
	switch (@sysvar::CH_Nodes::CH_EISDPC_IndMd_Rq_AR_UB_AUTO_01)
	{
		case (0):
			//Updatebit wird mit 1 gesendet; entspricht Standard
			break;
		case (1):
			//nur wenn manueller Wert gleich 0 ist, muss was gemacht werden
			if (@sysvar::CH_Nodes::CH_EISDPC_IndMd_Rq_AR_UB_AUTO_01 == 0)
				DisturbPDUUB("DPC_IndMd_Rq_AR", 1, 0); //Updatebit wird einmal auf Null gesetzt
			break;
		case (2):
			//Updatebit wird mit 1 gesendet; entspricht Standard
			break;
		case (3):
			DisturbPDUUB("DPC_IndMd_Rq_AR", 1, 0); //Updatebit wird einmal auf Null gesetzt
			break;
	}
}

CH_EISEL_Stat_AR2()
{
	switch (@sysvar::CH_Nodes::CH_EISEL_Stat_AR2_UB_AUTO_01)
	{
		case (0):
			//Updatebit wird mit 1 gesendet; entspricht Standard
			break;
		case (1):
			//nur wenn manueller Wert gleich 0 ist, muss was gemacht werden
			if (@sysvar::CH_Nodes::CH_EISEL_Stat_AR2_UB_AUTO_01 == 0)
				DisturbPDUUB("EL_Stat_AR2", 1, 0); //Updatebit wird einmal auf Null gesetzt
			break;
		case (2):
			//Updatebit wird mit 1 gesendet; entspricht Standard
			break;
		case (3):
			DisturbPDUUB("EL_Stat_AR2", 1, 0); //Updatebit wird einmal auf Null gesetzt
			break;
	}
}

CH_EISEL_TurnInd_Rq_AR2()
{
	switch (@sysvar::CH_Nodes::CH_EISEL_TurnInd_Rq_AR2_UB_AUTO)
	{
		case (0):
			//Updatebit wird mit 1 gesendet; entspricht Standard
			break;
		case (1):
			//nur wenn manueller Wert gleich 0 ist, muss was gemacht werden
			if (@sysvar::CH_Nodes::CH_EISEL_TurnInd_Rq_AR2_UB_AUTO == 0)
				DisturbPDUUB("EL_TurnInd_Rq_AR2", 1, 0); //Updatebit wird einmal auf Null gesetzt
			break;
		case (2):
			//Updatebit wird mit 1 gesendet; entspricht Standard
			break;
		case (3):
			DisturbPDUUB("EL_TurnInd_Rq_AR2", 1, 0); //Updatebit wird einmal auf Null gesetzt
			break;
	}
}

CH_EISEPKB_Stat_AR2()
{
	switch (@sysvar::CH_Nodes::CH_EISEPKB_Stat_AR2_UB_AUTO_01)
	{
		case (0):
			//Updatebit wird mit 1 gesendet; entspricht Standard
			break;
		case (1):
			//nur wenn manueller Wert gleich 0 ist, muss was gemacht werden
			if (@sysvar::CH_Nodes::CH_EISEPKB_Stat_AR2_UB_AUTO_01 == 0)
				DisturbPDUUB("EPKB_Stat_AR2", 1, 0); //Updatebit wird einmal auf Null gesetzt
			break;
		case (2):
			//Updatebit wird mit 1 gesendet; entspricht Standard
			break;
		case (3):
			DisturbPDUUB("EPKB_Stat_AR2", 1, 0); //Updatebit wird einmal auf Null gesetzt
			break;
	}
}

CH_EISEVC_CfgBit_01_32_AR2()
{
	switch (@sysvar::CH_Nodes::CH_EISEVC_CfgBit_01_32_A_UB_A_01)
	{
		case (0):
			//Updatebit wird mit 1 gesendet; entspricht Standard
			break;
		case (1):
			//nur wenn manueller Wert gleich 0 ist, muss was gemacht werden
			if (@sysvar::CH_Nodes::CH_EISEVC_CfgBit_01_32_A_UB_A_01 == 0)
				DisturbPDUUB("EVC_CfgBit_01_32_AR2", 1, 0); //Updatebit wird einmal auf Null gesetzt
			break;
		case (2):
			//Updatebit wird mit 1 gesendet; entspricht Standard
			break;
		case (3):
			DisturbPDUUB("EVC_CfgBit_01_32_AR2", 1, 0); //Updatebit wird einmal auf Null gesetzt
			break;
	}
}

CH_EISEVC_CfgBit_33_64_AR2()
{
	switch (@sysvar::CH_Nodes::CH_EISEVC_CfgBit_33_64_A_UB_A_01)
	{
		case (0):
			//Updatebit wird mit 1 gesendet; entspricht Standard
			break;
		case (1):
			//nur wenn manueller Wert gleich 0 ist, muss was gemacht werden
			if (@sysvar::CH_Nodes::CH_EISEVC_CfgBit_33_64_A_UB_A_01 == 0)
				DisturbPDUUB("EVC_CfgBit_33_64_AR2", 1, 0); //Updatebit wird einmal auf Null gesetzt
			break;
		case (2):
			//Updatebit wird mit 1 gesendet; entspricht Standard
			break;
		case (3):
			DisturbPDUUB("EVC_CfgBit_33_64_AR2", 1, 0); //Updatebit wird einmal auf Null gesetzt
			break;
	}
}

CH_EISEVC_CfgBit_65_96_AR2()
{
	switch (@sysvar::CH_Nodes::CH_EISEVC_CfgBit_65_96_A_UB_A_01)
	{
		case (0):
			//Updatebit wird mit 1 gesendet; entspricht Standard
			break;
		case (1):
			//nur wenn manueller Wert gleich 0 ist, muss was gemacht werden
			if (@sysvar::CH_Nodes::CH_EISEVC_CfgBit_65_96_A_UB_A_01 == 0)
				DisturbPDUUB("EVC_CfgBit_65_96_AR2", 1, 0); //Updatebit wird einmal auf Null gesetzt
			break;
		case (2):
			//Updatebit wird mit 1 gesendet; entspricht Standard
			break;
		case (3):
			DisturbPDUUB("EVC_CfgBit_65_96_AR2", 1, 0); //Updatebit wird einmal auf Null gesetzt
			break;
	}
}

CH_EISEVC_CfgBit_97_C8_AR2()
{
	switch (@sysvar::CH_Nodes::CH_EISEVC_CfgBit_97_C8_A_UB_AUTO)
	{
		case (0):
			//Updatebit wird mit 1 gesendet; entspricht Standard
			break;
		case (1):
			//nur wenn manueller Wert gleich 0 ist, muss was gemacht werden
			if (@sysvar::CH_Nodes::CH_EISEVC_CfgBit_97_C8_A_UB_AUTO == 0)
				DisturbPDUUB("EVC_CfgBit_97_C8_AR2", 1, 0); //Updatebit wird einmal auf Null gesetzt
			break;
		case (2):
			//Updatebit wird mit 1 gesendet; entspricht Standard
			break;
		case (3):
			DisturbPDUUB("EVC_CfgBit_97_C8_AR2", 1, 0); //Updatebit wird einmal auf Null gesetzt
			break;
	}
}

CH_EISEVC_CfgList_01_0C_AR2()
{
	switch (@sysvar::CH_Nodes::CH_EISEVC_CfgList_01_0C__UB_A_01)
	{
		case (0):
			//Updatebit wird mit 1 gesendet; entspricht Standard
			break;
		case (1):
			//nur wenn manueller Wert gleich 0 ist, muss was gemacht werden
			if (@sysvar::CH_Nodes::CH_EISEVC_CfgList_01_0C__UB_A_01 == 0)
				DisturbPDUUB("EVC_CfgList_01_0C_AR2", 1, 0); //Updatebit wird einmal auf Null gesetzt
			break;
		case (2):
			//Updatebit wird mit 1 gesendet; entspricht Standard
			break;
		case (3):
			DisturbPDUUB("EVC_CfgList_01_0C_AR2", 1, 0); //Updatebit wird einmal auf Null gesetzt
			break;
	}
}

CH_EISFCW_Disp_Rq_AR()
{
	switch (@sysvar::CH_Nodes::CH_EISFCW_Disp_Rq_AR_UB_AUTO)
	{
		case (0):
			//Updatebit wird mit 1 gesendet; entspricht Standard
			break;
		case (1):
			//nur wenn manueller Wert gleich 0 ist, muss was gemacht werden
			if (@sysvar::CH_Nodes::CH_EISFCW_Disp_Rq_AR_UB_AUTO == 0)
				DisturbPDUUB("FCW_Disp_Rq_AR", 1, 0); //Updatebit wird einmal auf Null gesetzt
			break;
		case (2):
			//Updatebit wird mit 1 gesendet; entspricht Standard
			break;
		case (3):
			DisturbPDUUB("FCW_Disp_Rq_AR", 1, 0); //Updatebit wird einmal auf Null gesetzt
			break;
	}
}

CH_EISHMI_CHASSIS_R1_AR2()
{
	switch (@sysvar::CH_Nodes::CH_EISHMI_CHASSIS_R1_AR2_UB_A_01)
	{
		case (0):
			//Updatebit wird mit 1 gesendet; entspricht Standard
			break;
		case (1):
			//nur wenn manueller Wert gleich 0 ist, muss was gemacht werden
			if (@sysvar::CH_Nodes::CH_EISHMI_CHASSIS_R1_AR2_UB_A_01 == 0)
				DisturbPDUUB("HMI_CHASSIS_R1_AR2", 1, 0); //Updatebit wird einmal auf Null gesetzt
			break;
		case (2):
			//Updatebit wird mit 1 gesendet; entspricht Standard
			break;
		case (3):
			DisturbPDUUB("HMI_CHASSIS_R1_AR2", 1, 0); //Updatebit wird einmal auf Null gesetzt
			break;
	}
}

CH_EISHU_State_AR()
{
	switch (@sysvar::CH_Nodes::CH_EISHU_State_AR_UB_AUTO)
	{
		case (0):
			//Updatebit wird mit 1 gesendet; entspricht Standard
			break;
		case (1):
			//nur wenn manueller Wert gleich 0 ist, muss was gemacht werden
			if (@sysvar::CH_Nodes::CH_EISHU_State_AR_UB_AUTO == 0)
				DisturbPDUUB("HU_State_AR", 1, 0); //Updatebit wird einmal auf Null gesetzt
			break;
		case (2):
			//Updatebit wird mit 1 gesendet; entspricht Standard
			break;
		case (3):
			DisturbPDUUB("HU_State_AR", 1, 0); //Updatebit wird einmal auf Null gesetzt
			break;
	}
}

CH_EISHVAC_OBD_DTC_AR()
{
	switch (@sysvar::CH_Nodes::CH_EISHVAC_OBD_DTC_AR_UB_AUTO_01)
	{
		case (0):
			//Updatebit wird mit 1 gesendet; entspricht Standard
			break;
		case (1):
			//nur wenn manueller Wert gleich 0 ist, muss was gemacht werden
			if (@sysvar::CH_Nodes::CH_EISHVAC_OBD_DTC_AR_UB_AUTO_01 == 0)
				DisturbPDUUB("HVAC_OBD_DTC_AR", 1, 0); //Updatebit wird einmal auf Null gesetzt
			break;
		case (2):
			//Updatebit wird mit 1 gesendet; entspricht Standard
			break;
		case (3):
			DisturbPDUUB("HVAC_OBD_DTC_AR", 1, 0); //Updatebit wird einmal auf Null gesetzt
			break;
	}
}

CH_EISHVAC_Rs_AR2()
{
	switch (@sysvar::CH_Nodes::CH_EISHVAC_Rs_AR2_UB_AUTO_01)
	{
		case (0):
			//Updatebit wird mit 1 gesendet; entspricht Standard
			break;
		case (1):
			//nur wenn manueller Wert gleich 0 ist, muss was gemacht werden
			if (@sysvar::CH_Nodes::CH_EISHVAC_Rs_AR2_UB_AUTO_01 == 0)
				DisturbPDUUB("HVAC_Rs_AR2", 1, 0); //Updatebit wird einmal auf Null gesetzt
			break;
		case (2):
			//Updatebit wird mit 1 gesendet; entspricht Standard
			break;
		case (3):
			DisturbPDUUB("HVAC_Rs_AR2", 1, 0); //Updatebit wird einmal auf Null gesetzt
			break;
	}
}

CH_EISIC_DriveAssistSys_AR2()
{
	switch (@sysvar::CH_Nodes::CH_EISIC_DriveAssistSys__UB_A_01)
	{
		case (0):
			//Updatebit wird mit 1 gesendet; entspricht Standard
			break;
		case (1):
			//nur wenn manueller Wert gleich 0 ist, muss was gemacht werden
			if (@sysvar::CH_Nodes::CH_EISIC_DriveAssistSys__UB_A_01 == 0)
				DisturbPDUUB("IC_DriveAssistSys_AR2", 1, 0); //Updatebit wird einmal auf Null gesetzt
			break;
		case (2):
			//Updatebit wird mit 1 gesendet; entspricht Standard
			break;
		case (3):
			DisturbPDUUB("IC_DriveAssistSys_AR2", 1, 0); //Updatebit wird einmal auf Null gesetzt
			break;
	}
}

CH_EISIC_Settings_AR2()
{
	switch (@sysvar::CH_Nodes::CH_EISIC_Settings_AR2_UB_AUTO_01)
	{
		case (0):
			//Updatebit wird mit 1 gesendet; entspricht Standard
			break;
		case (1):
			//nur wenn manueller Wert gleich 0 ist, muss was gemacht werden
			if (@sysvar::CH_Nodes::CH_EISIC_Settings_AR2_UB_AUTO_01 == 0)
				DisturbPDUUB("IC_Settings_AR2", 1, 0); //Updatebit wird einmal auf Null gesetzt
			break;
		case (2):
			//Updatebit wird mit 1 gesendet; entspricht Standard
			break;
		case (3):
			DisturbPDUUB("IC_Settings_AR2", 1, 0); //Updatebit wird einmal auf Null gesetzt
			break;
	}
}

CH_EISICH_Stat_AR()
{
	switch (@sysvar::CH_Nodes::CH_EISICH_Stat_AR_UB_AUTO_01)
	{
		case (0):
			//Updatebit wird mit 1 gesendet; entspricht Standard
			break;
		case (1):
			//nur wenn manueller Wert gleich 0 ist, muss was gemacht werden
			if (@sysvar::CH_Nodes::CH_EISICH_Stat_AR_UB_AUTO_01 == 0)
				DisturbPDUUB("ICH_Stat_AR", 1, 0); //Updatebit wird einmal auf Null gesetzt
			break;
		case (2):
			//Updatebit wird mit 1 gesendet; entspricht Standard
			break;
		case (3):
			DisturbPDUUB("ICH_Stat_AR", 1, 0); //Updatebit wird einmal auf Null gesetzt
			break;
	}
}

CH_EISIgn_Veh_Stat_AR2()
{
	switch (@sysvar::CH_Nodes::CH_EISIgn_Veh_Stat_AR2_UB_AUT_01)
	{
		case (0):
			//Updatebit wird mit 1 gesendet; entspricht Standard
			break;
		case (1):
			//nur wenn manueller Wert gleich 0 ist, muss was gemacht werden
			if (@sysvar::CH_Nodes::CH_EISIgn_Veh_Stat_AR2_UB_AUT_01 == 0)
				DisturbPDUUB("Ign_Veh_Stat_AR2", 1, 0); //Updatebit wird einmal auf Null gesetzt
			break;
		case (2):
			//Updatebit wird mit 1 gesendet; entspricht Standard
			break;
		case (3):
			DisturbPDUUB("Ign_Veh_Stat_AR2", 1, 0); //Updatebit wird einmal auf Null gesetzt
			break;
	}
}

CH_EISIHC_Lgt_Stat_HLI_2_AR2()
{
	switch (@sysvar::CH_Nodes::CH_EISIHC_Lgt_Stat_HLI_2_UB_AUTO)
	{
		case (0):
			//Updatebit wird mit 1 gesendet; entspricht Standard
			break;
		case (1):
			//nur wenn manueller Wert gleich 0 ist, muss was gemacht werden
			if (@sysvar::CH_Nodes::CH_EISIHC_Lgt_Stat_HLI_2_UB_AUTO == 0)
				DisturbPDUUB("IHC_Lgt_Stat_HLI_2_AR2", 1, 0); //Updatebit wird einmal auf Null gesetzt
			break;
		case (2):
			//Updatebit wird mit 1 gesendet; entspricht Standard
			break;
		case (3):
			DisturbPDUUB("IHC_Lgt_Stat_HLI_2_AR2", 1, 0); //Updatebit wird einmal auf Null gesetzt
			break;
	}
}

CH_EISIHC_Lgt_Stat_HLI_AR2()
{
	switch (@sysvar::CH_Nodes::CH_EISIHC_Lgt_Stat_HLI_A_UB_A_01)
	{
		case (0):
			//Updatebit wird mit 1 gesendet; entspricht Standard
			break;
		case (1):
			//nur wenn manueller Wert gleich 0 ist, muss was gemacht werden
			if (@sysvar::CH_Nodes::CH_EISIHC_Lgt_Stat_HLI_A_UB_A_01 == 0)
				DisturbPDUUB("IHC_Lgt_Stat_HLI_AR2", 1, 0); //Updatebit wird einmal auf Null gesetzt
			break;
		case (2):
			//Updatebit wird mit 1 gesendet; entspricht Standard
			break;
		case (3):
			DisturbPDUUB("IHC_Lgt_Stat_HLI_AR2", 1, 0); //Updatebit wird einmal auf Null gesetzt
			break;
	}
}

CH_EISKG_State_AR2()
{
	switch (@sysvar::CH_Nodes::CH_EISKG_State_AR2_UB_AUTO)
	{
		case (0):
			//Updatebit wird mit 1 gesendet; entspricht Standard
			break;
		case (1):
			//nur wenn manueller Wert gleich 0 ist, muss was gemacht werden
			if (@sysvar::CH_Nodes::CH_EISKG_State_AR2_UB_AUTO == 0)
				DisturbPDUUB("KG_State_AR2", 1, 0); //Updatebit wird einmal auf Null gesetzt
			break;
		case (2):
			//Updatebit wird mit 1 gesendet; entspricht Standard
			break;
		case (3):
			DisturbPDUUB("KG_State_AR2", 1, 0); //Updatebit wird einmal auf Null gesetzt
			break;
	}
}

CH_EISLDC_Disp_Stat_IC_AR2()
{
	switch (@sysvar::CH_Nodes::CH_EISLDC_Disp_Stat_IC_A_UB_A_01)
	{
		case (0):
			//Updatebit wird mit 1 gesendet; entspricht Standard
			break;
		case (1):
			//nur wenn manueller Wert gleich 0 ist, muss was gemacht werden
			if (@sysvar::CH_Nodes::CH_EISLDC_Disp_Stat_IC_A_UB_A_01 == 0)
				DisturbPDUUB("LDC_Disp_Stat_IC_AR2", 1, 0); //Updatebit wird einmal auf Null gesetzt
			break;
		case (2):
			//Updatebit wird mit 1 gesendet; entspricht Standard
			break;
		case (3):
			DisturbPDUUB("LDC_Disp_Stat_IC_AR2", 1, 0); //Updatebit wird einmal auf Null gesetzt
			break;
	}
}

CH_EISLgtSens_State_AR()
{
	switch (@sysvar::CH_Nodes::CH_EISLgtSens_State_AR_UB_AUT_01)
	{
		case (0):
			//Updatebit wird mit 1 gesendet; entspricht Standard
			break;
		case (1):
			//nur wenn manueller Wert gleich 0 ist, muss was gemacht werden
			if (@sysvar::CH_Nodes::CH_EISLgtSens_State_AR_UB_AUT_01 == 0)
				DisturbPDUUB("LgtSens_State_AR", 1, 0); //Updatebit wird einmal auf Null gesetzt
			break;
		case (2):
			//Updatebit wird mit 1 gesendet; entspricht Standard
			break;
		case (3):
			DisturbPDUUB("LgtSens_State_AR", 1, 0); //Updatebit wird einmal auf Null gesetzt
			break;
	}
}

CH_EISMirr_Adj_Lt_Rq_AR()
{
	switch (@sysvar::CH_Nodes::CH_EISMirr_Adj_Lt_Rq_AR_UB_AU_01)
	{
		case (0):
			//Updatebit wird mit 1 gesendet; entspricht Standard
			break;
		case (1):
			//nur wenn manueller Wert gleich 0 ist, muss was gemacht werden
			if (@sysvar::CH_Nodes::CH_EISMirr_Adj_Lt_Rq_AR_UB_AU_01 == 0)
				DisturbPDUUB("Mirr_Adj_Lt_Rq_AR", 1, 0); //Updatebit wird einmal auf Null gesetzt
			break;
		case (2):
			//Updatebit wird mit 1 gesendet; entspricht Standard
			break;
		case (3):
			DisturbPDUUB("Mirr_Adj_Lt_Rq_AR", 1, 0); //Updatebit wird einmal auf Null gesetzt
			break;
	}
}

CH_EISMirr_Adj_Rt_Rq_AR()
{
	switch (@sysvar::CH_Nodes::CH_EISMirr_Adj_Rt_Rq_AR_UB_AU_01)
	{
		case (0):
			//Updatebit wird mit 1 gesendet; entspricht Standard
			break;
		case (1):
			//nur wenn manueller Wert gleich 0 ist, muss was gemacht werden
			if (@sysvar::CH_Nodes::CH_EISMirr_Adj_Rt_Rq_AR_UB_AU_01 == 0)
				DisturbPDUUB("Mirr_Adj_Rt_Rq_AR", 1, 0); //Updatebit wird einmal auf Null gesetzt
			break;
		case (2):
			//Updatebit wird mit 1 gesendet; entspricht Standard
			break;
		case (3):
			DisturbPDUUB("Mirr_Adj_Rt_Rq_AR", 1, 0); //Updatebit wird einmal auf Null gesetzt
			break;
	}
}

CH_EISNAVI_Pos1_AR()
{
	switch (@sysvar::CH_Nodes::CH_EISNAVI_Pos1_AR_UB_AUTO_01)
	{
		case (0):
			//Updatebit wird mit 1 gesendet; entspricht Standard
			break;
		case (1):
			//nur wenn manueller Wert gleich 0 ist, muss was gemacht werden
			if (@sysvar::CH_Nodes::CH_EISNAVI_Pos1_AR_UB_AUTO_01 == 0)
				DisturbPDUUB("NAVI_Pos1_AR", 1, 0); //Updatebit wird einmal auf Null gesetzt
			break;
		case (2):
			//Updatebit wird mit 1 gesendet; entspricht Standard
			break;
		case (3):
			DisturbPDUUB("NAVI_Pos1_AR", 1, 0); //Updatebit wird einmal auf Null gesetzt
			break;
	}
}

CH_EISNAVI_Pos2_AR()
{
	switch (@sysvar::CH_Nodes::CH_EISNAVI_Pos2_AR_UB_AUTO_01)
	{
		case (0):
			//Updatebit wird mit 1 gesendet; entspricht Standard
			break;
		case (1):
			//nur wenn manueller Wert gleich 0 ist, muss was gemacht werden
			if (@sysvar::CH_Nodes::CH_EISNAVI_Pos2_AR_UB_AUTO_01 == 0)
				DisturbPDUUB("NAVI_Pos2_AR", 1, 0); //Updatebit wird einmal auf Null gesetzt
			break;
		case (2):
			//Updatebit wird mit 1 gesendet; entspricht Standard
			break;
		case (3):
			DisturbPDUUB("NAVI_Pos2_AR", 1, 0); //Updatebit wird einmal auf Null gesetzt
			break;
	}
}

CH_EISNAVI_Pos3_AR()
{
	switch (@sysvar::CH_Nodes::CH_EISNAVI_Pos3_AR_UB_AUTO_01)
	{
		case (0):
			//Updatebit wird mit 1 gesendet; entspricht Standard
			break;
		case (1):
			//nur wenn manueller Wert gleich 0 ist, muss was gemacht werden
			if (@sysvar::CH_Nodes::CH_EISNAVI_Pos3_AR_UB_AUTO_01 == 0)
				DisturbPDUUB("NAVI_Pos3_AR", 1, 0); //Updatebit wird einmal auf Null gesetzt
			break;
		case (2):
			//Updatebit wird mit 1 gesendet; entspricht Standard
			break;
		case (3):
			DisturbPDUUB("NAVI_Pos3_AR", 1, 0); //Updatebit wird einmal auf Null gesetzt
			break;
	}
}

CH_EISNAVI_Pos4_AR()
{
	switch (@sysvar::CH_Nodes::CH_EISNAVI_Pos4_AR_UB_AUTO_01)
	{
		case (0):
			//Updatebit wird mit 1 gesendet; entspricht Standard
			break;
		case (1):
			//nur wenn manueller Wert gleich 0 ist, muss was gemacht werden
			if (@sysvar::CH_Nodes::CH_EISNAVI_Pos4_AR_UB_AUTO_01 == 0)
				DisturbPDUUB("NAVI_Pos4_AR", 1, 0); //Updatebit wird einmal auf Null gesetzt
			break;
		case (2):
			//Updatebit wird mit 1 gesendet; entspricht Standard
			break;
		case (3):
			DisturbPDUUB("NAVI_Pos4_AR", 1, 0); //Updatebit wird einmal auf Null gesetzt
			break;
	}
}

CH_EISNAVI_Pos5_AR()
{
	switch (@sysvar::CH_Nodes::CH_EISNAVI_Pos5_AR_UB_AUTO_01)
	{
		case (0):
			//Updatebit wird mit 1 gesendet; entspricht Standard
			break;
		case (1):
			//nur wenn manueller Wert gleich 0 ist, muss was gemacht werden
			if (@sysvar::CH_Nodes::CH_EISNAVI_Pos5_AR_UB_AUTO_01 == 0)
				DisturbPDUUB("NAVI_Pos5_AR", 1, 0); //Updatebit wird einmal auf Null gesetzt
			break;
		case (2):
			//Updatebit wird mit 1 gesendet; entspricht Standard
			break;
		case (3):
			DisturbPDUUB("NAVI_Pos5_AR", 1, 0); //Updatebit wird einmal auf Null gesetzt
			break;
	}
}

CH_EISNVP_Stat1_AR2()
{
	switch (@sysvar::CH_Nodes::CH_EISNVP_Stat1_AR2_UB_AUTO_01)
	{
		case (0):
			//Updatebit wird mit 1 gesendet; entspricht Standard
			break;
		case (1):
			//nur wenn manueller Wert gleich 0 ist, muss was gemacht werden
			if (@sysvar::CH_Nodes::CH_EISNVP_Stat1_AR2_UB_AUTO_01 == 0)
				DisturbPDUUB("NVP_Stat1_AR2", 1, 0); //Updatebit wird einmal auf Null gesetzt
			break;
		case (2):
			//Updatebit wird mit 1 gesendet; entspricht Standard
			break;
		case (3):
			DisturbPDUUB("NVP_Stat1_AR2", 1, 0); //Updatebit wird einmal auf Null gesetzt
			break;
	}
}

CH_EISOHCM_Stat_AR2()
{
	switch (@sysvar::CH_Nodes::CH_EISOHCM_Stat_AR2_UB_AUTO_01)
	{
		case (0):
			//Updatebit wird mit 1 gesendet; entspricht Standard
			break;
		case (1):
			//nur wenn manueller Wert gleich 0 ist, muss was gemacht werden
			if (@sysvar::CH_Nodes::CH_EISOHCM_Stat_AR2_UB_AUTO_01 == 0)
				DisturbPDUUB("OHCM_Stat_AR2", 1, 0); //Updatebit wird einmal auf Null gesetzt
			break;
		case (2):
			//Updatebit wird mit 1 gesendet; entspricht Standard
			break;
		case (3):
			DisturbPDUUB("OHCM_Stat_AR2", 1, 0); //Updatebit wird einmal auf Null gesetzt
			break;
	}
}

CH_EISORC_Disp_Stat_AR2()
{
	switch (@sysvar::CH_Nodes::CH_EISORC_Disp_Stat_AR2_UB_AU_01)
	{
		case (0):
			//Updatebit wird mit 1 gesendet; entspricht Standard
			break;
		case (1):
			//nur wenn manueller Wert gleich 0 ist, muss was gemacht werden
			if (@sysvar::CH_Nodes::CH_EISORC_Disp_Stat_AR2_UB_AU_01 == 0)
				DisturbPDUUB("ORC_Disp_Stat_AR2", 1, 0); //Updatebit wird einmal auf Null gesetzt
			break;
		case (2):
			//Updatebit wird mit 1 gesendet; entspricht Standard
			break;
		case (3):
			DisturbPDUUB("ORC_Disp_Stat_AR2", 1, 0); //Updatebit wird einmal auf Null gesetzt
			break;
	}
}

CH_EISORC_Impact_AR2()
{
	switch (@sysvar::CH_Nodes::CH_EISORC_Impact_AR2_UB_AUTO_01)
	{
		case (0):
			//Updatebit wird mit 1 gesendet; entspricht Standard
			break;
		case (1):
			//nur wenn manueller Wert gleich 0 ist, muss was gemacht werden
			if (@sysvar::CH_Nodes::CH_EISORC_Impact_AR2_UB_AUTO_01 == 0)
				DisturbPDUUB("ORC_Impact_AR2", 1, 0); //Updatebit wird einmal auf Null gesetzt
			break;
		case (2):
			//Updatebit wird mit 1 gesendet; entspricht Standard
			break;
		case (3):
			DisturbPDUUB("ORC_Impact_AR2", 1, 0); //Updatebit wird einmal auf Null gesetzt
			break;
	}
}

CH_EISPark_Disp_Rs_AR2()
{
	switch (@sysvar::CH_Nodes::CH_EISPark_Disp_Rs_AR2_UB_AUT_01)
	{
		case (0):
			//Updatebit wird mit 1 gesendet; entspricht Standard
			break;
		case (1):
			//nur wenn manueller Wert gleich 0 ist, muss was gemacht werden
			if (@sysvar::CH_Nodes::CH_EISPark_Disp_Rs_AR2_UB_AUT_01 == 0)
				DisturbPDUUB("Park_Disp_Rs_AR2", 1, 0); //Updatebit wird einmal auf Null gesetzt
			break;
		case (2):
			//Updatebit wird mit 1 gesendet; entspricht Standard
			break;
		case (3):
			DisturbPDUUB("Park_Disp_Rs_AR2", 1, 0); //Updatebit wird einmal auf Null gesetzt
			break;
	}
}

CH_EISPHB_IHC_Plus_Tunnel_3_4_AR2()
{
	switch (@sysvar::CH_Nodes::CH_EISPHB_IHC_Plus_Tunne_UB_AUTO)
	{
		case (0):
			//Updatebit wird mit 1 gesendet; entspricht Standard
			break;
		case (1):
			//nur wenn manueller Wert gleich 0 ist, muss was gemacht werden
			if (@sysvar::CH_Nodes::CH_EISPHB_IHC_Plus_Tunne_UB_AUTO == 0)
				DisturbPDUUB("PHB_IHC_Plus_Tunnel_3_4_AR2", 1, 0); //Updatebit wird einmal auf Null gesetzt
			break;
		case (2):
			//Updatebit wird mit 1 gesendet; entspricht Standard
			break;
		case (3):
			DisturbPDUUB("PHB_IHC_Plus_Tunnel_3_4_AR2", 1, 0); //Updatebit wird einmal auf Null gesetzt
			break;
	}
}

CH_EISPHB_IHC_Plus_Tunnel_AR2()
{
	switch (@sysvar::CH_Nodes::CH_EISPHB_IHC_Plus_Tunne_UB_A_01)
	{
		case (0):
			//Updatebit wird mit 1 gesendet; entspricht Standard
			break;
		case (1):
			//nur wenn manueller Wert gleich 0 ist, muss was gemacht werden
			if (@sysvar::CH_Nodes::CH_EISPHB_IHC_Plus_Tunne_UB_A_01 == 0)
				DisturbPDUUB("PHB_IHC_Plus_Tunnel_AR2", 1, 0); //Updatebit wird einmal auf Null gesetzt
			break;
		case (2):
			//Updatebit wird mit 1 gesendet; entspricht Standard
			break;
		case (3):
			DisturbPDUUB("PHB_IHC_Plus_Tunnel_AR2", 1, 0); //Updatebit wird einmal auf Null gesetzt
			break;
	}
}

CH_EISPN14_Rs1_AR2()
{
	switch (@sysvar::CH_Nodes::CH_EISPN14_Rs1_AR2_UB_AUTO_01)
	{
		case (0):
			//Updatebit wird mit 1 gesendet; entspricht Standard
			break;
		case (1):
			//nur wenn manueller Wert gleich 0 ist, muss was gemacht werden
			if (@sysvar::CH_Nodes::CH_EISPN14_Rs1_AR2_UB_AUTO_01 == 0)
				DisturbPDUUB("PN14_Rs1_AR2", 1, 0); //Updatebit wird einmal auf Null gesetzt
			break;
		case (2):
			//Updatebit wird mit 1 gesendet; entspricht Standard
			break;
		case (3):
			DisturbPDUUB("PN14_Rs1_AR2", 1, 0); //Updatebit wird einmal auf Null gesetzt
			break;
	}
}

CH_EISPN14_Rs2_AR()
{
	switch (@sysvar::CH_Nodes::CH_EISPN14_Rs2_AR_UB_AUTO_01)
	{
		case (0):
			//Updatebit wird mit 1 gesendet; entspricht Standard
			break;
		case (1):
			//nur wenn manueller Wert gleich 0 ist, muss was gemacht werden
			if (@sysvar::CH_Nodes::CH_EISPN14_Rs2_AR_UB_AUTO_01 == 0)
				DisturbPDUUB("PN14_Rs2_AR", 1, 0); //Updatebit wird einmal auf Null gesetzt
			break;
		case (2):
			//Updatebit wird mit 1 gesendet; entspricht Standard
			break;
		case (3):
			DisturbPDUUB("PN14_Rs2_AR", 1, 0); //Updatebit wird einmal auf Null gesetzt
			break;
	}
}

CH_EISPN14_Stat2_AR2()
{
	switch (@sysvar::CH_Nodes::CH_EISPN14_Stat2_AR2_UB_AUTO_01)
	{
		case (0):
			//Updatebit wird mit 1 gesendet; entspricht Standard
			break;
		case (1):
			//nur wenn manueller Wert gleich 0 ist, muss was gemacht werden
			if (@sysvar::CH_Nodes::CH_EISPN14_Stat2_AR2_UB_AUTO_01 == 0)
				DisturbPDUUB("PN14_Stat2_AR2", 1, 0); //Updatebit wird einmal auf Null gesetzt
			break;
		case (2):
			//Updatebit wird mit 1 gesendet; entspricht Standard
			break;
		case (3):
			DisturbPDUUB("PN14_Stat2_AR2", 1, 0); //Updatebit wird einmal auf Null gesetzt
			break;
	}
}

CH_EISPN14_Stat_AR()
{
	switch (@sysvar::CH_Nodes::CH_EISPN14_Stat_AR_UB_AUTO_01)
	{
		case (0):
			//Updatebit wird mit 1 gesendet; entspricht Standard
			break;
		case (1):
			//nur wenn manueller Wert gleich 0 ist, muss was gemacht werden
			if (@sysvar::CH_Nodes::CH_EISPN14_Stat_AR_UB_AUTO_01 == 0)
				DisturbPDUUB("PN14_Stat_AR", 1, 0); //Updatebit wird einmal auf Null gesetzt
			break;
		case (2):
			//Updatebit wird mit 1 gesendet; entspricht Standard
			break;
		case (3):
			DisturbPDUUB("PN14_Stat_AR", 1, 0); //Updatebit wird einmal auf Null gesetzt
			break;
	}
}

CH_EISPN48_Bat_Stat_AR()
{
	switch (@sysvar::CH_Nodes::CH_EISPN48_Bat_Stat_AR_UB_AUT_01)
	{
		case (0):
			//Updatebit wird mit 1 gesendet; entspricht Standard
			break;
		case (1):
			//nur wenn manueller Wert gleich 0 ist, muss was gemacht werden
			if (@sysvar::CH_Nodes::CH_EISPN48_Bat_Stat_AR_UB_AUT_01 == 0)
				DisturbPDUUB("PN48_Bat_Stat_AR", 1, 0); //Updatebit wird einmal auf Null gesetzt
			break;
		case (2):
			//Updatebit wird mit 1 gesendet; entspricht Standard
			break;
		case (3):
			DisturbPDUUB("PN48_Bat_Stat_AR", 1, 0); //Updatebit wird einmal auf Null gesetzt
			break;
	}
}

CH_EISPN48_BatLim_Stat_AR()
{
	switch (@sysvar::CH_Nodes::CH_EISPN48_BatLim_Stat_A_UB_A_01)
	{
		case (0):
			//Updatebit wird mit 1 gesendet; entspricht Standard
			break;
		case (1):
			//nur wenn manueller Wert gleich 0 ist, muss was gemacht werden
			if (@sysvar::CH_Nodes::CH_EISPN48_BatLim_Stat_A_UB_A_01 == 0)
				DisturbPDUUB("PN48_BatLim_Stat_AR", 1, 0); //Updatebit wird einmal auf Null gesetzt
			break;
		case (2):
			//Updatebit wird mit 1 gesendet; entspricht Standard
			break;
		case (3):
			DisturbPDUUB("PN48_BatLim_Stat_AR", 1, 0); //Updatebit wird einmal auf Null gesetzt
			break;
	}
}

CH_EISPN48_Stat_AR()
{
	switch (@sysvar::CH_Nodes::CH_EISPN48_Stat_AR_UB_AUTO_01)
	{
		case (0):
			//Updatebit wird mit 1 gesendet; entspricht Standard
			break;
		case (1):
			//nur wenn manueller Wert gleich 0 ist, muss was gemacht werden
			if (@sysvar::CH_Nodes::CH_EISPN48_Stat_AR_UB_AUTO_01 == 0)
				DisturbPDUUB("PN48_Stat_AR", 1, 0); //Updatebit wird einmal auf Null gesetzt
			break;
		case (2):
			//Updatebit wird mit 1 gesendet; entspricht Standard
			break;
		case (3):
			DisturbPDUUB("PN48_Stat_AR", 1, 0); //Updatebit wird einmal auf Null gesetzt
			break;
	}
}

CH_EISPNHV_WeekDepTmTbl_Rq_HU_AR2()
{
	switch (@sysvar::CH_Nodes::CH_EISPNHV_WeekDepTmTbl__UB_A_01)
	{
		case (0):
			//Updatebit wird mit 1 gesendet; entspricht Standard
			break;
		case (1):
			//nur wenn manueller Wert gleich 0 ist, muss was gemacht werden
			if (@sysvar::CH_Nodes::CH_EISPNHV_WeekDepTmTbl__UB_A_01 == 0)
				DisturbPDUUB("PNHV_WeekDepTmTbl_Rq_HU_AR2", 1, 0); //Updatebit wird einmal auf Null gesetzt
			break;
		case (2):
			//Updatebit wird mit 1 gesendet; entspricht Standard
			break;
		case (3):
			DisturbPDUUB("PNHV_WeekDepTmTbl_Rq_HU_AR2", 1, 0); //Updatebit wird einmal auf Null gesetzt
			break;
	}
}

CH_EISPT_ObjIntrst_Gw_AR2()
{
	switch (@sysvar::CH_Nodes::CH_EISPT_ObjIntrst_Gw_AR_UB_AUTO)
	{
		case (0):
			//Updatebit wird mit 1 gesendet; entspricht Standard
			break;
		case (1):
			//nur wenn manueller Wert gleich 0 ist, muss was gemacht werden
			if (@sysvar::CH_Nodes::CH_EISPT_ObjIntrst_Gw_AR_UB_AUTO == 0)
				DisturbPDUUB("PT_ObjIntrst_Gw_AR2", 1, 0); //Updatebit wird einmal auf Null gesetzt
			break;
		case (2):
			//Updatebit wird mit 1 gesendet; entspricht Standard
			break;
		case (3):
			DisturbPDUUB("PT_ObjIntrst_Gw_AR2", 1, 0); //Updatebit wird einmal auf Null gesetzt
			break;
	}
}

CH_EISRemPark_Auth_Rs_AR2()
{
	switch (@sysvar::CH_Nodes::CH_EISRemPark_Auth_Rs_AR_UB_A_01)
	{
		case (0):
			//Updatebit wird mit 1 gesendet; entspricht Standard
			break;
		case (1):
			//nur wenn manueller Wert gleich 0 ist, muss was gemacht werden
			if (@sysvar::CH_Nodes::CH_EISRemPark_Auth_Rs_AR_UB_A_01 == 0)
				DisturbPDUUB("RemPark_Auth_Rs_AR2", 1, 0); //Updatebit wird einmal auf Null gesetzt
			break;
		case (2):
			//Updatebit wird mit 1 gesendet; entspricht Standard
			break;
		case (3):
			DisturbPDUUB("RemPark_Auth_Rs_AR2", 1, 0); //Updatebit wird einmal auf Null gesetzt
			break;
	}
}

CH_EISRemPark_Stat_EIS_AR2()
{
	switch (@sysvar::CH_Nodes::CH_EISRemPark_Stat_EIS_A_UB_AUTO)
	{
		case (0):
			//Updatebit wird mit 1 gesendet; entspricht Standard
			break;
		case (1):
			//nur wenn manueller Wert gleich 0 ist, muss was gemacht werden
			if (@sysvar::CH_Nodes::CH_EISRemPark_Stat_EIS_A_UB_AUTO == 0)
				DisturbPDUUB("RemPark_Stat_EIS_AR2", 1, 0); //Updatebit wird einmal auf Null gesetzt
			break;
		case (2):
			//Updatebit wird mit 1 gesendet; entspricht Standard
			break;
		case (3):
			DisturbPDUUB("RemPark_Stat_EIS_AR2", 1, 0); //Updatebit wird einmal auf Null gesetzt
			break;
	}
}

CH_EISRTC_Date_Time_AR2()
{
	switch (@sysvar::CH_Nodes::CH_EISRTC_Date_Time_AR2_UB_AU_01)
	{
		case (0):
			//Updatebit wird mit 1 gesendet; entspricht Standard
			break;
		case (1):
			//nur wenn manueller Wert gleich 0 ist, muss was gemacht werden
			if (@sysvar::CH_Nodes::CH_EISRTC_Date_Time_AR2_UB_AU_01 == 0)
				DisturbPDUUB("RTC_Date_Time_AR2", 1, 0); //Updatebit wird einmal auf Null gesetzt
			break;
		case (2):
			//Updatebit wird mit 1 gesendet; entspricht Standard
			break;
		case (3):
			DisturbPDUUB("RTC_Date_Time_AR2", 1, 0); //Updatebit wird einmal auf Null gesetzt
			break;
	}
}

CH_EISSADR_Trgr_FCW_AR2()
{
	switch (@sysvar::CH_Nodes::CH_EISSADR_Trgr_FCW_AR2_UB_AU_01)
	{
		case (0):
			//Updatebit wird mit 1 gesendet; entspricht Standard
			break;
		case (1):
			//nur wenn manueller Wert gleich 0 ist, muss was gemacht werden
			if (@sysvar::CH_Nodes::CH_EISSADR_Trgr_FCW_AR2_UB_AU_01 == 0)
				DisturbPDUUB("SADR_Trgr_FCW_AR2", 1, 0); //Updatebit wird einmal auf Null gesetzt
			break;
		case (2):
			//Updatebit wird mit 1 gesendet; entspricht Standard
			break;
		case (3):
			DisturbPDUUB("SADR_Trgr_FCW_AR2", 1, 0); //Updatebit wird einmal auf Null gesetzt
			break;
	}
}

CH_EISSPCR_Stat_BC_F_AR2()
{
	switch (@sysvar::CH_Nodes::CH_EISSPCR_Stat_BC_F_AR2_UB_A_01)
	{
		case (0):
			//Updatebit wird mit 1 gesendet; entspricht Standard
			break;
		case (1):
			//nur wenn manueller Wert gleich 0 ist, muss was gemacht werden
			if (@sysvar::CH_Nodes::CH_EISSPCR_Stat_BC_F_AR2_UB_A_01 == 0)
				DisturbPDUUB("SPCR_Stat_BC_F_AR2", 1, 0); //Updatebit wird einmal auf Null gesetzt
			break;
		case (2):
			//Updatebit wird mit 1 gesendet; entspricht Standard
			break;
		case (3):
			DisturbPDUUB("SPCR_Stat_BC_F_AR2", 1, 0); //Updatebit wird einmal auf Null gesetzt
			break;
	}
}

CH_EISSPL_Obj1_Obj2_NV_AR2()
{
	switch (@sysvar::CH_Nodes::CH_EISSPL_Obj1_Obj2_NV_A_UB_A_01)
	{
		case (0):
			//Updatebit wird mit 1 gesendet; entspricht Standard
			break;
		case (1):
			//nur wenn manueller Wert gleich 0 ist, muss was gemacht werden
			if (@sysvar::CH_Nodes::CH_EISSPL_Obj1_Obj2_NV_A_UB_A_01 == 0)
				DisturbPDUUB("SPL_Obj1_Obj2_NV_AR2", 1, 0); //Updatebit wird einmal auf Null gesetzt
			break;
		case (2):
			//Updatebit wird mit 1 gesendet; entspricht Standard
			break;
		case (3):
			DisturbPDUUB("SPL_Obj1_Obj2_NV_AR2", 1, 0); //Updatebit wird einmal auf Null gesetzt
			break;
	}
}

CH_EISSPV_Actn_Rq_AR2()
{
	switch (@sysvar::CH_Nodes::CH_EISSPV_Actn_Rq_AR2_UB_AUTO_01)
	{
		case (0):
			//Updatebit wird mit 1 gesendet; entspricht Standard
			break;
		case (1):
			//nur wenn manueller Wert gleich 0 ist, muss was gemacht werden
			if (@sysvar::CH_Nodes::CH_EISSPV_Actn_Rq_AR2_UB_AUTO_01 == 0)
				DisturbPDUUB("SPV_Actn_Rq_AR2", 1, 0); //Updatebit wird einmal auf Null gesetzt
			break;
		case (2):
			//Updatebit wird mit 1 gesendet; entspricht Standard
			break;
		case (3):
			DisturbPDUUB("SPV_Actn_Rq_AR2", 1, 0); //Updatebit wird einmal auf Null gesetzt
			break;
	}
}

CH_EISSPV_Alm_Rq_AR()
{
	switch (@sysvar::CH_Nodes::CH_EISSPV_Alm_Rq_AR_UB_AUTO_01)
	{
		case (0):
			//Updatebit wird mit 1 gesendet; entspricht Standard
			break;
		case (1):
			//nur wenn manueller Wert gleich 0 ist, muss was gemacht werden
			if (@sysvar::CH_Nodes::CH_EISSPV_Alm_Rq_AR_UB_AUTO_01 == 0)
				DisturbPDUUB("SPV_Alm_Rq_AR", 1, 0); //Updatebit wird einmal auf Null gesetzt
			break;
		case (2):
			//Updatebit wird mit 1 gesendet; entspricht Standard
			break;
		case (3):
			DisturbPDUUB("SPV_Alm_Rq_AR", 1, 0); //Updatebit wird einmal auf Null gesetzt
			break;
	}
}

CH_EISSVS_Rq_HU_AR2()
{
	switch (@sysvar::CH_Nodes::CH_EISSVS_Rq_HU_AR2_UB_AUTO)
	{
		case (0):
			//Updatebit wird mit 1 gesendet; entspricht Standard
			break;
		case (1):
			//nur wenn manueller Wert gleich 0 ist, muss was gemacht werden
			if (@sysvar::CH_Nodes::CH_EISSVS_Rq_HU_AR2_UB_AUTO == 0)
				DisturbPDUUB("SVS_Rq_HU_AR2", 1, 0); //Updatebit wird einmal auf Null gesetzt
			break;
		case (2):
			//Updatebit wird mit 1 gesendet; entspricht Standard
			break;
		case (3):
			DisturbPDUUB("SVS_Rq_HU_AR2", 1, 0); //Updatebit wird einmal auf Null gesetzt
			break;
	}
}

CH_EISTBCSC_DAC_EPS_AR2()
{
	switch (@sysvar::CH_Nodes::CH_EISTBCSC_DAC_EPS_AR2_UB_AU_01)
	{
		case (0):
			//Updatebit wird mit 1 gesendet; entspricht Standard
			break;
		case (1):
			//nur wenn manueller Wert gleich 0 ist, muss was gemacht werden
			if (@sysvar::CH_Nodes::CH_EISTBCSC_DAC_EPS_AR2_UB_AU_01 == 0)
				DisturbPDUUB("TBCSC_DAC_EPS_AR2", 1, 0); //Updatebit wird einmal auf Null gesetzt
			break;
		case (2):
			//Updatebit wird mit 1 gesendet; entspricht Standard
			break;
		case (3):
			DisturbPDUUB("TBCSC_DAC_EPS_AR2", 1, 0); //Updatebit wird einmal auf Null gesetzt
			break;
	}
}

CH_EISTBCSC_DAC_ESP_AR2()
{
	switch (@sysvar::CH_Nodes::CH_EISTBCSC_DAC_ESP_AR2_UB_AU_01)
	{
		case (0):
			//Updatebit wird mit 1 gesendet; entspricht Standard
			break;
		case (1):
			//nur wenn manueller Wert gleich 0 ist, muss was gemacht werden
			if (@sysvar::CH_Nodes::CH_EISTBCSC_DAC_ESP_AR2_UB_AU_01 == 0)
				DisturbPDUUB("TBCSC_DAC_ESP_AR2", 1, 0); //Updatebit wird einmal auf Null gesetzt
			break;
		case (2):
			//Updatebit wird mit 1 gesendet; entspricht Standard
			break;
		case (3):
			DisturbPDUUB("TBCSC_DAC_ESP_AR2", 1, 0); //Updatebit wird einmal auf Null gesetzt
			break;
	}
}

CH_EISTBCSC_Hi_Rq1_AR2()
{
	switch (@sysvar::CH_Nodes::CH_EISTBCSC_Hi_Rq1_AR2_UB_AUT_01)
	{
		case (0):
			//Updatebit wird mit 1 gesendet; entspricht Standard
			break;
		case (1):
			//nur wenn manueller Wert gleich 0 ist, muss was gemacht werden
			if (@sysvar::CH_Nodes::CH_EISTBCSC_Hi_Rq1_AR2_UB_AUT_01 == 0)
				DisturbPDUUB("TBCSC_Hi_Rq1_AR2", 1, 0); //Updatebit wird einmal auf Null gesetzt
			break;
		case (2):
			//Updatebit wird mit 1 gesendet; entspricht Standard
			break;
		case (3):
			DisturbPDUUB("TBCSC_Hi_Rq1_AR2", 1, 0); //Updatebit wird einmal auf Null gesetzt
			break;
	}
}

CH_EISTBCSC_Hi_Rq2_AR2()
{
	switch (@sysvar::CH_Nodes::CH_EISTBCSC_Hi_Rq2_AR2_UB_AUT_01)
	{
		case (0):
			//Updatebit wird mit 1 gesendet; entspricht Standard
			break;
		case (1):
			//nur wenn manueller Wert gleich 0 ist, muss was gemacht werden
			if (@sysvar::CH_Nodes::CH_EISTBCSC_Hi_Rq2_AR2_UB_AUT_01 == 0)
				DisturbPDUUB("TBCSC_Hi_Rq2_AR2", 1, 0); //Updatebit wird einmal auf Null gesetzt
			break;
		case (2):
			//Updatebit wird mit 1 gesendet; entspricht Standard
			break;
		case (3):
			DisturbPDUUB("TBCSC_Hi_Rq2_AR2", 1, 0); //Updatebit wird einmal auf Null gesetzt
			break;
	}
}

CH_EISTBCSC_Lo_Rq1_AR2()
{
	switch (@sysvar::CH_Nodes::CH_EISTBCSC_Lo_Rq1_AR2_UB_AUT_01)
	{
		case (0):
			//Updatebit wird mit 1 gesendet; entspricht Standard
			break;
		case (1):
			//nur wenn manueller Wert gleich 0 ist, muss was gemacht werden
			if (@sysvar::CH_Nodes::CH_EISTBCSC_Lo_Rq1_AR2_UB_AUT_01 == 0)
				DisturbPDUUB("TBCSC_Lo_Rq1_AR2", 1, 0); //Updatebit wird einmal auf Null gesetzt
			break;
		case (2):
			//Updatebit wird mit 1 gesendet; entspricht Standard
			break;
		case (3):
			DisturbPDUUB("TBCSC_Lo_Rq1_AR2", 1, 0); //Updatebit wird einmal auf Null gesetzt
			break;
	}
}

CH_EISTBCSC_Lo_Rq2_AR2()
{
	switch (@sysvar::CH_Nodes::CH_EISTBCSC_Lo_Rq2_AR2_UB_AUT_01)
	{
		case (0):
			//Updatebit wird mit 1 gesendet; entspricht Standard
			break;
		case (1):
			//nur wenn manueller Wert gleich 0 ist, muss was gemacht werden
			if (@sysvar::CH_Nodes::CH_EISTBCSC_Lo_Rq2_AR2_UB_AUT_01 == 0)
				DisturbPDUUB("TBCSC_Lo_Rq2_AR2", 1, 0); //Updatebit wird einmal auf Null gesetzt
			break;
		case (2):
			//Updatebit wird mit 1 gesendet; entspricht Standard
			break;
		case (3):
			DisturbPDUUB("TBCSC_Lo_Rq2_AR2", 1, 0); //Updatebit wird einmal auf Null gesetzt
			break;
	}
}

CH_EISTC_Distance_AR()
{
	switch (@sysvar::CH_Nodes::CH_EISTC_Distance_AR_0_UB_AUT_01)
	{
		case (0):
			//Updatebit wird mit 1 gesendet; entspricht Standard
			break;
		case (1):
			//nur wenn manueller Wert gleich 0 ist, muss was gemacht werden
			if (@sysvar::CH_Nodes::CH_EISTC_Distance_AR_0_UB_AUT_01 == 0)
				DisturbPDUUB("TC_Distance_AR", 1, 0); //Updatebit wird einmal auf Null gesetzt
			break;
		case (2):
			//Updatebit wird mit 1 gesendet; entspricht Standard
			break;
		case (3):
			DisturbPDUUB("TC_Distance_AR", 1, 0); //Updatebit wird einmal auf Null gesetzt
			break;
	}
}

CH_EISTGW_DateTm_Stat_AR()
{
	switch (@sysvar::CH_Nodes::CH_EISTGW_DateTm_Stat_AR_UB_A_01)
	{
		case (0):
			//Updatebit wird mit 1 gesendet; entspricht Standard
			break;
		case (1):
			//nur wenn manueller Wert gleich 0 ist, muss was gemacht werden
			if (@sysvar::CH_Nodes::CH_EISTGW_DateTm_Stat_AR_UB_A_01 == 0)
				DisturbPDUUB("TGW_DateTm_Stat_AR", 1, 0); //Updatebit wird einmal auf Null gesetzt
			break;
		case (2):
			//Updatebit wird mit 1 gesendet; entspricht Standard
			break;
		case (3):
			DisturbPDUUB("TGW_DateTm_Stat_AR", 1, 0); //Updatebit wird einmal auf Null gesetzt
			break;
	}
}

CH_EISTire_State_AR2()
{
	switch (@sysvar::CH_Nodes::CH_EISTire_State_AR2_UB_AUTO_01)
	{
		case (0):
			//Updatebit wird mit 1 gesendet; entspricht Standard
			break;
		case (1):
			//nur wenn manueller Wert gleich 0 ist, muss was gemacht werden
			if (@sysvar::CH_Nodes::CH_EISTire_State_AR2_UB_AUTO_01 == 0)
				DisturbPDUUB("Tire_State_AR2", 1, 0); //Updatebit wird einmal auf Null gesetzt
			break;
		case (2):
			//Updatebit wird mit 1 gesendet; entspricht Standard
			break;
		case (3):
			DisturbPDUUB("Tire_State_AR2", 1, 0); //Updatebit wird einmal auf Null gesetzt
			break;
	}
}

CH_EISTrafficInfo_AR()
{
	switch (@sysvar::CH_Nodes::CH_EISTrafficInfo_AR_UB_AUTO_01)
	{
		case (0):
			//Updatebit wird mit 1 gesendet; entspricht Standard
			break;
		case (1):
			//nur wenn manueller Wert gleich 0 ist, muss was gemacht werden
			if (@sysvar::CH_Nodes::CH_EISTrafficInfo_AR_UB_AUTO_01 == 0)
				DisturbPDUUB("TrafficInfo_AR", 1, 0); //Updatebit wird einmal auf Null gesetzt
			break;
		case (2):
			//Updatebit wird mit 1 gesendet; entspricht Standard
			break;
		case (3):
			DisturbPDUUB("TrafficInfo_AR", 1, 0); //Updatebit wird einmal auf Null gesetzt
			break;
	}
}

CH_EISTrailer_Stat_AR2()
{
	switch (@sysvar::CH_Nodes::CH_EISTrailer_Stat_AR2_UB_AUT_01)
	{
		case (0):
			//Updatebit wird mit 1 gesendet; entspricht Standard
			break;
		case (1):
			//nur wenn manueller Wert gleich 0 ist, muss was gemacht werden
			if (@sysvar::CH_Nodes::CH_EISTrailer_Stat_AR2_UB_AUT_01 == 0)
				DisturbPDUUB("Trailer_Stat_AR2", 1, 0); //Updatebit wird einmal auf Null gesetzt
			break;
		case (2):
			//Updatebit wird mit 1 gesendet; entspricht Standard
			break;
		case (3):
			DisturbPDUUB("Trailer_Stat_AR2", 1, 0); //Updatebit wird einmal auf Null gesetzt
			break;
	}
}

CH_EISTSA_Disp_Rq2_AR()
{
	switch (@sysvar::CH_Nodes::CH_EISTSA_Disp_Rq2_AR_UB_AUTO_01)
	{
		case (0):
			//Updatebit wird mit 1 gesendet; entspricht Standard
			break;
		case (1):
			//nur wenn manueller Wert gleich 0 ist, muss was gemacht werden
			if (@sysvar::CH_Nodes::CH_EISTSA_Disp_Rq2_AR_UB_AUTO_01 == 0)
				DisturbPDUUB("TSA_Disp_Rq2_AR", 1, 0); //Updatebit wird einmal auf Null gesetzt
			break;
		case (2):
			//Updatebit wird mit 1 gesendet; entspricht Standard
			break;
		case (3):
			DisturbPDUUB("TSA_Disp_Rq2_AR", 1, 0); //Updatebit wird einmal auf Null gesetzt
			break;
	}
}

CH_EISTSA_Disp_Rq3_AR()
{
	switch (@sysvar::CH_Nodes::CH_EISTSA_Disp_Rq3_AR_UB_AUTO_01)
	{
		case (0):
			//Updatebit wird mit 1 gesendet; entspricht Standard
			break;
		case (1):
			//nur wenn manueller Wert gleich 0 ist, muss was gemacht werden
			if (@sysvar::CH_Nodes::CH_EISTSA_Disp_Rq3_AR_UB_AUTO_01 == 0)
				DisturbPDUUB("TSA_Disp_Rq3_AR", 1, 0); //Updatebit wird einmal auf Null gesetzt
			break;
		case (2):
			//Updatebit wird mit 1 gesendet; entspricht Standard
			break;
		case (3):
			DisturbPDUUB("TSA_Disp_Rq3_AR", 1, 0); //Updatebit wird einmal auf Null gesetzt
			break;
	}
}

CH_EISVehAccel_X_Rq_Gw_AR2()
{
	switch (@sysvar::CH_Nodes::CH_EISVehAccel_X_Rq_Gw_A_UB_A_01)
	{
		case (0):
			//Updatebit wird mit 1 gesendet; entspricht Standard
			break;
		case (1):
			//nur wenn manueller Wert gleich 0 ist, muss was gemacht werden
			if (@sysvar::CH_Nodes::CH_EISVehAccel_X_Rq_Gw_A_UB_A_01 == 0)
				DisturbPDUUB("VehAccel_X_Rq_Gw_AR2", 1, 0); //Updatebit wird einmal auf Null gesetzt
			break;
		case (2):
			//Updatebit wird mit 1 gesendet; entspricht Standard
			break;
		case (3):
			DisturbPDUUB("VehAccel_X_Rq_Gw_AR2", 1, 0); //Updatebit wird einmal auf Null gesetzt
			break;
	}
}

CH_EISYMAS_Rq_MPC_AR2()
{
	switch (@sysvar::CH_Nodes::CH_EISYMAS_Rq_MPC_AR2_UB_AUTO_01)
	{
		case (0):
			//Updatebit wird mit 1 gesendet; entspricht Standard
			break;
		case (1):
			//nur wenn manueller Wert gleich 0 ist, muss was gemacht werden
			if (@sysvar::CH_Nodes::CH_EISYMAS_Rq_MPC_AR2_UB_AUTO_01 == 0)
				DisturbPDUUB("YMAS_Rq_MPC_AR2", 1, 0); //Updatebit wird einmal auf Null gesetzt
			break;
		case (2):
			//Updatebit wird mit 1 gesendet; entspricht Standard
			break;
		case (3):
			DisturbPDUUB("YMAS_Rq_MPC_AR2", 1, 0); //Updatebit wird einmal auf Null gesetzt
			break;
	}
}

void FrILTxPending(char pduName[], long len, byte payload[], long TxAck)
{
	byte crc;
	dword SQC;
	dword MC;
	dword Tgl;
	dword i;

	if (strncmp (pduName, "ActvComf_Rq_AR2", strLen(pduName)+strLen("ActvComf_Rq_AR2")) == 0)
	{
		if (TxAck == 1)
		{
		}
		else
		{
			CH_EISRemPark_Auth_Rs_AR2();
			CH_EISActvComf_Rq_AR2();
		}
	}
	if (strncmp (pduName, "ADAS_CURRENT_ATTRIBUTES_AR", strLen(pduName)+strLen("ADAS_CURRENT_ATTRIBUTES_AR")) == 0)
	{
		if (TxAck == 1)
		{
		}
		else
		{
			CH_EISADAS_CURRENT_ATTRIBUTES_AR();
			CH_EISADAS_POSITION_AR();
		}
	}
	if (strncmp (pduName, "ADAS_POSITION_AR", strLen(pduName)+strLen("ADAS_POSITION_AR")) == 0)
	{
		if (TxAck == 1)
		{
		}
		else
		{
			CH_EISADAS_CURRENT_ATTRIBUTES_AR();
			CH_EISADAS_POSITION_AR();
		}
	}
	if (strncmp (pduName, "ADAS_PREDICTION_AR", strLen(pduName)+strLen("ADAS_PREDICTION_AR")) == 0)
	{
		if (TxAck == 1)
		{
		}
		else
		{
		}
	}
	if (strncmp (pduName, "ADAS_PROFILE_LONG_AR", strLen(pduName)+strLen("ADAS_PROFILE_LONG_AR")) == 0)
	{
		if (TxAck == 1)
		{
		}
		else
		{
		}
	}
	if (strncmp (pduName, "ADAS_PROFILE_SHORT_AR", strLen(pduName)+strLen("ADAS_PROFILE_SHORT_AR")) == 0)
	{
		if (TxAck == 1)
		{
		}
		else
		{
		}
	}
	if (strncmp (pduName, "ADASLR_POSITION_AR", strLen(pduName)+strLen("ADASLR_POSITION_AR")) == 0)
	{
		if (TxAck == 1)
		{
		}
		else
		{
			CH_EISADASLR_POSITION_AR();
			CH_EISTGW_DateTm_Stat_AR();
		}
	}
	if (strncmp (pduName, "ADASLR_PROFILE_LONG_AR", strLen(pduName)+strLen("ADASLR_PROFILE_LONG_AR")) == 0)
	{
		if (TxAck == 1)
		{
		}
		else
		{
		}
	}
	if (strncmp (pduName, "Assyst_Rq_AR2", strLen(pduName)+strLen("Assyst_Rq_AR2")) == 0)
	{
		if (TxAck == 1)
		{
		}
		else
		{
		}
	}
	if (strncmp (pduName, "BC_F_Disp_Rq_AR", strLen(pduName)+strLen("BC_F_Disp_Rq_AR")) == 0)
	{
		if (TxAck == 1)
		{
		}
		else
		{
		}
	}
	if (strncmp (pduName, "BC_F_Stat1_AR", strLen(pduName)+strLen("BC_F_Stat1_AR")) == 0)
	{
		if (TxAck == 1)
		{
		}
		else
		{
		}
	}
	if (strncmp (pduName, "BC_F_Stat2_AR2", strLen(pduName)+strLen("BC_F_Stat2_AR2")) == 0)
	{
		if (TxAck == 1)
		{
		}
		else
		{
			CH_EISBC_R_Stat1_AR();
			CH_EISBC_F_Stat2_AR2();
			CH_EISSPCR_Stat_BC_F_AR2();
		}
	}
	if (strncmp (pduName, "BC_R_Stat1_AR", strLen(pduName)+strLen("BC_R_Stat1_AR")) == 0)
	{
		if (TxAck == 1)
		{
			if (@sysvar::CH_Nodes::CH_EISBckl_Sw_3L_SAM_R_TglB_AUTO == 0)
			{
				//TGL automatisch ändern
				TGL_VAL_ckl_Sw_3L_SAM_R_ = (TGL_VAL_ckl_Sw_3L_SAM_R_ + 1) % 2;
			}
			else
			{
				//TGL manuel veränderbar
			}
			if (@sysvar::CH_Nodes::CH_EISBckl_Sw_3R_SAM_R_TglB_AUTO == 0)
			{
				//TGL automatisch ändern
				TGL_VAL_ckl_Sw_3R_SAM_R_ = (TGL_VAL_ckl_Sw_3R_SAM_R_ + 1) % 2;
			}
			else
			{
				//TGL manuel veränderbar
			}
			if (@sysvar::CH_Nodes::CH_EISBckl_Sw_RL_SAM_R_TglB_AUTO == 0)
			{
				//TGL automatisch ändern
				TGL_VAL_ckl_Sw_RL_SAM_R_ = (TGL_VAL_ckl_Sw_RL_SAM_R_ + 1) % 2;
			}
			else
			{
				//TGL manuel veränderbar
			}
			if (@sysvar::CH_Nodes::CH_EISBckl_Sw_RM_SAM_R_TglB_AUTO == 0)
			{
				//TGL automatisch ändern
				TGL_VAL_ckl_Sw_RM_SAM_R_ = (TGL_VAL_ckl_Sw_RM_SAM_R_ + 1) % 2;
			}
			else
			{
				//TGL manuel veränderbar
			}
			if (@sysvar::CH_Nodes::CH_EISBckl_Sw_RR_SAM_R_TglB_AUTO == 0)
			{
				//TGL automatisch ändern
				TGL_VAL_ckl_Sw_RR_SAM_R_ = (TGL_VAL_ckl_Sw_RR_SAM_R_ + 1) % 2;
			}
			else
			{
				//TGL manuel veränderbar
			}

		}
		else
		{
			if (@sysvar::CH_Nodes::CH_EISBckl_Sw_3L_SAM_R_TglB_AUTO == 0)
			{
				//TGL automatisch ändern
				//TGL an richtige Position 'schieben'
				for (i = 0; i < 4; i++)
				{
					TGL_VAL_ckl_Sw_3L_SAM_R_ = TGL_VAL_ckl_Sw_3L_SAM_R_ << 1;
				}
				//TGL in Byte schreiben
				payload[4] = (payload[4] & ~0x10) |  TGL_VAL_ckl_Sw_3L_SAM_R_;
				//TGL wieder zurück 'schieben'
				for (i = 0; i < 4; i++)
				{
					TGL_VAL_ckl_Sw_3L_SAM_R_ = TGL_VAL_ckl_Sw_3L_SAM_R_ >> 1;
				}
			}
			else
			{
				//TGL manuel veränderbar
			}
			if (@sysvar::CH_Nodes::CH_EISBckl_Sw_3R_SAM_R_TglB_AUTO == 0)
			{
				//TGL automatisch ändern
				//TGL an richtige Position 'schieben'
				for (i = 0; i < 6; i++)
				{
					TGL_VAL_ckl_Sw_3R_SAM_R_ = TGL_VAL_ckl_Sw_3R_SAM_R_ << 1;
				}
				//TGL in Byte schreiben
				payload[4] = (payload[4] & ~0x40) |  TGL_VAL_ckl_Sw_3R_SAM_R_;
				//TGL wieder zurück 'schieben'
				for (i = 0; i < 6; i++)
				{
					TGL_VAL_ckl_Sw_3R_SAM_R_ = TGL_VAL_ckl_Sw_3R_SAM_R_ >> 1;
				}
			}
			else
			{
				//TGL manuel veränderbar
			}
			if (@sysvar::CH_Nodes::CH_EISBckl_Sw_RL_SAM_R_TglB_AUTO == 0)
			{
				//TGL automatisch ändern
				//TGL in Byte schreiben
				payload[5] = (payload[5] & ~0x01) |  TGL_VAL_ckl_Sw_RL_SAM_R_;
			}
			else
			{
				//TGL manuel veränderbar
			}
			if (@sysvar::CH_Nodes::CH_EISBckl_Sw_RM_SAM_R_TglB_AUTO == 0)
			{
				//TGL automatisch ändern
				//TGL an richtige Position 'schieben'
				for (i = 0; i < 2; i++)
				{
					TGL_VAL_ckl_Sw_RM_SAM_R_ = TGL_VAL_ckl_Sw_RM_SAM_R_ << 1;
				}
				//TGL in Byte schreiben
				payload[5] = (payload[5] & ~0x04) |  TGL_VAL_ckl_Sw_RM_SAM_R_;
				//TGL wieder zurück 'schieben'
				for (i = 0; i < 2; i++)
				{
					TGL_VAL_ckl_Sw_RM_SAM_R_ = TGL_VAL_ckl_Sw_RM_SAM_R_ >> 1;
				}
			}
			else
			{
				//TGL manuel veränderbar
			}
			if (@sysvar::CH_Nodes::CH_EISBckl_Sw_RR_SAM_R_TglB_AUTO == 0)
			{
				//TGL automatisch ändern
				//TGL an richtige Position 'schieben'
				for (i = 0; i < 4; i++)
				{
					TGL_VAL_ckl_Sw_RR_SAM_R_ = TGL_VAL_ckl_Sw_RR_SAM_R_ << 1;
				}
				//TGL in Byte schreiben
				payload[5] = (payload[5] & ~0x10) |  TGL_VAL_ckl_Sw_RR_SAM_R_;
				//TGL wieder zurück 'schieben'
				for (i = 0; i < 4; i++)
				{
					TGL_VAL_ckl_Sw_RR_SAM_R_ = TGL_VAL_ckl_Sw_RR_SAM_R_ >> 1;
				}
			}
			else
			{
				//TGL manuel veränderbar
			}

			CH_EISBC_R_Stat1_AR();
			CH_EISBC_F_Stat2_AR2();
			CH_EISSPCR_Stat_BC_F_AR2();
		}
	}
	if (strncmp (pduName, "BLSM_Disp_Stat_AR", strLen(pduName)+strLen("BLSM_Disp_Stat_AR")) == 0)
	{
		if (TxAck == 1)
		{
		}
		else
		{
		}
	}
	if (strncmp (pduName, "BODY_CHASSIS_R1_AR", strLen(pduName)+strLen("BODY_CHASSIS_R1_AR")) == 0)
	{
		if (TxAck == 1)
		{
		}
		else
		{
			CH_EISSPV_Alm_Rq_AR();
			CH_EISBODY_CHASSIS_R1_AR();
			CH_EISSPV_Actn_Rq_AR2();
		}
	}
	if (strncmp (pduName, "BSM_Disp_Warn_Rq_AR2", strLen(pduName)+strLen("BSM_Disp_Warn_Rq_AR2")) == 0)
	{
		if (TxAck == 1)
		{
		}
		else
		{
			CH_EISNVP_Stat1_AR2();
			CH_EISBSM_Disp_Warn_Rq_AR2();
			CH_EISSPL_Obj1_Obj2_NV_AR2();
		}
	}
	if (strncmp (pduName, "CamLane_Disp_Warn_Rq_AR2", strLen(pduName)+strLen("CamLane_Disp_Warn_Rq_AR2")) == 0)
	{
		if (TxAck == 1)
		{
			if (@sysvar::CH_Nodes::CH_EISSQC_CamLane_Disp_Warn_AUTO == 0)
			{
				//SQC automatisch ändern
				SQC_VAL_CamLane_Disp_Warn_Rq_Pr2 = (SQC_VAL_CamLane_Disp_Warn_Rq_Pr2 + 1) % 16;
			}
			else
			{
				//SQC manuel veränderbar
			}

		}
		else
		{
			if (@sysvar::CH_Nodes::CH_EISSQC_CamLane_Disp_Warn_AUTO == 0)
			{
				//SQC automatisch ändern
				//SQC für CRC speichern
				CounterValForCRC_CamLane_Disp_Warn_Rq_Pr2 = SQC_VAL_CamLane_Disp_Warn_Rq_Pr2;
				//SQC in Byte schreiben
				payload[1] = (payload[1] & ~0x0F) |  SQC_VAL_CamLane_Disp_Warn_Rq_Pr2;
			}
			else
			{
				//SQC manuel veränderbar
			}

			if (@sysvar::CH_Nodes::CH_EISCRC_CamLane_Disp_Warn_AUTO == 0)
			{
				//CRC automatisch berechnen
				crc = 0xFF;
				crc = crctableProfTwo[crc ^ payload[1]];
				crc = crctableProfTwo[crc ^ payload[2]];
				crc = crctableProfTwo[crc ^ payload[3]];
				crc = crctableProfTwo[crc ^ payload[4]];
				crc = crctableProfTwo[crc ^ payload[5]];
				crc = crctableProfTwo[crc ^ payload[6]];
				crc = crctableProfTwo[crc ^ payload[7]];
				switch (CounterValForCRC_CamLane_Disp_Warn_Rq_Pr2)
				{
					case(0) :
						crc = crctableProfTwo[crc ^ 227];
						break;
					case(1) :
						crc = crctableProfTwo[crc ^ 71];
						break;
					case(2) :
						crc = crctableProfTwo[crc ^ 166];
						break;
					case(3) :
						crc = crctableProfTwo[crc ^ 10];
						break;
					case(4) :
						crc = crctableProfTwo[crc ^ 105];
						break;
					case(5) :
						crc = crctableProfTwo[crc ^ 200];
						break;
					case(6) :
						crc = crctableProfTwo[crc ^ 44];
						break;
					case(7) :
						crc = crctableProfTwo[crc ^ 139];
						break;
					case(8) :
						crc = crctableProfTwo[crc ^ 234];
						break;
					case(9) :
						crc = crctableProfTwo[crc ^ 78];
						break;
					case(10) :
						crc = crctableProfTwo[crc ^ 173];
						break;
					case(11) :
						crc = crctableProfTwo[crc ^ 17];
						break;
					case(12) :
						crc = crctableProfTwo[crc ^ 112];
						break;
					case(13) :
						crc = crctableProfTwo[crc ^ 207];
						break;
					case(14) :
						crc = crctableProfTwo[crc ^ 51];
						break;
					case(15) :
						crc = crctableProfTwo[crc ^ 146];
						break;
					default :
//						write("error: wrong parameter (%d)",CounterValForCRC_CamLane_Disp_Warn_Rq_Pr2); stop();
						break;
				}
				crc = (crc ^ 0xFF);
				payload[0] = crc;
			}
			else
			{
				//CRC manuel veränderbar
			}

			CH_EISCamLane_LaneAttr1_AR2();
			CH_EISCamLane_LaneAttr2_AR2();
			CH_EISCamLane_Disp_Warn_Rq_AR2();
			CH_EISCamLane_LaneAttr3_AR2();
		}
	}
	if (strncmp (pduName, "CamLane_LaneAttr1_AR2", strLen(pduName)+strLen("CamLane_LaneAttr1_AR2")) == 0)
	{
		if (TxAck == 1)
		{
			if (@sysvar::CH_Nodes::CH_EISSQC_CamLane_LaneAttr1_AUTO == 0)
			{
				//SQC automatisch ändern
				SQC_VAL_CamLane_LaneAttr1_Pr2 = (SQC_VAL_CamLane_LaneAttr1_Pr2 + 1) % 16;
			}
			else
			{
				//SQC manuel veränderbar
			}

		}
		else
		{
			if (@sysvar::CH_Nodes::CH_EISSQC_CamLane_LaneAttr1_AUTO == 0)
			{
				//SQC automatisch ändern
				//SQC für CRC speichern
				CounterValForCRC_CamLane_LaneAttr1_Pr2 = SQC_VAL_CamLane_LaneAttr1_Pr2;
				//SQC in Byte schreiben
				payload[1] = (payload[1] & ~0x0F) |  SQC_VAL_CamLane_LaneAttr1_Pr2;
			}
			else
			{
				//SQC manuel veränderbar
			}

			if (@sysvar::CH_Nodes::CH_EISCRC_CamLane_LaneAttr1_AUTO == 0)
			{
				//CRC automatisch berechnen
				crc = 0xFF;
				crc = crctableProfTwo[crc ^ payload[1]];
				crc = crctableProfTwo[crc ^ payload[2]];
				crc = crctableProfTwo[crc ^ payload[3]];
				crc = crctableProfTwo[crc ^ payload[4]];
				crc = crctableProfTwo[crc ^ payload[5]];
				crc = crctableProfTwo[crc ^ payload[6]];
				crc = crctableProfTwo[crc ^ payload[7]];
				switch (CounterValForCRC_CamLane_LaneAttr1_Pr2)
				{
					case(0) :
						crc = crctableProfTwo[crc ^ 95];
						break;
					case(1) :
						crc = crctableProfTwo[crc ^ 30];
						break;
					case(2) :
						crc = crctableProfTwo[crc ^ 216];
						break;
					case(3) :
						crc = crctableProfTwo[crc ^ 151];
						break;
					case(4) :
						crc = crctableProfTwo[crc ^ 86];
						break;
					case(5) :
						crc = crctableProfTwo[crc ^ 21];
						break;
					case(6) :
						crc = crctableProfTwo[crc ^ 207];
						break;
					case(7) :
						crc = crctableProfTwo[crc ^ 142];
						break;
					case(8) :
						crc = crctableProfTwo[crc ^ 77];
						break;
					case(9) :
						crc = crctableProfTwo[crc ^ 12];
						break;
					case(10) :
						crc = crctableProfTwo[crc ^ 198];
						break;
					case(11) :
						crc = crctableProfTwo[crc ^ 133];
						break;
					case(12) :
						crc = crctableProfTwo[crc ^ 68];
						break;
					case(13) :
						crc = crctableProfTwo[crc ^ 3];
						break;
					case(14) :
						crc = crctableProfTwo[crc ^ 189];
						break;
					case(15) :
						crc = crctableProfTwo[crc ^ 124];
						break;
					default :
//						write("error: wrong parameter (%d)",CounterValForCRC_CamLane_LaneAttr1_Pr2); stop();
						break;
				}
				crc = (crc ^ 0xFF);
				payload[0] = crc;
			}
			else
			{
				//CRC manuel veränderbar
			}

			CH_EISCamLane_LaneAttr1_AR2();
			CH_EISCamLane_LaneAttr2_AR2();
			CH_EISCamLane_Disp_Warn_Rq_AR2();
			CH_EISCamLane_LaneAttr3_AR2();
		}
	}
	if (strncmp (pduName, "CamLane_LaneAttr2_AR2", strLen(pduName)+strLen("CamLane_LaneAttr2_AR2")) == 0)
	{
		if (TxAck == 1)
		{
			if (@sysvar::CH_Nodes::CH_EISSQC_CamLane_LaneAttr2_AUTO == 0)
			{
				//SQC automatisch ändern
				SQC_VAL_CamLane_LaneAttr2_Pr2 = (SQC_VAL_CamLane_LaneAttr2_Pr2 + 1) % 16;
			}
			else
			{
				//SQC manuel veränderbar
			}

		}
		else
		{
			if (@sysvar::CH_Nodes::CH_EISSQC_CamLane_LaneAttr2_AUTO == 0)
			{
				//SQC automatisch ändern
				//SQC für CRC speichern
				CounterValForCRC_CamLane_LaneAttr2_Pr2 = SQC_VAL_CamLane_LaneAttr2_Pr2;
				//SQC in Byte schreiben
				payload[1] = (payload[1] & ~0x0F) |  SQC_VAL_CamLane_LaneAttr2_Pr2;
			}
			else
			{
				//SQC manuel veränderbar
			}

			if (@sysvar::CH_Nodes::CH_EISCRC_CamLane_LaneAttr2_AUTO == 0)
			{
				//CRC automatisch berechnen
				crc = 0xFF;
				crc = crctableProfTwo[crc ^ payload[1]];
				crc = crctableProfTwo[crc ^ payload[2]];
				crc = crctableProfTwo[crc ^ payload[3]];
				crc = crctableProfTwo[crc ^ payload[4]];
				crc = crctableProfTwo[crc ^ payload[5]];
				crc = crctableProfTwo[crc ^ payload[6]];
				crc = crctableProfTwo[crc ^ payload[7]];
				switch (CounterValForCRC_CamLane_LaneAttr2_Pr2)
				{
					case(0) :
						crc = crctableProfTwo[crc ^ 248];
						break;
					case(1) :
						crc = crctableProfTwo[crc ^ 53];
						break;
					case(2) :
						crc = crctableProfTwo[crc ^ 109];
						break;
					case(3) :
						crc = crctableProfTwo[crc ^ 165];
						break;
					case(4) :
						crc = crctableProfTwo[crc ^ 221];
						break;
					case(5) :
						crc = crctableProfTwo[crc ^ 26];
						break;
					case(6) :
						crc = crctableProfTwo[crc ^ 82];
						break;
					case(7) :
						crc = crctableProfTwo[crc ^ 138];
						break;
					case(8) :
						crc = crctableProfTwo[crc ^ 194];
						break;
					case(9) :
						crc = crctableProfTwo[crc ^ 250];
						break;
					case(10) :
						crc = crctableProfTwo[crc ^ 55];
						break;
					case(11) :
						crc = crctableProfTwo[crc ^ 111];
						break;
					case(12) :
						crc = crctableProfTwo[crc ^ 167];
						break;
					case(13) :
						crc = crctableProfTwo[crc ^ 223];
						break;
					case(14) :
						crc = crctableProfTwo[crc ^ 28];
						break;
					case(15) :
						crc = crctableProfTwo[crc ^ 84];
						break;
					default :
//						write("error: wrong parameter (%d)",CounterValForCRC_CamLane_LaneAttr2_Pr2); stop();
						break;
				}
				crc = (crc ^ 0xFF);
				payload[0] = crc;
			}
			else
			{
				//CRC manuel veränderbar
			}

			CH_EISCamLane_LaneAttr1_AR2();
			CH_EISCamLane_LaneAttr2_AR2();
			CH_EISCamLane_Disp_Warn_Rq_AR2();
			CH_EISCamLane_LaneAttr3_AR2();
		}
	}
	if (strncmp (pduName, "CamLane_LaneAttr3_AR2", strLen(pduName)+strLen("CamLane_LaneAttr3_AR2")) == 0)
	{
		if (TxAck == 1)
		{
			if (@sysvar::CH_Nodes::CH_EISSQC_CamLane_LaneAttr3_AUTO == 0)
			{
				//SQC automatisch ändern
				SQC_VAL_CamLane_LaneAttr3_Pr2 = (SQC_VAL_CamLane_LaneAttr3_Pr2 + 1) % 16;
			}
			else
			{
				//SQC manuel veränderbar
			}

		}
		else
		{
			if (@sysvar::CH_Nodes::CH_EISSQC_CamLane_LaneAttr3_AUTO == 0)
			{
				//SQC automatisch ändern
				//SQC für CRC speichern
				CounterValForCRC_CamLane_LaneAttr3_Pr2 = SQC_VAL_CamLane_LaneAttr3_Pr2;
				//SQC in Byte schreiben
				payload[1] = (payload[1] & ~0x0F) |  SQC_VAL_CamLane_LaneAttr3_Pr2;
			}
			else
			{
				//SQC manuel veränderbar
			}

			if (@sysvar::CH_Nodes::CH_EISCRC_CamLane_LaneAttr3_AUTO == 0)
			{
				//CRC automatisch berechnen
				crc = 0xFF;
				crc = crctableProfTwo[crc ^ payload[1]];
				crc = crctableProfTwo[crc ^ payload[2]];
				crc = crctableProfTwo[crc ^ payload[3]];
				crc = crctableProfTwo[crc ^ payload[4]];
				crc = crctableProfTwo[crc ^ payload[5]];
				crc = crctableProfTwo[crc ^ payload[6]];
				crc = crctableProfTwo[crc ^ payload[7]];
				switch (CounterValForCRC_CamLane_LaneAttr3_Pr2)
				{
					case(0) :
						crc = crctableProfTwo[crc ^ 248];
						break;
					case(1) :
						crc = crctableProfTwo[crc ^ 142];
						break;
					case(2) :
						crc = crctableProfTwo[crc ^ 36];
						break;
					case(3) :
						crc = crctableProfTwo[crc ^ 181];
						break;
					case(4) :
						crc = crctableProfTwo[crc ^ 75];
						break;
					case(5) :
						crc = crctableProfTwo[crc ^ 220];
						break;
					case(6) :
						crc = crctableProfTwo[crc ^ 114];
						break;
					case(7) :
						crc = crctableProfTwo[crc ^ 8];
						break;
					case(8) :
						crc = crctableProfTwo[crc ^ 153];
						break;
					case(9) :
						crc = crctableProfTwo[crc ^ 47];
						break;
					case(10) :
						crc = crctableProfTwo[crc ^ 192];
						break;
					case(11) :
						crc = crctableProfTwo[crc ^ 86];
						break;
					case(12) :
						crc = crctableProfTwo[crc ^ 231];
						break;
					case(13) :
						crc = crctableProfTwo[crc ^ 125];
						break;
					case(14) :
						crc = crctableProfTwo[crc ^ 19];
						break;
					case(15) :
						crc = crctableProfTwo[crc ^ 164];
						break;
					default :
//						write("error: wrong parameter (%d)",CounterValForCRC_CamLane_LaneAttr3_Pr2); stop();
						break;
				}
				crc = (crc ^ 0xFF);
				payload[0] = crc;
			}
			else
			{
				//CRC manuel veränderbar
			}

			CH_EISCamLane_LaneAttr1_AR2();
			CH_EISCamLane_LaneAttr2_AR2();
			CH_EISCamLane_Disp_Warn_Rq_AR2();
			CH_EISCamLane_LaneAttr3_AR2();
		}
	}
	if (strncmp (pduName, "CamLane_LaneAttr6_AR2", strLen(pduName)+strLen("CamLane_LaneAttr6_AR2")) == 0)
	{
		if (TxAck == 1)
		{
			if (@sysvar::CH_Nodes::CH_EISSQC_CamLane_LaneAttr6_AUTO == 0)
			{
				//SQC automatisch ändern
				SQC_VAL_CamLane_LaneAttr6_Pr2 = (SQC_VAL_CamLane_LaneAttr6_Pr2 + 1) % 16;
			}
			else
			{
				//SQC manuel veränderbar
			}

		}
		else
		{
			if (@sysvar::CH_Nodes::CH_EISSQC_CamLane_LaneAttr6_AUTO == 0)
			{
				//SQC automatisch ändern
				//SQC für CRC speichern
				CounterValForCRC_CamLane_LaneAttr6_Pr2 = SQC_VAL_CamLane_LaneAttr6_Pr2;
				//SQC in Byte schreiben
				payload[1] = (payload[1] & ~0x0F) |  SQC_VAL_CamLane_LaneAttr6_Pr2;
			}
			else
			{
				//SQC manuel veränderbar
			}

			if (@sysvar::CH_Nodes::CH_EISCRC_CamLane_LaneAttr6_AUTO == 0)
			{
				//CRC automatisch berechnen
				crc = 0xFF;
				crc = crctableProfTwo[crc ^ payload[1]];
				crc = crctableProfTwo[crc ^ payload[2]];
				crc = crctableProfTwo[crc ^ payload[3]];
				crc = crctableProfTwo[crc ^ payload[4]];
				crc = crctableProfTwo[crc ^ payload[5]];
				crc = crctableProfTwo[crc ^ payload[6]];
				crc = crctableProfTwo[crc ^ payload[7]];
				switch (CounterValForCRC_CamLane_LaneAttr6_Pr2)
				{
					case(0) :
						crc = crctableProfTwo[crc ^ 202];
						break;
					case(1) :
						crc = crctableProfTwo[crc ^ 193];
						break;
					case(2) :
						crc = crctableProfTwo[crc ^ 184];
						break;
					case(3) :
						crc = crctableProfTwo[crc ^ 175];
						break;
					case(4) :
						crc = crctableProfTwo[crc ^ 166];
						break;
					case(5) :
						crc = crctableProfTwo[crc ^ 157];
						break;
					case(6) :
						crc = crctableProfTwo[crc ^ 148];
						break;
					case(7) :
						crc = crctableProfTwo[crc ^ 139];
						break;
					case(8) :
						crc = crctableProfTwo[crc ^ 130];
						break;
					case(9) :
						crc = crctableProfTwo[crc ^ 121];
						break;
					case(10) :
						crc = crctableProfTwo[crc ^ 112];
						break;
					case(11) :
						crc = crctableProfTwo[crc ^ 103];
						break;
					case(12) :
						crc = crctableProfTwo[crc ^ 94];
						break;
					case(13) :
						crc = crctableProfTwo[crc ^ 85];
						break;
					case(14) :
						crc = crctableProfTwo[crc ^ 76];
						break;
					case(15) :
						crc = crctableProfTwo[crc ^ 67];
						break;
					default :
//						write("error: wrong parameter (%d)",CounterValForCRC_CamLane_LaneAttr6_Pr2); stop();
						break;
				}
				crc = (crc ^ 0xFF);
				payload[0] = crc;
			}
			else
			{
				//CRC manuel veränderbar
			}

			CH_EISYMAS_Rq_MPC_AR2();
			CH_EISCamLane_LaneAttr7_AR2();
			CH_EISCamLane_LaneAttr6_AR2();
		}
	}
	if (strncmp (pduName, "CamLane_LaneAttr7_AR2", strLen(pduName)+strLen("CamLane_LaneAttr7_AR2")) == 0)
	{
		if (TxAck == 1)
		{
			if (@sysvar::CH_Nodes::CH_EISSQC_CamLane_LaneAttr7_AUTO == 0)
			{
				//SQC automatisch ändern
				SQC_VAL_CamLane_LaneAttr7_Pr2 = (SQC_VAL_CamLane_LaneAttr7_Pr2 + 1) % 16;
			}
			else
			{
				//SQC manuel veränderbar
			}

		}
		else
		{
			if (@sysvar::CH_Nodes::CH_EISSQC_CamLane_LaneAttr7_AUTO == 0)
			{
				//SQC automatisch ändern
				//SQC für CRC speichern
				CounterValForCRC_CamLane_LaneAttr7_Pr2 = SQC_VAL_CamLane_LaneAttr7_Pr2;
				//SQC in Byte schreiben
				payload[1] = (payload[1] & ~0x0F) |  SQC_VAL_CamLane_LaneAttr7_Pr2;
			}
			else
			{
				//SQC manuel veränderbar
			}

			if (@sysvar::CH_Nodes::CH_EISCRC_CamLane_LaneAttr7_AUTO == 0)
			{
				//CRC automatisch berechnen
				crc = 0xFF;
				crc = crctableProfTwo[crc ^ payload[1]];
				crc = crctableProfTwo[crc ^ payload[2]];
				crc = crctableProfTwo[crc ^ payload[3]];
				crc = crctableProfTwo[crc ^ payload[4]];
				crc = crctableProfTwo[crc ^ payload[5]];
				crc = crctableProfTwo[crc ^ payload[6]];
				crc = crctableProfTwo[crc ^ payload[7]];
				switch (CounterValForCRC_CamLane_LaneAttr7_Pr2)
				{
					case(0) :
						crc = crctableProfTwo[crc ^ 102];
						break;
					case(1) :
						crc = crctableProfTwo[crc ^ 163];
						break;
					case(2) :
						crc = crctableProfTwo[crc ^ 224];
						break;
					case(3) :
						crc = crctableProfTwo[crc ^ 34];
						break;
					case(4) :
						crc = crctableProfTwo[crc ^ 95];
						break;
					case(5) :
						crc = crctableProfTwo[crc ^ 156];
						break;
					case(6) :
						crc = crctableProfTwo[crc ^ 217];
						break;
					case(7) :
						crc = crctableProfTwo[crc ^ 27];
						break;
					case(8) :
						crc = crctableProfTwo[crc ^ 88];
						break;
					case(9) :
						crc = crctableProfTwo[crc ^ 149];
						break;
					case(10) :
						crc = crctableProfTwo[crc ^ 210];
						break;
					case(11) :
						crc = crctableProfTwo[crc ^ 20];
						break;
					case(12) :
						crc = crctableProfTwo[crc ^ 81];
						break;
					case(13) :
						crc = crctableProfTwo[crc ^ 142];
						break;
					case(14) :
						crc = crctableProfTwo[crc ^ 203];
						break;
					case(15) :
						crc = crctableProfTwo[crc ^ 13];
						break;
					default :
//						write("error: wrong parameter (%d)",CounterValForCRC_CamLane_LaneAttr7_Pr2); stop();
						break;
				}
				crc = (crc ^ 0xFF);
				payload[0] = crc;
			}
			else
			{
				//CRC manuel veränderbar
			}

			CH_EISYMAS_Rq_MPC_AR2();
			CH_EISCamLane_LaneAttr7_AR2();
			CH_EISCamLane_LaneAttr6_AR2();
		}
	}
	if (strncmp (pduName, "CLkS_Rq_AR", strLen(pduName)+strLen("CLkS_Rq_AR")) == 0)
	{
		if (TxAck == 1)
		{
		}
		else
		{
			CH_EISRemPark_Stat_EIS_AR2();
			CH_EISCLkS_State_AR();
			CH_EISIgn_Veh_Stat_AR2();
			CH_EISCLkS_Rq_AR();
		}
	}
	if (strncmp (pduName, "CLkS_State_AR", strLen(pduName)+strLen("CLkS_State_AR")) == 0)
	{
		if (TxAck == 1)
		{
		}
		else
		{
			CH_EISRemPark_Stat_EIS_AR2();
			CH_EISCLkS_State_AR();
			CH_EISIgn_Veh_Stat_AR2();
			CH_EISCLkS_Rq_AR();
		}
	}
	if (strncmp (pduName, "ClockSync_Stat_FR2", strLen(pduName)+strLen("ClockSync_Stat_FR2")) == 0)
	{
		if (TxAck == 1)
		{
			if (@sysvar::CH_Nodes::CH_EISSQC_ClockSync_Stat_Pr_AUTO == 0)
			{
				//SQC automatisch ändern
				SQC_VAL_ClockSync_Stat_Pr2 = (SQC_VAL_ClockSync_Stat_Pr2 + 1) % 16;
			}
			else
			{
				//SQC manuel veränderbar
			}

		}
		else
		{
			if (@sysvar::CH_Nodes::CH_EISSQC_ClockSync_Stat_Pr_AUTO == 0)
			{
				//SQC automatisch ändern
				//SQC für CRC speichern
				CounterValForCRC_ClockSync_Stat_Pr2 = SQC_VAL_ClockSync_Stat_Pr2;
				//SQC in Byte schreiben
				payload[2] = (payload[2] & ~0x0F) |  SQC_VAL_ClockSync_Stat_Pr2;
			}
			else
			{
				//SQC manuel veränderbar
			}

			if (@sysvar::CH_Nodes::CH_EISCRC_ClockSync_Stat_Pr_AUTO == 0)
			{
				//CRC automatisch berechnen
				crc = 0xFF;
				crc = crctableProfTwo[crc ^ payload[2]];
				crc = crctableProfTwo[crc ^ payload[3]];
				crc = crctableProfTwo[crc ^ payload[4]];
				crc = crctableProfTwo[crc ^ payload[5]];
				crc = crctableProfTwo[crc ^ payload[6]];
				crc = crctableProfTwo[crc ^ payload[7]];
				crc = crctableProfTwo[crc ^ payload[8]];
				crc = crctableProfTwo[crc ^ payload[9]];
				crc = crctableProfTwo[crc ^ payload[10]];
				crc = crctableProfTwo[crc ^ payload[11]];
				crc = crctableProfTwo[crc ^ payload[12]];
				crc = crctableProfTwo[crc ^ payload[13]];
				crc = crctableProfTwo[crc ^ payload[14]];
				crc = crctableProfTwo[crc ^ payload[15]];
				switch (CounterValForCRC_ClockSync_Stat_Pr2)
				{
					case(0) :
						crc = crctableProfTwo[crc ^ 209];
						break;
					case(1) :
						crc = crctableProfTwo[crc ^ 133];
						break;
					case(2) :
						crc = crctableProfTwo[crc ^ 57];
						break;
					case(3) :
						crc = crctableProfTwo[crc ^ 232];
						break;
					case(4) :
						crc = crctableProfTwo[crc ^ 156];
						break;
					case(5) :
						crc = crctableProfTwo[crc ^ 80];
						break;
					case(6) :
						crc = crctableProfTwo[crc ^ 4];
						break;
					case(7) :
						crc = crctableProfTwo[crc ^ 179];
						break;
					case(8) :
						crc = crctableProfTwo[crc ^ 103];
						break;
					case(9) :
						crc = crctableProfTwo[crc ^ 27];
						break;
					case(10) :
						crc = crctableProfTwo[crc ^ 202];
						break;
					case(11) :
						crc = crctableProfTwo[crc ^ 126];
						break;
					case(12) :
						crc = crctableProfTwo[crc ^ 50];
						break;
					case(13) :
						crc = crctableProfTwo[crc ^ 225];
						break;
					case(14) :
						crc = crctableProfTwo[crc ^ 149];
						break;
					case(15) :
						crc = crctableProfTwo[crc ^ 73];
						break;
					default :
//						write("error: wrong parameter (%d)",CounterValForCRC_ClockSync_Stat_Pr2); stop();
						break;
				}
				crc = (crc ^ 0xFF);
				payload[1] = crc;
			}
			else
			{
				//CRC manuel veränderbar
			}

		}
	}
	if (strncmp (pduName, "CMS_PI_State_Gw_AR2", strLen(pduName)+strLen("CMS_PI_State_Gw_AR2")) == 0)
	{
		if (TxAck == 1)
		{
			if (@sysvar::CH_Nodes::CH_EISSQC_CMS_PI_Stat_Pr2CM_AUTO == 0)
			{
				//SQC automatisch ändern
				SQC_VAL_CMS_PI_Stat_Pr2 = (SQC_VAL_CMS_PI_Stat_Pr2 + 1) % 16;
			}
			else
			{
				//SQC manuel veränderbar
			}

		}
		else
		{
			if (@sysvar::CH_Nodes::CH_EISSQC_CMS_PI_Stat_Pr2CM_AUTO == 0)
			{
				//SQC automatisch ändern
				//SQC für CRC speichern
				CounterValForCRC_CMS_PI_Stat_Pr2 = SQC_VAL_CMS_PI_Stat_Pr2;
				//SQC in Byte schreiben
				payload[1] = (payload[1] & ~0x0F) |  SQC_VAL_CMS_PI_Stat_Pr2;
			}
			else
			{
				//SQC manuel veränderbar
			}

			if (@sysvar::CH_Nodes::CH_EISCRC_CMS_PI_Stat_Pr2CM_AUTO == 0)
			{
				//CRC automatisch berechnen
				crc = 0xFF;
				crc = crctableProfTwo[crc ^ payload[1]];
				crc = crctableProfTwo[crc ^ payload[2]];
				crc = crctableProfTwo[crc ^ payload[3]];
				crc = crctableProfTwo[crc ^ payload[4]];
				crc = crctableProfTwo[crc ^ payload[5]];
				crc = crctableProfTwo[crc ^ payload[6]];
				crc = crctableProfTwo[crc ^ payload[7]];
				switch (CounterValForCRC_CMS_PI_Stat_Pr2)
				{
					case(0) :
						crc = crctableProfTwo[crc ^ 240];
						break;
					case(1) :
						crc = crctableProfTwo[crc ^ 207];
						break;
					case(2) :
						crc = crctableProfTwo[crc ^ 174];
						break;
					case(3) :
						crc = crctableProfTwo[crc ^ 141];
						break;
					case(4) :
						crc = crctableProfTwo[crc ^ 108];
						break;
					case(5) :
						crc = crctableProfTwo[crc ^ 75];
						break;
					case(6) :
						crc = crctableProfTwo[crc ^ 42];
						break;
					case(7) :
						crc = crctableProfTwo[crc ^ 9];
						break;
					case(8) :
						crc = crctableProfTwo[crc ^ 227];
						break;
					case(9) :
						crc = crctableProfTwo[crc ^ 194];
						break;
					case(10) :
						crc = crctableProfTwo[crc ^ 161];
						break;
					case(11) :
						crc = crctableProfTwo[crc ^ 128];
						break;
					case(12) :
						crc = crctableProfTwo[crc ^ 95];
						break;
					case(13) :
						crc = crctableProfTwo[crc ^ 62];
						break;
					case(14) :
						crc = crctableProfTwo[crc ^ 29];
						break;
					case(15) :
						crc = crctableProfTwo[crc ^ 247];
						break;
					default :
//						write("error: wrong parameter (%d)",CounterValForCRC_CMS_PI_Stat_Pr2); stop();
						break;
				}
				crc = (crc ^ 0xFF);
				payload[0] = crc;
			}
			else
			{
				//CRC manuel veränderbar
			}

			CH_EISPT_ObjIntrst_Gw_AR2();
			CH_EISCMS_PI_State_Gw_AR2();
			CH_EISVehAccel_X_Rq_Gw_AR2();
			CH_EISFCW_Disp_Rq_AR();
		}
	}
	if (strncmp (pduName, "Config_HU4_AR2", strLen(pduName)+strLen("Config_HU4_AR2")) == 0)
	{
		if (TxAck == 1)
		{
		}
		else
		{
		}
	}
	if (strncmp (pduName, "Config_HU5_AR2", strLen(pduName)+strLen("Config_HU5_AR2")) == 0)
	{
		if (TxAck == 1)
		{
		}
		else
		{
		}
	}
	if (strncmp (pduName, "CRCM_Stat_AR", strLen(pduName)+strLen("CRCM_Stat_AR")) == 0)
	{
		if (TxAck == 1)
		{
		}
		else
		{
		}
	}
	if (strncmp (pduName, "CTRL_C_Stat1_AR", strLen(pduName)+strLen("CTRL_C_Stat1_AR")) == 0)
	{
		if (TxAck == 1)
		{
		}
		else
		{
			CH_EISSVS_Rq_HU_AR2();
			CH_EISTrafficInfo_AR();
			CH_EISHU_State_AR();
			CH_EISTire_State_AR2();
			CH_EISCTRL_C_Stat1_AR();
		}
	}
	if (strncmp (pduName, "DAC4_ECM_AR", strLen(pduName)+strLen("DAC4_ECM_AR")) == 0)
	{
		if (TxAck == 1)
		{
		}
		else
		{
			CH_EISDAC4_TCM_AR();
			CH_EISDAC4_EM2_AR();
			CH_EISDAC4_ISM_AR();
			CH_EISDAC4_ECM_AR();
		}
	}
	if (strncmp (pduName, "DAC4_EM2_AR", strLen(pduName)+strLen("DAC4_EM2_AR")) == 0)
	{
		if (TxAck == 1)
		{
		}
		else
		{
			CH_EISDAC4_TCM_AR();
			CH_EISDAC4_EM2_AR();
			CH_EISDAC4_ISM_AR();
			CH_EISDAC4_ECM_AR();
		}
	}
	if (strncmp (pduName, "DAC4_ISM_AR", strLen(pduName)+strLen("DAC4_ISM_AR")) == 0)
	{
		if (TxAck == 1)
		{
		}
		else
		{
			CH_EISDAC4_TCM_AR();
			CH_EISDAC4_EM2_AR();
			CH_EISDAC4_ISM_AR();
			CH_EISDAC4_ECM_AR();
		}
	}
	if (strncmp (pduName, "DAC4_TCM_AR", strLen(pduName)+strLen("DAC4_TCM_AR")) == 0)
	{
		if (TxAck == 1)
		{
		}
		else
		{
			CH_EISDAC4_TCM_AR();
			CH_EISDAC4_EM2_AR();
			CH_EISDAC4_ISM_AR();
			CH_EISDAC4_ECM_AR();
		}
	}
	if (strncmp (pduName, "Dimming_Stat_AR2", strLen(pduName)+strLen("Dimming_Stat_AR2")) == 0)
	{
		if (TxAck == 1)
		{
		}
		else
		{
		}
	}
	if (strncmp (pduName, "Door_FL_Stat_AR2", strLen(pduName)+strLen("Door_FL_Stat_AR2")) == 0)
	{
		if (TxAck == 1)
		{
			if (@sysvar::CH_Nodes::CH_EISSQC_Door_FL_Stat_Pr2D_AUTO == 0)
			{
				//SQC automatisch ändern
				SQC_VAL_Door_FL_Stat_Pr2 = (SQC_VAL_Door_FL_Stat_Pr2 + 1) % 16;
			}
			else
			{
				//SQC manuel veränderbar
			}

		}
		else
		{
			if (@sysvar::CH_Nodes::CH_EISSQC_Door_FL_Stat_Pr2D_AUTO == 0)
			{
				//SQC automatisch ändern
				//SQC für CRC speichern
				CounterValForCRC_Door_FL_Stat_Pr2 = SQC_VAL_Door_FL_Stat_Pr2;
				//SQC in Byte schreiben
				payload[1] = (payload[1] & ~0x0F) |  SQC_VAL_Door_FL_Stat_Pr2;
			}
			else
			{
				//SQC manuel veränderbar
			}

			if (@sysvar::CH_Nodes::CH_EISCRC_Door_FL_Stat_Pr2D_AUTO == 0)
			{
				//CRC automatisch berechnen
				crc = 0xFF;
				crc = crctableProfTwo[crc ^ payload[1]];
				switch (CounterValForCRC_Door_FL_Stat_Pr2)
				{
					case(0) :
						crc = crctableProfTwo[crc ^ 51];
						break;
					case(1) :
						crc = crctableProfTwo[crc ^ 140];
						break;
					case(2) :
						crc = crctableProfTwo[crc ^ 229];
						break;
					case(3) :
						crc = crctableProfTwo[crc ^ 67];
						break;
					case(4) :
						crc = crctableProfTwo[crc ^ 156];
						break;
					case(5) :
						crc = crctableProfTwo[crc ^ 245];
						break;
					case(6) :
						crc = crctableProfTwo[crc ^ 83];
						break;
					case(7) :
						crc = crctableProfTwo[crc ^ 172];
						break;
					case(8) :
						crc = crctableProfTwo[crc ^ 10];
						break;
					case(9) :
						crc = crctableProfTwo[crc ^ 99];
						break;
					case(10) :
						crc = crctableProfTwo[crc ^ 188];
						break;
					case(11) :
						crc = crctableProfTwo[crc ^ 26];
						break;
					case(12) :
						crc = crctableProfTwo[crc ^ 115];
						break;
					case(13) :
						crc = crctableProfTwo[crc ^ 204];
						break;
					case(14) :
						crc = crctableProfTwo[crc ^ 42];
						break;
					case(15) :
						crc = crctableProfTwo[crc ^ 131];
						break;
					default :
//						write("error: wrong parameter (%d)",CounterValForCRC_Door_FL_Stat_Pr2); stop();
						break;
				}
				crc = (crc ^ 0xFF);
				payload[0] = crc;
			}
			else
			{
				//CRC manuel veränderbar
			}

			CH_EISDoor_FL_Stat_AR2();
			CH_EISDoor_RR_Stat_AR2();
			CH_EISKG_State_AR2();
			CH_EISDoor_FR_Stat_AR2();
			CH_EISDoor_RL_Stat_AR2();
		}
	}
	if (strncmp (pduName, "Door_FR_Stat_AR2", strLen(pduName)+strLen("Door_FR_Stat_AR2")) == 0)
	{
		if (TxAck == 1)
		{
			if (@sysvar::CH_Nodes::CH_EISSQC_Door_FR_Stat_Pr2D_AUTO == 0)
			{
				//SQC automatisch ändern
				SQC_VAL_Door_FR_Stat_Pr2 = (SQC_VAL_Door_FR_Stat_Pr2 + 1) % 16;
			}
			else
			{
				//SQC manuel veränderbar
			}

		}
		else
		{
			if (@sysvar::CH_Nodes::CH_EISSQC_Door_FR_Stat_Pr2D_AUTO == 0)
			{
				//SQC automatisch ändern
				//SQC für CRC speichern
				CounterValForCRC_Door_FR_Stat_Pr2 = SQC_VAL_Door_FR_Stat_Pr2;
				//SQC in Byte schreiben
				payload[1] = (payload[1] & ~0x0F) |  SQC_VAL_Door_FR_Stat_Pr2;
			}
			else
			{
				//SQC manuel veränderbar
			}

			if (@sysvar::CH_Nodes::CH_EISCRC_Door_FR_Stat_Pr2D_AUTO == 0)
			{
				//CRC automatisch berechnen
				crc = 0xFF;
				crc = crctableProfTwo[crc ^ payload[1]];
				switch (CounterValForCRC_Door_FR_Stat_Pr2)
				{
					case(0) :
						crc = crctableProfTwo[crc ^ 156];
						break;
					case(1) :
						crc = crctableProfTwo[crc ^ 86];
						break;
					case(2) :
						crc = crctableProfTwo[crc ^ 16];
						break;
					case(3) :
						crc = crctableProfTwo[crc ^ 197];
						break;
					case(4) :
						crc = crctableProfTwo[crc ^ 127];
						break;
					case(5) :
						crc = crctableProfTwo[crc ^ 57];
						break;
					case(6) :
						crc = crctableProfTwo[crc ^ 238];
						break;
					case(7) :
						crc = crctableProfTwo[crc ^ 168];
						break;
					case(8) :
						crc = crctableProfTwo[crc ^ 98];
						break;
					case(9) :
						crc = crctableProfTwo[crc ^ 28];
						break;
					case(10) :
						crc = crctableProfTwo[crc ^ 209];
						break;
					case(11) :
						crc = crctableProfTwo[crc ^ 139];
						break;
					case(12) :
						crc = crctableProfTwo[crc ^ 69];
						break;
					case(13) :
						crc = crctableProfTwo[crc ^ 250];
						break;
					case(14) :
						crc = crctableProfTwo[crc ^ 180];
						break;
					case(15) :
						crc = crctableProfTwo[crc ^ 110];
						break;
					default :
//						write("error: wrong parameter (%d)",CounterValForCRC_Door_FR_Stat_Pr2); stop();
						break;
				}
				crc = (crc ^ 0xFF);
				payload[0] = crc;
			}
			else
			{
				//CRC manuel veränderbar
			}

			CH_EISDoor_FL_Stat_AR2();
			CH_EISDoor_RR_Stat_AR2();
			CH_EISKG_State_AR2();
			CH_EISDoor_FR_Stat_AR2();
			CH_EISDoor_RL_Stat_AR2();
		}
	}
	if (strncmp (pduName, "Door_RL_Stat_AR2", strLen(pduName)+strLen("Door_RL_Stat_AR2")) == 0)
	{
		if (TxAck == 1)
		{
			if (@sysvar::CH_Nodes::CH_EISSQC_Door_RL_Stat_Pr2D_AUTO == 0)
			{
				//SQC automatisch ändern
				SQC_VAL_Door_RL_Stat_Pr2 = (SQC_VAL_Door_RL_Stat_Pr2 + 1) % 16;
			}
			else
			{
				//SQC manuel veränderbar
			}

		}
		else
		{
			if (@sysvar::CH_Nodes::CH_EISSQC_Door_RL_Stat_Pr2D_AUTO == 0)
			{
				//SQC automatisch ändern
				//SQC für CRC speichern
				CounterValForCRC_Door_RL_Stat_Pr2 = SQC_VAL_Door_RL_Stat_Pr2;
				//SQC in Byte schreiben
				payload[1] = (payload[1] & ~0x0F) |  SQC_VAL_Door_RL_Stat_Pr2;
			}
			else
			{
				//SQC manuel veränderbar
			}

			if (@sysvar::CH_Nodes::CH_EISCRC_Door_RL_Stat_Pr2D_AUTO == 0)
			{
				//CRC automatisch berechnen
				crc = 0xFF;
				crc = crctableProfTwo[crc ^ payload[1]];
				switch (CounterValForCRC_Door_RL_Stat_Pr2)
				{
					case(0) :
						crc = crctableProfTwo[crc ^ 72];
						break;
					case(1) :
						crc = crctableProfTwo[crc ^ 221];
						break;
					case(2) :
						crc = crctableProfTwo[crc ^ 119];
						break;
					case(3) :
						crc = crctableProfTwo[crc ^ 17];
						break;
					case(4) :
						crc = crctableProfTwo[crc ^ 166];
						break;
					case(5) :
						crc = crctableProfTwo[crc ^ 64];
						break;
					case(6) :
						crc = crctableProfTwo[crc ^ 213];
						break;
					case(7) :
						crc = crctableProfTwo[crc ^ 111];
						break;
					case(8) :
						crc = crctableProfTwo[crc ^ 9];
						break;
					case(9) :
						crc = crctableProfTwo[crc ^ 158];
						break;
					case(10) :
						crc = crctableProfTwo[crc ^ 56];
						break;
					case(11) :
						crc = crctableProfTwo[crc ^ 205];
						break;
					case(12) :
						crc = crctableProfTwo[crc ^ 103];
						break;
					case(13) :
						crc = crctableProfTwo[crc ^ 252];
						break;
					case(14) :
						crc = crctableProfTwo[crc ^ 150];
						break;
					case(15) :
						crc = crctableProfTwo[crc ^ 48];
						break;
					default :
//						write("error: wrong parameter (%d)",CounterValForCRC_Door_RL_Stat_Pr2); stop();
						break;
				}
				crc = (crc ^ 0xFF);
				payload[0] = crc;
			}
			else
			{
				//CRC manuel veränderbar
			}

			CH_EISDoor_FL_Stat_AR2();
			CH_EISDoor_RR_Stat_AR2();
			CH_EISKG_State_AR2();
			CH_EISDoor_FR_Stat_AR2();
			CH_EISDoor_RL_Stat_AR2();
		}
	}
	if (strncmp (pduName, "Door_RR_Stat_AR2", strLen(pduName)+strLen("Door_RR_Stat_AR2")) == 0)
	{
		if (TxAck == 1)
		{
			if (@sysvar::CH_Nodes::CH_EISSQC_Door_RR_Stat_Pr2D_AUTO == 0)
			{
				//SQC automatisch ändern
				SQC_VAL_Door_RR_Stat_Pr2 = (SQC_VAL_Door_RR_Stat_Pr2 + 1) % 16;
			}
			else
			{
				//SQC manuel veränderbar
			}

		}
		else
		{
			if (@sysvar::CH_Nodes::CH_EISSQC_Door_RR_Stat_Pr2D_AUTO == 0)
			{
				//SQC automatisch ändern
				//SQC für CRC speichern
				CounterValForCRC_Door_RR_Stat_Pr2 = SQC_VAL_Door_RR_Stat_Pr2;
				//SQC in Byte schreiben
				payload[1] = (payload[1] & ~0x0F) |  SQC_VAL_Door_RR_Stat_Pr2;
			}
			else
			{
				//SQC manuel veränderbar
			}

			if (@sysvar::CH_Nodes::CH_EISCRC_Door_RR_Stat_Pr2D_AUTO == 0)
			{
				//CRC automatisch berechnen
				crc = 0xFF;
				crc = crctableProfTwo[crc ^ payload[1]];
				switch (CounterValForCRC_Door_RR_Stat_Pr2)
				{
					case(0) :
						crc = crctableProfTwo[crc ^ 184];
						break;
					case(1) :
						crc = crctableProfTwo[crc ^ 165];
						break;
					case(2) :
						crc = crctableProfTwo[crc ^ 146];
						break;
					case(3) :
						crc = crctableProfTwo[crc ^ 127];
						break;
					case(4) :
						crc = crctableProfTwo[crc ^ 108];
						break;
					case(5) :
						crc = crctableProfTwo[crc ^ 89];
						break;
					case(6) :
						crc = crctableProfTwo[crc ^ 70];
						break;
					case(7) :
						crc = crctableProfTwo[crc ^ 51];
						break;
					case(8) :
						crc = crctableProfTwo[crc ^ 32];
						break;
					case(9) :
						crc = crctableProfTwo[crc ^ 13];
						break;
					case(10) :
						crc = crctableProfTwo[crc ^ 245];
						break;
					case(11) :
						crc = crctableProfTwo[crc ^ 226];
						break;
					case(12) :
						crc = crctableProfTwo[crc ^ 207];
						break;
					case(13) :
						crc = crctableProfTwo[crc ^ 188];
						break;
					case(14) :
						crc = crctableProfTwo[crc ^ 169];
						break;
					case(15) :
						crc = crctableProfTwo[crc ^ 150];
						break;
					default :
//						write("error: wrong parameter (%d)",CounterValForCRC_Door_RR_Stat_Pr2); stop();
						break;
				}
				crc = (crc ^ 0xFF);
				payload[0] = crc;
			}
			else
			{
				//CRC manuel veränderbar
			}

			CH_EISDoor_FL_Stat_AR2();
			CH_EISDoor_RR_Stat_AR2();
			CH_EISKG_State_AR2();
			CH_EISDoor_FR_Stat_AR2();
			CH_EISDoor_RL_Stat_AR2();
		}
	}
	if (strncmp (pduName, "DPC_IndMd_Rq_AR", strLen(pduName)+strLen("DPC_IndMd_Rq_AR")) == 0)
	{
		if (TxAck == 1)
		{
		}
		else
		{
			CH_EISPNHV_WeekDepTmTbl_Rq_HU_AR2();
			CH_EISHMI_CHASSIS_R1_AR2();
			CH_EISDPC_IndMd_Rq_AR();
		}
	}
	if (strncmp (pduName, "EAC_Stat_AR", strLen(pduName)+strLen("EAC_Stat_AR")) == 0)
	{
		if (TxAck == 1)
		{
		}
		else
		{
		}
	}
	if (strncmp (pduName, "EL_Stat_AR2", strLen(pduName)+strLen("EL_Stat_AR2")) == 0)
	{
		if (TxAck == 1)
		{
			if (@sysvar::CH_Nodes::CH_EISSQC_ExtLgt_Lmp_On_Rq__AUTO == 0)
			{
				//SQC automatisch ändern
				SQC_VAL_ExtLgt_Lmp_On_Rq_Pr2 = (SQC_VAL_ExtLgt_Lmp_On_Rq_Pr2 + 1) % 16;
			}
			else
			{
				//SQC manuel veränderbar
			}

		}
		else
		{
			if (@sysvar::CH_Nodes::CH_EISSQC_ExtLgt_Lmp_On_Rq__AUTO == 0)
			{
				//SQC automatisch ändern
				//SQC für CRC speichern
				CounterValForCRC_ExtLgt_Lmp_On_Rq_Pr2 = SQC_VAL_ExtLgt_Lmp_On_Rq_Pr2;
				//SQC in Byte schreiben
				payload[1] = (payload[1] & ~0x0F) |  SQC_VAL_ExtLgt_Lmp_On_Rq_Pr2;
			}
			else
			{
				//SQC manuel veränderbar
			}

			if (@sysvar::CH_Nodes::CH_EISCRC_ExtLgt_Lmp_On_Rq__AUTO == 0)
			{
				//CRC automatisch berechnen
				crc = 0xFF;
				crc = crctableProfTwo[crc ^ payload[1]];
				crc = crctableProfTwo[crc ^ payload[2]];
				crc = crctableProfTwo[crc ^ payload[3]];
				switch (CounterValForCRC_ExtLgt_Lmp_On_Rq_Pr2)
				{
					case(0) :
						crc = crctableProfTwo[crc ^ 189];
						break;
					case(1) :
						crc = crctableProfTwo[crc ^ 99];
						break;
					case(2) :
						crc = crctableProfTwo[crc ^ 9];
						break;
					case(3) :
						crc = crctableProfTwo[crc ^ 170];
						break;
					case(4) :
						crc = crctableProfTwo[crc ^ 80];
						break;
					case(5) :
						crc = crctableProfTwo[crc ^ 241];
						break;
					case(6) :
						crc = crctableProfTwo[crc ^ 151];
						break;
					case(7) :
						crc = crctableProfTwo[crc ^ 61];
						break;
					case(8) :
						crc = crctableProfTwo[crc ^ 222];
						break;
					case(9) :
						crc = crctableProfTwo[crc ^ 132];
						break;
					case(10) :
						crc = crctableProfTwo[crc ^ 42];
						break;
					case(11) :
						crc = crctableProfTwo[crc ^ 203];
						break;
					case(12) :
						crc = crctableProfTwo[crc ^ 113];
						break;
					case(13) :
						crc = crctableProfTwo[crc ^ 23];
						break;
					case(14) :
						crc = crctableProfTwo[crc ^ 184];
						break;
					case(15) :
						crc = crctableProfTwo[crc ^ 94];
						break;
					default :
//						write("error: wrong parameter (%d)",CounterValForCRC_ExtLgt_Lmp_On_Rq_Pr2); stop();
						break;
				}
				crc = (crc ^ 0xFF);
				payload[0] = crc;
			}
			else
			{
				//CRC manuel veränderbar
			}

			CH_EISEL_TurnInd_Rq_AR2();
			CH_EISLgtSens_State_AR();
			CH_EISOHCM_Stat_AR2();
			CH_EISEL_Stat_AR2();
		}
	}
	if (strncmp (pduName, "EL_TurnInd_Rq_AR2", strLen(pduName)+strLen("EL_TurnInd_Rq_AR2")) == 0)
	{
		if (TxAck == 1)
		{
			if (@sysvar::CH_Nodes::CH_EISSQC_EL_TurnInd_On_Rq__AUTO == 0)
			{
				//SQC automatisch ändern
				SQC_VAL_EL_TurnInd_On_Rq_Pr2 = (SQC_VAL_EL_TurnInd_On_Rq_Pr2 + 1) % 16;
			}
			else
			{
				//SQC manuel veränderbar
			}

		}
		else
		{
			if (@sysvar::CH_Nodes::CH_EISSQC_EL_TurnInd_On_Rq__AUTO == 0)
			{
				//SQC automatisch ändern
				//SQC für CRC speichern
				CounterValForCRC_EL_TurnInd_On_Rq_Pr2 = SQC_VAL_EL_TurnInd_On_Rq_Pr2;
				//SQC in Byte schreiben
				payload[1] = (payload[1] & ~0x0F) |  SQC_VAL_EL_TurnInd_On_Rq_Pr2;
			}
			else
			{
				//SQC manuel veränderbar
			}

			if (@sysvar::CH_Nodes::CH_EISCRC_EL_TurnInd_On_Rq__AUTO == 0)
			{
				//CRC automatisch berechnen
				crc = 0xFF;
				crc = crctableProfTwo[crc ^ payload[1]];
				crc = crctableProfTwo[crc ^ payload[2]];
				crc = crctableProfTwo[crc ^ payload[3]];
				switch (CounterValForCRC_EL_TurnInd_On_Rq_Pr2)
				{
					case(0) :
						crc = crctableProfTwo[crc ^ 242];
						break;
					case(1) :
						crc = crctableProfTwo[crc ^ 201];
						break;
					case(2) :
						crc = crctableProfTwo[crc ^ 160];
						break;
					case(3) :
						crc = crctableProfTwo[crc ^ 119];
						break;
					case(4) :
						crc = crctableProfTwo[crc ^ 78];
						break;
					case(5) :
						crc = crctableProfTwo[crc ^ 37];
						break;
					case(6) :
						crc = crctableProfTwo[crc ^ 247];
						break;
					case(7) :
						crc = crctableProfTwo[crc ^ 206];
						break;
					case(8) :
						crc = crctableProfTwo[crc ^ 165];
						break;
					case(9) :
						crc = crctableProfTwo[crc ^ 124];
						break;
					case(10) :
						crc = crctableProfTwo[crc ^ 83];
						break;
					case(11) :
						crc = crctableProfTwo[crc ^ 42];
						break;
					case(12) :
						crc = crctableProfTwo[crc ^ 252];
						break;
					case(13) :
						crc = crctableProfTwo[crc ^ 211];
						break;
					case(14) :
						crc = crctableProfTwo[crc ^ 170];
						break;
					case(15) :
						crc = crctableProfTwo[crc ^ 129];
						break;
					default :
//						write("error: wrong parameter (%d)",CounterValForCRC_EL_TurnInd_On_Rq_Pr2); stop();
						break;
				}
				crc = (crc ^ 0xFF);
				payload[0] = crc;
			}
			else
			{
				//CRC manuel veränderbar
			}

			CH_EISEL_TurnInd_Rq_AR2();
			CH_EISLgtSens_State_AR();
			CH_EISOHCM_Stat_AR2();
			CH_EISEL_Stat_AR2();
		}
	}
	if (strncmp (pduName, "EPKB_Stat_AR2", strLen(pduName)+strLen("EPKB_Stat_AR2")) == 0)
	{
		if (TxAck == 1)
		{
			if (@sysvar::CH_Nodes::CH_EISSQC_EPKB_Stat_Pr2EPKB_AUTO == 0)
			{
				//SQC automatisch ändern
				SQC_VAL_EPKB_Stat_Pr2 = (SQC_VAL_EPKB_Stat_Pr2 + 1) % 16;
			}
			else
			{
				//SQC manuel veränderbar
			}

		}
		else
		{
			if (@sysvar::CH_Nodes::CH_EISSQC_EPKB_Stat_Pr2EPKB_AUTO == 0)
			{
				//SQC automatisch ändern
				//SQC für CRC speichern
				CounterValForCRC_EPKB_Stat_Pr2 = SQC_VAL_EPKB_Stat_Pr2;
				//SQC in Byte schreiben
				payload[1] = (payload[1] & ~0x0F) |  SQC_VAL_EPKB_Stat_Pr2;
			}
			else
			{
				//SQC manuel veränderbar
			}

			if (@sysvar::CH_Nodes::CH_EISCRC_EPKB_Stat_Pr2EPKB_AUTO == 0)
			{
				//CRC automatisch berechnen
				crc = 0xFF;
				crc = crctableProfTwo[crc ^ payload[1]];
				crc = crctableProfTwo[crc ^ payload[2]];
				crc = crctableProfTwo[crc ^ payload[3]];
				crc = crctableProfTwo[crc ^ payload[4]];
				crc = crctableProfTwo[crc ^ payload[5]];
				crc = crctableProfTwo[crc ^ payload[6]];
				crc = crctableProfTwo[crc ^ payload[7]];
				switch (CounterValForCRC_EPKB_Stat_Pr2)
				{
					case(0) :
						crc = crctableProfTwo[crc ^ 27];
						break;
					case(1) :
						crc = crctableProfTwo[crc ^ 58];
						break;
					case(2) :
						crc = crctableProfTwo[crc ^ 89];
						break;
					case(3) :
						crc = crctableProfTwo[crc ^ 120];
						break;
					case(4) :
						crc = crctableProfTwo[crc ^ 151];
						break;
					case(5) :
						crc = crctableProfTwo[crc ^ 182];
						break;
					case(6) :
						crc = crctableProfTwo[crc ^ 213];
						break;
					case(7) :
						crc = crctableProfTwo[crc ^ 244];
						break;
					case(8) :
						crc = crctableProfTwo[crc ^ 24];
						break;
					case(9) :
						crc = crctableProfTwo[crc ^ 55];
						break;
					case(10) :
						crc = crctableProfTwo[crc ^ 86];
						break;
					case(11) :
						crc = crctableProfTwo[crc ^ 117];
						break;
					case(12) :
						crc = crctableProfTwo[crc ^ 148];
						break;
					case(13) :
						crc = crctableProfTwo[crc ^ 179];
						break;
					case(14) :
						crc = crctableProfTwo[crc ^ 210];
						break;
					case(15) :
						crc = crctableProfTwo[crc ^ 241];
						break;
					default :
//						write("error: wrong parameter (%d)",CounterValForCRC_EPKB_Stat_Pr2); stop();
						break;
				}
				crc = (crc ^ 0xFF);
				payload[0] = crc;
			}
			else
			{
				//CRC manuel veränderbar
			}

			CH_EISIHC_Lgt_Stat_HLI_AR2();
			CH_EISPHB_IHC_Plus_Tunnel_AR2();
			CH_EISPHB_IHC_Plus_Tunnel_3_4_AR2();
			CH_EISIHC_Lgt_Stat_HLI_2_AR2();
			CH_EISEPKB_Stat_AR2();
		}
	}
	if (strncmp (pduName, "EVC_CfgBit_01_32_AR2", strLen(pduName)+strLen("EVC_CfgBit_01_32_AR2")) == 0)
	{
		if (TxAck == 1)
		{
			if (@sysvar::CH_Nodes::CH_EISSQC_EVC_CfgBit_01_32__AUTO == 0)
			{
				//SQC automatisch ändern
				SQC_VAL_EVC_CfgBit_01_32_Pr2 = (SQC_VAL_EVC_CfgBit_01_32_Pr2 + 1) % 16;
			}
			else
			{
				//SQC manuel veränderbar
			}

		}
		else
		{
			if (@sysvar::CH_Nodes::CH_EISSQC_EVC_CfgBit_01_32__AUTO == 0)
			{
				//SQC automatisch ändern
				//SQC für CRC speichern
				CounterValForCRC_EVC_CfgBit_01_32_Pr2 = SQC_VAL_EVC_CfgBit_01_32_Pr2;
				//SQC in Byte schreiben
				payload[1] = (payload[1] & ~0x0F) |  SQC_VAL_EVC_CfgBit_01_32_Pr2;
			}
			else
			{
				//SQC manuel veränderbar
			}

			if (@sysvar::CH_Nodes::CH_EISCRC_EVC_CfgBit_01_32__AUTO == 0)
			{
				//CRC automatisch berechnen
				crc = 0xFF;
				crc = crctableProfTwo[crc ^ payload[1]];
				crc = crctableProfTwo[crc ^ payload[2]];
				crc = crctableProfTwo[crc ^ payload[3]];
				crc = crctableProfTwo[crc ^ payload[4]];
				crc = crctableProfTwo[crc ^ payload[5]];
				crc = crctableProfTwo[crc ^ payload[6]];
				crc = crctableProfTwo[crc ^ payload[7]];
				switch (CounterValForCRC_EVC_CfgBit_01_32_Pr2)
				{
					case(0) :
						crc = crctableProfTwo[crc ^ 153];
						break;
					case(1) :
						crc = crctableProfTwo[crc ^ 210];
						break;
					case(2) :
						crc = crctableProfTwo[crc ^ 16];
						break;
					case(3) :
						crc = crctableProfTwo[crc ^ 73];
						break;
					case(4) :
						crc = crctableProfTwo[crc ^ 130];
						break;
					case(5) :
						crc = crctableProfTwo[crc ^ 187];
						break;
					case(6) :
						crc = crctableProfTwo[crc ^ 244];
						break;
					case(7) :
						crc = crctableProfTwo[crc ^ 50];
						break;
					case(8) :
						crc = crctableProfTwo[crc ^ 107];
						break;
					case(9) :
						crc = crctableProfTwo[crc ^ 164];
						break;
					case(10) :
						crc = crctableProfTwo[crc ^ 221];
						break;
					case(11) :
						crc = crctableProfTwo[crc ^ 27];
						break;
					case(12) :
						crc = crctableProfTwo[crc ^ 84];
						break;
					case(13) :
						crc = crctableProfTwo[crc ^ 141];
						break;
					case(14) :
						crc = crctableProfTwo[crc ^ 198];
						break;
					case(15) :
						crc = crctableProfTwo[crc ^ 4];
						break;
					default :
//						write("error: wrong parameter (%d)",CounterValForCRC_EVC_CfgBit_01_32_Pr2); stop();
						break;
				}
				crc = (crc ^ 0xFF);
				payload[0] = crc;
			}
			else
			{
				//CRC manuel veränderbar
			}

			CH_EISEVC_CfgList_01_0C_AR2();
			CH_EISEVC_CfgBit_01_32_AR2();
		}
	}
	if (strncmp (pduName, "EVC_CfgBit_33_64_AR2", strLen(pduName)+strLen("EVC_CfgBit_33_64_AR2")) == 0)
	{
		if (TxAck == 1)
		{
			if (@sysvar::CH_Nodes::CH_EISSQC_EVC_CfgBit_33_64__AUTO == 0)
			{
				//SQC automatisch ändern
				SQC_VAL_EVC_CfgBit_33_64_Pr2 = (SQC_VAL_EVC_CfgBit_33_64_Pr2 + 1) % 16;
			}
			else
			{
				//SQC manuel veränderbar
			}

		}
		else
		{
			if (@sysvar::CH_Nodes::CH_EISSQC_EVC_CfgBit_33_64__AUTO == 0)
			{
				//SQC automatisch ändern
				//SQC für CRC speichern
				CounterValForCRC_EVC_CfgBit_33_64_Pr2 = SQC_VAL_EVC_CfgBit_33_64_Pr2;
				//SQC in Byte schreiben
				payload[1] = (payload[1] & ~0x0F) |  SQC_VAL_EVC_CfgBit_33_64_Pr2;
			}
			else
			{
				//SQC manuel veränderbar
			}

			if (@sysvar::CH_Nodes::CH_EISCRC_EVC_CfgBit_33_64__AUTO == 0)
			{
				//CRC automatisch berechnen
				crc = 0xFF;
				crc = crctableProfTwo[crc ^ payload[1]];
				crc = crctableProfTwo[crc ^ payload[2]];
				crc = crctableProfTwo[crc ^ payload[3]];
				crc = crctableProfTwo[crc ^ payload[4]];
				crc = crctableProfTwo[crc ^ payload[5]];
				crc = crctableProfTwo[crc ^ payload[6]];
				crc = crctableProfTwo[crc ^ payload[7]];
				switch (CounterValForCRC_EVC_CfgBit_33_64_Pr2)
				{
					case(0) :
						crc = crctableProfTwo[crc ^ 83];
						break;
					case(1) :
						crc = crctableProfTwo[crc ^ 104];
						break;
					case(2) :
						crc = crctableProfTwo[crc ^ 125];
						break;
					case(3) :
						crc = crctableProfTwo[crc ^ 146];
						break;
					case(4) :
						crc = crctableProfTwo[crc ^ 167];
						break;
					case(5) :
						crc = crctableProfTwo[crc ^ 188];
						break;
					case(6) :
						crc = crctableProfTwo[crc ^ 209];
						break;
					case(7) :
						crc = crctableProfTwo[crc ^ 230];
						break;
					case(8) :
						crc = crctableProfTwo[crc ^ 251];
						break;
					case(9) :
						crc = crctableProfTwo[crc ^ 21];
						break;
					case(10) :
						crc = crctableProfTwo[crc ^ 42];
						break;
					case(11) :
						crc = crctableProfTwo[crc ^ 63];
						break;
					case(12) :
						crc = crctableProfTwo[crc ^ 84];
						break;
					case(13) :
						crc = crctableProfTwo[crc ^ 105];
						break;
					case(14) :
						crc = crctableProfTwo[crc ^ 126];
						break;
					case(15) :
						crc = crctableProfTwo[crc ^ 147];
						break;
					default :
//						write("error: wrong parameter (%d)",CounterValForCRC_EVC_CfgBit_33_64_Pr2); stop();
						break;
				}
				crc = (crc ^ 0xFF);
				payload[0] = crc;
			}
			else
			{
				//CRC manuel veränderbar
			}

			CH_EISEVC_CfgBit_33_64_AR2();
			CH_EISEVC_CfgBit_65_96_AR2();
		}
	}
	if (strncmp (pduName, "EVC_CfgBit_65_96_AR2", strLen(pduName)+strLen("EVC_CfgBit_65_96_AR2")) == 0)
	{
		if (TxAck == 1)
		{
			if (@sysvar::CH_Nodes::CH_EISSQC_EVC_CfgBit_65_96__AUTO == 0)
			{
				//SQC automatisch ändern
				SQC_VAL_EVC_CfgBit_65_96_Pr2 = (SQC_VAL_EVC_CfgBit_65_96_Pr2 + 1) % 16;
			}
			else
			{
				//SQC manuel veränderbar
			}

		}
		else
		{
			if (@sysvar::CH_Nodes::CH_EISSQC_EVC_CfgBit_65_96__AUTO == 0)
			{
				//SQC automatisch ändern
				//SQC für CRC speichern
				CounterValForCRC_EVC_CfgBit_65_96_Pr2 = SQC_VAL_EVC_CfgBit_65_96_Pr2;
				//SQC in Byte schreiben
				payload[1] = (payload[1] & ~0x0F) |  SQC_VAL_EVC_CfgBit_65_96_Pr2;
			}
			else
			{
				//SQC manuel veränderbar
			}

			if (@sysvar::CH_Nodes::CH_EISCRC_EVC_CfgBit_65_96__AUTO == 0)
			{
				//CRC automatisch berechnen
				crc = 0xFF;
				crc = crctableProfTwo[crc ^ payload[1]];
				crc = crctableProfTwo[crc ^ payload[2]];
				crc = crctableProfTwo[crc ^ payload[3]];
				crc = crctableProfTwo[crc ^ payload[4]];
				crc = crctableProfTwo[crc ^ payload[5]];
				crc = crctableProfTwo[crc ^ payload[6]];
				crc = crctableProfTwo[crc ^ payload[7]];
				switch (CounterValForCRC_EVC_CfgBit_65_96_Pr2)
				{
					case(0) :
						crc = crctableProfTwo[crc ^ 35];
						break;
					case(1) :
						crc = crctableProfTwo[crc ^ 85];
						break;
					case(2) :
						crc = crctableProfTwo[crc ^ 135];
						break;
					case(3) :
						crc = crctableProfTwo[crc ^ 185];
						break;
					case(4) :
						crc = crctableProfTwo[crc ^ 235];
						break;
					case(5) :
						crc = crctableProfTwo[crc ^ 34];
						break;
					case(6) :
						crc = crctableProfTwo[crc ^ 84];
						break;
					case(7) :
						crc = crctableProfTwo[crc ^ 134];
						break;
					case(8) :
						crc = crctableProfTwo[crc ^ 184];
						break;
					case(9) :
						crc = crctableProfTwo[crc ^ 234];
						break;
					case(10) :
						crc = crctableProfTwo[crc ^ 33];
						break;
					case(11) :
						crc = crctableProfTwo[crc ^ 83];
						break;
					case(12) :
						crc = crctableProfTwo[crc ^ 133];
						break;
					case(13) :
						crc = crctableProfTwo[crc ^ 183];
						break;
					case(14) :
						crc = crctableProfTwo[crc ^ 233];
						break;
					case(15) :
						crc = crctableProfTwo[crc ^ 32];
						break;
					default :
//						write("error: wrong parameter (%d)",CounterValForCRC_EVC_CfgBit_65_96_Pr2); stop();
						break;
				}
				crc = (crc ^ 0xFF);
				payload[0] = crc;
			}
			else
			{
				//CRC manuel veränderbar
			}

			CH_EISEVC_CfgBit_33_64_AR2();
			CH_EISEVC_CfgBit_65_96_AR2();
		}
	}
	if (strncmp (pduName, "EVC_CfgBit_97_C8_AR2", strLen(pduName)+strLen("EVC_CfgBit_97_C8_AR2")) == 0)
	{
		if (TxAck == 1)
		{
			if (@sysvar::CH_Nodes::CH_EISSQC_EVC_CfgBit_97_C8__AUTO == 0)
			{
				//SQC automatisch ändern
				SQC_VAL_EVC_CfgBit_97_C8_Pr2 = (SQC_VAL_EVC_CfgBit_97_C8_Pr2 + getValue(VSys_SQC_Jump_EVC_CfgBit_97)) % 16;
			}
			else
			{
				//SQC manuel veränderbar
			}

		}
		else
		{
			if (@sysvar::CH_Nodes::CH_EISSQC_EVC_CfgBit_97_C8__AUTO == 0)
			{
				//SQC automatisch ändern
				//SQC für CRC speichern
				CounterValForCRC_EVC_CfgBit_97_C8_Pr2 = SQC_VAL_EVC_CfgBit_97_C8_Pr2;
				//SQC in Byte schreiben
				payload[1] = (payload[1] & ~0x0F) |  SQC_VAL_EVC_CfgBit_97_C8_Pr2;
			}
			else
			{
				//SQC manuel veränderbar
			}

			if (@sysvar::CH_Nodes::CH_EISCRC_EVC_CfgBit_97_C8__AUTO == 0)
			{
				//CRC automatisch berechnen
				crc = 0xFF;
				crc = crctableProfTwo[crc ^ payload[1]];
				crc = crctableProfTwo[crc ^ payload[2]];
				crc = crctableProfTwo[crc ^ payload[3]];
				crc = crctableProfTwo[crc ^ payload[4]];
				crc = crctableProfTwo[crc ^ payload[5]];
				crc = crctableProfTwo[crc ^ payload[6]];
				crc = crctableProfTwo[crc ^ payload[7]];
				switch (CounterValForCRC_EVC_CfgBit_97_C8_Pr2)
				{
					case(0) :
						crc = crctableProfTwo[crc ^ 13];
						break;
					case(1) :
						crc = crctableProfTwo[crc ^ 128];
						break;
					case(2) :
						crc = crctableProfTwo[crc ^ 243];
						break;
					case(3) :
						crc = crctableProfTwo[crc ^ 107];
						break;
					case(4) :
						crc = crctableProfTwo[crc ^ 222];
						break;
					case(5) :
						crc = crctableProfTwo[crc ^ 86];
						break;
					case(6) :
						crc = crctableProfTwo[crc ^ 201];
						break;
					case(7) :
						crc = crctableProfTwo[crc ^ 65];
						break;
					case(8) :
						crc = crctableProfTwo[crc ^ 180];
						break;
					case(9) :
						crc = crctableProfTwo[crc ^ 44];
						break;
					case(10) :
						crc = crctableProfTwo[crc ^ 159];
						break;
					case(11) :
						crc = crctableProfTwo[crc ^ 23];
						break;
					case(12) :
						crc = crctableProfTwo[crc ^ 138];
						break;
					case(13) :
						crc = crctableProfTwo[crc ^ 253];
						break;
					case(14) :
						crc = crctableProfTwo[crc ^ 117];
						break;
					case(15) :
						crc = crctableProfTwo[crc ^ 232];
						break;
					default :
//						write("error: wrong parameter (%d)",CounterValForCRC_EVC_CfgBit_97_C8_Pr2); stop();
						break;
				}
				crc = (crc ^ 0xFF);
				payload[0] = crc;
			}
			else
			{
				//CRC manuel veränderbar
			}

			CH_EISEVC_CfgBit_97_C8_AR2();
		}
	}
	if (strncmp (pduName, "EVC_CfgList_01_0C_AR2", strLen(pduName)+strLen("EVC_CfgList_01_0C_AR2")) == 0)
	{
		if (TxAck == 1)
		{
			if (@sysvar::CH_Nodes::CH_EISSQC_EVC_CfgList_01_0C_AUTO == 0)
			{
				//SQC automatisch ändern
				SQC_VAL_EVC_CfgList_01_0C_Pr2 = (SQC_VAL_EVC_CfgList_01_0C_Pr2 + 1) % 16;
			}
			else
			{
				//SQC manuel veränderbar
			}

		}
		else
		{
			if (@sysvar::CH_Nodes::CH_EISSQC_EVC_CfgList_01_0C_AUTO == 0)
			{
				//SQC automatisch ändern
				//SQC für CRC speichern
				CounterValForCRC_EVC_CfgList_01_0C_Pr2 = SQC_VAL_EVC_CfgList_01_0C_Pr2;
				//SQC in Byte schreiben
				payload[1] = (payload[1] & ~0x0F) |  SQC_VAL_EVC_CfgList_01_0C_Pr2;
			}
			else
			{
				//SQC manuel veränderbar
			}

			if (@sysvar::CH_Nodes::CH_EISCRC_EVC_CfgList_01_0C_AUTO == 0)
			{
				//CRC automatisch berechnen
				crc = 0xFF;
				crc = crctableProfTwo[crc ^ payload[1]];
				crc = crctableProfTwo[crc ^ payload[2]];
				crc = crctableProfTwo[crc ^ payload[3]];
				crc = crctableProfTwo[crc ^ payload[4]];
				crc = crctableProfTwo[crc ^ payload[5]];
				crc = crctableProfTwo[crc ^ payload[6]];
				crc = crctableProfTwo[crc ^ payload[7]];
				switch (CounterValForCRC_EVC_CfgList_01_0C_Pr2)
				{
					case(0) :
						crc = crctableProfTwo[crc ^ 198];
						break;
					case(1) :
						crc = crctableProfTwo[crc ^ 92];
						break;
					case(2) :
						crc = crctableProfTwo[crc ^ 237];
						break;
					case(3) :
						crc = crctableProfTwo[crc ^ 131];
						break;
					case(4) :
						crc = crctableProfTwo[crc ^ 25];
						break;
					case(5) :
						crc = crctableProfTwo[crc ^ 170];
						break;
					case(6) :
						crc = crctableProfTwo[crc ^ 64];
						break;
					case(7) :
						crc = crctableProfTwo[crc ^ 209];
						break;
					case(8) :
						crc = crctableProfTwo[crc ^ 103];
						break;
					case(9) :
						crc = crctableProfTwo[crc ^ 248];
						break;
					case(10) :
						crc = crctableProfTwo[crc ^ 142];
						break;
					case(11) :
						crc = crctableProfTwo[crc ^ 36];
						break;
					case(12) :
						crc = crctableProfTwo[crc ^ 181];
						break;
					case(13) :
						crc = crctableProfTwo[crc ^ 75];
						break;
					case(14) :
						crc = crctableProfTwo[crc ^ 220];
						break;
					case(15) :
						crc = crctableProfTwo[crc ^ 114];
						break;
					default :
//						write("error: wrong parameter (%d)",CounterValForCRC_EVC_CfgList_01_0C_Pr2); stop();
						break;
				}
				crc = (crc ^ 0xFF);
				payload[0] = crc;
			}
			else
			{
				//CRC manuel veränderbar
			}

			CH_EISEVC_CfgList_01_0C_AR2();
			CH_EISEVC_CfgBit_01_32_AR2();
		}
	}
	if (strncmp (pduName, "FCW_Disp_Rq_AR", strLen(pduName)+strLen("FCW_Disp_Rq_AR")) == 0)
	{
		if (TxAck == 1)
		{
		}
		else
		{
			CH_EISPT_ObjIntrst_Gw_AR2();
			CH_EISCMS_PI_State_Gw_AR2();
			CH_EISVehAccel_X_Rq_Gw_AR2();
			CH_EISFCW_Disp_Rq_AR();
		}
	}
	if (strncmp (pduName, "HMI_CHASSIS_R1_AR2", strLen(pduName)+strLen("HMI_CHASSIS_R1_AR2")) == 0)
	{
		if (TxAck == 1)
		{
			if (@sysvar::CH_Nodes::CH_EISSQC_CTRL_L_Stat_Pr2HM_AUTO == 0)
			{
				//SQC automatisch ändern
				SQC_VAL_CTRL_L_Stat_Pr2 = (SQC_VAL_CTRL_L_Stat_Pr2 + getValue(VSys_SQC_Jump_CTRL_L_Stat)) % 16;
			}
			else
			{
				//SQC manuel veränderbar
			}
			if (@sysvar::CH_Nodes::CH_EISSQC_CTRL_L2_Stat_Pr2H_AUTO == 0)
			{
				//SQC automatisch ändern
				SQC_VAL_CTRL_L2_Stat_Pr2 = (SQC_VAL_CTRL_L2_Stat_Pr2 + getValue(VSys_SQC_Jump_CTRL_L2_Stat)) % 16;
			}
			else
			{
				//SQC manuel veränderbar
			}

		}
		else
		{
			if (@sysvar::CH_Nodes::CH_EISSQC_CTRL_L_Stat_Pr2HM_AUTO == 0)
			{
				//SQC automatisch ändern
				//SQC für CRC speichern
				CounterValForCRC_CTRL_L_Stat_Pr2 = SQC_VAL_CTRL_L_Stat_Pr2;
				//SQC in Byte schreiben
				payload[2] = (payload[2] & ~0x0F) |  SQC_VAL_CTRL_L_Stat_Pr2;
			}
			else
			{
				//SQC manuel veränderbar
			}
			if (@sysvar::CH_Nodes::CH_EISSQC_CTRL_L2_Stat_Pr2H_AUTO == 0)
			{
				//SQC automatisch ändern
				//SQC für CRC speichern
				CounterValForCRC_CTRL_L2_Stat_Pr2 = SQC_VAL_CTRL_L2_Stat_Pr2;
				//SQC in Byte schreiben
				payload[4] = (payload[4] & ~0x0F) |  SQC_VAL_CTRL_L2_Stat_Pr2;
			}
			else
			{
				//SQC manuel veränderbar
			}

			if (@sysvar::CH_Nodes::CH_EISCRC_CTRL_L_Stat_Pr2HM_AUTO == 0)
			{
				//CRC automatisch berechnen
				crc = 0xFF;
				crc = crctableProfTwo[crc ^ payload[2]];
				switch (CounterValForCRC_CTRL_L_Stat_Pr2)
				{
					case(0) :
						crc = crctableProfTwo[crc ^ 227];
						break;
					case(1) :
						crc = crctableProfTwo[crc ^ 74];
						break;
					case(2) :
						crc = crctableProfTwo[crc ^ 172];
						break;
					case(3) :
						crc = crctableProfTwo[crc ^ 19];
						break;
					case(4) :
						crc = crctableProfTwo[crc ^ 117];
						break;
					case(5) :
						crc = crctableProfTwo[crc ^ 215];
						break;
					case(6) :
						crc = crctableProfTwo[crc ^ 62];
						break;
					case(7) :
						crc = crctableProfTwo[crc ^ 160];
						break;
					case(8) :
						crc = crctableProfTwo[crc ^ 7];
						break;
					case(9) :
						crc = crctableProfTwo[crc ^ 105];
						break;
					case(10) :
						crc = crctableProfTwo[crc ^ 203];
						break;
					case(11) :
						crc = crctableProfTwo[crc ^ 50];
						break;
					case(12) :
						crc = crctableProfTwo[crc ^ 148];
						break;
					case(13) :
						crc = crctableProfTwo[crc ^ 246];
						break;
					case(14) :
						crc = crctableProfTwo[crc ^ 93];
						break;
					case(15) :
						crc = crctableProfTwo[crc ^ 191];
						break;
					default :
//						write("error: wrong parameter (%d)",CounterValForCRC_CTRL_L_Stat_Pr2); stop();
						break;
				}
				crc = (crc ^ 0xFF);
				payload[1] = crc;
			}
			else
			{
				//CRC manuel veränderbar
			}
			if (@sysvar::CH_Nodes::CH_EISCRC_CTRL_L2_Stat_Pr2H_AUTO == 0)
			{
				//CRC automatisch berechnen
				crc = 0xFF;
				crc = crctableProfTwo[crc ^ payload[4]];
				switch (CounterValForCRC_CTRL_L2_Stat_Pr2)
				{
					case(0) :
						crc = crctableProfTwo[crc ^ 239];
						break;
					case(1) :
						crc = crctableProfTwo[crc ^ 79];
						break;
					case(2) :
						crc = crctableProfTwo[crc ^ 170];
						break;
					case(3) :
						crc = crctableProfTwo[crc ^ 10];
						break;
					case(4) :
						crc = crctableProfTwo[crc ^ 101];
						break;
					case(5) :
						crc = crctableProfTwo[crc ^ 192];
						break;
					case(6) :
						crc = crctableProfTwo[crc ^ 32];
						break;
					case(7) :
						crc = crctableProfTwo[crc ^ 123];
						break;
					case(8) :
						crc = crctableProfTwo[crc ^ 214];
						break;
					case(9) :
						crc = crctableProfTwo[crc ^ 54];
						break;
					case(10) :
						crc = crctableProfTwo[crc ^ 145];
						break;
					case(11) :
						crc = crctableProfTwo[crc ^ 236];
						break;
					case(12) :
						crc = crctableProfTwo[crc ^ 76];
						break;
					case(13) :
						crc = crctableProfTwo[crc ^ 167];
						break;
					case(14) :
						crc = crctableProfTwo[crc ^ 7];
						break;
					case(15) :
						crc = crctableProfTwo[crc ^ 98];
						break;
					default :
//						write("error: wrong parameter (%d)",CounterValForCRC_CTRL_L2_Stat_Pr2); stop();
						break;
				}
				crc = (crc ^ 0xFF);
				payload[3] = crc;
			}
			else
			{
				//CRC manuel veränderbar
			}

			CH_EISPNHV_WeekDepTmTbl_Rq_HU_AR2();
			CH_EISHMI_CHASSIS_R1_AR2();
			CH_EISDPC_IndMd_Rq_AR();
		}
	}
	if (strncmp (pduName, "HU_Comf_Rq_AR2", strLen(pduName)+strLen("HU_Comf_Rq_AR2")) == 0)
	{
		if (TxAck == 1)
		{
		}
		else
		{
		}
	}
	if (strncmp (pduName, "HU_State_AR", strLen(pduName)+strLen("HU_State_AR")) == 0)
	{
		if (TxAck == 1)
		{
		}
		else
		{
			CH_EISSVS_Rq_HU_AR2();
			CH_EISTrafficInfo_AR();
			CH_EISHU_State_AR();
			CH_EISTire_State_AR2();
			CH_EISCTRL_C_Stat1_AR();
		}
	}
	if (strncmp (pduName, "HVAC_Disp_Stat1_AR", strLen(pduName)+strLen("HVAC_Disp_Stat1_AR")) == 0)
	{
		if (TxAck == 1)
		{
		}
		else
		{
		}
	}
	if (strncmp (pduName, "HVAC_OBD_DTC_AR", strLen(pduName)+strLen("HVAC_OBD_DTC_AR")) == 0)
	{
		if (TxAck == 1)
		{
		}
		else
		{
			CH_EISHVAC_Rs_AR2();
			CH_EISHVAC_OBD_DTC_AR();
		}
	}
	if (strncmp (pduName, "HVAC_Rs2_AR", strLen(pduName)+strLen("HVAC_Rs2_AR")) == 0)
	{
		if (TxAck == 1)
		{
		}
		else
		{
		}
	}
	if (strncmp (pduName, "HVAC_Rs3_AR2", strLen(pduName)+strLen("HVAC_Rs3_AR2")) == 0)
	{
		if (TxAck == 1)
		{
		}
		else
		{
		}
	}
	if (strncmp (pduName, "HVAC_Rs_AR2", strLen(pduName)+strLen("HVAC_Rs_AR2")) == 0)
	{
		if (TxAck == 1)
		{
			if (@sysvar::CH_Nodes::CH_EISSQC_HVAC_CompTrq_Pr2H_AUTO == 0)
			{
				//SQC automatisch ändern
				SQC_VAL_HVAC_CompTrq_Pr2 = (SQC_VAL_HVAC_CompTrq_Pr2 + 1) % 16;
			}
			else
			{
				//SQC manuel veränderbar
			}

		}
		else
		{
			if (@sysvar::CH_Nodes::CH_EISSQC_HVAC_CompTrq_Pr2H_AUTO == 0)
			{
				//SQC automatisch ändern
				//SQC für CRC speichern
				CounterValForCRC_HVAC_CompTrq_Pr2 = SQC_VAL_HVAC_CompTrq_Pr2;
				//SQC in Byte schreiben
				payload[1] = (payload[1] & ~0x0F) |  SQC_VAL_HVAC_CompTrq_Pr2;
			}
			else
			{
				//SQC manuel veränderbar
			}

			if (@sysvar::CH_Nodes::CH_EISCRC_HVAC_CompTrq_Pr2H_AUTO == 0)
			{
				//CRC automatisch berechnen
				crc = 0xFF;
				crc = crctableProfTwo[crc ^ payload[1]];
				crc = crctableProfTwo[crc ^ payload[2]];
				switch (CounterValForCRC_HVAC_CompTrq_Pr2)
				{
					case(0) :
						crc = crctableProfTwo[crc ^ 114];
						break;
					case(1) :
						crc = crctableProfTwo[crc ^ 24];
						break;
					case(2) :
						crc = crctableProfTwo[crc ^ 185];
						break;
					case(3) :
						crc = crctableProfTwo[crc ^ 95];
						break;
					case(4) :
						crc = crctableProfTwo[crc ^ 5];
						break;
					case(5) :
						crc = crctableProfTwo[crc ^ 166];
						break;
					case(6) :
						crc = crctableProfTwo[crc ^ 76];
						break;
					case(7) :
						crc = crctableProfTwo[crc ^ 237];
						break;
					case(8) :
						crc = crctableProfTwo[crc ^ 147];
						break;
					case(9) :
						crc = crctableProfTwo[crc ^ 57];
						break;
					case(10) :
						crc = crctableProfTwo[crc ^ 218];
						break;
					case(11) :
						crc = crctableProfTwo[crc ^ 128];
						break;
					case(12) :
						crc = crctableProfTwo[crc ^ 38];
						break;
					case(13) :
						crc = crctableProfTwo[crc ^ 199];
						break;
					case(14) :
						crc = crctableProfTwo[crc ^ 109];
						break;
					case(15) :
						crc = crctableProfTwo[crc ^ 19];
						break;
					default :
//						write("error: wrong parameter (%d)",CounterValForCRC_HVAC_CompTrq_Pr2); stop();
						break;
				}
				crc = (crc ^ 0xFF);
				payload[0] = crc;
			}
			else
			{
				//CRC manuel veränderbar
			}

			CH_EISHVAC_Rs_AR2();
			CH_EISHVAC_OBD_DTC_AR();
		}
	}
	if (strncmp (pduName, "HVAC_State1_AR", strLen(pduName)+strLen("HVAC_State1_AR")) == 0)
	{
		if (TxAck == 1)
		{
		}
		else
		{
		}
	}
	if (strncmp (pduName, "IC_BasicInfo_AR2", strLen(pduName)+strLen("IC_BasicInfo_AR2")) == 0)
	{
		if (TxAck == 1)
		{
		}
		else
		{
		}
	}
	if (strncmp (pduName, "IC_DriveAssistSys_AR2", strLen(pduName)+strLen("IC_DriveAssistSys_AR2")) == 0)
	{
		if (TxAck == 1)
		{
		}
		else
		{
			CH_EISIC_DriveAssistSys_AR2();
			CH_EISLDC_Disp_Stat_IC_AR2();
			CH_EISPark_Disp_Rs_AR2();
		}
	}
	if (strncmp (pduName, "IC_Settings_AR2", strLen(pduName)+strLen("IC_Settings_AR2")) == 0)
	{
		if (TxAck == 1)
		{
		}
		else
		{
			CH_EISRTC_Date_Time_AR2();
			CH_EISIC_Settings_AR2();
		}
	}
	if (strncmp (pduName, "ICH_Stat_AR", strLen(pduName)+strLen("ICH_Stat_AR")) == 0)
	{
		if (TxAck == 1)
		{
		}
		else
		{
			CH_EISICH_Stat_AR();
			CH_EISTrailer_Stat_AR2();
		}
	}
	if (strncmp (pduName, "Ign_Veh_Stat_AR2", strLen(pduName)+strLen("Ign_Veh_Stat_AR2")) == 0)
	{
		if (TxAck == 1)
		{
			if (@sysvar::CH_Nodes::CH_EISSQC_Ign_Stat_Pr2Ign_V_AUTO == 0)
			{
				//SQC automatisch ändern
				SQC_VAL_Ign_Stat_Pr2 = (SQC_VAL_Ign_Stat_Pr2 + getValue(VSys_SQC_Jump_Ign_Stat)) % 16;
			}
			else
			{
				//SQC manuel veränderbar
			}

		}
		else
		{
			if (@sysvar::CH_Nodes::CH_EISSQC_Ign_Stat_Pr2Ign_V_AUTO == 0)
			{
				//SQC automatisch ändern
				//SQC für CRC speichern
				CounterValForCRC_Ign_Stat_Pr2 = SQC_VAL_Ign_Stat_Pr2;
				//SQC in Byte schreiben
				payload[1] = (payload[1] & ~0x0F) |  SQC_VAL_Ign_Stat_Pr2;
			}
			else
			{
				//SQC manuel veränderbar
			}

			if (@sysvar::CH_Nodes::CH_EISCRC_Ign_Stat_Pr2Ign_V_AUTO == 0)
			{
				//CRC automatisch berechnen
				crc = 0xFF;
				crc = crctableProfTwo[crc ^ payload[1]];
				crc = crctableProfTwo[crc ^ payload[2]];
				crc = crctableProfTwo[crc ^ payload[3]];
				switch (CounterValForCRC_Ign_Stat_Pr2)
				{
					case(0) :
						crc = crctableProfTwo[crc ^ 167];
						break;
					case(1) :
						crc = crctableProfTwo[crc ^ 211];
						break;
					case(2) :
						crc = crctableProfTwo[crc ^ 4];
						break;
					case(3) :
						crc = crctableProfTwo[crc ^ 48];
						break;
					case(4) :
						crc = crctableProfTwo[crc ^ 92];
						break;
					case(5) :
						crc = crctableProfTwo[crc ^ 136];
						break;
					case(6) :
						crc = crctableProfTwo[crc ^ 180];
						break;
					case(7) :
						crc = crctableProfTwo[crc ^ 224];
						break;
					case(8) :
						crc = crctableProfTwo[crc ^ 17];
						break;
					case(9) :
						crc = crctableProfTwo[crc ^ 61];
						break;
					case(10) :
						crc = crctableProfTwo[crc ^ 105];
						break;
					case(11) :
						crc = crctableProfTwo[crc ^ 149];
						break;
					case(12) :
						crc = crctableProfTwo[crc ^ 193];
						break;
					case(13) :
						crc = crctableProfTwo[crc ^ 237];
						break;
					case(14) :
						crc = crctableProfTwo[crc ^ 30];
						break;
					case(15) :
						crc = crctableProfTwo[crc ^ 74];
						break;
					default :
//						write("error: wrong parameter (%d)",CounterValForCRC_Ign_Stat_Pr2); stop();
						break;
				}
				crc = (crc ^ 0xFF);
				payload[0] = crc;
			}
			else
			{
				//CRC manuel veränderbar
			}

			CH_EISRemPark_Stat_EIS_AR2();
			CH_EISCLkS_State_AR();
			CH_EISIgn_Veh_Stat_AR2();
			CH_EISCLkS_Rq_AR();
		}
	}
	if (strncmp (pduName, "IHC_Lgt_Stat_HLI_2_AR2", strLen(pduName)+strLen("IHC_Lgt_Stat_HLI_2_AR2")) == 0)
	{
		if (TxAck == 1)
		{
		}
		else
		{
			CH_EISIHC_Lgt_Stat_HLI_AR2();
			CH_EISPHB_IHC_Plus_Tunnel_AR2();
			CH_EISPHB_IHC_Plus_Tunnel_3_4_AR2();
			CH_EISIHC_Lgt_Stat_HLI_2_AR2();
			CH_EISEPKB_Stat_AR2();
		}
	}
	if (strncmp (pduName, "IHC_Lgt_Stat_HLI_AR2", strLen(pduName)+strLen("IHC_Lgt_Stat_HLI_AR2")) == 0)
	{
		if (TxAck == 1)
		{
			if (@sysvar::CH_Nodes::CH_EISSQC_IHC_Lgt_Stat_HLI__AUTO == 0)
			{
				//SQC automatisch ändern
				SQC_VAL_IHC_Lgt_Stat_HLI_Pr2 = (SQC_VAL_IHC_Lgt_Stat_HLI_Pr2 + 1) % 16;
			}
			else
			{
				//SQC manuel veränderbar
			}

		}
		else
		{
			if (@sysvar::CH_Nodes::CH_EISSQC_IHC_Lgt_Stat_HLI__AUTO == 0)
			{
				//SQC automatisch ändern
				//SQC für CRC speichern
				CounterValForCRC_IHC_Lgt_Stat_HLI_Pr2 = SQC_VAL_IHC_Lgt_Stat_HLI_Pr2;
				//SQC in Byte schreiben
				payload[1] = (payload[1] & ~0x0F) |  SQC_VAL_IHC_Lgt_Stat_HLI_Pr2;
			}
			else
			{
				//SQC manuel veränderbar
			}

			if (@sysvar::CH_Nodes::CH_EISCRC_IHC_Lgt_Stat_HLI__AUTO == 0)
			{
				//CRC automatisch berechnen
				crc = 0xFF;
				crc = crctableProfTwo[crc ^ payload[1]];
				crc = crctableProfTwo[crc ^ payload[2]];
				crc = crctableProfTwo[crc ^ payload[3]];
				crc = crctableProfTwo[crc ^ payload[4]];
				crc = crctableProfTwo[crc ^ payload[5]];
				crc = crctableProfTwo[crc ^ payload[6]];
				crc = crctableProfTwo[crc ^ payload[7]];
				switch (CounterValForCRC_IHC_Lgt_Stat_HLI_Pr2)
				{
					case(0) :
						crc = crctableProfTwo[crc ^ 226];
						break;
					case(1) :
						crc = crctableProfTwo[crc ^ 225];
						break;
					case(2) :
						crc = crctableProfTwo[crc ^ 224];
						break;
					case(3) :
						crc = crctableProfTwo[crc ^ 223];
						break;
					case(4) :
						crc = crctableProfTwo[crc ^ 222];
						break;
					case(5) :
						crc = crctableProfTwo[crc ^ 221];
						break;
					case(6) :
						crc = crctableProfTwo[crc ^ 220];
						break;
					case(7) :
						crc = crctableProfTwo[crc ^ 219];
						break;
					case(8) :
						crc = crctableProfTwo[crc ^ 218];
						break;
					case(9) :
						crc = crctableProfTwo[crc ^ 217];
						break;
					case(10) :
						crc = crctableProfTwo[crc ^ 216];
						break;
					case(11) :
						crc = crctableProfTwo[crc ^ 215];
						break;
					case(12) :
						crc = crctableProfTwo[crc ^ 214];
						break;
					case(13) :
						crc = crctableProfTwo[crc ^ 213];
						break;
					case(14) :
						crc = crctableProfTwo[crc ^ 212];
						break;
					case(15) :
						crc = crctableProfTwo[crc ^ 211];
						break;
					default :
//						write("error: wrong parameter (%d)",CounterValForCRC_IHC_Lgt_Stat_HLI_Pr2); stop();
						break;
				}
				crc = (crc ^ 0xFF);
				payload[0] = crc;
			}
			else
			{
				//CRC manuel veränderbar
			}

			CH_EISIHC_Lgt_Stat_HLI_AR2();
			CH_EISPHB_IHC_Plus_Tunnel_AR2();
			CH_EISPHB_IHC_Plus_Tunnel_3_4_AR2();
			CH_EISIHC_Lgt_Stat_HLI_2_AR2();
			CH_EISEPKB_Stat_AR2();
		}
	}
	if (strncmp (pduName, "KG_State_AR2", strLen(pduName)+strLen("KG_State_AR2")) == 0)
	{
		if (TxAck == 1)
		{
			if (@sysvar::CH_Nodes::CH_EISSQC_RemPark_Stat_KG_P_AUTO == 0)
			{
				//SQC automatisch ändern
				SQC_VAL_RemPark_Stat_KG_Pr2 = (SQC_VAL_RemPark_Stat_KG_Pr2 + 1) % 16;
			}
			else
			{
				//SQC manuel veränderbar
			}

		}
		else
		{
			if (@sysvar::CH_Nodes::CH_EISSQC_RemPark_Stat_KG_P_AUTO == 0)
			{
				//SQC automatisch ändern
				//SQC für CRC speichern
				CounterValForCRC_RemPark_Stat_KG_Pr2 = SQC_VAL_RemPark_Stat_KG_Pr2;
				//SQC in Byte schreiben
				payload[3] = (payload[3] & ~0x0F) |  SQC_VAL_RemPark_Stat_KG_Pr2;
			}
			else
			{
				//SQC manuel veränderbar
			}

			if (@sysvar::CH_Nodes::CH_EISCRC_RemPark_Stat_KG_P_AUTO == 0)
			{
				//CRC automatisch berechnen
				crc = 0xFF;
				crc = crctableProfTwo[crc ^ payload[3]];
				crc = crctableProfTwo[crc ^ payload[4]];
				switch (CounterValForCRC_RemPark_Stat_KG_Pr2)
				{
					case(0) :
						crc = crctableProfTwo[crc ^ 191];
						break;
					case(1) :
						crc = crctableProfTwo[crc ^ 71];
						break;
					case(2) :
						crc = crctableProfTwo[crc ^ 202];
						break;
					case(3) :
						crc = crctableProfTwo[crc ^ 82];
						break;
					case(4) :
						crc = crctableProfTwo[crc ^ 213];
						break;
					case(5) :
						crc = crctableProfTwo[crc ^ 93];
						break;
					case(6) :
						crc = crctableProfTwo[crc ^ 224];
						break;
					case(7) :
						crc = crctableProfTwo[crc ^ 104];
						break;
					case(8) :
						crc = crctableProfTwo[crc ^ 235];
						break;
					case(9) :
						crc = crctableProfTwo[crc ^ 115];
						break;
					case(10) :
						crc = crctableProfTwo[crc ^ 246];
						break;
					case(11) :
						crc = crctableProfTwo[crc ^ 126];
						break;
					case(12) :
						crc = crctableProfTwo[crc ^ 6];
						break;
					case(13) :
						crc = crctableProfTwo[crc ^ 137];
						break;
					case(14) :
						crc = crctableProfTwo[crc ^ 17];
						break;
					case(15) :
						crc = crctableProfTwo[crc ^ 148];
						break;
					default :
//						write("error: wrong parameter (%d)",CounterValForCRC_RemPark_Stat_KG_Pr2); stop();
						break;
				}
				crc = (crc ^ 0xFF);
				payload[2] = crc;
			}
			else
			{
				//CRC manuel veränderbar
			}

			CH_EISDoor_FL_Stat_AR2();
			CH_EISDoor_RR_Stat_AR2();
			CH_EISKG_State_AR2();
			CH_EISDoor_FR_Stat_AR2();
			CH_EISDoor_RL_Stat_AR2();
		}
	}
	if (strncmp (pduName, "LDC_Disp_Stat_IC_AR2", strLen(pduName)+strLen("LDC_Disp_Stat_IC_AR2")) == 0)
	{
		if (TxAck == 1)
		{
		}
		else
		{
			CH_EISIC_DriveAssistSys_AR2();
			CH_EISLDC_Disp_Stat_IC_AR2();
			CH_EISPark_Disp_Rs_AR2();
		}
	}
	if (strncmp (pduName, "LgtSens_State_AR", strLen(pduName)+strLen("LgtSens_State_AR")) == 0)
	{
		if (TxAck == 1)
		{
		}
		else
		{
			CH_EISEL_TurnInd_Rq_AR2();
			CH_EISLgtSens_State_AR();
			CH_EISOHCM_Stat_AR2();
			CH_EISEL_Stat_AR2();
		}
	}
	if (strncmp (pduName, "Mirr_Adj_Lt_Rq_AR", strLen(pduName)+strLen("Mirr_Adj_Lt_Rq_AR")) == 0)
	{
		if (TxAck == 1)
		{
		}
		else
		{
			CH_EISMirr_Adj_Lt_Rq_AR();
			CH_EISMirr_Adj_Rt_Rq_AR();
		}
	}
	if (strncmp (pduName, "Mirr_Adj_Rt_Rq_AR", strLen(pduName)+strLen("Mirr_Adj_Rt_Rq_AR")) == 0)
	{
		if (TxAck == 1)
		{
		}
		else
		{
			CH_EISMirr_Adj_Lt_Rq_AR();
			CH_EISMirr_Adj_Rt_Rq_AR();
		}
	}
	if (strncmp (pduName, "NAVI_Pos1_AR", strLen(pduName)+strLen("NAVI_Pos1_AR")) == 0)
	{
		if (TxAck == 1)
		{
		}
		else
		{
			CH_EISNAVI_Pos3_AR();
			CH_EISNAVI_Pos4_AR();
			CH_EISNAVI_Pos1_AR();
			CH_EISNAVI_Pos5_AR();
			CH_EISNAVI_Pos2_AR();
		}
	}
	if (strncmp (pduName, "NAVI_Pos2_AR", strLen(pduName)+strLen("NAVI_Pos2_AR")) == 0)
	{
		if (TxAck == 1)
		{
		}
		else
		{
			CH_EISNAVI_Pos3_AR();
			CH_EISNAVI_Pos4_AR();
			CH_EISNAVI_Pos1_AR();
			CH_EISNAVI_Pos5_AR();
			CH_EISNAVI_Pos2_AR();
		}
	}
	if (strncmp (pduName, "NAVI_Pos3_AR", strLen(pduName)+strLen("NAVI_Pos3_AR")) == 0)
	{
		if (TxAck == 1)
		{
		}
		else
		{
			CH_EISNAVI_Pos3_AR();
			CH_EISNAVI_Pos4_AR();
			CH_EISNAVI_Pos1_AR();
			CH_EISNAVI_Pos5_AR();
			CH_EISNAVI_Pos2_AR();
		}
	}
	if (strncmp (pduName, "NAVI_Pos4_AR", strLen(pduName)+strLen("NAVI_Pos4_AR")) == 0)
	{
		if (TxAck == 1)
		{
		}
		else
		{
			CH_EISNAVI_Pos3_AR();
			CH_EISNAVI_Pos4_AR();
			CH_EISNAVI_Pos1_AR();
			CH_EISNAVI_Pos5_AR();
			CH_EISNAVI_Pos2_AR();
		}
	}
	if (strncmp (pduName, "NAVI_Pos5_AR", strLen(pduName)+strLen("NAVI_Pos5_AR")) == 0)
	{
		if (TxAck == 1)
		{
		}
		else
		{
			CH_EISNAVI_Pos3_AR();
			CH_EISNAVI_Pos4_AR();
			CH_EISNAVI_Pos1_AR();
			CH_EISNAVI_Pos5_AR();
			CH_EISNAVI_Pos2_AR();
		}
	}
	if (strncmp (pduName, "NVP_Stat1_AR2", strLen(pduName)+strLen("NVP_Stat1_AR2")) == 0)
	{
		if (TxAck == 1)
		{
			if (@sysvar::CH_Nodes::CH_EISSQC_NVP_Stat1_Pr2NVP__AUTO == 0)
			{
				//SQC automatisch ändern
				SQC_VAL_NVP_Stat1_Pr2 = (SQC_VAL_NVP_Stat1_Pr2 + 1) % 16;
			}
			else
			{
				//SQC manuel veränderbar
			}

		}
		else
		{
			if (@sysvar::CH_Nodes::CH_EISSQC_NVP_Stat1_Pr2NVP__AUTO == 0)
			{
				//SQC automatisch ändern
				//SQC für CRC speichern
				CounterValForCRC_NVP_Stat1_Pr2 = SQC_VAL_NVP_Stat1_Pr2;
				//SQC in Byte schreiben
				payload[1] = (payload[1] & ~0x0F) |  SQC_VAL_NVP_Stat1_Pr2;
			}
			else
			{
				//SQC manuel veränderbar
			}

			if (@sysvar::CH_Nodes::CH_EISCRC_NVP_Stat1_Pr2NVP__AUTO == 0)
			{
				//CRC automatisch berechnen
				crc = 0xFF;
				crc = crctableProfTwo[crc ^ payload[1]];
				crc = crctableProfTwo[crc ^ payload[2]];
				crc = crctableProfTwo[crc ^ payload[3]];
				crc = crctableProfTwo[crc ^ payload[4]];
				switch (CounterValForCRC_NVP_Stat1_Pr2)
				{
					case(0) :
						crc = crctableProfTwo[crc ^ 49];
						break;
					case(1) :
						crc = crctableProfTwo[crc ^ 10];
						break;
					case(2) :
						crc = crctableProfTwo[crc ^ 222];
						break;
					case(3) :
						crc = crctableProfTwo[crc ^ 183];
						break;
					case(4) :
						crc = crctableProfTwo[crc ^ 144];
						break;
					case(5) :
						crc = crctableProfTwo[crc ^ 105];
						break;
					case(6) :
						crc = crctableProfTwo[crc ^ 66];
						break;
					case(7) :
						crc = crctableProfTwo[crc ^ 27];
						break;
					case(8) :
						crc = crctableProfTwo[crc ^ 239];
						break;
					case(9) :
						crc = crctableProfTwo[crc ^ 200];
						break;
					case(10) :
						crc = crctableProfTwo[crc ^ 161];
						break;
					case(11) :
						crc = crctableProfTwo[crc ^ 122];
						break;
					case(12) :
						crc = crctableProfTwo[crc ^ 83];
						break;
					case(13) :
						crc = crctableProfTwo[crc ^ 44];
						break;
					case(14) :
						crc = crctableProfTwo[crc ^ 5];
						break;
					case(15) :
						crc = crctableProfTwo[crc ^ 217];
						break;
					default :
//						write("error: wrong parameter (%d)",CounterValForCRC_NVP_Stat1_Pr2); stop();
						break;
				}
				crc = (crc ^ 0xFF);
				payload[0] = crc;
			}
			else
			{
				//CRC manuel veränderbar
			}

			CH_EISNVP_Stat1_AR2();
			CH_EISBSM_Disp_Warn_Rq_AR2();
			CH_EISSPL_Obj1_Obj2_NV_AR2();
		}
	}
	if (strncmp (pduName, "OHCM_Stat_AR2", strLen(pduName)+strLen("OHCM_Stat_AR2")) == 0)
	{
		if (TxAck == 1)
		{
		}
		else
		{
			CH_EISEL_TurnInd_Rq_AR2();
			CH_EISLgtSens_State_AR();
			CH_EISOHCM_Stat_AR2();
			CH_EISEL_Stat_AR2();
		}
	}
	if (strncmp (pduName, "ORC_Disp_Stat_AR2", strLen(pduName)+strLen("ORC_Disp_Stat_AR2")) == 0)
	{
		if (TxAck == 1)
		{
			if (@sysvar::CH_Nodes::CH_EISSQC_Bckl_Sw_Ft_Stat_P_AUTO == 0)
			{
				//SQC automatisch ändern
				SQC_VAL_Bckl_Sw_Ft_Stat_Pr2 = (SQC_VAL_Bckl_Sw_Ft_Stat_Pr2 + 1) % 16;
			}
			else
			{
				//SQC manuel veränderbar
			}

		}
		else
		{
			if (@sysvar::CH_Nodes::CH_EISSQC_Bckl_Sw_Ft_Stat_P_AUTO == 0)
			{
				//SQC automatisch ändern
				//SQC für CRC speichern
				CounterValForCRC_Bckl_Sw_Ft_Stat_Pr2 = SQC_VAL_Bckl_Sw_Ft_Stat_Pr2;
				//SQC in Byte schreiben
				payload[6] = (payload[6] & ~0x0F) |  SQC_VAL_Bckl_Sw_Ft_Stat_Pr2;
			}
			else
			{
				//SQC manuel veränderbar
			}

			if (@sysvar::CH_Nodes::CH_EISCRC_Bckl_Sw_Ft_Stat_P_AUTO == 0)
			{
				//CRC automatisch berechnen
				crc = 0xFF;
				crc = crctableProfTwo[crc ^ payload[6]];
				crc = crctableProfTwo[crc ^ payload[7]];
				switch (CounterValForCRC_Bckl_Sw_Ft_Stat_Pr2)
				{
					case(0) :
						crc = crctableProfTwo[crc ^ 34];
						break;
					case(1) :
						crc = crctableProfTwo[crc ^ 73];
						break;
					case(2) :
						crc = crctableProfTwo[crc ^ 112];
						break;
					case(3) :
						crc = crctableProfTwo[crc ^ 151];
						break;
					case(4) :
						crc = crctableProfTwo[crc ^ 190];
						break;
					case(5) :
						crc = crctableProfTwo[crc ^ 229];
						break;
					case(6) :
						crc = crctableProfTwo[crc ^ 17];
						break;
					case(7) :
						crc = crctableProfTwo[crc ^ 56];
						break;
					case(8) :
						crc = crctableProfTwo[crc ^ 95];
						break;
					case(9) :
						crc = crctableProfTwo[crc ^ 134];
						break;
					case(10) :
						crc = crctableProfTwo[crc ^ 173];
						break;
					case(11) :
						crc = crctableProfTwo[crc ^ 212];
						break;
					case(12) :
						crc = crctableProfTwo[crc ^ 251];
						break;
					case(13) :
						crc = crctableProfTwo[crc ^ 39];
						break;
					case(14) :
						crc = crctableProfTwo[crc ^ 78];
						break;
					case(15) :
						crc = crctableProfTwo[crc ^ 117];
						break;
					default :
//						write("error: wrong parameter (%d)",CounterValForCRC_Bckl_Sw_Ft_Stat_Pr2); stop();
						break;
				}
				crc = (crc ^ 0xFF);
				payload[5] = crc;
			}
			else
			{
				//CRC manuel veränderbar
			}

			CH_EISORC_Disp_Stat_AR2();
			CH_EISORC_Impact_AR2();
		}
	}
	if (strncmp (pduName, "ORC_Impact_AR2", strLen(pduName)+strLen("ORC_Impact_AR2")) == 0)
	{
		if (TxAck == 1)
		{
			if (@sysvar::CH_Nodes::CH_EISSQC_Impact_Pr2ORC_Imp_AUTO == 0)
			{
				//SQC automatisch ändern
				SQC_VAL_Impact_Pr2 = (SQC_VAL_Impact_Pr2 + 1) % 16;
			}
			else
			{
				//SQC manuel veränderbar
			}
			if (@sysvar::CH_Nodes::CH_EISImpact_TglORC_Impact__AUTO == 0)
			{
				//TGL automatisch ändern
				TGL_VAL_mpact_ = (TGL_VAL_mpact_ + 1) % 2;
			}
			else
			{
				//TGL manuel veränderbar
			}

		}
		else
		{
			if (@sysvar::CH_Nodes::CH_EISSQC_Impact_Pr2ORC_Imp_AUTO == 0)
			{
				//SQC automatisch ändern
				//SQC für CRC speichern
				CounterValForCRC_Impact_Pr2 = SQC_VAL_Impact_Pr2;
				//SQC in Byte schreiben
				payload[1] = (payload[1] & ~0x0F) |  SQC_VAL_Impact_Pr2;
			}
			else
			{
				//SQC manuel veränderbar
			}
			if (@sysvar::CH_Nodes::CH_EISImpact_TglORC_Impact__AUTO == 0)
			{
				//TGL automatisch ändern
				//TGL an richtige Position 'schieben'
				for (i = 0; i < 6; i++)
				{
					TGL_VAL_mpact_ = TGL_VAL_mpact_ << 1;
				}
				//TGL in Byte schreiben
				payload[1] = (payload[1] & ~0x40) |  TGL_VAL_mpact_;
				//TGL wieder zurück 'schieben'
				for (i = 0; i < 6; i++)
				{
					TGL_VAL_mpact_ = TGL_VAL_mpact_ >> 1;
				}
			}
			else
			{
				//TGL manuel veränderbar
			}

			if (@sysvar::CH_Nodes::CH_EISCRC_Impact_Pr2ORC_Imp_AUTO == 0)
			{
				//CRC automatisch berechnen
				crc = 0xFF;
				crc = crctableProfTwo[crc ^ payload[1]];
				crc = crctableProfTwo[crc ^ payload[2]];
				crc = crctableProfTwo[crc ^ payload[3]];
				crc = crctableProfTwo[crc ^ payload[4]];
				crc = crctableProfTwo[crc ^ payload[5]];
				crc = crctableProfTwo[crc ^ payload[6]];
				crc = crctableProfTwo[crc ^ payload[7]];
				switch (CounterValForCRC_Impact_Pr2)
				{
					case(0) :
						crc = crctableProfTwo[crc ^ 93];
						break;
					case(1) :
						crc = crctableProfTwo[crc ^ 168];
						break;
					case(2) :
						crc = crctableProfTwo[crc ^ 243];
						break;
					case(3) :
						crc = crctableProfTwo[crc ^ 67];
						break;
					case(4) :
						crc = crctableProfTwo[crc ^ 142];
						break;
					case(5) :
						crc = crctableProfTwo[crc ^ 217];
						break;
					case(6) :
						crc = crctableProfTwo[crc ^ 41];
						break;
					case(7) :
						crc = crctableProfTwo[crc ^ 116];
						break;
					case(8) :
						crc = crctableProfTwo[crc ^ 191];
						break;
					case(9) :
						crc = crctableProfTwo[crc ^ 15];
						break;
					case(10) :
						crc = crctableProfTwo[crc ^ 90];
						break;
					case(11) :
						crc = crctableProfTwo[crc ^ 165];
						break;
					case(12) :
						crc = crctableProfTwo[crc ^ 240];
						break;
					case(13) :
						crc = crctableProfTwo[crc ^ 64];
						break;
					case(14) :
						crc = crctableProfTwo[crc ^ 139];
						break;
					case(15) :
						crc = crctableProfTwo[crc ^ 214];
						break;
					default :
//						write("error: wrong parameter (%d)",CounterValForCRC_Impact_Pr2); stop();
						break;
				}
				crc = (crc ^ 0xFF);
				payload[0] = crc;
			}
			else
			{
				//CRC manuel veränderbar
			}

			CH_EISORC_Disp_Stat_AR2();
			CH_EISORC_Impact_AR2();
		}
	}
	if (strncmp (pduName, "Park_Disp_Rs_AR2", strLen(pduName)+strLen("Park_Disp_Rs_AR2")) == 0)
	{
		if (TxAck == 1)
		{
		}
		else
		{
			CH_EISIC_DriveAssistSys_AR2();
			CH_EISLDC_Disp_Stat_IC_AR2();
			CH_EISPark_Disp_Rs_AR2();
		}
	}
	if (strncmp (pduName, "PHB_IHC_Plus_Tunnel_3_4_AR2", strLen(pduName)+strLen("PHB_IHC_Plus_Tunnel_3_4_AR2")) == 0)
	{
		if (TxAck == 1)
		{
			if (@sysvar::CH_Nodes::CH_EISSQC_PHB_IHC_Plus_Tunn_AUTO == 0)
			{
				//SQC automatisch ändern
				SQC_VAL_PHB_IHC_Plus_Tunnel_3_4_Pr2 = (SQC_VAL_PHB_IHC_Plus_Tunnel_3_4_Pr2 + 1) % 16;
			}
			else
			{
				//SQC manuel veränderbar
			}

		}
		else
		{
			if (@sysvar::CH_Nodes::CH_EISSQC_PHB_IHC_Plus_Tunn_AUTO == 0)
			{
				//SQC automatisch ändern
				//SQC für CRC speichern
				CounterValForCRC_PHB_IHC_Plus_Tunnel_3_4_Pr2 = SQC_VAL_PHB_IHC_Plus_Tunnel_3_4_Pr2;
				//SQC in Byte schreiben
				payload[1] = (payload[1] & ~0x0F) |  SQC_VAL_PHB_IHC_Plus_Tunnel_3_4_Pr2;
			}
			else
			{
				//SQC manuel veränderbar
			}

			if (@sysvar::CH_Nodes::CH_EISCRC_PHB_IHC_Plus_Tunn_AUTO == 0)
			{
				//CRC automatisch berechnen
				crc = 0xFF;
				crc = crctableProfTwo[crc ^ payload[1]];
				crc = crctableProfTwo[crc ^ payload[2]];
				crc = crctableProfTwo[crc ^ payload[3]];
				crc = crctableProfTwo[crc ^ payload[4]];
				crc = crctableProfTwo[crc ^ payload[5]];
				crc = crctableProfTwo[crc ^ payload[6]];
				crc = crctableProfTwo[crc ^ payload[7]];
				switch (CounterValForCRC_PHB_IHC_Plus_Tunnel_3_4_Pr2)
				{
					case(0) :
						crc = crctableProfTwo[crc ^ 128];
						break;
					case(1) :
						crc = crctableProfTwo[crc ^ 126];
						break;
					case(2) :
						crc = crctableProfTwo[crc ^ 124];
						break;
					case(3) :
						crc = crctableProfTwo[crc ^ 122];
						break;
					case(4) :
						crc = crctableProfTwo[crc ^ 120];
						break;
					case(5) :
						crc = crctableProfTwo[crc ^ 118];
						break;
					case(6) :
						crc = crctableProfTwo[crc ^ 116];
						break;
					case(7) :
						crc = crctableProfTwo[crc ^ 114];
						break;
					case(8) :
						crc = crctableProfTwo[crc ^ 112];
						break;
					case(9) :
						crc = crctableProfTwo[crc ^ 110];
						break;
					case(10) :
						crc = crctableProfTwo[crc ^ 108];
						break;
					case(11) :
						crc = crctableProfTwo[crc ^ 106];
						break;
					case(12) :
						crc = crctableProfTwo[crc ^ 104];
						break;
					case(13) :
						crc = crctableProfTwo[crc ^ 102];
						break;
					case(14) :
						crc = crctableProfTwo[crc ^ 100];
						break;
					case(15) :
						crc = crctableProfTwo[crc ^ 98];
						break;
					default :
//						write("error: wrong parameter (%d)",CounterValForCRC_PHB_IHC_Plus_Tunnel_3_4_Pr2); stop();
						break;
				}
				crc = (crc ^ 0xFF);
				payload[0] = crc;
			}
			else
			{
				//CRC manuel veränderbar
			}

			CH_EISIHC_Lgt_Stat_HLI_AR2();
			CH_EISPHB_IHC_Plus_Tunnel_AR2();
			CH_EISPHB_IHC_Plus_Tunnel_3_4_AR2();
			CH_EISIHC_Lgt_Stat_HLI_2_AR2();
			CH_EISEPKB_Stat_AR2();
		}
	}
	if (strncmp (pduName, "PHB_IHC_Plus_Tunnel_AR2", strLen(pduName)+strLen("PHB_IHC_Plus_Tunnel_AR2")) == 0)
	{
		if (TxAck == 1)
		{
			if (@sysvar::CH_Nodes::CH_EISSQC_PHB_IHC_Plus_Tunn_A_01 == 0)
			{
				//SQC automatisch ändern
				SQC_VAL_PHB_IHC_Plus_Tunnel_Pr2 = (SQC_VAL_PHB_IHC_Plus_Tunnel_Pr2 + 1) % 16;
			}
			else
			{
				//SQC manuel veränderbar
			}

		}
		else
		{
			if (@sysvar::CH_Nodes::CH_EISSQC_PHB_IHC_Plus_Tunn_A_01 == 0)
			{
				//SQC automatisch ändern
				//SQC für CRC speichern
				CounterValForCRC_PHB_IHC_Plus_Tunnel_Pr2 = SQC_VAL_PHB_IHC_Plus_Tunnel_Pr2;
				//SQC in Byte schreiben
				payload[1] = (payload[1] & ~0x0F) |  SQC_VAL_PHB_IHC_Plus_Tunnel_Pr2;
			}
			else
			{
				//SQC manuel veränderbar
			}

			if (@sysvar::CH_Nodes::CH_EISCRC_PHB_IHC_Plus_Tunn_A_01 == 0)
			{
				//CRC automatisch berechnen
				crc = 0xFF;
				crc = crctableProfTwo[crc ^ payload[1]];
				crc = crctableProfTwo[crc ^ payload[2]];
				crc = crctableProfTwo[crc ^ payload[3]];
				crc = crctableProfTwo[crc ^ payload[4]];
				crc = crctableProfTwo[crc ^ payload[5]];
				crc = crctableProfTwo[crc ^ payload[6]];
				crc = crctableProfTwo[crc ^ payload[7]];
				switch (CounterValForCRC_PHB_IHC_Plus_Tunnel_Pr2)
				{
					case(0) :
						crc = crctableProfTwo[crc ^ 113];
						break;
					case(1) :
						crc = crctableProfTwo[crc ^ 84];
						break;
					case(2) :
						crc = crctableProfTwo[crc ^ 55];
						break;
					case(3) :
						crc = crctableProfTwo[crc ^ 26];
						break;
					case(4) :
						crc = crctableProfTwo[crc ^ 248];
						break;
					case(5) :
						crc = crctableProfTwo[crc ^ 219];
						break;
					case(6) :
						crc = crctableProfTwo[crc ^ 190];
						break;
					case(7) :
						crc = crctableProfTwo[crc ^ 161];
						break;
					case(8) :
						crc = crctableProfTwo[crc ^ 132];
						break;
					case(9) :
						crc = crctableProfTwo[crc ^ 103];
						break;
					case(10) :
						crc = crctableProfTwo[crc ^ 74];
						break;
					case(11) :
						crc = crctableProfTwo[crc ^ 45];
						break;
					case(12) :
						crc = crctableProfTwo[crc ^ 16];
						break;
					case(13) :
						crc = crctableProfTwo[crc ^ 238];
						break;
					case(14) :
						crc = crctableProfTwo[crc ^ 209];
						break;
					case(15) :
						crc = crctableProfTwo[crc ^ 180];
						break;
					default :
//						write("error: wrong parameter (%d)",CounterValForCRC_PHB_IHC_Plus_Tunnel_Pr2); stop();
						break;
				}
				crc = (crc ^ 0xFF);
				payload[0] = crc;
			}
			else
			{
				//CRC manuel veränderbar
			}

			CH_EISIHC_Lgt_Stat_HLI_AR2();
			CH_EISPHB_IHC_Plus_Tunnel_AR2();
			CH_EISPHB_IHC_Plus_Tunnel_3_4_AR2();
			CH_EISIHC_Lgt_Stat_HLI_2_AR2();
			CH_EISEPKB_Stat_AR2();
		}
	}
	if (strncmp (pduName, "PN14_Disp_Rq_AR", strLen(pduName)+strLen("PN14_Disp_Rq_AR")) == 0)
	{
		if (TxAck == 1)
		{
		}
		else
		{
		}
	}
	if (strncmp (pduName, "PN14_Rs1_AR2", strLen(pduName)+strLen("PN14_Rs1_AR2")) == 0)
	{
		if (TxAck == 1)
		{
			if (@sysvar::CH_Nodes::CH_EISSQC_PN14_Rs1_Pr2PN14__AUTO == 0)
			{
				//SQC automatisch ändern
				SQC_VAL_PN14_Rs1_Pr2 = (SQC_VAL_PN14_Rs1_Pr2 + 1) % 16;
			}
			else
			{
				//SQC manuel veränderbar
			}

		}
		else
		{
			if (@sysvar::CH_Nodes::CH_EISSQC_PN14_Rs1_Pr2PN14__AUTO == 0)
			{
				//SQC automatisch ändern
				//SQC für CRC speichern
				CounterValForCRC_PN14_Rs1_Pr2 = SQC_VAL_PN14_Rs1_Pr2;
				//SQC in Byte schreiben
				payload[1] = (payload[1] & ~0x0F) |  SQC_VAL_PN14_Rs1_Pr2;
			}
			else
			{
				//SQC manuel veränderbar
			}

			if (@sysvar::CH_Nodes::CH_EISCRC_PN14_Rs1_Pr2PN14__AUTO == 0)
			{
				//CRC automatisch berechnen
				crc = 0xFF;
				crc = crctableProfTwo[crc ^ payload[1]];
				crc = crctableProfTwo[crc ^ payload[2]];
				crc = crctableProfTwo[crc ^ payload[3]];
				crc = crctableProfTwo[crc ^ payload[4]];
				crc = crctableProfTwo[crc ^ payload[5]];
				crc = crctableProfTwo[crc ^ payload[6]];
				crc = crctableProfTwo[crc ^ payload[7]];
				switch (CounterValForCRC_PN14_Rs1_Pr2)
				{
					case(0) :
						crc = crctableProfTwo[crc ^ 50];
						break;
					case(1) :
						crc = crctableProfTwo[crc ^ 104];
						break;
					case(2) :
						crc = crctableProfTwo[crc ^ 158];
						break;
					case(3) :
						crc = crctableProfTwo[crc ^ 212];
						break;
					case(4) :
						crc = crctableProfTwo[crc ^ 15];
						break;
					case(5) :
						crc = crctableProfTwo[crc ^ 69];
						break;
					case(6) :
						crc = crctableProfTwo[crc ^ 123];
						break;
					case(7) :
						crc = crctableProfTwo[crc ^ 177];
						break;
					case(8) :
						crc = crctableProfTwo[crc ^ 231];
						break;
					case(9) :
						crc = crctableProfTwo[crc ^ 34];
						break;
					case(10) :
						crc = crctableProfTwo[crc ^ 88];
						break;
					case(11) :
						crc = crctableProfTwo[crc ^ 142];
						break;
					case(12) :
						crc = crctableProfTwo[crc ^ 196];
						break;
					case(13) :
						crc = crctableProfTwo[crc ^ 250];
						break;
					case(14) :
						crc = crctableProfTwo[crc ^ 53];
						break;
					case(15) :
						crc = crctableProfTwo[crc ^ 107];
						break;
					default :
//						write("error: wrong parameter (%d)",CounterValForCRC_PN14_Rs1_Pr2); stop();
						break;
				}
				crc = (crc ^ 0xFF);
				payload[0] = crc;
			}
			else
			{
				//CRC manuel veränderbar
			}

			CH_EISPN14_Stat2_AR2();
			CH_EISPN14_Rs1_AR2();
			CH_EISPN14_Rs2_AR();
			CH_EISPN14_Stat_AR();
		}
	}
	if (strncmp (pduName, "PN14_Rs2_AR", strLen(pduName)+strLen("PN14_Rs2_AR")) == 0)
	{
		if (TxAck == 1)
		{
		}
		else
		{
			CH_EISPN14_Stat2_AR2();
			CH_EISPN14_Rs1_AR2();
			CH_EISPN14_Rs2_AR();
			CH_EISPN14_Stat_AR();
		}
	}
	if (strncmp (pduName, "PN14_Stat2_AR2", strLen(pduName)+strLen("PN14_Stat2_AR2")) == 0)
	{
		if (TxAck == 1)
		{
		}
		else
		{
			CH_EISPN14_Stat2_AR2();
			CH_EISPN14_Rs1_AR2();
			CH_EISPN14_Rs2_AR();
			CH_EISPN14_Stat_AR();
		}
	}
	if (strncmp (pduName, "PN14_Stat_AR", strLen(pduName)+strLen("PN14_Stat_AR")) == 0)
	{
		if (TxAck == 1)
		{
		}
		else
		{
			CH_EISPN14_Stat2_AR2();
			CH_EISPN14_Rs1_AR2();
			CH_EISPN14_Rs2_AR();
			CH_EISPN14_Stat_AR();
		}
	}
	if (strncmp (pduName, "PN48_Bat_Stat2_AR2", strLen(pduName)+strLen("PN48_Bat_Stat2_AR2")) == 0)
	{
		if (TxAck == 1)
		{
		}
		else
		{
		}
	}
	if (strncmp (pduName, "PN48_Bat_Stat_AR", strLen(pduName)+strLen("PN48_Bat_Stat_AR")) == 0)
	{
		if (TxAck == 1)
		{
		}
		else
		{
			CH_EISPN48_Stat_AR();
			CH_EISPN48_Bat_Stat_AR();
			CH_EISPN48_BatLim_Stat_AR();
		}
	}
	if (strncmp (pduName, "PN48_BatLim_Stat_AR", strLen(pduName)+strLen("PN48_BatLim_Stat_AR")) == 0)
	{
		if (TxAck == 1)
		{
		}
		else
		{
			CH_EISPN48_Stat_AR();
			CH_EISPN48_Bat_Stat_AR();
			CH_EISPN48_BatLim_Stat_AR();
		}
	}
	if (strncmp (pduName, "PN48_DCDC48_LISB48_Stat_AR", strLen(pduName)+strLen("PN48_DCDC48_LISB48_Stat_AR")) == 0)
	{
		if (TxAck == 1)
		{
		}
		else
		{
		}
	}
	if (strncmp (pduName, "PN48_Stat_AR", strLen(pduName)+strLen("PN48_Stat_AR")) == 0)
	{
		if (TxAck == 1)
		{
		}
		else
		{
			CH_EISPN48_Stat_AR();
			CH_EISPN48_Bat_Stat_AR();
			CH_EISPN48_BatLim_Stat_AR();
		}
	}
	if (strncmp (pduName, "PNHV_WeekDepTmTbl_Rq_HU_AR2", strLen(pduName)+strLen("PNHV_WeekDepTmTbl_Rq_HU_AR2")) == 0)
	{
		if (TxAck == 1)
		{
		}
		else
		{
			CH_EISPNHV_WeekDepTmTbl_Rq_HU_AR2();
			CH_EISHMI_CHASSIS_R1_AR2();
			CH_EISDPC_IndMd_Rq_AR();
		}
	}
	if (strncmp (pduName, "PreCond_On_Rq_AR", strLen(pduName)+strLen("PreCond_On_Rq_AR")) == 0)
	{
		if (TxAck == 1)
		{
		}
		else
		{
		}
	}
	if (strncmp (pduName, "PreCond_Rq_HU_AR2", strLen(pduName)+strLen("PreCond_Rq_HU_AR2")) == 0)
	{
		if (TxAck == 1)
		{
		}
		else
		{
		}
	}
	if (strncmp (pduName, "PreCond_Stat_AR", strLen(pduName)+strLen("PreCond_Stat_AR")) == 0)
	{
		if (TxAck == 1)
		{
		}
		else
		{
		}
	}
	if (strncmp (pduName, "PT_ObjIntrst_Gw_AR2", strLen(pduName)+strLen("PT_ObjIntrst_Gw_AR2")) == 0)
	{
		if (TxAck == 1)
		{
			if (@sysvar::CH_Nodes::CH_EISSQC_PT_ObjIntrst_Pr2P_AUTO == 0)
			{
				//SQC automatisch ändern
				SQC_VAL_PT_ObjIntrst_Pr2 = (SQC_VAL_PT_ObjIntrst_Pr2 + 1) % 16;
			}
			else
			{
				//SQC manuel veränderbar
			}

		}
		else
		{
			if (@sysvar::CH_Nodes::CH_EISSQC_PT_ObjIntrst_Pr2P_AUTO == 0)
			{
				//SQC automatisch ändern
				//SQC für CRC speichern
				CounterValForCRC_PT_ObjIntrst_Pr2 = SQC_VAL_PT_ObjIntrst_Pr2;
				//SQC in Byte schreiben
				payload[1] = (payload[1] & ~0x0F) |  SQC_VAL_PT_ObjIntrst_Pr2;
			}
			else
			{
				//SQC manuel veränderbar
			}

			if (@sysvar::CH_Nodes::CH_EISCRC_PT_ObjIntrst_Pr2P_AUTO == 0)
			{
				//CRC automatisch berechnen
				crc = 0xFF;
				crc = crctableProfTwo[crc ^ payload[1]];
				crc = crctableProfTwo[crc ^ payload[2]];
				crc = crctableProfTwo[crc ^ payload[3]];
				crc = crctableProfTwo[crc ^ payload[4]];
				crc = crctableProfTwo[crc ^ payload[5]];
				switch (CounterValForCRC_PT_ObjIntrst_Pr2)
				{
					case(0) :
						crc = crctableProfTwo[crc ^ 161];
						break;
					case(1) :
						crc = crctableProfTwo[crc ^ 85];
						break;
					case(2) :
						crc = crctableProfTwo[crc ^ 9];
						break;
					case(3) :
						crc = crctableProfTwo[crc ^ 184];
						break;
					case(4) :
						crc = crctableProfTwo[crc ^ 108];
						break;
					case(5) :
						crc = crctableProfTwo[crc ^ 32];
						break;
					case(6) :
						crc = crctableProfTwo[crc ^ 207];
						break;
					case(7) :
						crc = crctableProfTwo[crc ^ 131];
						break;
					case(8) :
						crc = crctableProfTwo[crc ^ 55];
						break;
					case(9) :
						crc = crctableProfTwo[crc ^ 230];
						break;
					case(10) :
						crc = crctableProfTwo[crc ^ 154];
						break;
					case(11) :
						crc = crctableProfTwo[crc ^ 78];
						break;
					case(12) :
						crc = crctableProfTwo[crc ^ 253];
						break;
					case(13) :
						crc = crctableProfTwo[crc ^ 177];
						break;
					case(14) :
						crc = crctableProfTwo[crc ^ 101];
						break;
					case(15) :
						crc = crctableProfTwo[crc ^ 25];
						break;
					default :
//						write("error: wrong parameter (%d)",CounterValForCRC_PT_ObjIntrst_Pr2); stop();
						break;
				}
				crc = (crc ^ 0xFF);
				payload[0] = crc;
			}
			else
			{
				//CRC manuel veränderbar
			}

			CH_EISPT_ObjIntrst_Gw_AR2();
			CH_EISCMS_PI_State_Gw_AR2();
			CH_EISVehAccel_X_Rq_Gw_AR2();
			CH_EISFCW_Disp_Rq_AR();
		}
	}
	if (strncmp (pduName, "RemPark_Auth_Rs_AR2", strLen(pduName)+strLen("RemPark_Auth_Rs_AR2")) == 0)
	{
		if (TxAck == 1)
		{
			if (@sysvar::CH_Nodes::CH_EISSQC_RemPark_Auth_Rs_P_AUTO == 0)
			{
				//SQC automatisch ändern
				SQC_VAL_RemPark_Auth_Rs_Pr2 = (SQC_VAL_RemPark_Auth_Rs_Pr2 + 1) % 16;
			}
			else
			{
				//SQC manuel veränderbar
			}

		}
		else
		{
			if (@sysvar::CH_Nodes::CH_EISSQC_RemPark_Auth_Rs_P_AUTO == 0)
			{
				//SQC automatisch ändern
				//SQC für CRC speichern
				CounterValForCRC_RemPark_Auth_Rs_Pr2 = SQC_VAL_RemPark_Auth_Rs_Pr2;
				//SQC in Byte schreiben
				payload[1] = (payload[1] & ~0x0F) |  SQC_VAL_RemPark_Auth_Rs_Pr2;
			}
			else
			{
				//SQC manuel veränderbar
			}

			if (@sysvar::CH_Nodes::CH_EISCRC_RemPark_Auth_Rs_P_AUTO == 0)
			{
				//CRC automatisch berechnen
				crc = 0xFF;
				crc = crctableProfTwo[crc ^ payload[1]];
				switch (CounterValForCRC_RemPark_Auth_Rs_Pr2)
				{
					case(0) :
						crc = crctableProfTwo[crc ^ 247];
						break;
					case(1) :
						crc = crctableProfTwo[crc ^ 7];
						break;
					case(2) :
						crc = crctableProfTwo[crc ^ 18];
						break;
					case(3) :
						crc = crctableProfTwo[crc ^ 29];
						break;
					case(4) :
						crc = crctableProfTwo[crc ^ 40];
						break;
					case(5) :
						crc = crctableProfTwo[crc ^ 51];
						break;
					case(6) :
						crc = crctableProfTwo[crc ^ 62];
						break;
					case(7) :
						crc = crctableProfTwo[crc ^ 73];
						break;
					case(8) :
						crc = crctableProfTwo[crc ^ 84];
						break;
					case(9) :
						crc = crctableProfTwo[crc ^ 95];
						break;
					case(10) :
						crc = crctableProfTwo[crc ^ 106];
						break;
					case(11) :
						crc = crctableProfTwo[crc ^ 117];
						break;
					case(12) :
						crc = crctableProfTwo[crc ^ 128];
						break;
					case(13) :
						crc = crctableProfTwo[crc ^ 139];
						break;
					case(14) :
						crc = crctableProfTwo[crc ^ 150];
						break;
					case(15) :
						crc = crctableProfTwo[crc ^ 161];
						break;
					default :
//						write("error: wrong parameter (%d)",CounterValForCRC_RemPark_Auth_Rs_Pr2); stop();
						break;
				}
				crc = (crc ^ 0xFF);
				payload[0] = crc;
			}
			else
			{
				//CRC manuel veränderbar
			}

			CH_EISRemPark_Auth_Rs_AR2();
			CH_EISActvComf_Rq_AR2();
		}
	}
	if (strncmp (pduName, "RemPark_Stat_EIS_AR2", strLen(pduName)+strLen("RemPark_Stat_EIS_AR2")) == 0)
	{
		if (TxAck == 1)
		{
			if (@sysvar::CH_Nodes::CH_EISSQC_RemPark_Stat_EIS__AUTO == 0)
			{
				//SQC automatisch ändern
				SQC_VAL_RemPark_Stat_EIS_Pr2 = (SQC_VAL_RemPark_Stat_EIS_Pr2 + 1) % 16;
			}
			else
			{
				//SQC manuel veränderbar
			}

		}
		else
		{
			if (@sysvar::CH_Nodes::CH_EISSQC_RemPark_Stat_EIS__AUTO == 0)
			{
				//SQC automatisch ändern
				//SQC für CRC speichern
				CounterValForCRC_RemPark_Stat_EIS_Pr2 = SQC_VAL_RemPark_Stat_EIS_Pr2;
				//SQC in Byte schreiben
				payload[1] = (payload[1] & ~0x0F) |  SQC_VAL_RemPark_Stat_EIS_Pr2;
			}
			else
			{
				//SQC manuel veränderbar
			}

			if (@sysvar::CH_Nodes::CH_EISCRC_RemPark_Stat_EIS__AUTO == 0)
			{
				//CRC automatisch berechnen
				crc = 0xFF;
				crc = crctableProfTwo[crc ^ payload[1]];
				crc = crctableProfTwo[crc ^ payload[2]];
				switch (CounterValForCRC_RemPark_Stat_EIS_Pr2)
				{
					case(0) :
						crc = crctableProfTwo[crc ^ 252];
						break;
					case(1) :
						crc = crctableProfTwo[crc ^ 142];
						break;
					case(2) :
						crc = crctableProfTwo[crc ^ 32];
						break;
					case(3) :
						crc = crctableProfTwo[crc ^ 173];
						break;
					case(4) :
						crc = crctableProfTwo[crc ^ 63];
						break;
					case(5) :
						crc = crctableProfTwo[crc ^ 204];
						break;
					case(6) :
						crc = crctableProfTwo[crc ^ 94];
						break;
					case(7) :
						crc = crctableProfTwo[crc ^ 235];
						break;
					case(8) :
						crc = crctableProfTwo[crc ^ 125];
						break;
					case(9) :
						crc = crctableProfTwo[crc ^ 15];
						break;
					case(10) :
						crc = crctableProfTwo[crc ^ 156];
						break;
					case(11) :
						crc = crctableProfTwo[crc ^ 46];
						break;
					case(12) :
						crc = crctableProfTwo[crc ^ 187];
						break;
					case(13) :
						crc = crctableProfTwo[crc ^ 77];
						break;
					case(14) :
						crc = crctableProfTwo[crc ^ 218];
						break;
					case(15) :
						crc = crctableProfTwo[crc ^ 108];
						break;
					default :
//						write("error: wrong parameter (%d)",CounterValForCRC_RemPark_Stat_EIS_Pr2); stop();
						break;
				}
				crc = (crc ^ 0xFF);
				payload[0] = crc;
			}
			else
			{
				//CRC manuel veränderbar
			}

			CH_EISRemPark_Stat_EIS_AR2();
			CH_EISCLkS_State_AR();
			CH_EISIgn_Veh_Stat_AR2();
			CH_EISCLkS_Rq_AR();
		}
	}
	if (strncmp (pduName, "RTC_Date_Time_AR2", strLen(pduName)+strLen("RTC_Date_Time_AR2")) == 0)
	{
		if (TxAck == 1)
		{
		}
		else
		{
			CH_EISRTC_Date_Time_AR2();
			CH_EISIC_Settings_AR2();
		}
	}
	if (strncmp (pduName, "RTC_Stat1_AR2", strLen(pduName)+strLen("RTC_Stat1_AR2")) == 0)
	{
		if (TxAck == 1)
		{
		}
		else
		{
		}
	}
	if (strncmp (pduName, "SADR_Trgr_FCW_AR2", strLen(pduName)+strLen("SADR_Trgr_FCW_AR2")) == 0)
	{
		if (TxAck == 1)
		{
			if (@sysvar::CH_Nodes::CH_EISSQC_SADR_Trgr_FCW_Pr2_AUTO == 0)
			{
				//SQC automatisch ändern
				SQC_VAL_SADR_Trgr_FCW_Pr2 = (SQC_VAL_SADR_Trgr_FCW_Pr2 + 1) % 16;
			}
			else
			{
				//SQC manuel veränderbar
			}

		}
		else
		{
			if (@sysvar::CH_Nodes::CH_EISSQC_SADR_Trgr_FCW_Pr2_AUTO == 0)
			{
				//SQC automatisch ändern
				//SQC für CRC speichern
				CounterValForCRC_SADR_Trgr_FCW_Pr2 = SQC_VAL_SADR_Trgr_FCW_Pr2;
				//SQC in Byte schreiben
				payload[1] = (payload[1] & ~0x0F) |  SQC_VAL_SADR_Trgr_FCW_Pr2;
			}
			else
			{
				//SQC manuel veränderbar
			}

			if (@sysvar::CH_Nodes::CH_EISCRC_SADR_Trgr_FCW_Pr2_AUTO == 0)
			{
				//CRC automatisch berechnen
				crc = 0xFF;
				crc = crctableProfTwo[crc ^ payload[1]];
				crc = crctableProfTwo[crc ^ payload[2]];
				crc = crctableProfTwo[crc ^ payload[3]];
				switch (CounterValForCRC_SADR_Trgr_FCW_Pr2)
				{
					case(0) :
						crc = crctableProfTwo[crc ^ 65];
						break;
					case(1) :
						crc = crctableProfTwo[crc ^ 60];
						break;
					case(2) :
						crc = crctableProfTwo[crc ^ 55];
						break;
					case(3) :
						crc = crctableProfTwo[crc ^ 50];
						break;
					case(4) :
						crc = crctableProfTwo[crc ^ 45];
						break;
					case(5) :
						crc = crctableProfTwo[crc ^ 40];
						break;
					case(6) :
						crc = crctableProfTwo[crc ^ 35];
						break;
					case(7) :
						crc = crctableProfTwo[crc ^ 30];
						break;
					case(8) :
						crc = crctableProfTwo[crc ^ 25];
						break;
					case(9) :
						crc = crctableProfTwo[crc ^ 20];
						break;
					case(10) :
						crc = crctableProfTwo[crc ^ 15];
						break;
					case(11) :
						crc = crctableProfTwo[crc ^ 10];
						break;
					case(12) :
						crc = crctableProfTwo[crc ^ 5];
						break;
					case(13) :
						crc = crctableProfTwo[crc ^ 251];
						break;
					case(14) :
						crc = crctableProfTwo[crc ^ 246];
						break;
					case(15) :
						crc = crctableProfTwo[crc ^ 241];
						break;
					default :
//						write("error: wrong parameter (%d)",CounterValForCRC_SADR_Trgr_FCW_Pr2); stop();
						break;
				}
				crc = (crc ^ 0xFF);
				payload[0] = crc;
			}
			else
			{
				//CRC manuel veränderbar
			}

			CH_EISSADR_Trgr_FCW_AR2();
		}
	}
	if (strncmp (pduName, "SeatAdj_FL_Rq_AR", strLen(pduName)+strLen("SeatAdj_FL_Rq_AR")) == 0)
	{
		if (TxAck == 1)
		{
			if (@sysvar::CH_Nodes::CH_EISSeat_FL_TglSeatAdj_FL_AUTO == 0)
			{
				//TGL automatisch ändern
				TGL_VAL_eat_FL_ = (TGL_VAL_eat_FL_ + 1) % 2;
			}
			else
			{
				//TGL manuel veränderbar
			}

		}
		else
		{
			if (@sysvar::CH_Nodes::CH_EISSeat_FL_TglSeatAdj_FL_AUTO == 0)
			{
				//TGL automatisch ändern
				//TGL in Byte schreiben
				payload[0] = (payload[0] & ~0x01) |  TGL_VAL_eat_FL_;
			}
			else
			{
				//TGL manuel veränderbar
			}

		}
	}
	if (strncmp (pduName, "SeatAdj_FR_Rq_AR", strLen(pduName)+strLen("SeatAdj_FR_Rq_AR")) == 0)
	{
		if (TxAck == 1)
		{
			if (@sysvar::CH_Nodes::CH_EISSeat_FR_TglSeatAdj_FR_AUTO == 0)
			{
				//TGL automatisch ändern
				TGL_VAL_eat_FR_ = (TGL_VAL_eat_FR_ + 1) % 2;
			}
			else
			{
				//TGL manuel veränderbar
			}

		}
		else
		{
			if (@sysvar::CH_Nodes::CH_EISSeat_FR_TglSeatAdj_FR_AUTO == 0)
			{
				//TGL automatisch ändern
				//TGL in Byte schreiben
				payload[0] = (payload[0] & ~0x01) |  TGL_VAL_eat_FR_;
			}
			else
			{
				//TGL manuel veränderbar
			}

		}
	}
	if (strncmp (pduName, "SPCR_Stat_BC_F_AR2", strLen(pduName)+strLen("SPCR_Stat_BC_F_AR2")) == 0)
	{
		if (TxAck == 1)
		{
			if (@sysvar::CH_Nodes::CH_EISSQC_SPCR_Stat_BC_F_Pr_AUTO == 0)
			{
				//SQC automatisch ändern
				SQC_VAL_SPCR_Stat_BC_F_Pr2 = (SQC_VAL_SPCR_Stat_BC_F_Pr2 + 1) % 16;
			}
			else
			{
				//SQC manuel veränderbar
			}

		}
		else
		{
			if (@sysvar::CH_Nodes::CH_EISSQC_SPCR_Stat_BC_F_Pr_AUTO == 0)
			{
				//SQC automatisch ändern
				//SQC für CRC speichern
				CounterValForCRC_SPCR_Stat_BC_F_Pr2 = SQC_VAL_SPCR_Stat_BC_F_Pr2;
				//SQC in Byte schreiben
				payload[1] = (payload[1] & ~0x0F) |  SQC_VAL_SPCR_Stat_BC_F_Pr2;
			}
			else
			{
				//SQC manuel veränderbar
			}

			if (@sysvar::CH_Nodes::CH_EISCRC_SPCR_Stat_BC_F_Pr_AUTO == 0)
			{
				//CRC automatisch berechnen
				crc = 0xFF;
				crc = crctableProfTwo[crc ^ payload[1]];
				crc = crctableProfTwo[crc ^ payload[2]];
				switch (CounterValForCRC_SPCR_Stat_BC_F_Pr2)
				{
					case(0) :
						crc = crctableProfTwo[crc ^ 66];
						break;
					case(1) :
						crc = crctableProfTwo[crc ^ 193];
						break;
					case(2) :
						crc = crctableProfTwo[crc ^ 69];
						break;
					case(3) :
						crc = crctableProfTwo[crc ^ 196];
						break;
					case(4) :
						crc = crctableProfTwo[crc ^ 72];
						break;
					case(5) :
						crc = crctableProfTwo[crc ^ 199];
						break;
					case(6) :
						crc = crctableProfTwo[crc ^ 75];
						break;
					case(7) :
						crc = crctableProfTwo[crc ^ 202];
						break;
					case(8) :
						crc = crctableProfTwo[crc ^ 78];
						break;
					case(9) :
						crc = crctableProfTwo[crc ^ 205];
						break;
					case(10) :
						crc = crctableProfTwo[crc ^ 81];
						break;
					case(11) :
						crc = crctableProfTwo[crc ^ 208];
						break;
					case(12) :
						crc = crctableProfTwo[crc ^ 84];
						break;
					case(13) :
						crc = crctableProfTwo[crc ^ 211];
						break;
					case(14) :
						crc = crctableProfTwo[crc ^ 87];
						break;
					case(15) :
						crc = crctableProfTwo[crc ^ 214];
						break;
					default :
//						write("error: wrong parameter (%d)",CounterValForCRC_SPCR_Stat_BC_F_Pr2); stop();
						break;
				}
				crc = (crc ^ 0xFF);
				payload[0] = crc;
			}
			else
			{
				//CRC manuel veränderbar
			}

			CH_EISBC_R_Stat1_AR();
			CH_EISBC_F_Stat2_AR2();
			CH_EISSPCR_Stat_BC_F_AR2();
		}
	}
	if (strncmp (pduName, "SPL_Obj1_Obj2_NV_AR2", strLen(pduName)+strLen("SPL_Obj1_Obj2_NV_AR2")) == 0)
	{
		if (TxAck == 1)
		{
			if (@sysvar::CH_Nodes::CH_EISSQC_SPL_Obj1_Obj2_NV__AUTO == 0)
			{
				//SQC automatisch ändern
				SQC_VAL_SPL_Obj1_Obj2_NV_Pr2 = (SQC_VAL_SPL_Obj1_Obj2_NV_Pr2 + 1) % 16;
			}
			else
			{
				//SQC manuel veränderbar
			}

		}
		else
		{
			if (@sysvar::CH_Nodes::CH_EISSQC_SPL_Obj1_Obj2_NV__AUTO == 0)
			{
				//SQC automatisch ändern
				//SQC für CRC speichern
				CounterValForCRC_SPL_Obj1_Obj2_NV_Pr2 = SQC_VAL_SPL_Obj1_Obj2_NV_Pr2;
				//SQC in Byte schreiben
				payload[1] = (payload[1] & ~0x0F) |  SQC_VAL_SPL_Obj1_Obj2_NV_Pr2;
			}
			else
			{
				//SQC manuel veränderbar
			}

			if (@sysvar::CH_Nodes::CH_EISCRC_SPL_Obj1_Obj2_NV__AUTO == 0)
			{
				//CRC automatisch berechnen
				crc = 0xFF;
				crc = crctableProfTwo[crc ^ payload[1]];
				crc = crctableProfTwo[crc ^ payload[2]];
				crc = crctableProfTwo[crc ^ payload[3]];
				crc = crctableProfTwo[crc ^ payload[4]];
				crc = crctableProfTwo[crc ^ payload[5]];
				crc = crctableProfTwo[crc ^ payload[6]];
				crc = crctableProfTwo[crc ^ payload[7]];
				switch (CounterValForCRC_SPL_Obj1_Obj2_NV_Pr2)
				{
					case(0) :
						crc = crctableProfTwo[crc ^ 251];
						break;
					case(1) :
						crc = crctableProfTwo[crc ^ 43];
						break;
					case(2) :
						crc = crctableProfTwo[crc ^ 86];
						break;
					case(3) :
						crc = crctableProfTwo[crc ^ 129];
						break;
					case(4) :
						crc = crctableProfTwo[crc ^ 172];
						break;
					case(5) :
						crc = crctableProfTwo[crc ^ 215];
						break;
					case(6) :
						crc = crctableProfTwo[crc ^ 7];
						break;
					case(7) :
						crc = crctableProfTwo[crc ^ 50];
						break;
					case(8) :
						crc = crctableProfTwo[crc ^ 93];
						break;
					case(9) :
						crc = crctableProfTwo[crc ^ 136];
						break;
					case(10) :
						crc = crctableProfTwo[crc ^ 179];
						break;
					case(11) :
						crc = crctableProfTwo[crc ^ 222];
						break;
					case(12) :
						crc = crctableProfTwo[crc ^ 14];
						break;
					case(13) :
						crc = crctableProfTwo[crc ^ 57];
						break;
					case(14) :
						crc = crctableProfTwo[crc ^ 100];
						break;
					case(15) :
						crc = crctableProfTwo[crc ^ 143];
						break;
					default :
//						write("error: wrong parameter (%d)",CounterValForCRC_SPL_Obj1_Obj2_NV_Pr2); stop();
						break;
				}
				crc = (crc ^ 0xFF);
				payload[0] = crc;
			}
			else
			{
				//CRC manuel veränderbar
			}

			CH_EISNVP_Stat1_AR2();
			CH_EISBSM_Disp_Warn_Rq_AR2();
			CH_EISSPL_Obj1_Obj2_NV_AR2();
		}
	}
	if (strncmp (pduName, "SPV_Actn_Rq_AR2", strLen(pduName)+strLen("SPV_Actn_Rq_AR2")) == 0)
	{
		if (TxAck == 1)
		{
			if (@sysvar::CH_Nodes::CH_EISSQC_SPV_ExtLgt_Rq_Pr2_AUTO == 0)
			{
				//SQC automatisch ändern
				SQC_VAL_SPV_ExtLgt_Rq_Pr2 = (SQC_VAL_SPV_ExtLgt_Rq_Pr2 + 1) % 16;
			}
			else
			{
				//SQC manuel veränderbar
			}
			if (@sysvar::CH_Nodes::CH_EISSQC_SPV_WprWash_Rq_Pr_AUTO == 0)
			{
				//SQC automatisch ändern
				SQC_VAL_SPV_WprWash_Rq_Pr2 = (SQC_VAL_SPV_WprWash_Rq_Pr2 + 1) % 16;
			}
			else
			{
				//SQC manuel veränderbar
			}

		}
		else
		{
			if (@sysvar::CH_Nodes::CH_EISSQC_SPV_ExtLgt_Rq_Pr2_AUTO == 0)
			{
				//SQC automatisch ändern
				//SQC für CRC speichern
				CounterValForCRC_SPV_ExtLgt_Rq_Pr2 = SQC_VAL_SPV_ExtLgt_Rq_Pr2;
				//SQC in Byte schreiben
				payload[1] = (payload[1] & ~0x0F) |  SQC_VAL_SPV_ExtLgt_Rq_Pr2;
			}
			else
			{
				//SQC manuel veränderbar
			}
			if (@sysvar::CH_Nodes::CH_EISSQC_SPV_WprWash_Rq_Pr_AUTO == 0)
			{
				//SQC automatisch ändern
				//SQC für CRC speichern
				CounterValForCRC_SPV_WprWash_Rq_Pr2 = SQC_VAL_SPV_WprWash_Rq_Pr2;
				//SQC in Byte schreiben
				payload[4] = (payload[4] & ~0x0F) |  SQC_VAL_SPV_WprWash_Rq_Pr2;
			}
			else
			{
				//SQC manuel veränderbar
			}

			if (@sysvar::CH_Nodes::CH_EISCRC_SPV_ExtLgt_Rq_Pr2_AUTO == 0)
			{
				//CRC automatisch berechnen
				crc = 0xFF;
				crc = crctableProfTwo[crc ^ payload[1]];
				crc = crctableProfTwo[crc ^ payload[2]];
				switch (CounterValForCRC_SPV_ExtLgt_Rq_Pr2)
				{
					case(0) :
						crc = crctableProfTwo[crc ^ 243];
						break;
					case(1) :
						crc = crctableProfTwo[crc ^ 9];
						break;
					case(2) :
						crc = crctableProfTwo[crc ^ 26];
						break;
					case(3) :
						crc = crctableProfTwo[crc ^ 43];
						break;
					case(4) :
						crc = crctableProfTwo[crc ^ 60];
						break;
					case(5) :
						crc = crctableProfTwo[crc ^ 77];
						break;
					case(6) :
						crc = crctableProfTwo[crc ^ 94];
						break;
					case(7) :
						crc = crctableProfTwo[crc ^ 111];
						break;
					case(8) :
						crc = crctableProfTwo[crc ^ 128];
						break;
					case(9) :
						crc = crctableProfTwo[crc ^ 145];
						break;
					case(10) :
						crc = crctableProfTwo[crc ^ 162];
						break;
					case(11) :
						crc = crctableProfTwo[crc ^ 179];
						break;
					case(12) :
						crc = crctableProfTwo[crc ^ 196];
						break;
					case(13) :
						crc = crctableProfTwo[crc ^ 213];
						break;
					case(14) :
						crc = crctableProfTwo[crc ^ 230];
						break;
					case(15) :
						crc = crctableProfTwo[crc ^ 247];
						break;
					default :
//						write("error: wrong parameter (%d)",CounterValForCRC_SPV_ExtLgt_Rq_Pr2); stop();
						break;
				}
				crc = (crc ^ 0xFF);
				payload[0] = crc;
			}
			else
			{
				//CRC manuel veränderbar
			}
			if (@sysvar::CH_Nodes::CH_EISCRC_SPV_WprWash_Rq_Pr_AUTO == 0)
			{
				//CRC automatisch berechnen
				crc = 0xFF;
				crc = crctableProfTwo[crc ^ payload[4]];
				crc = crctableProfTwo[crc ^ payload[5]];
				switch (CounterValForCRC_SPV_WprWash_Rq_Pr2)
				{
					case(0) :
						crc = crctableProfTwo[crc ^ 126];
						break;
					case(1) :
						crc = crctableProfTwo[crc ^ 175];
						break;
					case(2) :
						crc = crctableProfTwo[crc ^ 224];
						break;
					case(3) :
						crc = crctableProfTwo[crc ^ 22];
						break;
					case(4) :
						crc = crctableProfTwo[crc ^ 71];
						break;
					case(5) :
						crc = crctableProfTwo[crc ^ 120];
						break;
					case(6) :
						crc = crctableProfTwo[crc ^ 169];
						break;
					case(7) :
						crc = crctableProfTwo[crc ^ 218];
						break;
					case(8) :
						crc = crctableProfTwo[crc ^ 16];
						break;
					case(9) :
						crc = crctableProfTwo[crc ^ 65];
						break;
					case(10) :
						crc = crctableProfTwo[crc ^ 114];
						break;
					case(11) :
						crc = crctableProfTwo[crc ^ 163];
						break;
					case(12) :
						crc = crctableProfTwo[crc ^ 212];
						break;
					case(13) :
						crc = crctableProfTwo[crc ^ 10];
						break;
					case(14) :
						crc = crctableProfTwo[crc ^ 59];
						break;
					case(15) :
						crc = crctableProfTwo[crc ^ 108];
						break;
					default :
//						write("error: wrong parameter (%d)",CounterValForCRC_SPV_WprWash_Rq_Pr2); stop();
						break;
				}
				crc = (crc ^ 0xFF);
				payload[3] = crc;
			}
			else
			{
				//CRC manuel veränderbar
			}

			CH_EISSPV_Alm_Rq_AR();
			CH_EISBODY_CHASSIS_R1_AR();
			CH_EISSPV_Actn_Rq_AR2();
		}
	}
	if (strncmp (pduName, "SPV_Alm_Rq_AR", strLen(pduName)+strLen("SPV_Alm_Rq_AR")) == 0)
	{
		if (TxAck == 1)
		{
		}
		else
		{
			CH_EISSPV_Alm_Rq_AR();
			CH_EISBODY_CHASSIS_R1_AR();
			CH_EISSPV_Actn_Rq_AR2();
		}
	}
	if (strncmp (pduName, "SPV_Stat_AR2", strLen(pduName)+strLen("SPV_Stat_AR2")) == 0)
	{
		if (TxAck == 1)
		{
		}
		else
		{
		}
	}
	if (strncmp (pduName, "SVS_Rq_HU_AR2", strLen(pduName)+strLen("SVS_Rq_HU_AR2")) == 0)
	{
		if (TxAck == 1)
		{
		}
		else
		{
			CH_EISSVS_Rq_HU_AR2();
			CH_EISTrafficInfo_AR();
			CH_EISHU_State_AR();
			CH_EISTire_State_AR2();
			CH_EISCTRL_C_Stat1_AR();
		}
	}
	if (strncmp (pduName, "TBCSC_DAC_EPS_AR2", strLen(pduName)+strLen("TBCSC_DAC_EPS_AR2")) == 0)
	{
		if (TxAck == 1)
		{
		}
		else
		{
			CH_EISTBCSC_DAC_ESP_AR2();
			CH_EISTBCSC_DAC_EPS_AR2();
		}
	}
	if (strncmp (pduName, "TBCSC_DAC_ESP_AR2", strLen(pduName)+strLen("TBCSC_DAC_ESP_AR2")) == 0)
	{
		if (TxAck == 1)
		{
		}
		else
		{
			CH_EISTBCSC_DAC_ESP_AR2();
			CH_EISTBCSC_DAC_EPS_AR2();
		}
	}
	if (strncmp (pduName, "TBCSC_Hi_Rq1_AR2", strLen(pduName)+strLen("TBCSC_Hi_Rq1_AR2")) == 0)
	{
		if (TxAck == 1)
		{
			if (@sysvar::CH_Nodes::CH_EISSQC_TBCSC_Hi_Rq1_Pr2T_AUTO == 0)
			{
				//SQC automatisch ändern
				SQC_VAL_TBCSC_Hi_Rq1_Pr2 = (SQC_VAL_TBCSC_Hi_Rq1_Pr2 + 1) % 16;
			}
			else
			{
				//SQC manuel veränderbar
			}

		}
		else
		{
			if (@sysvar::CH_Nodes::CH_EISSQC_TBCSC_Hi_Rq1_Pr2T_AUTO == 0)
			{
				//SQC automatisch ändern
				//SQC für CRC speichern
				CounterValForCRC_TBCSC_Hi_Rq1_Pr2 = SQC_VAL_TBCSC_Hi_Rq1_Pr2;
				//SQC in Byte schreiben
				payload[1] = (payload[1] & ~0x0F) |  SQC_VAL_TBCSC_Hi_Rq1_Pr2;
			}
			else
			{
				//SQC manuel veränderbar
			}

			if (@sysvar::CH_Nodes::CH_EISCRC_TBCSC_Hi_Rq1_Pr2T_AUTO == 0)
			{
				//CRC automatisch berechnen
				crc = 0xFF;
				crc = crctableProfTwo[crc ^ payload[1]];
				crc = crctableProfTwo[crc ^ payload[2]];
				crc = crctableProfTwo[crc ^ payload[3]];
				crc = crctableProfTwo[crc ^ payload[4]];
				crc = crctableProfTwo[crc ^ payload[5]];
				crc = crctableProfTwo[crc ^ payload[6]];
				crc = crctableProfTwo[crc ^ payload[7]];
				switch (CounterValForCRC_TBCSC_Hi_Rq1_Pr2)
				{
					case(0) :
						crc = crctableProfTwo[crc ^ 213];
						break;
					case(1) :
						crc = crctableProfTwo[crc ^ 3];
						break;
					case(2) :
						crc = crctableProfTwo[crc ^ 44];
						break;
					case(3) :
						crc = crctableProfTwo[crc ^ 85];
						break;
					case(4) :
						crc = crctableProfTwo[crc ^ 126];
						break;
					case(5) :
						crc = crctableProfTwo[crc ^ 167];
						break;
					case(6) :
						crc = crctableProfTwo[crc ^ 208];
						break;
					case(7) :
						crc = crctableProfTwo[crc ^ 249];
						break;
					case(8) :
						crc = crctableProfTwo[crc ^ 39];
						break;
					case(9) :
						crc = crctableProfTwo[crc ^ 80];
						break;
					case(10) :
						crc = crctableProfTwo[crc ^ 121];
						break;
					case(11) :
						crc = crctableProfTwo[crc ^ 162];
						break;
					case(12) :
						crc = crctableProfTwo[crc ^ 203];
						break;
					case(13) :
						crc = crctableProfTwo[crc ^ 244];
						break;
					case(14) :
						crc = crctableProfTwo[crc ^ 34];
						break;
					case(15) :
						crc = crctableProfTwo[crc ^ 75];
						break;
					default :
//						write("error: wrong parameter (%d)",CounterValForCRC_TBCSC_Hi_Rq1_Pr2); stop();
						break;
				}
				crc = (crc ^ 0xFF);
				payload[0] = crc;
			}
			else
			{
				//CRC manuel veränderbar
			}

			CH_EISTBCSC_Hi_Rq1_AR2();
			CH_EISTBCSC_Hi_Rq2_AR2();
		}
	}
	if (strncmp (pduName, "TBCSC_Hi_Rq2_AR2", strLen(pduName)+strLen("TBCSC_Hi_Rq2_AR2")) == 0)
	{
		if (TxAck == 1)
		{
			if (@sysvar::CH_Nodes::CH_EISSQC_TBCSC_Hi_Rq2_Pr2T_AUTO == 0)
			{
				//SQC automatisch ändern
				SQC_VAL_TBCSC_Hi_Rq2_Pr2 = (SQC_VAL_TBCSC_Hi_Rq2_Pr2 + 1) % 16;
			}
			else
			{
				//SQC manuel veränderbar
			}

		}
		else
		{
			if (@sysvar::CH_Nodes::CH_EISSQC_TBCSC_Hi_Rq2_Pr2T_AUTO == 0)
			{
				//SQC automatisch ändern
				//SQC für CRC speichern
				CounterValForCRC_TBCSC_Hi_Rq2_Pr2 = SQC_VAL_TBCSC_Hi_Rq2_Pr2;
				//SQC in Byte schreiben
				payload[1] = (payload[1] & ~0x0F) |  SQC_VAL_TBCSC_Hi_Rq2_Pr2;
			}
			else
			{
				//SQC manuel veränderbar
			}

			if (@sysvar::CH_Nodes::CH_EISCRC_TBCSC_Hi_Rq2_Pr2T_AUTO == 0)
			{
				//CRC automatisch berechnen
				crc = 0xFF;
				crc = crctableProfTwo[crc ^ payload[1]];
				crc = crctableProfTwo[crc ^ payload[2]];
				crc = crctableProfTwo[crc ^ payload[3]];
				crc = crctableProfTwo[crc ^ payload[4]];
				crc = crctableProfTwo[crc ^ payload[5]];
				crc = crctableProfTwo[crc ^ payload[6]];
				crc = crctableProfTwo[crc ^ payload[7]];
				switch (CounterValForCRC_TBCSC_Hi_Rq2_Pr2)
				{
					case(0) :
						crc = crctableProfTwo[crc ^ 32];
						break;
					case(1) :
						crc = crctableProfTwo[crc ^ 199];
						break;
					case(2) :
						crc = crctableProfTwo[crc ^ 115];
						break;
					case(3) :
						crc = crctableProfTwo[crc ^ 31];
						break;
					case(4) :
						crc = crctableProfTwo[crc ^ 198];
						break;
					case(5) :
						crc = crctableProfTwo[crc ^ 114];
						break;
					case(6) :
						crc = crctableProfTwo[crc ^ 30];
						break;
					case(7) :
						crc = crctableProfTwo[crc ^ 197];
						break;
					case(8) :
						crc = crctableProfTwo[crc ^ 113];
						break;
					case(9) :
						crc = crctableProfTwo[crc ^ 29];
						break;
					case(10) :
						crc = crctableProfTwo[crc ^ 196];
						break;
					case(11) :
						crc = crctableProfTwo[crc ^ 112];
						break;
					case(12) :
						crc = crctableProfTwo[crc ^ 28];
						break;
					case(13) :
						crc = crctableProfTwo[crc ^ 195];
						break;
					case(14) :
						crc = crctableProfTwo[crc ^ 111];
						break;
					case(15) :
						crc = crctableProfTwo[crc ^ 27];
						break;
					default :
//						write("error: wrong parameter (%d)",CounterValForCRC_TBCSC_Hi_Rq2_Pr2); stop();
						break;
				}
				crc = (crc ^ 0xFF);
				payload[0] = crc;
			}
			else
			{
				//CRC manuel veränderbar
			}

			CH_EISTBCSC_Hi_Rq1_AR2();
			CH_EISTBCSC_Hi_Rq2_AR2();
		}
	}
	if (strncmp (pduName, "TBCSC_Lo_Rq1_AR2", strLen(pduName)+strLen("TBCSC_Lo_Rq1_AR2")) == 0)
	{
		if (TxAck == 1)
		{
			if (@sysvar::CH_Nodes::CH_EISSQC_TBCSC_Lo_Rq1_Pr2T_AUTO == 0)
			{
				//SQC automatisch ändern
				SQC_VAL_TBCSC_Lo_Rq1_Pr2 = (SQC_VAL_TBCSC_Lo_Rq1_Pr2 + 1) % 16;
			}
			else
			{
				//SQC manuel veränderbar
			}

		}
		else
		{
			if (@sysvar::CH_Nodes::CH_EISSQC_TBCSC_Lo_Rq1_Pr2T_AUTO == 0)
			{
				//SQC automatisch ändern
				//SQC für CRC speichern
				CounterValForCRC_TBCSC_Lo_Rq1_Pr2 = SQC_VAL_TBCSC_Lo_Rq1_Pr2;
				//SQC in Byte schreiben
				payload[1] = (payload[1] & ~0x0F) |  SQC_VAL_TBCSC_Lo_Rq1_Pr2;
			}
			else
			{
				//SQC manuel veränderbar
			}

			if (@sysvar::CH_Nodes::CH_EISCRC_TBCSC_Lo_Rq1_Pr2T_AUTO == 0)
			{
				//CRC automatisch berechnen
				crc = 0xFF;
				crc = crctableProfTwo[crc ^ payload[1]];
				crc = crctableProfTwo[crc ^ payload[2]];
				crc = crctableProfTwo[crc ^ payload[3]];
				crc = crctableProfTwo[crc ^ payload[4]];
				crc = crctableProfTwo[crc ^ payload[5]];
				crc = crctableProfTwo[crc ^ payload[6]];
				crc = crctableProfTwo[crc ^ payload[7]];
				switch (CounterValForCRC_TBCSC_Lo_Rq1_Pr2)
				{
					case(0) :
						crc = crctableProfTwo[crc ^ 157];
						break;
					case(1) :
						crc = crctableProfTwo[crc ^ 12];
						break;
					case(2) :
						crc = crctableProfTwo[crc ^ 118];
						break;
					case(3) :
						crc = crctableProfTwo[crc ^ 224];
						break;
					case(4) :
						crc = crctableProfTwo[crc ^ 79];
						break;
					case(5) :
						crc = crctableProfTwo[crc ^ 185];
						break;
					case(6) :
						crc = crctableProfTwo[crc ^ 40];
						break;
					case(7) :
						crc = crctableProfTwo[crc ^ 146];
						break;
					case(8) :
						crc = crctableProfTwo[crc ^ 252];
						break;
					case(9) :
						crc = crctableProfTwo[crc ^ 107];
						break;
					case(10) :
						crc = crctableProfTwo[crc ^ 213];
						break;
					case(11) :
						crc = crctableProfTwo[crc ^ 68];
						break;
					case(12) :
						crc = crctableProfTwo[crc ^ 174];
						break;
					case(13) :
						crc = crctableProfTwo[crc ^ 29];
						break;
					case(14) :
						crc = crctableProfTwo[crc ^ 135];
						break;
					case(15) :
						crc = crctableProfTwo[crc ^ 241];
						break;
					default :
//						write("error: wrong parameter (%d)",CounterValForCRC_TBCSC_Lo_Rq1_Pr2); stop();
						break;
				}
				crc = (crc ^ 0xFF);
				payload[0] = crc;
			}
			else
			{
				//CRC manuel veränderbar
			}

			CH_EISTBCSC_Lo_Rq1_AR2();
			CH_EISTBCSC_Lo_Rq2_AR2();
		}
	}
	if (strncmp (pduName, "TBCSC_Lo_Rq2_AR2", strLen(pduName)+strLen("TBCSC_Lo_Rq2_AR2")) == 0)
	{
		if (TxAck == 1)
		{
			if (@sysvar::CH_Nodes::CH_EISSQC_TBCSC_Lo_Rq2_Pr2T_AUTO == 0)
			{
				//SQC automatisch ändern
				SQC_VAL_TBCSC_Lo_Rq2_Pr2 = (SQC_VAL_TBCSC_Lo_Rq2_Pr2 + 1) % 16;
			}
			else
			{
				//SQC manuel veränderbar
			}

		}
		else
		{
			if (@sysvar::CH_Nodes::CH_EISSQC_TBCSC_Lo_Rq2_Pr2T_AUTO == 0)
			{
				//SQC automatisch ändern
				//SQC für CRC speichern
				CounterValForCRC_TBCSC_Lo_Rq2_Pr2 = SQC_VAL_TBCSC_Lo_Rq2_Pr2;
				//SQC in Byte schreiben
				payload[1] = (payload[1] & ~0x0F) |  SQC_VAL_TBCSC_Lo_Rq2_Pr2;
			}
			else
			{
				//SQC manuel veränderbar
			}

			if (@sysvar::CH_Nodes::CH_EISCRC_TBCSC_Lo_Rq2_Pr2T_AUTO == 0)
			{
				//CRC automatisch berechnen
				crc = 0xFF;
				crc = crctableProfTwo[crc ^ payload[1]];
				crc = crctableProfTwo[crc ^ payload[2]];
				crc = crctableProfTwo[crc ^ payload[3]];
				crc = crctableProfTwo[crc ^ payload[4]];
				crc = crctableProfTwo[crc ^ payload[5]];
				crc = crctableProfTwo[crc ^ payload[6]];
				crc = crctableProfTwo[crc ^ payload[7]];
				switch (CounterValForCRC_TBCSC_Lo_Rq2_Pr2)
				{
					case(0) :
						crc = crctableProfTwo[crc ^ 31];
						break;
					case(1) :
						crc = crctableProfTwo[crc ^ 178];
						break;
					case(2) :
						crc = crctableProfTwo[crc ^ 74];
						break;
					case(3) :
						crc = crctableProfTwo[crc ^ 221];
						break;
					case(4) :
						crc = crctableProfTwo[crc ^ 117];
						break;
					case(5) :
						crc = crctableProfTwo[crc ^ 13];
						break;
					case(6) :
						crc = crctableProfTwo[crc ^ 160];
						break;
					case(7) :
						crc = crctableProfTwo[crc ^ 56];
						break;
					case(8) :
						crc = crctableProfTwo[crc ^ 203];
						break;
					case(9) :
						crc = crctableProfTwo[crc ^ 99];
						break;
					case(10) :
						crc = crctableProfTwo[crc ^ 246];
						break;
					case(11) :
						crc = crctableProfTwo[crc ^ 142];
						break;
					case(12) :
						crc = crctableProfTwo[crc ^ 38];
						break;
					case(13) :
						crc = crctableProfTwo[crc ^ 185];
						break;
					case(14) :
						crc = crctableProfTwo[crc ^ 81];
						break;
					case(15) :
						crc = crctableProfTwo[crc ^ 228];
						break;
					default :
//						write("error: wrong parameter (%d)",CounterValForCRC_TBCSC_Lo_Rq2_Pr2); stop();
						break;
				}
				crc = (crc ^ 0xFF);
				payload[0] = crc;
			}
			else
			{
				//CRC manuel veränderbar
			}

			CH_EISTBCSC_Lo_Rq1_AR2();
			CH_EISTBCSC_Lo_Rq2_AR2();
		}
	}
	if (strncmp (pduName, "TC_Distance_AR", strLen(pduName)+strLen("TC_Distance_AR")) == 0)
	{
		if (TxAck == 1)
		{
		}
		else
		{
		}
	}
	if (strncmp (pduName, "TGW_DateTm_Stat_AR", strLen(pduName)+strLen("TGW_DateTm_Stat_AR")) == 0)
	{
		if (TxAck == 1)
		{
		}
		else
		{
			CH_EISADASLR_POSITION_AR();
			CH_EISTGW_DateTm_Stat_AR();
		}
	}
	if (strncmp (pduName, "Tire_State_AR2", strLen(pduName)+strLen("Tire_State_AR2")) == 0)
	{
		if (TxAck == 1)
		{
		}
		else
		{
			CH_EISSVS_Rq_HU_AR2();
			CH_EISTrafficInfo_AR();
			CH_EISHU_State_AR();
			CH_EISTire_State_AR2();
			CH_EISCTRL_C_Stat1_AR();
		}
	}
	if (strncmp (pduName, "TrafficInfo_AR", strLen(pduName)+strLen("TrafficInfo_AR")) == 0)
	{
		if (TxAck == 1)
		{
		}
		else
		{
			CH_EISSVS_Rq_HU_AR2();
			CH_EISTrafficInfo_AR();
			CH_EISHU_State_AR();
			CH_EISTire_State_AR2();
			CH_EISCTRL_C_Stat1_AR();
		}
	}
	if (strncmp (pduName, "Trailer_Stat_AR2", strLen(pduName)+strLen("Trailer_Stat_AR2")) == 0)
	{
		if (TxAck == 1)
		{
			if (@sysvar::CH_Nodes::CH_EISSQC_ElecTrlrHtch_Stat_AUTO == 0)
			{
				//SQC automatisch ändern
				SQC_VAL_ElecTrlrHtch_Stat_Pr2 = (SQC_VAL_ElecTrlrHtch_Stat_Pr2 + 1) % 16;
			}
			else
			{
				//SQC manuel veränderbar
			}

		}
		else
		{
			if (@sysvar::CH_Nodes::CH_EISSQC_ElecTrlrHtch_Stat_AUTO == 0)
			{
				//SQC automatisch ändern
				//SQC für CRC speichern
				CounterValForCRC_ElecTrlrHtch_Stat_Pr2 = SQC_VAL_ElecTrlrHtch_Stat_Pr2;
				//SQC in Byte schreiben
				payload[1] = (payload[1] & ~0x0F) |  SQC_VAL_ElecTrlrHtch_Stat_Pr2;
			}
			else
			{
				//SQC manuel veränderbar
			}

			if (@sysvar::CH_Nodes::CH_EISCRC_ElecTrlrHtch_Stat_AUTO == 0)
			{
				//CRC automatisch berechnen
				crc = 0xFF;
				crc = crctableProfTwo[crc ^ payload[1]];
				switch (CounterValForCRC_ElecTrlrHtch_Stat_Pr2)
				{
					case(0) :
						crc = crctableProfTwo[crc ^ 164];
						break;
					case(1) :
						crc = crctableProfTwo[crc ^ 239];
						break;
					case(2) :
						crc = crctableProfTwo[crc ^ 63];
						break;
					case(3) :
						crc = crctableProfTwo[crc ^ 138];
						break;
					case(4) :
						crc = crctableProfTwo[crc ^ 213];
						break;
					case(5) :
						crc = crctableProfTwo[crc ^ 37];
						break;
					case(6) :
						crc = crctableProfTwo[crc ^ 112];
						break;
					case(7) :
						crc = crctableProfTwo[crc ^ 187];
						break;
					case(8) :
						crc = crctableProfTwo[crc ^ 11];
						break;
					case(9) :
						crc = crctableProfTwo[crc ^ 86];
						break;
					case(10) :
						crc = crctableProfTwo[crc ^ 161];
						break;
					case(11) :
						crc = crctableProfTwo[crc ^ 236];
						break;
					case(12) :
						crc = crctableProfTwo[crc ^ 60];
						break;
					case(13) :
						crc = crctableProfTwo[crc ^ 135];
						break;
					case(14) :
						crc = crctableProfTwo[crc ^ 210];
						break;
					case(15) :
						crc = crctableProfTwo[crc ^ 34];
						break;
					default :
//						write("error: wrong parameter (%d)",CounterValForCRC_ElecTrlrHtch_Stat_Pr2); stop();
						break;
				}
				crc = (crc ^ 0xFF);
				payload[0] = crc;
			}
			else
			{
				//CRC manuel veränderbar
			}

			CH_EISICH_Stat_AR();
			CH_EISTrailer_Stat_AR2();
		}
	}
	if (strncmp (pduName, "TSA_Disp_Rq1_AR2", strLen(pduName)+strLen("TSA_Disp_Rq1_AR2")) == 0)
	{
		if (TxAck == 1)
		{
		}
		else
		{
		}
	}
	if (strncmp (pduName, "TSA_Disp_Rq2_AR", strLen(pduName)+strLen("TSA_Disp_Rq2_AR")) == 0)
	{
		if (TxAck == 1)
		{
		}
		else
		{
			CH_EISTSA_Disp_Rq3_AR();
			CH_EISTSA_Disp_Rq2_AR();
		}
	}
	if (strncmp (pduName, "TSA_Disp_Rq3_AR", strLen(pduName)+strLen("TSA_Disp_Rq3_AR")) == 0)
	{
		if (TxAck == 1)
		{
		}
		else
		{
			CH_EISTSA_Disp_Rq3_AR();
			CH_EISTSA_Disp_Rq2_AR();
		}
	}
	if (strncmp (pduName, "VehAccel_X_Rq_Gw_AR2", strLen(pduName)+strLen("VehAccel_X_Rq_Gw_AR2")) == 0)
	{
		if (TxAck == 1)
		{
			if (@sysvar::CH_Nodes::CH_EISSQC_VehAccel_X_Rq_Pr2_AUTO == 0)
			{
				//SQC automatisch ändern
				SQC_VAL_VehAccel_X_Rq_Pr2 = (SQC_VAL_VehAccel_X_Rq_Pr2 + 1) % 16;
			}
			else
			{
				//SQC manuel veränderbar
			}

		}
		else
		{
			if (@sysvar::CH_Nodes::CH_EISSQC_VehAccel_X_Rq_Pr2_AUTO == 0)
			{
				//SQC automatisch ändern
				//SQC für CRC speichern
				CounterValForCRC_VehAccel_X_Rq_Pr2 = SQC_VAL_VehAccel_X_Rq_Pr2;
				//SQC in Byte schreiben
				payload[1] = (payload[1] & ~0x0F) |  SQC_VAL_VehAccel_X_Rq_Pr2;
			}
			else
			{
				//SQC manuel veränderbar
			}

			if (@sysvar::CH_Nodes::CH_EISCRC_VehAccel_X_Rq_Pr2_AUTO == 0)
			{
				//CRC automatisch berechnen
				crc = 0xFF;
				crc = crctableProfTwo[crc ^ payload[1]];
				crc = crctableProfTwo[crc ^ payload[2]];
				crc = crctableProfTwo[crc ^ payload[3]];
				crc = crctableProfTwo[crc ^ payload[4]];
				crc = crctableProfTwo[crc ^ payload[5]];
				crc = crctableProfTwo[crc ^ payload[6]];
				crc = crctableProfTwo[crc ^ payload[7]];
				switch (CounterValForCRC_VehAccel_X_Rq_Pr2)
				{
					case(0) :
						crc = crctableProfTwo[crc ^ 57];
						break;
					case(1) :
						crc = crctableProfTwo[crc ^ 200];
						break;
					case(2) :
						crc = crctableProfTwo[crc ^ 92];
						break;
					case(3) :
						crc = crctableProfTwo[crc ^ 235];
						break;
					case(4) :
						crc = crctableProfTwo[crc ^ 127];
						break;
					case(5) :
						crc = crctableProfTwo[crc ^ 19];
						break;
					case(6) :
						crc = crctableProfTwo[crc ^ 162];
						break;
					case(7) :
						crc = crctableProfTwo[crc ^ 54];
						break;
					case(8) :
						crc = crctableProfTwo[crc ^ 197];
						break;
					case(9) :
						crc = crctableProfTwo[crc ^ 89];
						break;
					case(10) :
						crc = crctableProfTwo[crc ^ 232];
						break;
					case(11) :
						crc = crctableProfTwo[crc ^ 124];
						break;
					case(12) :
						crc = crctableProfTwo[crc ^ 16];
						break;
					case(13) :
						crc = crctableProfTwo[crc ^ 159];
						break;
					case(14) :
						crc = crctableProfTwo[crc ^ 51];
						break;
					case(15) :
						crc = crctableProfTwo[crc ^ 194];
						break;
					default :
//						write("error: wrong parameter (%d)",CounterValForCRC_VehAccel_X_Rq_Pr2); stop();
						break;
				}
				crc = (crc ^ 0xFF);
				payload[0] = crc;
			}
			else
			{
				//CRC manuel veränderbar
			}

			CH_EISPT_ObjIntrst_Gw_AR2();
			CH_EISCMS_PI_State_Gw_AR2();
			CH_EISVehAccel_X_Rq_Gw_AR2();
			CH_EISFCW_Disp_Rq_AR();
		}
	}
	if (strncmp (pduName, "VIN_AR", strLen(pduName)+strLen("VIN_AR")) == 0)
	{
		if (TxAck == 1)
		{
		}
		else
		{
		}
	}
	if (strncmp (pduName, "Wiper_Stat_AR", strLen(pduName)+strLen("Wiper_Stat_AR")) == 0)
	{
		if (TxAck == 1)
		{
		}
		else
		{
		}
	}
	if (strncmp (pduName, "WUDOP_EIS_FR", strLen(pduName)+strLen("WUDOP_EIS_FR")) == 0)
	{
		if (TxAck == 1)
		{
		}
		else
		{
		}
	}
	if (strncmp (pduName, "YMAS_Rq_MPC_AR2", strLen(pduName)+strLen("YMAS_Rq_MPC_AR2")) == 0)
	{
		if (TxAck == 1)
		{
			if (@sysvar::CH_Nodes::CH_EISSQC_YMAS_Rq_MPC_Pr2YM_AUTO == 0)
			{
				//SQC automatisch ändern
				SQC_VAL_YMAS_Rq_MPC_Pr2 = (SQC_VAL_YMAS_Rq_MPC_Pr2 + 1) % 16;
			}
			else
			{
				//SQC manuel veränderbar
			}

		}
		else
		{
			if (@sysvar::CH_Nodes::CH_EISSQC_YMAS_Rq_MPC_Pr2YM_AUTO == 0)
			{
				//SQC automatisch ändern
				//SQC für CRC speichern
				CounterValForCRC_YMAS_Rq_MPC_Pr2 = SQC_VAL_YMAS_Rq_MPC_Pr2;
				//SQC in Byte schreiben
				payload[1] = (payload[1] & ~0x0F) |  SQC_VAL_YMAS_Rq_MPC_Pr2;
			}
			else
			{
				//SQC manuel veränderbar
			}

			if (@sysvar::CH_Nodes::CH_EISCRC_YMAS_Rq_MPC_Pr2YM_AUTO == 0)
			{
				//CRC automatisch berechnen
				crc = 0xFF;
				crc = crctableProfTwo[crc ^ payload[1]];
				crc = crctableProfTwo[crc ^ payload[2]];
				crc = crctableProfTwo[crc ^ payload[3]];
				crc = crctableProfTwo[crc ^ payload[4]];
				crc = crctableProfTwo[crc ^ payload[5]];
				crc = crctableProfTwo[crc ^ payload[6]];
				crc = crctableProfTwo[crc ^ payload[7]];
				switch (CounterValForCRC_YMAS_Rq_MPC_Pr2)
				{
					case(0) :
						crc = crctableProfTwo[crc ^ 10];
						break;
					case(1) :
						crc = crctableProfTwo[crc ^ 215];
						break;
					case(2) :
						crc = crctableProfTwo[crc ^ 169];
						break;
					case(3) :
						crc = crctableProfTwo[crc ^ 123];
						break;
					case(4) :
						crc = crctableProfTwo[crc ^ 77];
						break;
					case(5) :
						crc = crctableProfTwo[crc ^ 31];
						break;
					case(6) :
						crc = crctableProfTwo[crc ^ 236];
						break;
					case(7) :
						crc = crctableProfTwo[crc ^ 190];
						break;
					case(8) :
						crc = crctableProfTwo[crc ^ 144];
						break;
					case(9) :
						crc = crctableProfTwo[crc ^ 98];
						break;
					case(10) :
						crc = crctableProfTwo[crc ^ 52];
						break;
					case(11) :
						crc = crctableProfTwo[crc ^ 6];
						break;
					case(12) :
						crc = crctableProfTwo[crc ^ 211];
						break;
					case(13) :
						crc = crctableProfTwo[crc ^ 165];
						break;
					case(14) :
						crc = crctableProfTwo[crc ^ 119];
						break;
					case(15) :
						crc = crctableProfTwo[crc ^ 73];
						break;
					default :
//						write("error: wrong parameter (%d)",CounterValForCRC_YMAS_Rq_MPC_Pr2); stop();
						break;
				}
				crc = (crc ^ 0xFF);
				payload[0] = crc;
			}
			else
			{
				//CRC manuel veränderbar
			}

			CH_EISYMAS_Rq_MPC_AR2();
			CH_EISCamLane_LaneAttr7_AR2();
			CH_EISCamLane_LaneAttr6_AR2();
		}
	}
}

StartSim(int BusAktiv)
{
	result = EnableCRC("", 0); // 1 = on, 0 = off
	result = EnableTGL("", 0); // 1 = on, 0 = off 
	result = EnableSQC("", 0); // 1 = on, 0 = off 
	result = EnableMC("", 0); // 1 = on, 0 = off 
	switch (@sysvar::CH_Nodes::CH_EISActvComf_Rq_AR2_UB_AUTO_01)
	{
		case (0):
			enableControl("ActvComf_Rq_AR2", "CH_EISActvComf_Rq_AR2_UB__01", 0); //1: enable; 0: disable
			@sysvar::CH_Nodes::CH_EISActvComf_Rq_AR2_UB__01 = 1;
			break;
		case (1):
			enableControl("ActvComf_Rq_AR2", "CH_EISActvComf_Rq_AR2_UB__01", 1); //1: enable; 0: disable
			break;
		case (2):
			enableControl("ActvComf_Rq_AR2", "CH_EISActvComf_Rq_AR2_UB__01", 0); //1: enable; 0: disable
			@sysvar::CH_Nodes::CH_EISActvComf_Rq_AR2_UB__01 = 1;
			break;
		case (3):
			enableControl("ActvComf_Rq_AR2", "CH_EISActvComf_Rq_AR2_UB__01", 0); //1: enable; 0: disable
			@sysvar::CH_Nodes::CH_EISActvComf_Rq_AR2_UB__01 = 0;
			break;
	}

	switch (@sysvar::CH_Nodes::CH_EISADAS_CURRENT_ATTRI_UB_A_01)
	{
		case (0):
			enableControl("ADAS_CURRENT_ATTRIBUTES_AR", "CH_EISADAS_CURRENT_ATTRIBUTE__01", 0); //1: enable; 0: disable
			@sysvar::CH_Nodes::CH_EISADAS_CURRENT_ATTRIBUTE__01 = 1;
			break;
		case (1):
			enableControl("ADAS_CURRENT_ATTRIBUTES_AR", "CH_EISADAS_CURRENT_ATTRIBUTE__01", 1); //1: enable; 0: disable
			break;
		case (2):
			enableControl("ADAS_CURRENT_ATTRIBUTES_AR", "CH_EISADAS_CURRENT_ATTRIBUTE__01", 0); //1: enable; 0: disable
			@sysvar::CH_Nodes::CH_EISADAS_CURRENT_ATTRIBUTE__01 = 1;
			break;
		case (3):
			enableControl("ADAS_CURRENT_ATTRIBUTES_AR", "CH_EISADAS_CURRENT_ATTRIBUTE__01", 0); //1: enable; 0: disable
			@sysvar::CH_Nodes::CH_EISADAS_CURRENT_ATTRIBUTE__01 = 0;
			break;
	}

	switch (@sysvar::CH_Nodes::CH_EISADAS_POSITION_AR_UB_AUT_01)
	{
		case (0):
			enableControl("ADAS_POSITION_AR", "CH_EISADAS_POSITION_AR_UB__01", 0); //1: enable; 0: disable
			@sysvar::CH_Nodes::CH_EISADAS_POSITION_AR_UB__01 = 1;
			break;
		case (1):
			enableControl("ADAS_POSITION_AR", "CH_EISADAS_POSITION_AR_UB__01", 1); //1: enable; 0: disable
			break;
		case (2):
			enableControl("ADAS_POSITION_AR", "CH_EISADAS_POSITION_AR_UB__01", 0); //1: enable; 0: disable
			@sysvar::CH_Nodes::CH_EISADAS_POSITION_AR_UB__01 = 1;
			break;
		case (3):
			enableControl("ADAS_POSITION_AR", "CH_EISADAS_POSITION_AR_UB__01", 0); //1: enable; 0: disable
			@sysvar::CH_Nodes::CH_EISADAS_POSITION_AR_UB__01 = 0;
			break;
	}

	switch (@sysvar::CH_Nodes::CH_EISADAS_PREDICTION_AR_UB_A_03)
	{
		case (0):
			enableControl("ADAS_PREDICTION_AR", "CH_EISADAS_PREDICTION_AR_2_UB_01", 0); //1: enable; 0: disable
			@sysvar::CH_Nodes::CH_EISADAS_PREDICTION_AR_2_UB_01 = 1;
			break;
		case (1):
			enableControl("ADAS_PREDICTION_AR", "CH_EISADAS_PREDICTION_AR_2_UB_01", 1); //1: enable; 0: disable
			break;
		case (2):
			enableControl("ADAS_PREDICTION_AR", "CH_EISADAS_PREDICTION_AR_2_UB_01", 0); //1: enable; 0: disable
			@sysvar::CH_Nodes::CH_EISADAS_PREDICTION_AR_2_UB_01 = 1;
			break;
		case (3):
			enableControl("ADAS_PREDICTION_AR", "CH_EISADAS_PREDICTION_AR_2_UB_01", 0); //1: enable; 0: disable
			@sysvar::CH_Nodes::CH_EISADAS_PREDICTION_AR_2_UB_01 = 0;
			break;
	}

	switch (@sysvar::CH_Nodes::CH_EISADAS_PROFILE_LONG__UB_A_04)
	{
		case (0):
			enableControl("ADAS_PROFILE_LONG_AR", "CH_EISADAS_PROFILE_LONG_AR_1__03", 0); //1: enable; 0: disable
			@sysvar::CH_Nodes::CH_EISADAS_PROFILE_LONG_AR_1__03 = 1;
			break;
		case (1):
			enableControl("ADAS_PROFILE_LONG_AR", "CH_EISADAS_PROFILE_LONG_AR_1__03", 1); //1: enable; 0: disable
			break;
		case (2):
			enableControl("ADAS_PROFILE_LONG_AR", "CH_EISADAS_PROFILE_LONG_AR_1__03", 0); //1: enable; 0: disable
			@sysvar::CH_Nodes::CH_EISADAS_PROFILE_LONG_AR_1__03 = 1;
			break;
		case (3):
			enableControl("ADAS_PROFILE_LONG_AR", "CH_EISADAS_PROFILE_LONG_AR_1__03", 0); //1: enable; 0: disable
			@sysvar::CH_Nodes::CH_EISADAS_PROFILE_LONG_AR_1__03 = 0;
			break;
	}

	switch (@sysvar::CH_Nodes::CH_EISADAS_PROFILE_SHORT_UB_A_09)
	{
		case (0):
			enableControl("ADAS_PROFILE_SHORT_AR", "CH_EISADAS_PROFILE_SHORT_AR___09", 0); //1: enable; 0: disable
			@sysvar::CH_Nodes::CH_EISADAS_PROFILE_SHORT_AR___09 = 1;
			break;
		case (1):
			enableControl("ADAS_PROFILE_SHORT_AR", "CH_EISADAS_PROFILE_SHORT_AR___09", 1); //1: enable; 0: disable
			break;
		case (2):
			enableControl("ADAS_PROFILE_SHORT_AR", "CH_EISADAS_PROFILE_SHORT_AR___09", 0); //1: enable; 0: disable
			@sysvar::CH_Nodes::CH_EISADAS_PROFILE_SHORT_AR___09 = 1;
			break;
		case (3):
			enableControl("ADAS_PROFILE_SHORT_AR", "CH_EISADAS_PROFILE_SHORT_AR___09", 0); //1: enable; 0: disable
			@sysvar::CH_Nodes::CH_EISADAS_PROFILE_SHORT_AR___09 = 0;
			break;
	}

	switch (@sysvar::CH_Nodes::CH_EISADASLR_POSITION_AR_UB_A_01)
	{
		case (0):
			enableControl("ADASLR_POSITION_AR", "CH_EISADASLR_POSITION_AR_UB__01", 0); //1: enable; 0: disable
			@sysvar::CH_Nodes::CH_EISADASLR_POSITION_AR_UB__01 = 1;
			break;
		case (1):
			enableControl("ADASLR_POSITION_AR", "CH_EISADASLR_POSITION_AR_UB__01", 1); //1: enable; 0: disable
			break;
		case (2):
			enableControl("ADASLR_POSITION_AR", "CH_EISADASLR_POSITION_AR_UB__01", 0); //1: enable; 0: disable
			@sysvar::CH_Nodes::CH_EISADASLR_POSITION_AR_UB__01 = 1;
			break;
		case (3):
			enableControl("ADASLR_POSITION_AR", "CH_EISADASLR_POSITION_AR_UB__01", 0); //1: enable; 0: disable
			@sysvar::CH_Nodes::CH_EISADASLR_POSITION_AR_UB__01 = 0;
			break;
	}

	switch (@sysvar::CH_Nodes::CH_EISADASLR_PROFILE_LON_UB_A_04)
	{
		case (0):
			enableControl("ADASLR_PROFILE_LONG_AR", "CH_EISADASLR_PROFILE_LONG_AR__04", 0); //1: enable; 0: disable
			@sysvar::CH_Nodes::CH_EISADASLR_PROFILE_LONG_AR__04 = 1;
			break;
		case (1):
			enableControl("ADASLR_PROFILE_LONG_AR", "CH_EISADASLR_PROFILE_LONG_AR__04", 1); //1: enable; 0: disable
			break;
		case (2):
			enableControl("ADASLR_PROFILE_LONG_AR", "CH_EISADASLR_PROFILE_LONG_AR__04", 0); //1: enable; 0: disable
			@sysvar::CH_Nodes::CH_EISADASLR_PROFILE_LONG_AR__04 = 1;
			break;
		case (3):
			enableControl("ADASLR_PROFILE_LONG_AR", "CH_EISADASLR_PROFILE_LONG_AR__04", 0); //1: enable; 0: disable
			@sysvar::CH_Nodes::CH_EISADASLR_PROFILE_LONG_AR__04 = 0;
			break;
	}

	switch (@sysvar::CH_Nodes::CH_EISBC_F_Stat2_AR2_UB_AUTO)
	{
		case (0):
			enableControl("BC_F_Stat2_AR2", "CH_EISBC_F_Stat2_AR2_UB_", 0); //1: enable; 0: disable
			@sysvar::CH_Nodes::CH_EISBC_F_Stat2_AR2_UB_ = 1;
			break;
		case (1):
			enableControl("BC_F_Stat2_AR2", "CH_EISBC_F_Stat2_AR2_UB_", 1); //1: enable; 0: disable
			break;
		case (2):
			enableControl("BC_F_Stat2_AR2", "CH_EISBC_F_Stat2_AR2_UB_", 0); //1: enable; 0: disable
			@sysvar::CH_Nodes::CH_EISBC_F_Stat2_AR2_UB_ = 1;
			break;
		case (3):
			enableControl("BC_F_Stat2_AR2", "CH_EISBC_F_Stat2_AR2_UB_", 0); //1: enable; 0: disable
			@sysvar::CH_Nodes::CH_EISBC_F_Stat2_AR2_UB_ = 0;
			break;
	}

	switch (@sysvar::CH_Nodes::CH_EISBC_R_Stat1_AR_UB_AUTO_01)
	{
		case (0):
			enableControl("BC_R_Stat1_AR", "CH_EISBC_R_Stat1_AR_UB__01", 0); //1: enable; 0: disable
			@sysvar::CH_Nodes::CH_EISBC_R_Stat1_AR_UB__01 = 1;
			break;
		case (1):
			enableControl("BC_R_Stat1_AR", "CH_EISBC_R_Stat1_AR_UB__01", 1); //1: enable; 0: disable
			break;
		case (2):
			enableControl("BC_R_Stat1_AR", "CH_EISBC_R_Stat1_AR_UB__01", 0); //1: enable; 0: disable
			@sysvar::CH_Nodes::CH_EISBC_R_Stat1_AR_UB__01 = 1;
			break;
		case (3):
			enableControl("BC_R_Stat1_AR", "CH_EISBC_R_Stat1_AR_UB__01", 0); //1: enable; 0: disable
			@sysvar::CH_Nodes::CH_EISBC_R_Stat1_AR_UB__01 = 0;
			break;
	}

	TGL_VAL_ckl_Sw_3L_SAM_R_ = 0;
	TGL_ckl_Sw_3L_SAM_R_ = 0;
	TGL_VAL_ckl_Sw_3R_SAM_R_ = 0;
	TGL_ckl_Sw_3R_SAM_R_ = 0;
	TGL_VAL_ckl_Sw_RL_SAM_R_ = 0;
	TGL_ckl_Sw_RL_SAM_R_ = 0;
	TGL_VAL_ckl_Sw_RM_SAM_R_ = 0;
	TGL_ckl_Sw_RM_SAM_R_ = 0;
	TGL_VAL_ckl_Sw_RR_SAM_R_ = 0;
	TGL_ckl_Sw_RR_SAM_R_ = 0;
	switch (@sysvar::CH_Nodes::CH_EISBODY_CHASSIS_R1_AR_UB_A_01)
	{
		case (0):
			enableControl("BODY_CHASSIS_R1_AR", "CH_EISBODY_CHASSIS_R1_AR_UB__01", 0); //1: enable; 0: disable
			@sysvar::CH_Nodes::CH_EISBODY_CHASSIS_R1_AR_UB__01 = 1;
			break;
		case (1):
			enableControl("BODY_CHASSIS_R1_AR", "CH_EISBODY_CHASSIS_R1_AR_UB__01", 1); //1: enable; 0: disable
			break;
		case (2):
			enableControl("BODY_CHASSIS_R1_AR", "CH_EISBODY_CHASSIS_R1_AR_UB__01", 0); //1: enable; 0: disable
			@sysvar::CH_Nodes::CH_EISBODY_CHASSIS_R1_AR_UB__01 = 1;
			break;
		case (3):
			enableControl("BODY_CHASSIS_R1_AR", "CH_EISBODY_CHASSIS_R1_AR_UB__01", 0); //1: enable; 0: disable
			@sysvar::CH_Nodes::CH_EISBODY_CHASSIS_R1_AR_UB__01 = 0;
			break;
	}

	switch (@sysvar::CH_Nodes::CH_EISBSM_Disp_Warn_Rq_A_UB_A_01)
	{
		case (0):
			enableControl("BSM_Disp_Warn_Rq_AR2", "CH_EISBSM_Disp_Warn_Rq_AR2_UB_01", 0); //1: enable; 0: disable
			@sysvar::CH_Nodes::CH_EISBSM_Disp_Warn_Rq_AR2_UB_01 = 1;
			break;
		case (1):
			enableControl("BSM_Disp_Warn_Rq_AR2", "CH_EISBSM_Disp_Warn_Rq_AR2_UB_01", 1); //1: enable; 0: disable
			break;
		case (2):
			enableControl("BSM_Disp_Warn_Rq_AR2", "CH_EISBSM_Disp_Warn_Rq_AR2_UB_01", 0); //1: enable; 0: disable
			@sysvar::CH_Nodes::CH_EISBSM_Disp_Warn_Rq_AR2_UB_01 = 1;
			break;
		case (3):
			enableControl("BSM_Disp_Warn_Rq_AR2", "CH_EISBSM_Disp_Warn_Rq_AR2_UB_01", 0); //1: enable; 0: disable
			@sysvar::CH_Nodes::CH_EISBSM_Disp_Warn_Rq_AR2_UB_01 = 0;
			break;
	}

	switch (@sysvar::CH_Nodes::CH_EISCamLane_Disp_Warn__UB_A_01)
	{
		case (0):
			enableControl("CamLane_Disp_Warn_Rq_AR2", "CH_EISCamLane_Disp_Warn_Rq_A__01", 0); //1: enable; 0: disable
			@sysvar::CH_Nodes::CH_EISCamLane_Disp_Warn_Rq_A__01 = 1;
			break;
		case (1):
			enableControl("CamLane_Disp_Warn_Rq_AR2", "CH_EISCamLane_Disp_Warn_Rq_A__01", 1); //1: enable; 0: disable
			break;
		case (2):
			enableControl("CamLane_Disp_Warn_Rq_AR2", "CH_EISCamLane_Disp_Warn_Rq_A__01", 0); //1: enable; 0: disable
			@sysvar::CH_Nodes::CH_EISCamLane_Disp_Warn_Rq_A__01 = 1;
			break;
		case (3):
			enableControl("CamLane_Disp_Warn_Rq_AR2", "CH_EISCamLane_Disp_Warn_Rq_A__01", 0); //1: enable; 0: disable
			@sysvar::CH_Nodes::CH_EISCamLane_Disp_Warn_Rq_A__01 = 0;
			break;
	}

	CRC_CamLane_Disp_Warn_Rq_Pr2 = 0;
	SQC_VAL_CamLane_Disp_Warn_Rq_Pr2 = 0;
	SQC_CamLane_Disp_Warn_Rq_Pr2 = 0;
	switch (@sysvar::CH_Nodes::CH_EISCamLane_LaneAttr1__UB_A_01)
	{
		case (0):
			enableControl("CamLane_LaneAttr1_AR2", "CH_EISCamLane_LaneAttr1_AR2_U_01", 0); //1: enable; 0: disable
			@sysvar::CH_Nodes::CH_EISCamLane_LaneAttr1_AR2_U_01 = 1;
			break;
		case (1):
			enableControl("CamLane_LaneAttr1_AR2", "CH_EISCamLane_LaneAttr1_AR2_U_01", 1); //1: enable; 0: disable
			break;
		case (2):
			enableControl("CamLane_LaneAttr1_AR2", "CH_EISCamLane_LaneAttr1_AR2_U_01", 0); //1: enable; 0: disable
			@sysvar::CH_Nodes::CH_EISCamLane_LaneAttr1_AR2_U_01 = 1;
			break;
		case (3):
			enableControl("CamLane_LaneAttr1_AR2", "CH_EISCamLane_LaneAttr1_AR2_U_01", 0); //1: enable; 0: disable
			@sysvar::CH_Nodes::CH_EISCamLane_LaneAttr1_AR2_U_01 = 0;
			break;
	}

	CRC_CamLane_LaneAttr1_Pr2 = 0;
	SQC_VAL_CamLane_LaneAttr1_Pr2 = 0;
	SQC_CamLane_LaneAttr1_Pr2 = 0;
	switch (@sysvar::CH_Nodes::CH_EISCamLane_LaneAttr2__UB_A_01)
	{
		case (0):
			enableControl("CamLane_LaneAttr2_AR2", "CH_EISCamLane_LaneAttr2_AR2_U_01", 0); //1: enable; 0: disable
			@sysvar::CH_Nodes::CH_EISCamLane_LaneAttr2_AR2_U_01 = 1;
			break;
		case (1):
			enableControl("CamLane_LaneAttr2_AR2", "CH_EISCamLane_LaneAttr2_AR2_U_01", 1); //1: enable; 0: disable
			break;
		case (2):
			enableControl("CamLane_LaneAttr2_AR2", "CH_EISCamLane_LaneAttr2_AR2_U_01", 0); //1: enable; 0: disable
			@sysvar::CH_Nodes::CH_EISCamLane_LaneAttr2_AR2_U_01 = 1;
			break;
		case (3):
			enableControl("CamLane_LaneAttr2_AR2", "CH_EISCamLane_LaneAttr2_AR2_U_01", 0); //1: enable; 0: disable
			@sysvar::CH_Nodes::CH_EISCamLane_LaneAttr2_AR2_U_01 = 0;
			break;
	}

	CRC_CamLane_LaneAttr2_Pr2 = 0;
	SQC_VAL_CamLane_LaneAttr2_Pr2 = 0;
	SQC_CamLane_LaneAttr2_Pr2 = 0;
	switch (@sysvar::CH_Nodes::CH_EISCamLane_LaneAttr3__UB_A_01)
	{
		case (0):
			enableControl("CamLane_LaneAttr3_AR2", "CH_EISCamLane_LaneAttr3_AR2_U_01", 0); //1: enable; 0: disable
			@sysvar::CH_Nodes::CH_EISCamLane_LaneAttr3_AR2_U_01 = 1;
			break;
		case (1):
			enableControl("CamLane_LaneAttr3_AR2", "CH_EISCamLane_LaneAttr3_AR2_U_01", 1); //1: enable; 0: disable
			break;
		case (2):
			enableControl("CamLane_LaneAttr3_AR2", "CH_EISCamLane_LaneAttr3_AR2_U_01", 0); //1: enable; 0: disable
			@sysvar::CH_Nodes::CH_EISCamLane_LaneAttr3_AR2_U_01 = 1;
			break;
		case (3):
			enableControl("CamLane_LaneAttr3_AR2", "CH_EISCamLane_LaneAttr3_AR2_U_01", 0); //1: enable; 0: disable
			@sysvar::CH_Nodes::CH_EISCamLane_LaneAttr3_AR2_U_01 = 0;
			break;
	}

	CRC_CamLane_LaneAttr3_Pr2 = 0;
	SQC_VAL_CamLane_LaneAttr3_Pr2 = 0;
	SQC_CamLane_LaneAttr3_Pr2 = 0;
	switch (@sysvar::CH_Nodes::CH_EISCamLane_LaneAttr6__UB_A_01)
	{
		case (0):
			enableControl("CamLane_LaneAttr6_AR2", "CH_EISCamLane_LaneAttr6_AR2_U_01", 0); //1: enable; 0: disable
			@sysvar::CH_Nodes::CH_EISCamLane_LaneAttr6_AR2_U_01 = 1;
			break;
		case (1):
			enableControl("CamLane_LaneAttr6_AR2", "CH_EISCamLane_LaneAttr6_AR2_U_01", 1); //1: enable; 0: disable
			break;
		case (2):
			enableControl("CamLane_LaneAttr6_AR2", "CH_EISCamLane_LaneAttr6_AR2_U_01", 0); //1: enable; 0: disable
			@sysvar::CH_Nodes::CH_EISCamLane_LaneAttr6_AR2_U_01 = 1;
			break;
		case (3):
			enableControl("CamLane_LaneAttr6_AR2", "CH_EISCamLane_LaneAttr6_AR2_U_01", 0); //1: enable; 0: disable
			@sysvar::CH_Nodes::CH_EISCamLane_LaneAttr6_AR2_U_01 = 0;
			break;
	}

	CRC_CamLane_LaneAttr6_Pr2 = 0;
	SQC_VAL_CamLane_LaneAttr6_Pr2 = 0;
	SQC_CamLane_LaneAttr6_Pr2 = 0;
	switch (@sysvar::CH_Nodes::CH_EISCamLane_LaneAttr7__UB_A_01)
	{
		case (0):
			enableControl("CamLane_LaneAttr7_AR2", "CH_EISCamLane_LaneAttr7_AR2_U_01", 0); //1: enable; 0: disable
			@sysvar::CH_Nodes::CH_EISCamLane_LaneAttr7_AR2_U_01 = 1;
			break;
		case (1):
			enableControl("CamLane_LaneAttr7_AR2", "CH_EISCamLane_LaneAttr7_AR2_U_01", 1); //1: enable; 0: disable
			break;
		case (2):
			enableControl("CamLane_LaneAttr7_AR2", "CH_EISCamLane_LaneAttr7_AR2_U_01", 0); //1: enable; 0: disable
			@sysvar::CH_Nodes::CH_EISCamLane_LaneAttr7_AR2_U_01 = 1;
			break;
		case (3):
			enableControl("CamLane_LaneAttr7_AR2", "CH_EISCamLane_LaneAttr7_AR2_U_01", 0); //1: enable; 0: disable
			@sysvar::CH_Nodes::CH_EISCamLane_LaneAttr7_AR2_U_01 = 0;
			break;
	}

	CRC_CamLane_LaneAttr7_Pr2 = 0;
	SQC_VAL_CamLane_LaneAttr7_Pr2 = 0;
	SQC_CamLane_LaneAttr7_Pr2 = 0;
	switch (@sysvar::CH_Nodes::CH_EISCLkS_Rq_AR_UB_AUTO_01)
	{
		case (0):
			enableControl("CLkS_Rq_AR", "CH_EISCLkS_Rq_AR_UB__01", 0); //1: enable; 0: disable
			@sysvar::CH_Nodes::CH_EISCLkS_Rq_AR_UB__01 = 1;
			break;
		case (1):
			enableControl("CLkS_Rq_AR", "CH_EISCLkS_Rq_AR_UB__01", 1); //1: enable; 0: disable
			break;
		case (2):
			enableControl("CLkS_Rq_AR", "CH_EISCLkS_Rq_AR_UB__01", 0); //1: enable; 0: disable
			@sysvar::CH_Nodes::CH_EISCLkS_Rq_AR_UB__01 = 1;
			break;
		case (3):
			enableControl("CLkS_Rq_AR", "CH_EISCLkS_Rq_AR_UB__01", 0); //1: enable; 0: disable
			@sysvar::CH_Nodes::CH_EISCLkS_Rq_AR_UB__01 = 0;
			break;
	}

	switch (@sysvar::CH_Nodes::CH_EISCLkS_State_AR_UB_AUTO_01)
	{
		case (0):
			enableControl("CLkS_State_AR", "CH_EISCLkS_State_AR_UB__01", 0); //1: enable; 0: disable
			@sysvar::CH_Nodes::CH_EISCLkS_State_AR_UB__01 = 1;
			break;
		case (1):
			enableControl("CLkS_State_AR", "CH_EISCLkS_State_AR_UB__01", 1); //1: enable; 0: disable
			break;
		case (2):
			enableControl("CLkS_State_AR", "CH_EISCLkS_State_AR_UB__01", 0); //1: enable; 0: disable
			@sysvar::CH_Nodes::CH_EISCLkS_State_AR_UB__01 = 1;
			break;
		case (3):
			enableControl("CLkS_State_AR", "CH_EISCLkS_State_AR_UB__01", 0); //1: enable; 0: disable
			@sysvar::CH_Nodes::CH_EISCLkS_State_AR_UB__01 = 0;
			break;
	}

	CRC_ClockSync_Stat_Pr2 = 0;
	SQC_VAL_ClockSync_Stat_Pr2 = 0;
	SQC_ClockSync_Stat_Pr2 = 0;

	// Simulation der ClockSync_Stat_FR2-Botschaft
	if (isTimerActive(Timer_EIS_ClockSync_Stat_FR2_1) == 0)
	{
		setTimer(Timer_EIS_ClockSync_Stat_FR2_1,1000);
	}
	switch (@sysvar::CH_Nodes::CH_EISCMS_PI_State_Gw_AR_UB_A_01)
	{
		case (0):
			enableControl("CMS_PI_State_Gw_AR2", "CH_EISCMS_PI_State_Gw_AR2_UB__01", 0); //1: enable; 0: disable
			@sysvar::CH_Nodes::CH_EISCMS_PI_State_Gw_AR2_UB__01 = 1;
			break;
		case (1):
			enableControl("CMS_PI_State_Gw_AR2", "CH_EISCMS_PI_State_Gw_AR2_UB__01", 1); //1: enable; 0: disable
			break;
		case (2):
			enableControl("CMS_PI_State_Gw_AR2", "CH_EISCMS_PI_State_Gw_AR2_UB__01", 0); //1: enable; 0: disable
			@sysvar::CH_Nodes::CH_EISCMS_PI_State_Gw_AR2_UB__01 = 1;
			break;
		case (3):
			enableControl("CMS_PI_State_Gw_AR2", "CH_EISCMS_PI_State_Gw_AR2_UB__01", 0); //1: enable; 0: disable
			@sysvar::CH_Nodes::CH_EISCMS_PI_State_Gw_AR2_UB__01 = 0;
			break;
	}

	CRC_CMS_PI_Stat_Pr2 = 0;
	SQC_VAL_CMS_PI_Stat_Pr2 = 0;
	SQC_CMS_PI_Stat_Pr2 = 0;
	switch (@sysvar::CH_Nodes::CH_EISCTRL_C_Stat1_AR_UB_AUTO_01)
	{
		case (0):
			enableControl("CTRL_C_Stat1_AR", "CH_EISCTRL_C_Stat1_AR_UB__01", 0); //1: enable; 0: disable
			@sysvar::CH_Nodes::CH_EISCTRL_C_Stat1_AR_UB__01 = 1;
			break;
		case (1):
			enableControl("CTRL_C_Stat1_AR", "CH_EISCTRL_C_Stat1_AR_UB__01", 1); //1: enable; 0: disable
			break;
		case (2):
			enableControl("CTRL_C_Stat1_AR", "CH_EISCTRL_C_Stat1_AR_UB__01", 0); //1: enable; 0: disable
			@sysvar::CH_Nodes::CH_EISCTRL_C_Stat1_AR_UB__01 = 1;
			break;
		case (3):
			enableControl("CTRL_C_Stat1_AR", "CH_EISCTRL_C_Stat1_AR_UB__01", 0); //1: enable; 0: disable
			@sysvar::CH_Nodes::CH_EISCTRL_C_Stat1_AR_UB__01 = 0;
			break;
	}

	OldVal_OnKey_Psd = $OnKey_Psd;
	OldVal_PhoneKey_Psd = $PhoneKey_Psd;
	OldVal_RadioKey_Psd = $RadioKey_Psd;
	OldVal_SeatKey_Psd = $SeatKey_Psd;
	OldVal_NaviKey_Psd = $NaviKey_Psd;
	OldVal_MediaKey_Psd = $MediaKey_Psd;
	OldVal_CarKey_Psd = $CarKey_Psd;
	OldVal_ReturnKey_Psd = $ReturnKey_Psd;
	OldVal_MenuKey_Psd = $MenuKey_Psd;
	OldVal_MuteKey_Psd = $MuteKey_Psd;
	switch (@sysvar::CH_Nodes::CH_EISDAC4_ECM_AR_UB_AUTO_01)
	{
		case (0):
			enableControl("DAC4_ECM_AR", "CH_EISDAC4_ECM_AR_UB__01", 0); //1: enable; 0: disable
			@sysvar::CH_Nodes::CH_EISDAC4_ECM_AR_UB__01 = 1;
			break;
		case (1):
			enableControl("DAC4_ECM_AR", "CH_EISDAC4_ECM_AR_UB__01", 1); //1: enable; 0: disable
			break;
		case (2):
			enableControl("DAC4_ECM_AR", "CH_EISDAC4_ECM_AR_UB__01", 0); //1: enable; 0: disable
			@sysvar::CH_Nodes::CH_EISDAC4_ECM_AR_UB__01 = 1;
			break;
		case (3):
			enableControl("DAC4_ECM_AR", "CH_EISDAC4_ECM_AR_UB__01", 0); //1: enable; 0: disable
			@sysvar::CH_Nodes::CH_EISDAC4_ECM_AR_UB__01 = 0;
			break;
	}

	switch (@sysvar::CH_Nodes::CH_EISDAC4_EM2_AR_UB_AUTO_01)
	{
		case (0):
			enableControl("DAC4_EM2_AR", "CH_EISDAC4_EM2_AR_UB__01", 0); //1: enable; 0: disable
			@sysvar::CH_Nodes::CH_EISDAC4_EM2_AR_UB__01 = 1;
			break;
		case (1):
			enableControl("DAC4_EM2_AR", "CH_EISDAC4_EM2_AR_UB__01", 1); //1: enable; 0: disable
			break;
		case (2):
			enableControl("DAC4_EM2_AR", "CH_EISDAC4_EM2_AR_UB__01", 0); //1: enable; 0: disable
			@sysvar::CH_Nodes::CH_EISDAC4_EM2_AR_UB__01 = 1;
			break;
		case (3):
			enableControl("DAC4_EM2_AR", "CH_EISDAC4_EM2_AR_UB__01", 0); //1: enable; 0: disable
			@sysvar::CH_Nodes::CH_EISDAC4_EM2_AR_UB__01 = 0;
			break;
	}

	switch (@sysvar::CH_Nodes::CH_EISDAC4_ISM_AR_UB_AUTO_01)
	{
		case (0):
			enableControl("DAC4_ISM_AR", "CH_EISDAC4_ISM_AR_UB__01", 0); //1: enable; 0: disable
			@sysvar::CH_Nodes::CH_EISDAC4_ISM_AR_UB__01 = 1;
			break;
		case (1):
			enableControl("DAC4_ISM_AR", "CH_EISDAC4_ISM_AR_UB__01", 1); //1: enable; 0: disable
			break;
		case (2):
			enableControl("DAC4_ISM_AR", "CH_EISDAC4_ISM_AR_UB__01", 0); //1: enable; 0: disable
			@sysvar::CH_Nodes::CH_EISDAC4_ISM_AR_UB__01 = 1;
			break;
		case (3):
			enableControl("DAC4_ISM_AR", "CH_EISDAC4_ISM_AR_UB__01", 0); //1: enable; 0: disable
			@sysvar::CH_Nodes::CH_EISDAC4_ISM_AR_UB__01 = 0;
			break;
	}

	switch (@sysvar::CH_Nodes::CH_EISDAC4_TCM_AR_UB_AUTO_01)
	{
		case (0):
			enableControl("DAC4_TCM_AR", "CH_EISDAC4_TCM_AR_UB__01", 0); //1: enable; 0: disable
			@sysvar::CH_Nodes::CH_EISDAC4_TCM_AR_UB__01 = 1;
			break;
		case (1):
			enableControl("DAC4_TCM_AR", "CH_EISDAC4_TCM_AR_UB__01", 1); //1: enable; 0: disable
			break;
		case (2):
			enableControl("DAC4_TCM_AR", "CH_EISDAC4_TCM_AR_UB__01", 0); //1: enable; 0: disable
			@sysvar::CH_Nodes::CH_EISDAC4_TCM_AR_UB__01 = 1;
			break;
		case (3):
			enableControl("DAC4_TCM_AR", "CH_EISDAC4_TCM_AR_UB__01", 0); //1: enable; 0: disable
			@sysvar::CH_Nodes::CH_EISDAC4_TCM_AR_UB__01 = 0;
			break;
	}

	switch (@sysvar::CH_Nodes::CH_EISDoor_FL_Stat_AR2_UB_AUT_01)
	{
		case (0):
			enableControl("Door_FL_Stat_AR2", "CH_EISDoor_FL_Stat_AR2_UB__01", 0); //1: enable; 0: disable
			@sysvar::CH_Nodes::CH_EISDoor_FL_Stat_AR2_UB__01 = 1;
			break;
		case (1):
			enableControl("Door_FL_Stat_AR2", "CH_EISDoor_FL_Stat_AR2_UB__01", 1); //1: enable; 0: disable
			break;
		case (2):
			enableControl("Door_FL_Stat_AR2", "CH_EISDoor_FL_Stat_AR2_UB__01", 0); //1: enable; 0: disable
			@sysvar::CH_Nodes::CH_EISDoor_FL_Stat_AR2_UB__01 = 1;
			break;
		case (3):
			enableControl("Door_FL_Stat_AR2", "CH_EISDoor_FL_Stat_AR2_UB__01", 0); //1: enable; 0: disable
			@sysvar::CH_Nodes::CH_EISDoor_FL_Stat_AR2_UB__01 = 0;
			break;
	}

	CRC_Door_FL_Stat_Pr2 = 0;
	SQC_VAL_Door_FL_Stat_Pr2 = 0;
	SQC_Door_FL_Stat_Pr2 = 0;
	switch (@sysvar::CH_Nodes::CH_EISDoor_FR_Stat_AR2_UB_AUT_01)
	{
		case (0):
			enableControl("Door_FR_Stat_AR2", "CH_EISDoor_FR_Stat_AR2_UB__01", 0); //1: enable; 0: disable
			@sysvar::CH_Nodes::CH_EISDoor_FR_Stat_AR2_UB__01 = 1;
			break;
		case (1):
			enableControl("Door_FR_Stat_AR2", "CH_EISDoor_FR_Stat_AR2_UB__01", 1); //1: enable; 0: disable
			break;
		case (2):
			enableControl("Door_FR_Stat_AR2", "CH_EISDoor_FR_Stat_AR2_UB__01", 0); //1: enable; 0: disable
			@sysvar::CH_Nodes::CH_EISDoor_FR_Stat_AR2_UB__01 = 1;
			break;
		case (3):
			enableControl("Door_FR_Stat_AR2", "CH_EISDoor_FR_Stat_AR2_UB__01", 0); //1: enable; 0: disable
			@sysvar::CH_Nodes::CH_EISDoor_FR_Stat_AR2_UB__01 = 0;
			break;
	}

	CRC_Door_FR_Stat_Pr2 = 0;
	SQC_VAL_Door_FR_Stat_Pr2 = 0;
	SQC_Door_FR_Stat_Pr2 = 0;
	switch (@sysvar::CH_Nodes::CH_EISDoor_RL_Stat_AR2_UB_AUT_01)
	{
		case (0):
			enableControl("Door_RL_Stat_AR2", "CH_EISDoor_RL_Stat_AR2_UB__01", 0); //1: enable; 0: disable
			@sysvar::CH_Nodes::CH_EISDoor_RL_Stat_AR2_UB__01 = 1;
			break;
		case (1):
			enableControl("Door_RL_Stat_AR2", "CH_EISDoor_RL_Stat_AR2_UB__01", 1); //1: enable; 0: disable
			break;
		case (2):
			enableControl("Door_RL_Stat_AR2", "CH_EISDoor_RL_Stat_AR2_UB__01", 0); //1: enable; 0: disable
			@sysvar::CH_Nodes::CH_EISDoor_RL_Stat_AR2_UB__01 = 1;
			break;
		case (3):
			enableControl("Door_RL_Stat_AR2", "CH_EISDoor_RL_Stat_AR2_UB__01", 0); //1: enable; 0: disable
			@sysvar::CH_Nodes::CH_EISDoor_RL_Stat_AR2_UB__01 = 0;
			break;
	}

	CRC_Door_RL_Stat_Pr2 = 0;
	SQC_VAL_Door_RL_Stat_Pr2 = 0;
	SQC_Door_RL_Stat_Pr2 = 0;
	switch (@sysvar::CH_Nodes::CH_EISDoor_RR_Stat_AR2_UB_AUT_01)
	{
		case (0):
			enableControl("Door_RR_Stat_AR2", "CH_EISDoor_RR_Stat_AR2_UB__01", 0); //1: enable; 0: disable
			@sysvar::CH_Nodes::CH_EISDoor_RR_Stat_AR2_UB__01 = 1;
			break;
		case (1):
			enableControl("Door_RR_Stat_AR2", "CH_EISDoor_RR_Stat_AR2_UB__01", 1); //1: enable; 0: disable
			break;
		case (2):
			enableControl("Door_RR_Stat_AR2", "CH_EISDoor_RR_Stat_AR2_UB__01", 0); //1: enable; 0: disable
			@sysvar::CH_Nodes::CH_EISDoor_RR_Stat_AR2_UB__01 = 1;
			break;
		case (3):
			enableControl("Door_RR_Stat_AR2", "CH_EISDoor_RR_Stat_AR2_UB__01", 0); //1: enable; 0: disable
			@sysvar::CH_Nodes::CH_EISDoor_RR_Stat_AR2_UB__01 = 0;
			break;
	}

	CRC_Door_RR_Stat_Pr2 = 0;
	SQC_VAL_Door_RR_Stat_Pr2 = 0;
	SQC_Door_RR_Stat_Pr2 = 0;
	switch (@sysvar::CH_Nodes::CH_EISDPC_IndMd_Rq_AR_UB_AUTO_01)
	{
		case (0):
			enableControl("DPC_IndMd_Rq_AR", "CH_EISDPC_IndMd_Rq_AR_UB__01", 0); //1: enable; 0: disable
			@sysvar::CH_Nodes::CH_EISDPC_IndMd_Rq_AR_UB__01 = 1;
			break;
		case (1):
			enableControl("DPC_IndMd_Rq_AR", "CH_EISDPC_IndMd_Rq_AR_UB__01", 1); //1: enable; 0: disable
			break;
		case (2):
			enableControl("DPC_IndMd_Rq_AR", "CH_EISDPC_IndMd_Rq_AR_UB__01", 0); //1: enable; 0: disable
			@sysvar::CH_Nodes::CH_EISDPC_IndMd_Rq_AR_UB__01 = 1;
			break;
		case (3):
			enableControl("DPC_IndMd_Rq_AR", "CH_EISDPC_IndMd_Rq_AR_UB__01", 0); //1: enable; 0: disable
			@sysvar::CH_Nodes::CH_EISDPC_IndMd_Rq_AR_UB__01 = 0;
			break;
	}

	switch (@sysvar::CH_Nodes::CH_EISEL_Stat_AR2_UB_AUTO_01)
	{
		case (0):
			enableControl("EL_Stat_AR2", "CH_EISEL_Stat_AR2_UB__01", 0); //1: enable; 0: disable
			@sysvar::CH_Nodes::CH_EISEL_Stat_AR2_UB__01 = 1;
			break;
		case (1):
			enableControl("EL_Stat_AR2", "CH_EISEL_Stat_AR2_UB__01", 1); //1: enable; 0: disable
			break;
		case (2):
			enableControl("EL_Stat_AR2", "CH_EISEL_Stat_AR2_UB__01", 0); //1: enable; 0: disable
			@sysvar::CH_Nodes::CH_EISEL_Stat_AR2_UB__01 = 1;
			break;
		case (3):
			enableControl("EL_Stat_AR2", "CH_EISEL_Stat_AR2_UB__01", 0); //1: enable; 0: disable
			@sysvar::CH_Nodes::CH_EISEL_Stat_AR2_UB__01 = 0;
			break;
	}

	CRC_ExtLgt_Lmp_On_Rq_Pr2 = 0;
	SQC_VAL_ExtLgt_Lmp_On_Rq_Pr2 = 0;
	SQC_ExtLgt_Lmp_On_Rq_Pr2 = 0;
	switch (@sysvar::CH_Nodes::CH_EISEL_TurnInd_Rq_AR2_UB_AUTO)
	{
		case (0):
			enableControl("EL_TurnInd_Rq_AR2", "CH_EISEL_TurnInd_Rq_AR2_UB_", 0); //1: enable; 0: disable
			@sysvar::CH_Nodes::CH_EISEL_TurnInd_Rq_AR2_UB_ = 1;
			break;
		case (1):
			enableControl("EL_TurnInd_Rq_AR2", "CH_EISEL_TurnInd_Rq_AR2_UB_", 1); //1: enable; 0: disable
			break;
		case (2):
			enableControl("EL_TurnInd_Rq_AR2", "CH_EISEL_TurnInd_Rq_AR2_UB_", 0); //1: enable; 0: disable
			@sysvar::CH_Nodes::CH_EISEL_TurnInd_Rq_AR2_UB_ = 1;
			break;
		case (3):
			enableControl("EL_TurnInd_Rq_AR2", "CH_EISEL_TurnInd_Rq_AR2_UB_", 0); //1: enable; 0: disable
			@sysvar::CH_Nodes::CH_EISEL_TurnInd_Rq_AR2_UB_ = 0;
			break;
	}

	CRC_EL_TurnInd_On_Rq_Pr2 = 0;
	SQC_VAL_EL_TurnInd_On_Rq_Pr2 = 0;
	SQC_EL_TurnInd_On_Rq_Pr2 = 0;
	switch (@sysvar::CH_Nodes::CH_EISEPKB_Stat_AR2_UB_AUTO_01)
	{
		case (0):
			enableControl("EPKB_Stat_AR2", "CH_EISEPKB_Stat_AR2_UB__01", 0); //1: enable; 0: disable
			@sysvar::CH_Nodes::CH_EISEPKB_Stat_AR2_UB__01 = 1;
			break;
		case (1):
			enableControl("EPKB_Stat_AR2", "CH_EISEPKB_Stat_AR2_UB__01", 1); //1: enable; 0: disable
			break;
		case (2):
			enableControl("EPKB_Stat_AR2", "CH_EISEPKB_Stat_AR2_UB__01", 0); //1: enable; 0: disable
			@sysvar::CH_Nodes::CH_EISEPKB_Stat_AR2_UB__01 = 1;
			break;
		case (3):
			enableControl("EPKB_Stat_AR2", "CH_EISEPKB_Stat_AR2_UB__01", 0); //1: enable; 0: disable
			@sysvar::CH_Nodes::CH_EISEPKB_Stat_AR2_UB__01 = 0;
			break;
	}

	CRC_EPKB_Stat_Pr2 = 0;
	SQC_VAL_EPKB_Stat_Pr2 = 0;
	SQC_EPKB_Stat_Pr2 = 0;
	switch (@sysvar::CH_Nodes::CH_EISEVC_CfgBit_01_32_A_UB_A_01)
	{
		case (0):
			enableControl("EVC_CfgBit_01_32_AR2", "CH_EISEVC_CfgBit_01_32_AR2_UB_01", 0); //1: enable; 0: disable
			@sysvar::CH_Nodes::CH_EISEVC_CfgBit_01_32_AR2_UB_01 = 1;
			break;
		case (1):
			enableControl("EVC_CfgBit_01_32_AR2", "CH_EISEVC_CfgBit_01_32_AR2_UB_01", 1); //1: enable; 0: disable
			break;
		case (2):
			enableControl("EVC_CfgBit_01_32_AR2", "CH_EISEVC_CfgBit_01_32_AR2_UB_01", 0); //1: enable; 0: disable
			@sysvar::CH_Nodes::CH_EISEVC_CfgBit_01_32_AR2_UB_01 = 1;
			break;
		case (3):
			enableControl("EVC_CfgBit_01_32_AR2", "CH_EISEVC_CfgBit_01_32_AR2_UB_01", 0); //1: enable; 0: disable
			@sysvar::CH_Nodes::CH_EISEVC_CfgBit_01_32_AR2_UB_01 = 0;
			break;
	}

	CRC_EVC_CfgBit_01_32_Pr2 = 0;
	SQC_VAL_EVC_CfgBit_01_32_Pr2 = 0;
	SQC_EVC_CfgBit_01_32_Pr2 = 0;
	switch (@sysvar::CH_Nodes::CH_EISEVC_CfgBit_33_64_A_UB_A_01)
	{
		case (0):
			enableControl("EVC_CfgBit_33_64_AR2", "CH_EISEVC_CfgBit_33_64_AR2_UB_01", 0); //1: enable; 0: disable
			@sysvar::CH_Nodes::CH_EISEVC_CfgBit_33_64_AR2_UB_01 = 1;
			break;
		case (1):
			enableControl("EVC_CfgBit_33_64_AR2", "CH_EISEVC_CfgBit_33_64_AR2_UB_01", 1); //1: enable; 0: disable
			break;
		case (2):
			enableControl("EVC_CfgBit_33_64_AR2", "CH_EISEVC_CfgBit_33_64_AR2_UB_01", 0); //1: enable; 0: disable
			@sysvar::CH_Nodes::CH_EISEVC_CfgBit_33_64_AR2_UB_01 = 1;
			break;
		case (3):
			enableControl("EVC_CfgBit_33_64_AR2", "CH_EISEVC_CfgBit_33_64_AR2_UB_01", 0); //1: enable; 0: disable
			@sysvar::CH_Nodes::CH_EISEVC_CfgBit_33_64_AR2_UB_01 = 0;
			break;
	}

	CRC_EVC_CfgBit_33_64_Pr2 = 0;
	SQC_VAL_EVC_CfgBit_33_64_Pr2 = 0;
	SQC_EVC_CfgBit_33_64_Pr2 = 0;
	switch (@sysvar::CH_Nodes::CH_EISEVC_CfgBit_65_96_A_UB_A_01)
	{
		case (0):
			enableControl("EVC_CfgBit_65_96_AR2", "CH_EISEVC_CfgBit_65_96_AR2_UB_01", 0); //1: enable; 0: disable
			@sysvar::CH_Nodes::CH_EISEVC_CfgBit_65_96_AR2_UB_01 = 1;
			break;
		case (1):
			enableControl("EVC_CfgBit_65_96_AR2", "CH_EISEVC_CfgBit_65_96_AR2_UB_01", 1); //1: enable; 0: disable
			break;
		case (2):
			enableControl("EVC_CfgBit_65_96_AR2", "CH_EISEVC_CfgBit_65_96_AR2_UB_01", 0); //1: enable; 0: disable
			@sysvar::CH_Nodes::CH_EISEVC_CfgBit_65_96_AR2_UB_01 = 1;
			break;
		case (3):
			enableControl("EVC_CfgBit_65_96_AR2", "CH_EISEVC_CfgBit_65_96_AR2_UB_01", 0); //1: enable; 0: disable
			@sysvar::CH_Nodes::CH_EISEVC_CfgBit_65_96_AR2_UB_01 = 0;
			break;
	}

	CRC_EVC_CfgBit_65_96_Pr2 = 0;
	SQC_VAL_EVC_CfgBit_65_96_Pr2 = 0;
	SQC_EVC_CfgBit_65_96_Pr2 = 0;
	switch (@sysvar::CH_Nodes::CH_EISEVC_CfgBit_97_C8_A_UB_AUTO)
	{
		case (0):
			enableControl("EVC_CfgBit_97_C8_AR2", "CH_EISEVC_CfgBit_97_C8_AR2_UB_", 0); //1: enable; 0: disable
			@sysvar::CH_Nodes::CH_EISEVC_CfgBit_97_C8_AR2_UB_ = 1;
			break;
		case (1):
			enableControl("EVC_CfgBit_97_C8_AR2", "CH_EISEVC_CfgBit_97_C8_AR2_UB_", 1); //1: enable; 0: disable
			break;
		case (2):
			enableControl("EVC_CfgBit_97_C8_AR2", "CH_EISEVC_CfgBit_97_C8_AR2_UB_", 0); //1: enable; 0: disable
			@sysvar::CH_Nodes::CH_EISEVC_CfgBit_97_C8_AR2_UB_ = 1;
			break;
		case (3):
			enableControl("EVC_CfgBit_97_C8_AR2", "CH_EISEVC_CfgBit_97_C8_AR2_UB_", 0); //1: enable; 0: disable
			@sysvar::CH_Nodes::CH_EISEVC_CfgBit_97_C8_AR2_UB_ = 0;
			break;
	}

	CRC_EVC_CfgBit_97_C8_Pr2 = 0;
	SQC_VAL_EVC_CfgBit_97_C8_Pr2 = 0;
	SQC_EVC_CfgBit_97_C8_Pr2 = 0;
	switch (@sysvar::CH_Nodes::CH_EISEVC_CfgList_01_0C__UB_A_01)
	{
		case (0):
			enableControl("EVC_CfgList_01_0C_AR2", "CH_EISEVC_CfgList_01_0C_AR2_U_01", 0); //1: enable; 0: disable
			@sysvar::CH_Nodes::CH_EISEVC_CfgList_01_0C_AR2_U_01 = 1;
			break;
		case (1):
			enableControl("EVC_CfgList_01_0C_AR2", "CH_EISEVC_CfgList_01_0C_AR2_U_01", 1); //1: enable; 0: disable
			break;
		case (2):
			enableControl("EVC_CfgList_01_0C_AR2", "CH_EISEVC_CfgList_01_0C_AR2_U_01", 0); //1: enable; 0: disable
			@sysvar::CH_Nodes::CH_EISEVC_CfgList_01_0C_AR2_U_01 = 1;
			break;
		case (3):
			enableControl("EVC_CfgList_01_0C_AR2", "CH_EISEVC_CfgList_01_0C_AR2_U_01", 0); //1: enable; 0: disable
			@sysvar::CH_Nodes::CH_EISEVC_CfgList_01_0C_AR2_U_01 = 0;
			break;
	}

	CRC_EVC_CfgList_01_0C_Pr2 = 0;
	SQC_VAL_EVC_CfgList_01_0C_Pr2 = 0;
	SQC_EVC_CfgList_01_0C_Pr2 = 0;
	switch (@sysvar::CH_Nodes::CH_EISFCW_Disp_Rq_AR_UB_AUTO)
	{
		case (0):
			enableControl("FCW_Disp_Rq_AR", "CH_EISFCW_Disp_Rq_AR_UB_", 0); //1: enable; 0: disable
			@sysvar::CH_Nodes::CH_EISFCW_Disp_Rq_AR_UB_ = 1;
			break;
		case (1):
			enableControl("FCW_Disp_Rq_AR", "CH_EISFCW_Disp_Rq_AR_UB_", 1); //1: enable; 0: disable
			break;
		case (2):
			enableControl("FCW_Disp_Rq_AR", "CH_EISFCW_Disp_Rq_AR_UB_", 0); //1: enable; 0: disable
			@sysvar::CH_Nodes::CH_EISFCW_Disp_Rq_AR_UB_ = 1;
			break;
		case (3):
			enableControl("FCW_Disp_Rq_AR", "CH_EISFCW_Disp_Rq_AR_UB_", 0); //1: enable; 0: disable
			@sysvar::CH_Nodes::CH_EISFCW_Disp_Rq_AR_UB_ = 0;
			break;
	}

	switch (@sysvar::CH_Nodes::CH_EISHMI_CHASSIS_R1_AR2_UB_A_01)
	{
		case (0):
			enableControl("HMI_CHASSIS_R1_AR2", "CH_EISHMI_CHASSIS_R1_AR2_UB__01", 0); //1: enable; 0: disable
			@sysvar::CH_Nodes::CH_EISHMI_CHASSIS_R1_AR2_UB__01 = 1;
			break;
		case (1):
			enableControl("HMI_CHASSIS_R1_AR2", "CH_EISHMI_CHASSIS_R1_AR2_UB__01", 1); //1: enable; 0: disable
			break;
		case (2):
			enableControl("HMI_CHASSIS_R1_AR2", "CH_EISHMI_CHASSIS_R1_AR2_UB__01", 0); //1: enable; 0: disable
			@sysvar::CH_Nodes::CH_EISHMI_CHASSIS_R1_AR2_UB__01 = 1;
			break;
		case (3):
			enableControl("HMI_CHASSIS_R1_AR2", "CH_EISHMI_CHASSIS_R1_AR2_UB__01", 0); //1: enable; 0: disable
			@sysvar::CH_Nodes::CH_EISHMI_CHASSIS_R1_AR2_UB__01 = 0;
			break;
	}

	OldVal_Park_Disp_Stat = $Park_Disp_Stat;
	CRC_CTRL_L_Stat_Pr2 = 0;
	SQC_VAL_CTRL_L_Stat_Pr2 = 0;
	SQC_CTRL_L_Stat_Pr2 = 0;
	CRC_CTRL_L2_Stat_Pr2 = 0;
	SQC_VAL_CTRL_L2_Stat_Pr2 = 0;
	SQC_CTRL_L2_Stat_Pr2 = 0;
	switch (@sysvar::CH_Nodes::CH_EISHU_State_AR_UB_AUTO)
	{
		case (0):
			enableControl("HU_State_AR", "CH_EISHU_State_AR_UB_", 0); //1: enable; 0: disable
			@sysvar::CH_Nodes::CH_EISHU_State_AR_UB_ = 1;
			break;
		case (1):
			enableControl("HU_State_AR", "CH_EISHU_State_AR_UB_", 1); //1: enable; 0: disable
			break;
		case (2):
			enableControl("HU_State_AR", "CH_EISHU_State_AR_UB_", 0); //1: enable; 0: disable
			@sysvar::CH_Nodes::CH_EISHU_State_AR_UB_ = 1;
			break;
		case (3):
			enableControl("HU_State_AR", "CH_EISHU_State_AR_UB_", 0); //1: enable; 0: disable
			@sysvar::CH_Nodes::CH_EISHU_State_AR_UB_ = 0;
			break;
	}

	switch (@sysvar::CH_Nodes::CH_EISHVAC_OBD_DTC_AR_UB_AUTO_01)
	{
		case (0):
			enableControl("HVAC_OBD_DTC_AR", "CH_EISHVAC_OBD_DTC_AR_UB__01", 0); //1: enable; 0: disable
			@sysvar::CH_Nodes::CH_EISHVAC_OBD_DTC_AR_UB__01 = 1;
			break;
		case (1):
			enableControl("HVAC_OBD_DTC_AR", "CH_EISHVAC_OBD_DTC_AR_UB__01", 1); //1: enable; 0: disable
			break;
		case (2):
			enableControl("HVAC_OBD_DTC_AR", "CH_EISHVAC_OBD_DTC_AR_UB__01", 0); //1: enable; 0: disable
			@sysvar::CH_Nodes::CH_EISHVAC_OBD_DTC_AR_UB__01 = 1;
			break;
		case (3):
			enableControl("HVAC_OBD_DTC_AR", "CH_EISHVAC_OBD_DTC_AR_UB__01", 0); //1: enable; 0: disable
			@sysvar::CH_Nodes::CH_EISHVAC_OBD_DTC_AR_UB__01 = 0;
			break;
	}

	switch (@sysvar::CH_Nodes::CH_EISHVAC_Rs_AR2_UB_AUTO_01)
	{
		case (0):
			enableControl("HVAC_Rs_AR2", "CH_EISHVAC_Rs_AR2_UB__01", 0); //1: enable; 0: disable
			@sysvar::CH_Nodes::CH_EISHVAC_Rs_AR2_UB__01 = 1;
			break;
		case (1):
			enableControl("HVAC_Rs_AR2", "CH_EISHVAC_Rs_AR2_UB__01", 1); //1: enable; 0: disable
			break;
		case (2):
			enableControl("HVAC_Rs_AR2", "CH_EISHVAC_Rs_AR2_UB__01", 0); //1: enable; 0: disable
			@sysvar::CH_Nodes::CH_EISHVAC_Rs_AR2_UB__01 = 1;
			break;
		case (3):
			enableControl("HVAC_Rs_AR2", "CH_EISHVAC_Rs_AR2_UB__01", 0); //1: enable; 0: disable
			@sysvar::CH_Nodes::CH_EISHVAC_Rs_AR2_UB__01 = 0;
			break;
	}

	CRC_HVAC_CompTrq_Pr2 = 0;
	SQC_VAL_HVAC_CompTrq_Pr2 = 0;
	SQC_HVAC_CompTrq_Pr2 = 0;
	switch (@sysvar::CH_Nodes::CH_EISIC_DriveAssistSys__UB_A_01)
	{
		case (0):
			enableControl("IC_DriveAssistSys_AR2", "CH_EISIC_DriveAssistSys_AR2_U_01", 0); //1: enable; 0: disable
			@sysvar::CH_Nodes::CH_EISIC_DriveAssistSys_AR2_U_01 = 1;
			break;
		case (1):
			enableControl("IC_DriveAssistSys_AR2", "CH_EISIC_DriveAssistSys_AR2_U_01", 1); //1: enable; 0: disable
			break;
		case (2):
			enableControl("IC_DriveAssistSys_AR2", "CH_EISIC_DriveAssistSys_AR2_U_01", 0); //1: enable; 0: disable
			@sysvar::CH_Nodes::CH_EISIC_DriveAssistSys_AR2_U_01 = 1;
			break;
		case (3):
			enableControl("IC_DriveAssistSys_AR2", "CH_EISIC_DriveAssistSys_AR2_U_01", 0); //1: enable; 0: disable
			@sysvar::CH_Nodes::CH_EISIC_DriveAssistSys_AR2_U_01 = 0;
			break;
	}

	switch (@sysvar::CH_Nodes::CH_EISIC_Settings_AR2_UB_AUTO_01)
	{
		case (0):
			enableControl("IC_Settings_AR2", "CH_EISIC_Settings_AR2_UB__01", 0); //1: enable; 0: disable
			@sysvar::CH_Nodes::CH_EISIC_Settings_AR2_UB__01 = 1;
			break;
		case (1):
			enableControl("IC_Settings_AR2", "CH_EISIC_Settings_AR2_UB__01", 1); //1: enable; 0: disable
			break;
		case (2):
			enableControl("IC_Settings_AR2", "CH_EISIC_Settings_AR2_UB__01", 0); //1: enable; 0: disable
			@sysvar::CH_Nodes::CH_EISIC_Settings_AR2_UB__01 = 1;
			break;
		case (3):
			enableControl("IC_Settings_AR2", "CH_EISIC_Settings_AR2_UB__01", 0); //1: enable; 0: disable
			@sysvar::CH_Nodes::CH_EISIC_Settings_AR2_UB__01 = 0;
			break;
	}

	switch (@sysvar::CH_Nodes::CH_EISICH_Stat_AR_UB_AUTO_01)
	{
		case (0):
			enableControl("ICH_Stat_AR", "CH_EISICH_Stat_AR_UB__01", 0); //1: enable; 0: disable
			@sysvar::CH_Nodes::CH_EISICH_Stat_AR_UB__01 = 1;
			break;
		case (1):
			enableControl("ICH_Stat_AR", "CH_EISICH_Stat_AR_UB__01", 1); //1: enable; 0: disable
			break;
		case (2):
			enableControl("ICH_Stat_AR", "CH_EISICH_Stat_AR_UB__01", 0); //1: enable; 0: disable
			@sysvar::CH_Nodes::CH_EISICH_Stat_AR_UB__01 = 1;
			break;
		case (3):
			enableControl("ICH_Stat_AR", "CH_EISICH_Stat_AR_UB__01", 0); //1: enable; 0: disable
			@sysvar::CH_Nodes::CH_EISICH_Stat_AR_UB__01 = 0;
			break;
	}

	switch (@sysvar::CH_Nodes::CH_EISIgn_Veh_Stat_AR2_UB_AUT_01)
	{
		case (0):
			enableControl("Ign_Veh_Stat_AR2", "CH_EISIgn_Veh_Stat_AR2_UB__01", 0); //1: enable; 0: disable
			@sysvar::CH_Nodes::CH_EISIgn_Veh_Stat_AR2_UB__01 = 1;
			break;
		case (1):
			enableControl("Ign_Veh_Stat_AR2", "CH_EISIgn_Veh_Stat_AR2_UB__01", 1); //1: enable; 0: disable
			break;
		case (2):
			enableControl("Ign_Veh_Stat_AR2", "CH_EISIgn_Veh_Stat_AR2_UB__01", 0); //1: enable; 0: disable
			@sysvar::CH_Nodes::CH_EISIgn_Veh_Stat_AR2_UB__01 = 1;
			break;
		case (3):
			enableControl("Ign_Veh_Stat_AR2", "CH_EISIgn_Veh_Stat_AR2_UB__01", 0); //1: enable; 0: disable
			@sysvar::CH_Nodes::CH_EISIgn_Veh_Stat_AR2_UB__01 = 0;
			break;
	}

	CRC_Ign_Stat_Pr2 = 0;
	SQC_VAL_Ign_Stat_Pr2 = 0;
	SQC_Ign_Stat_Pr2 = 0;
	switch (@sysvar::CH_Nodes::CH_EISIHC_Lgt_Stat_HLI_2_UB_AUTO)
	{
		case (0):
			enableControl("IHC_Lgt_Stat_HLI_2_AR2", "CH_EISIHC_Lgt_Stat_HLI_2_AR2_UB_", 0); //1: enable; 0: disable
			@sysvar::CH_Nodes::CH_EISIHC_Lgt_Stat_HLI_2_AR2_UB_ = 1;
			break;
		case (1):
			enableControl("IHC_Lgt_Stat_HLI_2_AR2", "CH_EISIHC_Lgt_Stat_HLI_2_AR2_UB_", 1); //1: enable; 0: disable
			break;
		case (2):
			enableControl("IHC_Lgt_Stat_HLI_2_AR2", "CH_EISIHC_Lgt_Stat_HLI_2_AR2_UB_", 0); //1: enable; 0: disable
			@sysvar::CH_Nodes::CH_EISIHC_Lgt_Stat_HLI_2_AR2_UB_ = 1;
			break;
		case (3):
			enableControl("IHC_Lgt_Stat_HLI_2_AR2", "CH_EISIHC_Lgt_Stat_HLI_2_AR2_UB_", 0); //1: enable; 0: disable
			@sysvar::CH_Nodes::CH_EISIHC_Lgt_Stat_HLI_2_AR2_UB_ = 0;
			break;
	}

	switch (@sysvar::CH_Nodes::CH_EISIHC_Lgt_Stat_HLI_A_UB_A_01)
	{
		case (0):
			enableControl("IHC_Lgt_Stat_HLI_AR2", "CH_EISIHC_Lgt_Stat_HLI_AR2_UB_01", 0); //1: enable; 0: disable
			@sysvar::CH_Nodes::CH_EISIHC_Lgt_Stat_HLI_AR2_UB_01 = 1;
			break;
		case (1):
			enableControl("IHC_Lgt_Stat_HLI_AR2", "CH_EISIHC_Lgt_Stat_HLI_AR2_UB_01", 1); //1: enable; 0: disable
			break;
		case (2):
			enableControl("IHC_Lgt_Stat_HLI_AR2", "CH_EISIHC_Lgt_Stat_HLI_AR2_UB_01", 0); //1: enable; 0: disable
			@sysvar::CH_Nodes::CH_EISIHC_Lgt_Stat_HLI_AR2_UB_01 = 1;
			break;
		case (3):
			enableControl("IHC_Lgt_Stat_HLI_AR2", "CH_EISIHC_Lgt_Stat_HLI_AR2_UB_01", 0); //1: enable; 0: disable
			@sysvar::CH_Nodes::CH_EISIHC_Lgt_Stat_HLI_AR2_UB_01 = 0;
			break;
	}

	CRC_IHC_Lgt_Stat_HLI_Pr2 = 0;
	SQC_VAL_IHC_Lgt_Stat_HLI_Pr2 = 0;
	SQC_IHC_Lgt_Stat_HLI_Pr2 = 0;
	switch (@sysvar::CH_Nodes::CH_EISKG_State_AR2_UB_AUTO)
	{
		case (0):
			enableControl("KG_State_AR2", "CH_EISKG_State_AR2_UB_", 0); //1: enable; 0: disable
			@sysvar::CH_Nodes::CH_EISKG_State_AR2_UB_ = 1;
			break;
		case (1):
			enableControl("KG_State_AR2", "CH_EISKG_State_AR2_UB_", 1); //1: enable; 0: disable
			break;
		case (2):
			enableControl("KG_State_AR2", "CH_EISKG_State_AR2_UB_", 0); //1: enable; 0: disable
			@sysvar::CH_Nodes::CH_EISKG_State_AR2_UB_ = 1;
			break;
		case (3):
			enableControl("KG_State_AR2", "CH_EISKG_State_AR2_UB_", 0); //1: enable; 0: disable
			@sysvar::CH_Nodes::CH_EISKG_State_AR2_UB_ = 0;
			break;
	}

	CRC_RemPark_Stat_KG_Pr2 = 0;
	SQC_VAL_RemPark_Stat_KG_Pr2 = 0;
	SQC_RemPark_Stat_KG_Pr2 = 0;
	switch (@sysvar::CH_Nodes::CH_EISLDC_Disp_Stat_IC_A_UB_A_01)
	{
		case (0):
			enableControl("LDC_Disp_Stat_IC_AR2", "CH_EISLDC_Disp_Stat_IC_AR2_UB_01", 0); //1: enable; 0: disable
			@sysvar::CH_Nodes::CH_EISLDC_Disp_Stat_IC_AR2_UB_01 = 1;
			break;
		case (1):
			enableControl("LDC_Disp_Stat_IC_AR2", "CH_EISLDC_Disp_Stat_IC_AR2_UB_01", 1); //1: enable; 0: disable
			break;
		case (2):
			enableControl("LDC_Disp_Stat_IC_AR2", "CH_EISLDC_Disp_Stat_IC_AR2_UB_01", 0); //1: enable; 0: disable
			@sysvar::CH_Nodes::CH_EISLDC_Disp_Stat_IC_AR2_UB_01 = 1;
			break;
		case (3):
			enableControl("LDC_Disp_Stat_IC_AR2", "CH_EISLDC_Disp_Stat_IC_AR2_UB_01", 0); //1: enable; 0: disable
			@sysvar::CH_Nodes::CH_EISLDC_Disp_Stat_IC_AR2_UB_01 = 0;
			break;
	}

	switch (@sysvar::CH_Nodes::CH_EISLgtSens_State_AR_UB_AUT_01)
	{
		case (0):
			enableControl("LgtSens_State_AR", "CH_EISLgtSens_State_AR_UB__01", 0); //1: enable; 0: disable
			@sysvar::CH_Nodes::CH_EISLgtSens_State_AR_UB__01 = 1;
			break;
		case (1):
			enableControl("LgtSens_State_AR", "CH_EISLgtSens_State_AR_UB__01", 1); //1: enable; 0: disable
			break;
		case (2):
			enableControl("LgtSens_State_AR", "CH_EISLgtSens_State_AR_UB__01", 0); //1: enable; 0: disable
			@sysvar::CH_Nodes::CH_EISLgtSens_State_AR_UB__01 = 1;
			break;
		case (3):
			enableControl("LgtSens_State_AR", "CH_EISLgtSens_State_AR_UB__01", 0); //1: enable; 0: disable
			@sysvar::CH_Nodes::CH_EISLgtSens_State_AR_UB__01 = 0;
			break;
	}

	switch (@sysvar::CH_Nodes::CH_EISMirr_Adj_Lt_Rq_AR_UB_AU_01)
	{
		case (0):
			enableControl("Mirr_Adj_Lt_Rq_AR", "CH_EISMirr_Adj_Lt_Rq_AR_UB__01", 0); //1: enable; 0: disable
			@sysvar::CH_Nodes::CH_EISMirr_Adj_Lt_Rq_AR_UB__01 = 1;
			break;
		case (1):
			enableControl("Mirr_Adj_Lt_Rq_AR", "CH_EISMirr_Adj_Lt_Rq_AR_UB__01", 1); //1: enable; 0: disable
			break;
		case (2):
			enableControl("Mirr_Adj_Lt_Rq_AR", "CH_EISMirr_Adj_Lt_Rq_AR_UB__01", 0); //1: enable; 0: disable
			@sysvar::CH_Nodes::CH_EISMirr_Adj_Lt_Rq_AR_UB__01 = 1;
			break;
		case (3):
			enableControl("Mirr_Adj_Lt_Rq_AR", "CH_EISMirr_Adj_Lt_Rq_AR_UB__01", 0); //1: enable; 0: disable
			@sysvar::CH_Nodes::CH_EISMirr_Adj_Lt_Rq_AR_UB__01 = 0;
			break;
	}

	switch (@sysvar::CH_Nodes::CH_EISMirr_Adj_Rt_Rq_AR_UB_AU_01)
	{
		case (0):
			enableControl("Mirr_Adj_Rt_Rq_AR", "CH_EISMirr_Adj_Rt_Rq_AR_UB__01", 0); //1: enable; 0: disable
			@sysvar::CH_Nodes::CH_EISMirr_Adj_Rt_Rq_AR_UB__01 = 1;
			break;
		case (1):
			enableControl("Mirr_Adj_Rt_Rq_AR", "CH_EISMirr_Adj_Rt_Rq_AR_UB__01", 1); //1: enable; 0: disable
			break;
		case (2):
			enableControl("Mirr_Adj_Rt_Rq_AR", "CH_EISMirr_Adj_Rt_Rq_AR_UB__01", 0); //1: enable; 0: disable
			@sysvar::CH_Nodes::CH_EISMirr_Adj_Rt_Rq_AR_UB__01 = 1;
			break;
		case (3):
			enableControl("Mirr_Adj_Rt_Rq_AR", "CH_EISMirr_Adj_Rt_Rq_AR_UB__01", 0); //1: enable; 0: disable
			@sysvar::CH_Nodes::CH_EISMirr_Adj_Rt_Rq_AR_UB__01 = 0;
			break;
	}

	switch (@sysvar::CH_Nodes::CH_EISNAVI_Pos1_AR_UB_AUTO_01)
	{
		case (0):
			enableControl("NAVI_Pos1_AR", "CH_EISNAVI_Pos1_AR_UB__01", 0); //1: enable; 0: disable
			@sysvar::CH_Nodes::CH_EISNAVI_Pos1_AR_UB__01 = 1;
			break;
		case (1):
			enableControl("NAVI_Pos1_AR", "CH_EISNAVI_Pos1_AR_UB__01", 1); //1: enable; 0: disable
			break;
		case (2):
			enableControl("NAVI_Pos1_AR", "CH_EISNAVI_Pos1_AR_UB__01", 0); //1: enable; 0: disable
			@sysvar::CH_Nodes::CH_EISNAVI_Pos1_AR_UB__01 = 1;
			break;
		case (3):
			enableControl("NAVI_Pos1_AR", "CH_EISNAVI_Pos1_AR_UB__01", 0); //1: enable; 0: disable
			@sysvar::CH_Nodes::CH_EISNAVI_Pos1_AR_UB__01 = 0;
			break;
	}

	switch (@sysvar::CH_Nodes::CH_EISNAVI_Pos2_AR_UB_AUTO_01)
	{
		case (0):
			enableControl("NAVI_Pos2_AR", "CH_EISNAVI_Pos2_AR_UB__01", 0); //1: enable; 0: disable
			@sysvar::CH_Nodes::CH_EISNAVI_Pos2_AR_UB__01 = 1;
			break;
		case (1):
			enableControl("NAVI_Pos2_AR", "CH_EISNAVI_Pos2_AR_UB__01", 1); //1: enable; 0: disable
			break;
		case (2):
			enableControl("NAVI_Pos2_AR", "CH_EISNAVI_Pos2_AR_UB__01", 0); //1: enable; 0: disable
			@sysvar::CH_Nodes::CH_EISNAVI_Pos2_AR_UB__01 = 1;
			break;
		case (3):
			enableControl("NAVI_Pos2_AR", "CH_EISNAVI_Pos2_AR_UB__01", 0); //1: enable; 0: disable
			@sysvar::CH_Nodes::CH_EISNAVI_Pos2_AR_UB__01 = 0;
			break;
	}

	switch (@sysvar::CH_Nodes::CH_EISNAVI_Pos3_AR_UB_AUTO_01)
	{
		case (0):
			enableControl("NAVI_Pos3_AR", "CH_EISNAVI_Pos3_AR_UB__01", 0); //1: enable; 0: disable
			@sysvar::CH_Nodes::CH_EISNAVI_Pos3_AR_UB__01 = 1;
			break;
		case (1):
			enableControl("NAVI_Pos3_AR", "CH_EISNAVI_Pos3_AR_UB__01", 1); //1: enable; 0: disable
			break;
		case (2):
			enableControl("NAVI_Pos3_AR", "CH_EISNAVI_Pos3_AR_UB__01", 0); //1: enable; 0: disable
			@sysvar::CH_Nodes::CH_EISNAVI_Pos3_AR_UB__01 = 1;
			break;
		case (3):
			enableControl("NAVI_Pos3_AR", "CH_EISNAVI_Pos3_AR_UB__01", 0); //1: enable; 0: disable
			@sysvar::CH_Nodes::CH_EISNAVI_Pos3_AR_UB__01 = 0;
			break;
	}

	switch (@sysvar::CH_Nodes::CH_EISNAVI_Pos4_AR_UB_AUTO_01)
	{
		case (0):
			enableControl("NAVI_Pos4_AR", "CH_EISNAVI_Pos4_AR_UB__01", 0); //1: enable; 0: disable
			@sysvar::CH_Nodes::CH_EISNAVI_Pos4_AR_UB__01 = 1;
			break;
		case (1):
			enableControl("NAVI_Pos4_AR", "CH_EISNAVI_Pos4_AR_UB__01", 1); //1: enable; 0: disable
			break;
		case (2):
			enableControl("NAVI_Pos4_AR", "CH_EISNAVI_Pos4_AR_UB__01", 0); //1: enable; 0: disable
			@sysvar::CH_Nodes::CH_EISNAVI_Pos4_AR_UB__01 = 1;
			break;
		case (3):
			enableControl("NAVI_Pos4_AR", "CH_EISNAVI_Pos4_AR_UB__01", 0); //1: enable; 0: disable
			@sysvar::CH_Nodes::CH_EISNAVI_Pos4_AR_UB__01 = 0;
			break;
	}

	switch (@sysvar::CH_Nodes::CH_EISNAVI_Pos5_AR_UB_AUTO_01)
	{
		case (0):
			enableControl("NAVI_Pos5_AR", "CH_EISNAVI_Pos5_AR_UB__01", 0); //1: enable; 0: disable
			@sysvar::CH_Nodes::CH_EISNAVI_Pos5_AR_UB__01 = 1;
			break;
		case (1):
			enableControl("NAVI_Pos5_AR", "CH_EISNAVI_Pos5_AR_UB__01", 1); //1: enable; 0: disable
			break;
		case (2):
			enableControl("NAVI_Pos5_AR", "CH_EISNAVI_Pos5_AR_UB__01", 0); //1: enable; 0: disable
			@sysvar::CH_Nodes::CH_EISNAVI_Pos5_AR_UB__01 = 1;
			break;
		case (3):
			enableControl("NAVI_Pos5_AR", "CH_EISNAVI_Pos5_AR_UB__01", 0); //1: enable; 0: disable
			@sysvar::CH_Nodes::CH_EISNAVI_Pos5_AR_UB__01 = 0;
			break;
	}

	switch (@sysvar::CH_Nodes::CH_EISNVP_Stat1_AR2_UB_AUTO_01)
	{
		case (0):
			enableControl("NVP_Stat1_AR2", "CH_EISNVP_Stat1_AR2_UB__01", 0); //1: enable; 0: disable
			@sysvar::CH_Nodes::CH_EISNVP_Stat1_AR2_UB__01 = 1;
			break;
		case (1):
			enableControl("NVP_Stat1_AR2", "CH_EISNVP_Stat1_AR2_UB__01", 1); //1: enable; 0: disable
			break;
		case (2):
			enableControl("NVP_Stat1_AR2", "CH_EISNVP_Stat1_AR2_UB__01", 0); //1: enable; 0: disable
			@sysvar::CH_Nodes::CH_EISNVP_Stat1_AR2_UB__01 = 1;
			break;
		case (3):
			enableControl("NVP_Stat1_AR2", "CH_EISNVP_Stat1_AR2_UB__01", 0); //1: enable; 0: disable
			@sysvar::CH_Nodes::CH_EISNVP_Stat1_AR2_UB__01 = 0;
			break;
	}

	CRC_NVP_Stat1_Pr2 = 0;
	SQC_VAL_NVP_Stat1_Pr2 = 0;
	SQC_NVP_Stat1_Pr2 = 0;
	switch (@sysvar::CH_Nodes::CH_EISOHCM_Stat_AR2_UB_AUTO_01)
	{
		case (0):
			enableControl("OHCM_Stat_AR2", "CH_EISOHCM_Stat_AR2_UB__01", 0); //1: enable; 0: disable
			@sysvar::CH_Nodes::CH_EISOHCM_Stat_AR2_UB__01 = 1;
			break;
		case (1):
			enableControl("OHCM_Stat_AR2", "CH_EISOHCM_Stat_AR2_UB__01", 1); //1: enable; 0: disable
			break;
		case (2):
			enableControl("OHCM_Stat_AR2", "CH_EISOHCM_Stat_AR2_UB__01", 0); //1: enable; 0: disable
			@sysvar::CH_Nodes::CH_EISOHCM_Stat_AR2_UB__01 = 1;
			break;
		case (3):
			enableControl("OHCM_Stat_AR2", "CH_EISOHCM_Stat_AR2_UB__01", 0); //1: enable; 0: disable
			@sysvar::CH_Nodes::CH_EISOHCM_Stat_AR2_UB__01 = 0;
			break;
	}

	switch (@sysvar::CH_Nodes::CH_EISORC_Disp_Stat_AR2_UB_AU_01)
	{
		case (0):
			enableControl("ORC_Disp_Stat_AR2", "CH_EISORC_Disp_Stat_AR2_UB__01", 0); //1: enable; 0: disable
			@sysvar::CH_Nodes::CH_EISORC_Disp_Stat_AR2_UB__01 = 1;
			break;
		case (1):
			enableControl("ORC_Disp_Stat_AR2", "CH_EISORC_Disp_Stat_AR2_UB__01", 1); //1: enable; 0: disable
			break;
		case (2):
			enableControl("ORC_Disp_Stat_AR2", "CH_EISORC_Disp_Stat_AR2_UB__01", 0); //1: enable; 0: disable
			@sysvar::CH_Nodes::CH_EISORC_Disp_Stat_AR2_UB__01 = 1;
			break;
		case (3):
			enableControl("ORC_Disp_Stat_AR2", "CH_EISORC_Disp_Stat_AR2_UB__01", 0); //1: enable; 0: disable
			@sysvar::CH_Nodes::CH_EISORC_Disp_Stat_AR2_UB__01 = 0;
			break;
	}

	CRC_Bckl_Sw_Ft_Stat_Pr2 = 0;
	SQC_VAL_Bckl_Sw_Ft_Stat_Pr2 = 0;
	SQC_Bckl_Sw_Ft_Stat_Pr2 = 0;
	switch (@sysvar::CH_Nodes::CH_EISORC_Impact_AR2_UB_AUTO_01)
	{
		case (0):
			enableControl("ORC_Impact_AR2", "CH_EISORC_Impact_AR2_UB__01", 0); //1: enable; 0: disable
			@sysvar::CH_Nodes::CH_EISORC_Impact_AR2_UB__01 = 1;
			break;
		case (1):
			enableControl("ORC_Impact_AR2", "CH_EISORC_Impact_AR2_UB__01", 1); //1: enable; 0: disable
			break;
		case (2):
			enableControl("ORC_Impact_AR2", "CH_EISORC_Impact_AR2_UB__01", 0); //1: enable; 0: disable
			@sysvar::CH_Nodes::CH_EISORC_Impact_AR2_UB__01 = 1;
			break;
		case (3):
			enableControl("ORC_Impact_AR2", "CH_EISORC_Impact_AR2_UB__01", 0); //1: enable; 0: disable
			@sysvar::CH_Nodes::CH_EISORC_Impact_AR2_UB__01 = 0;
			break;
	}

	CRC_Impact_Pr2 = 0;
	SQC_VAL_Impact_Pr2 = 0;
	SQC_Impact_Pr2 = 0;
	TGL_VAL_mpact_ = 0;
	TGL_mpact_ = 0;
	switch (@sysvar::CH_Nodes::CH_EISPark_Disp_Rs_AR2_UB_AUT_01)
	{
		case (0):
			enableControl("Park_Disp_Rs_AR2", "CH_EISPark_Disp_Rs_AR2_UB__01", 0); //1: enable; 0: disable
			@sysvar::CH_Nodes::CH_EISPark_Disp_Rs_AR2_UB__01 = 1;
			break;
		case (1):
			enableControl("Park_Disp_Rs_AR2", "CH_EISPark_Disp_Rs_AR2_UB__01", 1); //1: enable; 0: disable
			break;
		case (2):
			enableControl("Park_Disp_Rs_AR2", "CH_EISPark_Disp_Rs_AR2_UB__01", 0); //1: enable; 0: disable
			@sysvar::CH_Nodes::CH_EISPark_Disp_Rs_AR2_UB__01 = 1;
			break;
		case (3):
			enableControl("Park_Disp_Rs_AR2", "CH_EISPark_Disp_Rs_AR2_UB__01", 0); //1: enable; 0: disable
			@sysvar::CH_Nodes::CH_EISPark_Disp_Rs_AR2_UB__01 = 0;
			break;
	}

	switch (@sysvar::CH_Nodes::CH_EISPHB_IHC_Plus_Tunne_UB_AUTO)
	{
		case (0):
			enableControl("PHB_IHC_Plus_Tunnel_3_4_AR2", "CH_EISPHB_IHC_Plus_Tunnel_3__UB_", 0); //1: enable; 0: disable
			@sysvar::CH_Nodes::CH_EISPHB_IHC_Plus_Tunnel_3__UB_ = 1;
			break;
		case (1):
			enableControl("PHB_IHC_Plus_Tunnel_3_4_AR2", "CH_EISPHB_IHC_Plus_Tunnel_3__UB_", 1); //1: enable; 0: disable
			break;
		case (2):
			enableControl("PHB_IHC_Plus_Tunnel_3_4_AR2", "CH_EISPHB_IHC_Plus_Tunnel_3__UB_", 0); //1: enable; 0: disable
			@sysvar::CH_Nodes::CH_EISPHB_IHC_Plus_Tunnel_3__UB_ = 1;
			break;
		case (3):
			enableControl("PHB_IHC_Plus_Tunnel_3_4_AR2", "CH_EISPHB_IHC_Plus_Tunnel_3__UB_", 0); //1: enable; 0: disable
			@sysvar::CH_Nodes::CH_EISPHB_IHC_Plus_Tunnel_3__UB_ = 0;
			break;
	}

	CRC_PHB_IHC_Plus_Tunnel_3_4_Pr2 = 0;
	SQC_VAL_PHB_IHC_Plus_Tunnel_3_4_Pr2 = 0;
	SQC_PHB_IHC_Plus_Tunnel_3_4_Pr2 = 0;
	switch (@sysvar::CH_Nodes::CH_EISPHB_IHC_Plus_Tunne_UB_A_01)
	{
		case (0):
			enableControl("PHB_IHC_Plus_Tunnel_AR2", "CH_EISPHB_IHC_Plus_Tunnel_AR_UB_", 0); //1: enable; 0: disable
			@sysvar::CH_Nodes::CH_EISPHB_IHC_Plus_Tunnel_AR_UB_ = 1;
			break;
		case (1):
			enableControl("PHB_IHC_Plus_Tunnel_AR2", "CH_EISPHB_IHC_Plus_Tunnel_AR_UB_", 1); //1: enable; 0: disable
			break;
		case (2):
			enableControl("PHB_IHC_Plus_Tunnel_AR2", "CH_EISPHB_IHC_Plus_Tunnel_AR_UB_", 0); //1: enable; 0: disable
			@sysvar::CH_Nodes::CH_EISPHB_IHC_Plus_Tunnel_AR_UB_ = 1;
			break;
		case (3):
			enableControl("PHB_IHC_Plus_Tunnel_AR2", "CH_EISPHB_IHC_Plus_Tunnel_AR_UB_", 0); //1: enable; 0: disable
			@sysvar::CH_Nodes::CH_EISPHB_IHC_Plus_Tunnel_AR_UB_ = 0;
			break;
	}

	CRC_PHB_IHC_Plus_Tunnel_Pr2 = 0;
	SQC_VAL_PHB_IHC_Plus_Tunnel_Pr2 = 0;
	SQC_PHB_IHC_Plus_Tunnel_Pr2 = 0;
	switch (@sysvar::CH_Nodes::CH_EISPN14_Rs1_AR2_UB_AUTO_01)
	{
		case (0):
			enableControl("PN14_Rs1_AR2", "CH_EISPN14_Rs1_AR2_UB__01", 0); //1: enable; 0: disable
			@sysvar::CH_Nodes::CH_EISPN14_Rs1_AR2_UB__01 = 1;
			break;
		case (1):
			enableControl("PN14_Rs1_AR2", "CH_EISPN14_Rs1_AR2_UB__01", 1); //1: enable; 0: disable
			break;
		case (2):
			enableControl("PN14_Rs1_AR2", "CH_EISPN14_Rs1_AR2_UB__01", 0); //1: enable; 0: disable
			@sysvar::CH_Nodes::CH_EISPN14_Rs1_AR2_UB__01 = 1;
			break;
		case (3):
			enableControl("PN14_Rs1_AR2", "CH_EISPN14_Rs1_AR2_UB__01", 0); //1: enable; 0: disable
			@sysvar::CH_Nodes::CH_EISPN14_Rs1_AR2_UB__01 = 0;
			break;
	}

	CRC_PN14_Rs1_Pr2 = 0;
	SQC_VAL_PN14_Rs1_Pr2 = 0;
	SQC_PN14_Rs1_Pr2 = 0;
	switch (@sysvar::CH_Nodes::CH_EISPN14_Rs2_AR_UB_AUTO_01)
	{
		case (0):
			enableControl("PN14_Rs2_AR", "CH_EISPN14_Rs2_AR_UB__01", 0); //1: enable; 0: disable
			@sysvar::CH_Nodes::CH_EISPN14_Rs2_AR_UB__01 = 1;
			break;
		case (1):
			enableControl("PN14_Rs2_AR", "CH_EISPN14_Rs2_AR_UB__01", 1); //1: enable; 0: disable
			break;
		case (2):
			enableControl("PN14_Rs2_AR", "CH_EISPN14_Rs2_AR_UB__01", 0); //1: enable; 0: disable
			@sysvar::CH_Nodes::CH_EISPN14_Rs2_AR_UB__01 = 1;
			break;
		case (3):
			enableControl("PN14_Rs2_AR", "CH_EISPN14_Rs2_AR_UB__01", 0); //1: enable; 0: disable
			@sysvar::CH_Nodes::CH_EISPN14_Rs2_AR_UB__01 = 0;
			break;
	}

	switch (@sysvar::CH_Nodes::CH_EISPN14_Stat2_AR2_UB_AUTO_01)
	{
		case (0):
			enableControl("PN14_Stat2_AR2", "CH_EISPN14_Stat2_AR2_UB__01", 0); //1: enable; 0: disable
			@sysvar::CH_Nodes::CH_EISPN14_Stat2_AR2_UB__01 = 1;
			break;
		case (1):
			enableControl("PN14_Stat2_AR2", "CH_EISPN14_Stat2_AR2_UB__01", 1); //1: enable; 0: disable
			break;
		case (2):
			enableControl("PN14_Stat2_AR2", "CH_EISPN14_Stat2_AR2_UB__01", 0); //1: enable; 0: disable
			@sysvar::CH_Nodes::CH_EISPN14_Stat2_AR2_UB__01 = 1;
			break;
		case (3):
			enableControl("PN14_Stat2_AR2", "CH_EISPN14_Stat2_AR2_UB__01", 0); //1: enable; 0: disable
			@sysvar::CH_Nodes::CH_EISPN14_Stat2_AR2_UB__01 = 0;
			break;
	}

	switch (@sysvar::CH_Nodes::CH_EISPN14_Stat_AR_UB_AUTO_01)
	{
		case (0):
			enableControl("PN14_Stat_AR", "CH_EISPN14_Stat_AR_UB__01", 0); //1: enable; 0: disable
			@sysvar::CH_Nodes::CH_EISPN14_Stat_AR_UB__01 = 1;
			break;
		case (1):
			enableControl("PN14_Stat_AR", "CH_EISPN14_Stat_AR_UB__01", 1); //1: enable; 0: disable
			break;
		case (2):
			enableControl("PN14_Stat_AR", "CH_EISPN14_Stat_AR_UB__01", 0); //1: enable; 0: disable
			@sysvar::CH_Nodes::CH_EISPN14_Stat_AR_UB__01 = 1;
			break;
		case (3):
			enableControl("PN14_Stat_AR", "CH_EISPN14_Stat_AR_UB__01", 0); //1: enable; 0: disable
			@sysvar::CH_Nodes::CH_EISPN14_Stat_AR_UB__01 = 0;
			break;
	}

	switch (@sysvar::CH_Nodes::CH_EISPN48_Bat_Stat_AR_UB_AUT_01)
	{
		case (0):
			enableControl("PN48_Bat_Stat_AR", "CH_EISPN48_Bat_Stat_AR_UB__01", 0); //1: enable; 0: disable
			@sysvar::CH_Nodes::CH_EISPN48_Bat_Stat_AR_UB__01 = 1;
			break;
		case (1):
			enableControl("PN48_Bat_Stat_AR", "CH_EISPN48_Bat_Stat_AR_UB__01", 1); //1: enable; 0: disable
			break;
		case (2):
			enableControl("PN48_Bat_Stat_AR", "CH_EISPN48_Bat_Stat_AR_UB__01", 0); //1: enable; 0: disable
			@sysvar::CH_Nodes::CH_EISPN48_Bat_Stat_AR_UB__01 = 1;
			break;
		case (3):
			enableControl("PN48_Bat_Stat_AR", "CH_EISPN48_Bat_Stat_AR_UB__01", 0); //1: enable; 0: disable
			@sysvar::CH_Nodes::CH_EISPN48_Bat_Stat_AR_UB__01 = 0;
			break;
	}

	switch (@sysvar::CH_Nodes::CH_EISPN48_BatLim_Stat_A_UB_A_01)
	{
		case (0):
			enableControl("PN48_BatLim_Stat_AR", "CH_EISPN48_BatLim_Stat_AR_UB__01", 0); //1: enable; 0: disable
			@sysvar::CH_Nodes::CH_EISPN48_BatLim_Stat_AR_UB__01 = 1;
			break;
		case (1):
			enableControl("PN48_BatLim_Stat_AR", "CH_EISPN48_BatLim_Stat_AR_UB__01", 1); //1: enable; 0: disable
			break;
		case (2):
			enableControl("PN48_BatLim_Stat_AR", "CH_EISPN48_BatLim_Stat_AR_UB__01", 0); //1: enable; 0: disable
			@sysvar::CH_Nodes::CH_EISPN48_BatLim_Stat_AR_UB__01 = 1;
			break;
		case (3):
			enableControl("PN48_BatLim_Stat_AR", "CH_EISPN48_BatLim_Stat_AR_UB__01", 0); //1: enable; 0: disable
			@sysvar::CH_Nodes::CH_EISPN48_BatLim_Stat_AR_UB__01 = 0;
			break;
	}

	switch (@sysvar::CH_Nodes::CH_EISPN48_Stat_AR_UB_AUTO_01)
	{
		case (0):
			enableControl("PN48_Stat_AR", "CH_EISPN48_Stat_AR_UB__01", 0); //1: enable; 0: disable
			@sysvar::CH_Nodes::CH_EISPN48_Stat_AR_UB__01 = 1;
			break;
		case (1):
			enableControl("PN48_Stat_AR", "CH_EISPN48_Stat_AR_UB__01", 1); //1: enable; 0: disable
			break;
		case (2):
			enableControl("PN48_Stat_AR", "CH_EISPN48_Stat_AR_UB__01", 0); //1: enable; 0: disable
			@sysvar::CH_Nodes::CH_EISPN48_Stat_AR_UB__01 = 1;
			break;
		case (3):
			enableControl("PN48_Stat_AR", "CH_EISPN48_Stat_AR_UB__01", 0); //1: enable; 0: disable
			@sysvar::CH_Nodes::CH_EISPN48_Stat_AR_UB__01 = 0;
			break;
	}

	switch (@sysvar::CH_Nodes::CH_EISPNHV_WeekDepTmTbl__UB_A_01)
	{
		case (0):
			enableControl("PNHV_WeekDepTmTbl_Rq_HU_AR2", "CH_EISPNHV_WeekDepTmTbl_Rq_H__01", 0); //1: enable; 0: disable
			@sysvar::CH_Nodes::CH_EISPNHV_WeekDepTmTbl_Rq_H__01 = 1;
			break;
		case (1):
			enableControl("PNHV_WeekDepTmTbl_Rq_HU_AR2", "CH_EISPNHV_WeekDepTmTbl_Rq_H__01", 1); //1: enable; 0: disable
			break;
		case (2):
			enableControl("PNHV_WeekDepTmTbl_Rq_HU_AR2", "CH_EISPNHV_WeekDepTmTbl_Rq_H__01", 0); //1: enable; 0: disable
			@sysvar::CH_Nodes::CH_EISPNHV_WeekDepTmTbl_Rq_H__01 = 1;
			break;
		case (3):
			enableControl("PNHV_WeekDepTmTbl_Rq_HU_AR2", "CH_EISPNHV_WeekDepTmTbl_Rq_H__01", 0); //1: enable; 0: disable
			@sysvar::CH_Nodes::CH_EISPNHV_WeekDepTmTbl_Rq_H__01 = 0;
			break;
	}

	switch (@sysvar::CH_Nodes::CH_EISPT_ObjIntrst_Gw_AR_UB_AUTO)
	{
		case (0):
			enableControl("PT_ObjIntrst_Gw_AR2", "CH_EISPT_ObjIntrst_Gw_AR2_UB_", 0); //1: enable; 0: disable
			@sysvar::CH_Nodes::CH_EISPT_ObjIntrst_Gw_AR2_UB_ = 1;
			break;
		case (1):
			enableControl("PT_ObjIntrst_Gw_AR2", "CH_EISPT_ObjIntrst_Gw_AR2_UB_", 1); //1: enable; 0: disable
			break;
		case (2):
			enableControl("PT_ObjIntrst_Gw_AR2", "CH_EISPT_ObjIntrst_Gw_AR2_UB_", 0); //1: enable; 0: disable
			@sysvar::CH_Nodes::CH_EISPT_ObjIntrst_Gw_AR2_UB_ = 1;
			break;
		case (3):
			enableControl("PT_ObjIntrst_Gw_AR2", "CH_EISPT_ObjIntrst_Gw_AR2_UB_", 0); //1: enable; 0: disable
			@sysvar::CH_Nodes::CH_EISPT_ObjIntrst_Gw_AR2_UB_ = 0;
			break;
	}

	CRC_PT_ObjIntrst_Pr2 = 0;
	SQC_VAL_PT_ObjIntrst_Pr2 = 0;
	SQC_PT_ObjIntrst_Pr2 = 0;
	switch (@sysvar::CH_Nodes::CH_EISRemPark_Auth_Rs_AR_UB_A_01)
	{
		case (0):
			enableControl("RemPark_Auth_Rs_AR2", "CH_EISRemPark_Auth_Rs_AR2_UB__01", 0); //1: enable; 0: disable
			@sysvar::CH_Nodes::CH_EISRemPark_Auth_Rs_AR2_UB__01 = 1;
			break;
		case (1):
			enableControl("RemPark_Auth_Rs_AR2", "CH_EISRemPark_Auth_Rs_AR2_UB__01", 1); //1: enable; 0: disable
			break;
		case (2):
			enableControl("RemPark_Auth_Rs_AR2", "CH_EISRemPark_Auth_Rs_AR2_UB__01", 0); //1: enable; 0: disable
			@sysvar::CH_Nodes::CH_EISRemPark_Auth_Rs_AR2_UB__01 = 1;
			break;
		case (3):
			enableControl("RemPark_Auth_Rs_AR2", "CH_EISRemPark_Auth_Rs_AR2_UB__01", 0); //1: enable; 0: disable
			@sysvar::CH_Nodes::CH_EISRemPark_Auth_Rs_AR2_UB__01 = 0;
			break;
	}

	CRC_RemPark_Auth_Rs_Pr2 = 0;
	SQC_VAL_RemPark_Auth_Rs_Pr2 = 0;
	SQC_RemPark_Auth_Rs_Pr2 = 0;
	switch (@sysvar::CH_Nodes::CH_EISRemPark_Stat_EIS_A_UB_AUTO)
	{
		case (0):
			enableControl("RemPark_Stat_EIS_AR2", "CH_EISRemPark_Stat_EIS_AR2_UB_", 0); //1: enable; 0: disable
			@sysvar::CH_Nodes::CH_EISRemPark_Stat_EIS_AR2_UB_ = 1;
			break;
		case (1):
			enableControl("RemPark_Stat_EIS_AR2", "CH_EISRemPark_Stat_EIS_AR2_UB_", 1); //1: enable; 0: disable
			break;
		case (2):
			enableControl("RemPark_Stat_EIS_AR2", "CH_EISRemPark_Stat_EIS_AR2_UB_", 0); //1: enable; 0: disable
			@sysvar::CH_Nodes::CH_EISRemPark_Stat_EIS_AR2_UB_ = 1;
			break;
		case (3):
			enableControl("RemPark_Stat_EIS_AR2", "CH_EISRemPark_Stat_EIS_AR2_UB_", 0); //1: enable; 0: disable
			@sysvar::CH_Nodes::CH_EISRemPark_Stat_EIS_AR2_UB_ = 0;
			break;
	}

	CRC_RemPark_Stat_EIS_Pr2 = 0;
	SQC_VAL_RemPark_Stat_EIS_Pr2 = 0;
	SQC_RemPark_Stat_EIS_Pr2 = 0;
	switch (@sysvar::CH_Nodes::CH_EISRTC_Date_Time_AR2_UB_AU_01)
	{
		case (0):
			enableControl("RTC_Date_Time_AR2", "CH_EISRTC_Date_Time_AR2_UB__01", 0); //1: enable; 0: disable
			@sysvar::CH_Nodes::CH_EISRTC_Date_Time_AR2_UB__01 = 1;
			break;
		case (1):
			enableControl("RTC_Date_Time_AR2", "CH_EISRTC_Date_Time_AR2_UB__01", 1); //1: enable; 0: disable
			break;
		case (2):
			enableControl("RTC_Date_Time_AR2", "CH_EISRTC_Date_Time_AR2_UB__01", 0); //1: enable; 0: disable
			@sysvar::CH_Nodes::CH_EISRTC_Date_Time_AR2_UB__01 = 1;
			break;
		case (3):
			enableControl("RTC_Date_Time_AR2", "CH_EISRTC_Date_Time_AR2_UB__01", 0); //1: enable; 0: disable
			@sysvar::CH_Nodes::CH_EISRTC_Date_Time_AR2_UB__01 = 0;
			break;
	}

	switch (@sysvar::CH_Nodes::CH_EISSADR_Trgr_FCW_AR2_UB_AU_01)
	{
		case (0):
			enableControl("SADR_Trgr_FCW_AR2", "CH_EISSADR_Trgr_FCW_AR2_UB__01", 0); //1: enable; 0: disable
			@sysvar::CH_Nodes::CH_EISSADR_Trgr_FCW_AR2_UB__01 = 1;
			break;
		case (1):
			enableControl("SADR_Trgr_FCW_AR2", "CH_EISSADR_Trgr_FCW_AR2_UB__01", 1); //1: enable; 0: disable
			break;
		case (2):
			enableControl("SADR_Trgr_FCW_AR2", "CH_EISSADR_Trgr_FCW_AR2_UB__01", 0); //1: enable; 0: disable
			@sysvar::CH_Nodes::CH_EISSADR_Trgr_FCW_AR2_UB__01 = 1;
			break;
		case (3):
			enableControl("SADR_Trgr_FCW_AR2", "CH_EISSADR_Trgr_FCW_AR2_UB__01", 0); //1: enable; 0: disable
			@sysvar::CH_Nodes::CH_EISSADR_Trgr_FCW_AR2_UB__01 = 0;
			break;
	}

	CRC_SADR_Trgr_FCW_Pr2 = 0;
	SQC_VAL_SADR_Trgr_FCW_Pr2 = 0;
	SQC_SADR_Trgr_FCW_Pr2 = 0;
	TGL_VAL_eat_FL_ = 0;
	TGL_eat_FL_ = 0;
	TGL_VAL_eat_FR_ = 0;
	TGL_eat_FR_ = 0;
	switch (@sysvar::CH_Nodes::CH_EISSPCR_Stat_BC_F_AR2_UB_A_01)
	{
		case (0):
			enableControl("SPCR_Stat_BC_F_AR2", "CH_EISSPCR_Stat_BC_F_AR2_UB__01", 0); //1: enable; 0: disable
			@sysvar::CH_Nodes::CH_EISSPCR_Stat_BC_F_AR2_UB__01 = 1;
			break;
		case (1):
			enableControl("SPCR_Stat_BC_F_AR2", "CH_EISSPCR_Stat_BC_F_AR2_UB__01", 1); //1: enable; 0: disable
			break;
		case (2):
			enableControl("SPCR_Stat_BC_F_AR2", "CH_EISSPCR_Stat_BC_F_AR2_UB__01", 0); //1: enable; 0: disable
			@sysvar::CH_Nodes::CH_EISSPCR_Stat_BC_F_AR2_UB__01 = 1;
			break;
		case (3):
			enableControl("SPCR_Stat_BC_F_AR2", "CH_EISSPCR_Stat_BC_F_AR2_UB__01", 0); //1: enable; 0: disable
			@sysvar::CH_Nodes::CH_EISSPCR_Stat_BC_F_AR2_UB__01 = 0;
			break;
	}

	CRC_SPCR_Stat_BC_F_Pr2 = 0;
	SQC_VAL_SPCR_Stat_BC_F_Pr2 = 0;
	SQC_SPCR_Stat_BC_F_Pr2 = 0;
	switch (@sysvar::CH_Nodes::CH_EISSPL_Obj1_Obj2_NV_A_UB_A_01)
	{
		case (0):
			enableControl("SPL_Obj1_Obj2_NV_AR2", "CH_EISSPL_Obj1_Obj2_NV_AR2_UB_01", 0); //1: enable; 0: disable
			@sysvar::CH_Nodes::CH_EISSPL_Obj1_Obj2_NV_AR2_UB_01 = 1;
			break;
		case (1):
			enableControl("SPL_Obj1_Obj2_NV_AR2", "CH_EISSPL_Obj1_Obj2_NV_AR2_UB_01", 1); //1: enable; 0: disable
			break;
		case (2):
			enableControl("SPL_Obj1_Obj2_NV_AR2", "CH_EISSPL_Obj1_Obj2_NV_AR2_UB_01", 0); //1: enable; 0: disable
			@sysvar::CH_Nodes::CH_EISSPL_Obj1_Obj2_NV_AR2_UB_01 = 1;
			break;
		case (3):
			enableControl("SPL_Obj1_Obj2_NV_AR2", "CH_EISSPL_Obj1_Obj2_NV_AR2_UB_01", 0); //1: enable; 0: disable
			@sysvar::CH_Nodes::CH_EISSPL_Obj1_Obj2_NV_AR2_UB_01 = 0;
			break;
	}

	CRC_SPL_Obj1_Obj2_NV_Pr2 = 0;
	SQC_VAL_SPL_Obj1_Obj2_NV_Pr2 = 0;
	SQC_SPL_Obj1_Obj2_NV_Pr2 = 0;
	switch (@sysvar::CH_Nodes::CH_EISSPV_Actn_Rq_AR2_UB_AUTO_01)
	{
		case (0):
			enableControl("SPV_Actn_Rq_AR2", "CH_EISSPV_Actn_Rq_AR2_UB__01", 0); //1: enable; 0: disable
			@sysvar::CH_Nodes::CH_EISSPV_Actn_Rq_AR2_UB__01 = 1;
			break;
		case (1):
			enableControl("SPV_Actn_Rq_AR2", "CH_EISSPV_Actn_Rq_AR2_UB__01", 1); //1: enable; 0: disable
			break;
		case (2):
			enableControl("SPV_Actn_Rq_AR2", "CH_EISSPV_Actn_Rq_AR2_UB__01", 0); //1: enable; 0: disable
			@sysvar::CH_Nodes::CH_EISSPV_Actn_Rq_AR2_UB__01 = 1;
			break;
		case (3):
			enableControl("SPV_Actn_Rq_AR2", "CH_EISSPV_Actn_Rq_AR2_UB__01", 0); //1: enable; 0: disable
			@sysvar::CH_Nodes::CH_EISSPV_Actn_Rq_AR2_UB__01 = 0;
			break;
	}

	CRC_SPV_ExtLgt_Rq_Pr2 = 0;
	SQC_VAL_SPV_ExtLgt_Rq_Pr2 = 0;
	SQC_SPV_ExtLgt_Rq_Pr2 = 0;
	CRC_SPV_WprWash_Rq_Pr2 = 0;
	SQC_VAL_SPV_WprWash_Rq_Pr2 = 0;
	SQC_SPV_WprWash_Rq_Pr2 = 0;
	switch (@sysvar::CH_Nodes::CH_EISSPV_Alm_Rq_AR_UB_AUTO_01)
	{
		case (0):
			enableControl("SPV_Alm_Rq_AR", "CH_EISSPV_Alm_Rq_AR_UB__01", 0); //1: enable; 0: disable
			@sysvar::CH_Nodes::CH_EISSPV_Alm_Rq_AR_UB__01 = 1;
			break;
		case (1):
			enableControl("SPV_Alm_Rq_AR", "CH_EISSPV_Alm_Rq_AR_UB__01", 1); //1: enable; 0: disable
			break;
		case (2):
			enableControl("SPV_Alm_Rq_AR", "CH_EISSPV_Alm_Rq_AR_UB__01", 0); //1: enable; 0: disable
			@sysvar::CH_Nodes::CH_EISSPV_Alm_Rq_AR_UB__01 = 1;
			break;
		case (3):
			enableControl("SPV_Alm_Rq_AR", "CH_EISSPV_Alm_Rq_AR_UB__01", 0); //1: enable; 0: disable
			@sysvar::CH_Nodes::CH_EISSPV_Alm_Rq_AR_UB__01 = 0;
			break;
	}

	switch (@sysvar::CH_Nodes::CH_EISSVS_Rq_HU_AR2_UB_AUTO)
	{
		case (0):
			enableControl("SVS_Rq_HU_AR2", "CH_EISSVS_Rq_HU_AR2_UB_", 0); //1: enable; 0: disable
			@sysvar::CH_Nodes::CH_EISSVS_Rq_HU_AR2_UB_ = 1;
			break;
		case (1):
			enableControl("SVS_Rq_HU_AR2", "CH_EISSVS_Rq_HU_AR2_UB_", 1); //1: enable; 0: disable
			break;
		case (2):
			enableControl("SVS_Rq_HU_AR2", "CH_EISSVS_Rq_HU_AR2_UB_", 0); //1: enable; 0: disable
			@sysvar::CH_Nodes::CH_EISSVS_Rq_HU_AR2_UB_ = 1;
			break;
		case (3):
			enableControl("SVS_Rq_HU_AR2", "CH_EISSVS_Rq_HU_AR2_UB_", 0); //1: enable; 0: disable
			@sysvar::CH_Nodes::CH_EISSVS_Rq_HU_AR2_UB_ = 0;
			break;
	}

	switch (@sysvar::CH_Nodes::CH_EISTBCSC_DAC_EPS_AR2_UB_AU_01)
	{
		case (0):
			enableControl("TBCSC_DAC_EPS_AR2", "CH_EISTBCSC_DAC_EPS_AR2_UB__01", 0); //1: enable; 0: disable
			@sysvar::CH_Nodes::CH_EISTBCSC_DAC_EPS_AR2_UB__01 = 1;
			break;
		case (1):
			enableControl("TBCSC_DAC_EPS_AR2", "CH_EISTBCSC_DAC_EPS_AR2_UB__01", 1); //1: enable; 0: disable
			break;
		case (2):
			enableControl("TBCSC_DAC_EPS_AR2", "CH_EISTBCSC_DAC_EPS_AR2_UB__01", 0); //1: enable; 0: disable
			@sysvar::CH_Nodes::CH_EISTBCSC_DAC_EPS_AR2_UB__01 = 1;
			break;
		case (3):
			enableControl("TBCSC_DAC_EPS_AR2", "CH_EISTBCSC_DAC_EPS_AR2_UB__01", 0); //1: enable; 0: disable
			@sysvar::CH_Nodes::CH_EISTBCSC_DAC_EPS_AR2_UB__01 = 0;
			break;
	}

	switch (@sysvar::CH_Nodes::CH_EISTBCSC_DAC_ESP_AR2_UB_AU_01)
	{
		case (0):
			enableControl("TBCSC_DAC_ESP_AR2", "CH_EISTBCSC_DAC_ESP_AR2_UB__01", 0); //1: enable; 0: disable
			@sysvar::CH_Nodes::CH_EISTBCSC_DAC_ESP_AR2_UB__01 = 1;
			break;
		case (1):
			enableControl("TBCSC_DAC_ESP_AR2", "CH_EISTBCSC_DAC_ESP_AR2_UB__01", 1); //1: enable; 0: disable
			break;
		case (2):
			enableControl("TBCSC_DAC_ESP_AR2", "CH_EISTBCSC_DAC_ESP_AR2_UB__01", 0); //1: enable; 0: disable
			@sysvar::CH_Nodes::CH_EISTBCSC_DAC_ESP_AR2_UB__01 = 1;
			break;
		case (3):
			enableControl("TBCSC_DAC_ESP_AR2", "CH_EISTBCSC_DAC_ESP_AR2_UB__01", 0); //1: enable; 0: disable
			@sysvar::CH_Nodes::CH_EISTBCSC_DAC_ESP_AR2_UB__01 = 0;
			break;
	}

	switch (@sysvar::CH_Nodes::CH_EISTBCSC_Hi_Rq1_AR2_UB_AUT_01)
	{
		case (0):
			enableControl("TBCSC_Hi_Rq1_AR2", "CH_EISTBCSC_Hi_Rq1_AR2_UB__01", 0); //1: enable; 0: disable
			@sysvar::CH_Nodes::CH_EISTBCSC_Hi_Rq1_AR2_UB__01 = 1;
			break;
		case (1):
			enableControl("TBCSC_Hi_Rq1_AR2", "CH_EISTBCSC_Hi_Rq1_AR2_UB__01", 1); //1: enable; 0: disable
			break;
		case (2):
			enableControl("TBCSC_Hi_Rq1_AR2", "CH_EISTBCSC_Hi_Rq1_AR2_UB__01", 0); //1: enable; 0: disable
			@sysvar::CH_Nodes::CH_EISTBCSC_Hi_Rq1_AR2_UB__01 = 1;
			break;
		case (3):
			enableControl("TBCSC_Hi_Rq1_AR2", "CH_EISTBCSC_Hi_Rq1_AR2_UB__01", 0); //1: enable; 0: disable
			@sysvar::CH_Nodes::CH_EISTBCSC_Hi_Rq1_AR2_UB__01 = 0;
			break;
	}

	CRC_TBCSC_Hi_Rq1_Pr2 = 0;
	SQC_VAL_TBCSC_Hi_Rq1_Pr2 = 0;
	SQC_TBCSC_Hi_Rq1_Pr2 = 0;
	switch (@sysvar::CH_Nodes::CH_EISTBCSC_Hi_Rq2_AR2_UB_AUT_01)
	{
		case (0):
			enableControl("TBCSC_Hi_Rq2_AR2", "CH_EISTBCSC_Hi_Rq2_AR2_UB__01", 0); //1: enable; 0: disable
			@sysvar::CH_Nodes::CH_EISTBCSC_Hi_Rq2_AR2_UB__01 = 1;
			break;
		case (1):
			enableControl("TBCSC_Hi_Rq2_AR2", "CH_EISTBCSC_Hi_Rq2_AR2_UB__01", 1); //1: enable; 0: disable
			break;
		case (2):
			enableControl("TBCSC_Hi_Rq2_AR2", "CH_EISTBCSC_Hi_Rq2_AR2_UB__01", 0); //1: enable; 0: disable
			@sysvar::CH_Nodes::CH_EISTBCSC_Hi_Rq2_AR2_UB__01 = 1;
			break;
		case (3):
			enableControl("TBCSC_Hi_Rq2_AR2", "CH_EISTBCSC_Hi_Rq2_AR2_UB__01", 0); //1: enable; 0: disable
			@sysvar::CH_Nodes::CH_EISTBCSC_Hi_Rq2_AR2_UB__01 = 0;
			break;
	}

	CRC_TBCSC_Hi_Rq2_Pr2 = 0;
	SQC_VAL_TBCSC_Hi_Rq2_Pr2 = 0;
	SQC_TBCSC_Hi_Rq2_Pr2 = 0;
	switch (@sysvar::CH_Nodes::CH_EISTBCSC_Lo_Rq1_AR2_UB_AUT_01)
	{
		case (0):
			enableControl("TBCSC_Lo_Rq1_AR2", "CH_EISTBCSC_Lo_Rq1_AR2_UB__01", 0); //1: enable; 0: disable
			@sysvar::CH_Nodes::CH_EISTBCSC_Lo_Rq1_AR2_UB__01 = 1;
			break;
		case (1):
			enableControl("TBCSC_Lo_Rq1_AR2", "CH_EISTBCSC_Lo_Rq1_AR2_UB__01", 1); //1: enable; 0: disable
			break;
		case (2):
			enableControl("TBCSC_Lo_Rq1_AR2", "CH_EISTBCSC_Lo_Rq1_AR2_UB__01", 0); //1: enable; 0: disable
			@sysvar::CH_Nodes::CH_EISTBCSC_Lo_Rq1_AR2_UB__01 = 1;
			break;
		case (3):
			enableControl("TBCSC_Lo_Rq1_AR2", "CH_EISTBCSC_Lo_Rq1_AR2_UB__01", 0); //1: enable; 0: disable
			@sysvar::CH_Nodes::CH_EISTBCSC_Lo_Rq1_AR2_UB__01 = 0;
			break;
	}

	CRC_TBCSC_Lo_Rq1_Pr2 = 0;
	SQC_VAL_TBCSC_Lo_Rq1_Pr2 = 0;
	SQC_TBCSC_Lo_Rq1_Pr2 = 0;
	switch (@sysvar::CH_Nodes::CH_EISTBCSC_Lo_Rq2_AR2_UB_AUT_01)
	{
		case (0):
			enableControl("TBCSC_Lo_Rq2_AR2", "CH_EISTBCSC_Lo_Rq2_AR2_UB__01", 0); //1: enable; 0: disable
			@sysvar::CH_Nodes::CH_EISTBCSC_Lo_Rq2_AR2_UB__01 = 1;
			break;
		case (1):
			enableControl("TBCSC_Lo_Rq2_AR2", "CH_EISTBCSC_Lo_Rq2_AR2_UB__01", 1); //1: enable; 0: disable
			break;
		case (2):
			enableControl("TBCSC_Lo_Rq2_AR2", "CH_EISTBCSC_Lo_Rq2_AR2_UB__01", 0); //1: enable; 0: disable
			@sysvar::CH_Nodes::CH_EISTBCSC_Lo_Rq2_AR2_UB__01 = 1;
			break;
		case (3):
			enableControl("TBCSC_Lo_Rq2_AR2", "CH_EISTBCSC_Lo_Rq2_AR2_UB__01", 0); //1: enable; 0: disable
			@sysvar::CH_Nodes::CH_EISTBCSC_Lo_Rq2_AR2_UB__01 = 0;
			break;
	}

	CRC_TBCSC_Lo_Rq2_Pr2 = 0;
	SQC_VAL_TBCSC_Lo_Rq2_Pr2 = 0;
	SQC_TBCSC_Lo_Rq2_Pr2 = 0;
	switch (@sysvar::CH_Nodes::CH_EISTC_Distance_AR_0_UB_AUT_01)
	{
		case (0):
			enableControl("TC_Distance_AR", "CH_EISTC_Distance_AR_0_UB__01", 0); //1: enable; 0: disable
			@sysvar::CH_Nodes::CH_EISTC_Distance_AR_0_UB__01 = 1;
			break;
		case (1):
			enableControl("TC_Distance_AR", "CH_EISTC_Distance_AR_0_UB__01", 1); //1: enable; 0: disable
			break;
		case (2):
			enableControl("TC_Distance_AR", "CH_EISTC_Distance_AR_0_UB__01", 0); //1: enable; 0: disable
			@sysvar::CH_Nodes::CH_EISTC_Distance_AR_0_UB__01 = 1;
			break;
		case (3):
			enableControl("TC_Distance_AR", "CH_EISTC_Distance_AR_0_UB__01", 0); //1: enable; 0: disable
			@sysvar::CH_Nodes::CH_EISTC_Distance_AR_0_UB__01 = 0;
			break;
	}

	switch (@sysvar::CH_Nodes::CH_EISTGW_DateTm_Stat_AR_UB_A_01)
	{
		case (0):
			enableControl("TGW_DateTm_Stat_AR", "CH_EISTGW_DateTm_Stat_AR_UB__01", 0); //1: enable; 0: disable
			@sysvar::CH_Nodes::CH_EISTGW_DateTm_Stat_AR_UB__01 = 1;
			break;
		case (1):
			enableControl("TGW_DateTm_Stat_AR", "CH_EISTGW_DateTm_Stat_AR_UB__01", 1); //1: enable; 0: disable
			break;
		case (2):
			enableControl("TGW_DateTm_Stat_AR", "CH_EISTGW_DateTm_Stat_AR_UB__01", 0); //1: enable; 0: disable
			@sysvar::CH_Nodes::CH_EISTGW_DateTm_Stat_AR_UB__01 = 1;
			break;
		case (3):
			enableControl("TGW_DateTm_Stat_AR", "CH_EISTGW_DateTm_Stat_AR_UB__01", 0); //1: enable; 0: disable
			@sysvar::CH_Nodes::CH_EISTGW_DateTm_Stat_AR_UB__01 = 0;
			break;
	}

	switch (@sysvar::CH_Nodes::CH_EISTire_State_AR2_UB_AUTO_01)
	{
		case (0):
			enableControl("Tire_State_AR2", "CH_EISTire_State_AR2_UB__01", 0); //1: enable; 0: disable
			@sysvar::CH_Nodes::CH_EISTire_State_AR2_UB__01 = 1;
			break;
		case (1):
			enableControl("Tire_State_AR2", "CH_EISTire_State_AR2_UB__01", 1); //1: enable; 0: disable
			break;
		case (2):
			enableControl("Tire_State_AR2", "CH_EISTire_State_AR2_UB__01", 0); //1: enable; 0: disable
			@sysvar::CH_Nodes::CH_EISTire_State_AR2_UB__01 = 1;
			break;
		case (3):
			enableControl("Tire_State_AR2", "CH_EISTire_State_AR2_UB__01", 0); //1: enable; 0: disable
			@sysvar::CH_Nodes::CH_EISTire_State_AR2_UB__01 = 0;
			break;
	}

	switch (@sysvar::CH_Nodes::CH_EISTrafficInfo_AR_UB_AUTO_01)
	{
		case (0):
			enableControl("TrafficInfo_AR", "CH_EISTrafficInfo_AR_UB__01", 0); //1: enable; 0: disable
			@sysvar::CH_Nodes::CH_EISTrafficInfo_AR_UB__01 = 1;
			break;
		case (1):
			enableControl("TrafficInfo_AR", "CH_EISTrafficInfo_AR_UB__01", 1); //1: enable; 0: disable
			break;
		case (2):
			enableControl("TrafficInfo_AR", "CH_EISTrafficInfo_AR_UB__01", 0); //1: enable; 0: disable
			@sysvar::CH_Nodes::CH_EISTrafficInfo_AR_UB__01 = 1;
			break;
		case (3):
			enableControl("TrafficInfo_AR", "CH_EISTrafficInfo_AR_UB__01", 0); //1: enable; 0: disable
			@sysvar::CH_Nodes::CH_EISTrafficInfo_AR_UB__01 = 0;
			break;
	}

	switch (@sysvar::CH_Nodes::CH_EISTrailer_Stat_AR2_UB_AUT_01)
	{
		case (0):
			enableControl("Trailer_Stat_AR2", "CH_EISTrailer_Stat_AR2_UB__01", 0); //1: enable; 0: disable
			@sysvar::CH_Nodes::CH_EISTrailer_Stat_AR2_UB__01 = 1;
			break;
		case (1):
			enableControl("Trailer_Stat_AR2", "CH_EISTrailer_Stat_AR2_UB__01", 1); //1: enable; 0: disable
			break;
		case (2):
			enableControl("Trailer_Stat_AR2", "CH_EISTrailer_Stat_AR2_UB__01", 0); //1: enable; 0: disable
			@sysvar::CH_Nodes::CH_EISTrailer_Stat_AR2_UB__01 = 1;
			break;
		case (3):
			enableControl("Trailer_Stat_AR2", "CH_EISTrailer_Stat_AR2_UB__01", 0); //1: enable; 0: disable
			@sysvar::CH_Nodes::CH_EISTrailer_Stat_AR2_UB__01 = 0;
			break;
	}

	CRC_ElecTrlrHtch_Stat_Pr2 = 0;
	SQC_VAL_ElecTrlrHtch_Stat_Pr2 = 0;
	SQC_ElecTrlrHtch_Stat_Pr2 = 0;
	switch (@sysvar::CH_Nodes::CH_EISTSA_Disp_Rq2_AR_UB_AUTO_01)
	{
		case (0):
			enableControl("TSA_Disp_Rq2_AR", "CH_EISTSA_Disp_Rq2_AR_UB__01", 0); //1: enable; 0: disable
			@sysvar::CH_Nodes::CH_EISTSA_Disp_Rq2_AR_UB__01 = 1;
			break;
		case (1):
			enableControl("TSA_Disp_Rq2_AR", "CH_EISTSA_Disp_Rq2_AR_UB__01", 1); //1: enable; 0: disable
			break;
		case (2):
			enableControl("TSA_Disp_Rq2_AR", "CH_EISTSA_Disp_Rq2_AR_UB__01", 0); //1: enable; 0: disable
			@sysvar::CH_Nodes::CH_EISTSA_Disp_Rq2_AR_UB__01 = 1;
			break;
		case (3):
			enableControl("TSA_Disp_Rq2_AR", "CH_EISTSA_Disp_Rq2_AR_UB__01", 0); //1: enable; 0: disable
			@sysvar::CH_Nodes::CH_EISTSA_Disp_Rq2_AR_UB__01 = 0;
			break;
	}

	switch (@sysvar::CH_Nodes::CH_EISTSA_Disp_Rq3_AR_UB_AUTO_01)
	{
		case (0):
			enableControl("TSA_Disp_Rq3_AR", "CH_EISTSA_Disp_Rq3_AR_UB__01", 0); //1: enable; 0: disable
			@sysvar::CH_Nodes::CH_EISTSA_Disp_Rq3_AR_UB__01 = 1;
			break;
		case (1):
			enableControl("TSA_Disp_Rq3_AR", "CH_EISTSA_Disp_Rq3_AR_UB__01", 1); //1: enable; 0: disable
			break;
		case (2):
			enableControl("TSA_Disp_Rq3_AR", "CH_EISTSA_Disp_Rq3_AR_UB__01", 0); //1: enable; 0: disable
			@sysvar::CH_Nodes::CH_EISTSA_Disp_Rq3_AR_UB__01 = 1;
			break;
		case (3):
			enableControl("TSA_Disp_Rq3_AR", "CH_EISTSA_Disp_Rq3_AR_UB__01", 0); //1: enable; 0: disable
			@sysvar::CH_Nodes::CH_EISTSA_Disp_Rq3_AR_UB__01 = 0;
			break;
	}

	switch (@sysvar::CH_Nodes::CH_EISVehAccel_X_Rq_Gw_A_UB_A_01)
	{
		case (0):
			enableControl("VehAccel_X_Rq_Gw_AR2", "CH_EISVehAccel_X_Rq_Gw_AR2_UB_01", 0); //1: enable; 0: disable
			@sysvar::CH_Nodes::CH_EISVehAccel_X_Rq_Gw_AR2_UB_01 = 1;
			break;
		case (1):
			enableControl("VehAccel_X_Rq_Gw_AR2", "CH_EISVehAccel_X_Rq_Gw_AR2_UB_01", 1); //1: enable; 0: disable
			break;
		case (2):
			enableControl("VehAccel_X_Rq_Gw_AR2", "CH_EISVehAccel_X_Rq_Gw_AR2_UB_01", 0); //1: enable; 0: disable
			@sysvar::CH_Nodes::CH_EISVehAccel_X_Rq_Gw_AR2_UB_01 = 1;
			break;
		case (3):
			enableControl("VehAccel_X_Rq_Gw_AR2", "CH_EISVehAccel_X_Rq_Gw_AR2_UB_01", 0); //1: enable; 0: disable
			@sysvar::CH_Nodes::CH_EISVehAccel_X_Rq_Gw_AR2_UB_01 = 0;
			break;
	}

	CRC_VehAccel_X_Rq_Pr2 = 0;
	SQC_VAL_VehAccel_X_Rq_Pr2 = 0;
	SQC_VehAccel_X_Rq_Pr2 = 0;

	// Simulation der VIN-Botschaft
	if (isTimerActive(TimerVIN) == 0)
	{
		setTimer(TimerVIN,1);
	}
	SysGetVariableString(sysvar::CH_Nodes::CH__EIS_VIN, EIS_VINBuffer, elcount(EIS_VINBuffer));
	if (strlen(EIS_VINBuffer) == 0)
	{
		strncpy(EIS_VINBuffer, "WDB21301234567890", 24);
		SysSetVariableString(sysvar::CH_Nodes::CH__EIS_VIN, EIS_VINBuffer);
	}

	switch (@sysvar::CH_Nodes::CH_EISYMAS_Rq_MPC_AR2_UB_AUTO_01)
	{
		case (0):
			enableControl("YMAS_Rq_MPC_AR2", "CH_EISYMAS_Rq_MPC_AR2_UB__01", 0); //1: enable; 0: disable
			@sysvar::CH_Nodes::CH_EISYMAS_Rq_MPC_AR2_UB__01 = 1;
			break;
		case (1):
			enableControl("YMAS_Rq_MPC_AR2", "CH_EISYMAS_Rq_MPC_AR2_UB__01", 1); //1: enable; 0: disable
			break;
		case (2):
			enableControl("YMAS_Rq_MPC_AR2", "CH_EISYMAS_Rq_MPC_AR2_UB__01", 0); //1: enable; 0: disable
			@sysvar::CH_Nodes::CH_EISYMAS_Rq_MPC_AR2_UB__01 = 1;
			break;
		case (3):
			enableControl("YMAS_Rq_MPC_AR2", "CH_EISYMAS_Rq_MPC_AR2_UB__01", 0); //1: enable; 0: disable
			@sysvar::CH_Nodes::CH_EISYMAS_Rq_MPC_AR2_UB__01 = 0;
			break;
	}

	CRC_YMAS_Rq_MPC_Pr2 = 0;
	SQC_VAL_YMAS_Rq_MPC_Pr2 = 0;
	SQC_YMAS_Rq_MPC_Pr2 = 0;
}

StopSim()
{

  //Don't even think about using $ClockSync_Second48_Hi!
  cancelTimer(Timer_EIS_ClockSync_Stat_FR2_1);
  ClockSync_Backup_ns = $ClockSync_Second48 *1E9 + $ClockSync_NanoSecond;
  ClockSync_DeltaCalculated = 0;  //reset flag


	// Simulation der VIN-Botschaft
	cancelTimer(TimerVIN);
}


callback_ADAS_PREDICTION_ARADAS_Seg_Offset (double value)
{
	PDU_ADAS_PREDICTION_AR.ADAS_Seg_Offset.phys = value;
	frUpdatePDU(PDU_ADAS_PREDICTION_AR,1,1);
}

callback_ADAS_PREDICTION_ARADAS_Seg_PathIdx (double value)
{
	PDU_ADAS_PREDICTION_AR.ADAS_Seg_PathIdx.phys = value;
	frUpdatePDU(PDU_ADAS_PREDICTION_AR,1,1);
}

callback_ADAS_PREDICTION_ARADAS_Seg_CycCnt (double value)
{
	PDU_ADAS_PREDICTION_AR.ADAS_Seg_CycCnt.phys = value;
	frUpdatePDU(PDU_ADAS_PREDICTION_AR,1,1);
}

callback_ADAS_PREDICTION_ARADAS_Seg_Updt (double value)
{
	PDU_ADAS_PREDICTION_AR.ADAS_Seg_Updt.phys = value;
	frUpdatePDU(PDU_ADAS_PREDICTION_AR,1,1);
}

callback_ADAS_PREDICTION_ARADAS_Seg_ReTr (double value)
{
	PDU_ADAS_PREDICTION_AR.ADAS_Seg_ReTr.phys = value;
	frUpdatePDU(PDU_ADAS_PREDICTION_AR,1,1);
}

callback_ADAS_PREDICTION_ARADAS_Seg_AreaBuildUp (double value)
{
	PDU_ADAS_PREDICTION_AR.ADAS_Seg_AreaBuildUp.phys = value;
	frUpdatePDU(PDU_ADAS_PREDICTION_AR,1,1);
}

callback_ADAS_PREDICTION_ARADAS_Seg_Bridge (double value)
{
	PDU_ADAS_PREDICTION_AR.ADAS_Seg_Bridge.phys = value;
	frUpdatePDU(PDU_ADAS_PREDICTION_AR,1,1);
}

callback_ADAS_PREDICTION_ARADAS_Seg_Tunnel (double value)
{
	PDU_ADAS_PREDICTION_AR.ADAS_Seg_Tunnel.phys = value;
	frUpdatePDU(PDU_ADAS_PREDICTION_AR,1,1);
}

callback_ADAS_PREDICTION_ARADAS_Seg_FuncRoadClass (double value)
{
	PDU_ADAS_PREDICTION_AR.ADAS_Seg_FuncRoadClass.phys = value;
	frUpdatePDU(PDU_ADAS_PREDICTION_AR,1,1);
}

callback_ADAS_PREDICTION_ARADAS_Seg_RelProbb (double value)
{
	PDU_ADAS_PREDICTION_AR.ADAS_Seg_RelProbb.phys = value;
	frUpdatePDU(PDU_ADAS_PREDICTION_AR,1,1);
}

callback_ADAS_PREDICTION_ARADAS_Seg_WayForm (double value)
{
	PDU_ADAS_PREDICTION_AR.ADAS_Seg_WayForm.phys = value;
	frUpdatePDU(PDU_ADAS_PREDICTION_AR,1,1);
}

callback_ADAS_PREDICTION_ARADAS_Seg_CmpxInsct (double value)
{
	PDU_ADAS_PREDICTION_AR.ADAS_Seg_CmpxInsct.phys = value;
	frUpdatePDU(PDU_ADAS_PREDICTION_AR,1,1);
}

callback_ADAS_PREDICTION_ARADAS_Seg_PartRoute (double value)
{
	PDU_ADAS_PREDICTION_AR.ADAS_Seg_PartRoute.phys = value;
	frUpdatePDU(PDU_ADAS_PREDICTION_AR,1,1);
}

callback_ADAS_PREDICTION_ARADAS_Seg_EffSpdLmtType (double value)
{
	PDU_ADAS_PREDICTION_AR.ADAS_Seg_EffSpdLmtType.phys = value;
	frUpdatePDU(PDU_ADAS_PREDICTION_AR,1,1);
}

callback_ADAS_PREDICTION_ARADAS_Seg_EffSpdLmt (double value)
{
	PDU_ADAS_PREDICTION_AR.ADAS_Seg_EffSpdLmt.phys = value;
	frUpdatePDU(PDU_ADAS_PREDICTION_AR,1,1);
}

callback_ADAS_PREDICTION_ARADAS_Seg_NumOfLaneDrvDir (double value)
{
	PDU_ADAS_PREDICTION_AR.ADAS_Seg_NumOfLaneDrvDir.phys = value;
	frUpdatePDU(PDU_ADAS_PREDICTION_AR,1,1);
}

callback_ADAS_PREDICTION_ARADAS_Seg_NumOfLaneOppDir (double value)
{
	PDU_ADAS_PREDICTION_AR.ADAS_Seg_NumOfLaneOppDir.phys = value;
	frUpdatePDU(PDU_ADAS_PREDICTION_AR,1,1);
}

callback_ADAS_PREDICTION_ARADAS_Seg_RoadDivd (double value)
{
	PDU_ADAS_PREDICTION_AR.ADAS_Seg_RoadDivd.phys = value;
	frUpdatePDU(PDU_ADAS_PREDICTION_AR,1,1);
}

callback_ADAS_PREDICTION_ARADAS_Stub_Offset (double value)
{
	PDU_ADAS_PREDICTION_AR.ADAS_Stub_Offset.phys = value;
	frUpdatePDU(PDU_ADAS_PREDICTION_AR,1,1);
}

callback_ADAS_PREDICTION_ARADAS_Stub_PathIdx (double value)
{
	PDU_ADAS_PREDICTION_AR.ADAS_Stub_PathIdx.phys = value;
	frUpdatePDU(PDU_ADAS_PREDICTION_AR,1,1);
}

callback_ADAS_PREDICTION_ARADAS_Stub_CycCnt (double value)
{
	PDU_ADAS_PREDICTION_AR.ADAS_Stub_CycCnt.phys = value;
	frUpdatePDU(PDU_ADAS_PREDICTION_AR,1,1);
}

callback_ADAS_PREDICTION_ARADAS_Stub_Updt (double value)
{
	PDU_ADAS_PREDICTION_AR.ADAS_Stub_Updt.phys = value;
	frUpdatePDU(PDU_ADAS_PREDICTION_AR,1,1);
}

callback_ADAS_PREDICTION_ARADAS_Stub_ReTr (double value)
{
	PDU_ADAS_PREDICTION_AR.ADAS_Stub_ReTr.phys = value;
	frUpdatePDU(PDU_ADAS_PREDICTION_AR,1,1);
}

callback_ADAS_PREDICTION_ARADAS_Stub_SubPathIdx (double value)
{
	PDU_ADAS_PREDICTION_AR.ADAS_Stub_SubPathIdx.phys = value;
	frUpdatePDU(PDU_ADAS_PREDICTION_AR,1,1);
}

callback_ADAS_PREDICTION_ARADAS_Stub_FuncRoadClass (double value)
{
	PDU_ADAS_PREDICTION_AR.ADAS_Stub_FuncRoadClass.phys = value;
	frUpdatePDU(PDU_ADAS_PREDICTION_AR,1,1);
}

callback_ADAS_PREDICTION_ARADAS_Stub_RelProbb (double value)
{
	PDU_ADAS_PREDICTION_AR.ADAS_Stub_RelProbb.phys = value;
	frUpdatePDU(PDU_ADAS_PREDICTION_AR,1,1);
}

callback_ADAS_PREDICTION_ARADAS_Stub_WayForm (double value)
{
	PDU_ADAS_PREDICTION_AR.ADAS_Stub_WayForm.phys = value;
	frUpdatePDU(PDU_ADAS_PREDICTION_AR,1,1);
}

callback_ADAS_PREDICTION_ARADAS_Stub_CmpxInsct (double value)
{
	PDU_ADAS_PREDICTION_AR.ADAS_Stub_CmpxInsct.phys = value;
	frUpdatePDU(PDU_ADAS_PREDICTION_AR,1,1);
}

callback_ADAS_PREDICTION_ARADAS_Stub_PartRoute (double value)
{
	PDU_ADAS_PREDICTION_AR.ADAS_Stub_PartRoute.phys = value;
	frUpdatePDU(PDU_ADAS_PREDICTION_AR,1,1);
}

callback_ADAS_PREDICTION_ARADAS_Stub_TurnAngl (double value)
{
	PDU_ADAS_PREDICTION_AR.ADAS_Stub_TurnAngl.phys = value;
	frUpdatePDU(PDU_ADAS_PREDICTION_AR,1,1);
}

callback_ADAS_PREDICTION_ARADAS_Stub_NumOfLaneDrvDir (double value)
{
	PDU_ADAS_PREDICTION_AR.ADAS_Stub_NumOfLaneDrvDir.phys = value;
	frUpdatePDU(PDU_ADAS_PREDICTION_AR,1,1);
}

callback_ADAS_PREDICTION_ARADAS_Stub_NumOfLaneOppDir (double value)
{
	PDU_ADAS_PREDICTION_AR.ADAS_Stub_NumOfLaneOppDir.phys = value;
	frUpdatePDU(PDU_ADAS_PREDICTION_AR,1,1);
}

callback_ADAS_PREDICTION_ARADAS_Stub_WayRt (double value)
{
	PDU_ADAS_PREDICTION_AR.ADAS_Stub_WayRt.phys = value;
	frUpdatePDU(PDU_ADAS_PREDICTION_AR,1,1);
}

callback_ADAS_PREDICTION_ARADAS_Stub_LastStub (double value)
{
	PDU_ADAS_PREDICTION_AR.ADAS_Stub_LastStub.phys = value;
	frUpdatePDU(PDU_ADAS_PREDICTION_AR,1,1);
}

callback_ADAS_PREDICTION_ARADAS_Meta_MapProvid (double value)
{
	PDU_ADAS_PREDICTION_AR.ADAS_Meta_MapProvid.phys = value;
	frUpdatePDU(PDU_ADAS_PREDICTION_AR,1,1);
}

callback_ADAS_PREDICTION_ARADAS_Meta_CountryCode (double value)
{
	PDU_ADAS_PREDICTION_AR.ADAS_Meta_CountryCode.phys = value;
	frUpdatePDU(PDU_ADAS_PREDICTION_AR,1,1);
}

callback_ADAS_PREDICTION_ARADAS_Meta_DrvSide (double value)
{
	PDU_ADAS_PREDICTION_AR.ADAS_Meta_DrvSide.phys = value;
	frUpdatePDU(PDU_ADAS_PREDICTION_AR,1,1);
}

callback_ADAS_PREDICTION_ARADAS_Meta_ProtVer_MinorSub (double value)
{
	PDU_ADAS_PREDICTION_AR.ADAS_Meta_ProtVer_MinorSub.phys = value;
	frUpdatePDU(PDU_ADAS_PREDICTION_AR,1,1);
}

callback_ADAS_PREDICTION_ARADAS_Meta_ProtVer_Major (double value)
{
	PDU_ADAS_PREDICTION_AR.ADAS_Meta_ProtVer_Major.phys = value;
	frUpdatePDU(PDU_ADAS_PREDICTION_AR,1,1);
}

callback_ADAS_PREDICTION_ARADAS_Meta_CycCnt (double value)
{
	PDU_ADAS_PREDICTION_AR.ADAS_Meta_CycCnt.phys = value;
	frUpdatePDU(PDU_ADAS_PREDICTION_AR,1,1);
}

callback_ADAS_PREDICTION_ARADAS_Meta_HwVer (double value)
{
	PDU_ADAS_PREDICTION_AR.ADAS_Meta_HwVer.phys = value;
	frUpdatePDU(PDU_ADAS_PREDICTION_AR,1,1);
}

callback_ADAS_PREDICTION_ARADAS_Meta_RegionCode (double value)
{
	PDU_ADAS_PREDICTION_AR.ADAS_Meta_RegionCode.phys = value;
	frUpdatePDU(PDU_ADAS_PREDICTION_AR,1,1);
}

callback_ADAS_PREDICTION_ARADAS_Meta_MapVerYear (double value)
{
	PDU_ADAS_PREDICTION_AR.ADAS_Meta_MapVerYear.phys = value;
	frUpdatePDU(PDU_ADAS_PREDICTION_AR,1,1);
}

callback_ADAS_PREDICTION_ARADAS_Meta_MapVerQuar (double value)
{
	PDU_ADAS_PREDICTION_AR.ADAS_Meta_MapVerQuar.phys = value;
	frUpdatePDU(PDU_ADAS_PREDICTION_AR,1,1);
}

callback_ADAS_PREDICTION_ARADAS_Meta_ProtVer_Minor (double value)
{
	PDU_ADAS_PREDICTION_AR.ADAS_Meta_ProtVer_Minor.phys = value;
	frUpdatePDU(PDU_ADAS_PREDICTION_AR,1,1);
}

callback_ADAS_PREDICTION_ARADAS_Meta_SpdUnits (double value)
{
	PDU_ADAS_PREDICTION_AR.ADAS_Meta_SpdUnits.phys = value;
	frUpdatePDU(PDU_ADAS_PREDICTION_AR,1,1);
}

callback_ADAS_PREDICTION_ARADAS_Prediction_MsgTyp (double value)
{
	PDU_ADAS_PREDICTION_AR.ADAS_Prediction_MsgTyp.phys = value;
	frUpdatePDU(PDU_ADAS_PREDICTION_AR,1,1);
}

callback_ADAS_PROFILE_LONG_ARADAS_ProfLong_MsgTyp_Longi (double value)
{
	PDU_ADAS_PROFILE_LONG_AR.ADAS_ProfLong_MsgTyp_Longi.phys = value;
	frUpdatePDU(PDU_ADAS_PROFILE_LONG_AR,1,1);
}

callback_ADAS_PROFILE_LONG_ARADAS_ProfLong_Offset_Longi (double value)
{
	PDU_ADAS_PROFILE_LONG_AR.ADAS_ProfLong_Offset_Longi.phys = value;
	frUpdatePDU(PDU_ADAS_PROFILE_LONG_AR,1,1);
}

callback_ADAS_PROFILE_LONG_ARADAS_ProfLong_PathIdx_Longi (double value)
{
	PDU_ADAS_PROFILE_LONG_AR.ADAS_ProfLong_PathIdx_Longi.phys = value;
	frUpdatePDU(PDU_ADAS_PROFILE_LONG_AR,1,1);
}

callback_ADAS_PROFILE_LONG_ARADAS_ProfLong_CycCnt_Longi (double value)
{
	PDU_ADAS_PROFILE_LONG_AR.ADAS_ProfLong_CycCnt_Longi.phys = value;
	frUpdatePDU(PDU_ADAS_PROFILE_LONG_AR,1,1);
}

callback_ADAS_PROFILE_LONG_ARADAS_ProfLong_Updt_Longi (double value)
{
	PDU_ADAS_PROFILE_LONG_AR.ADAS_ProfLong_Updt_Longi.phys = value;
	frUpdatePDU(PDU_ADAS_PROFILE_LONG_AR,1,1);
}

callback_ADAS_PROFILE_LONG_ARADAS_ProfLong_ReTr_Longi (double value)
{
	PDU_ADAS_PROFILE_LONG_AR.ADAS_ProfLong_ReTr_Longi.phys = value;
	frUpdatePDU(PDU_ADAS_PROFILE_LONG_AR,1,1);
}

callback_ADAS_PROFILE_LONG_ARADAS_ProfLong_CtrlPoint_Longi (double value)
{
	PDU_ADAS_PROFILE_LONG_AR.ADAS_ProfLong_CtrlPoint_Longi.phys = value;
	frUpdatePDU(PDU_ADAS_PROFILE_LONG_AR,1,1);
}

callback_ADAS_PROFILE_LONG_ARADAS_ProfLong_Val_Longit (double value)
{
	PDU_ADAS_PROFILE_LONG_AR.ADAS_ProfLong_Val_Longit.phys = value;
	frUpdatePDU(PDU_ADAS_PROFILE_LONG_AR,1,1);
}

callback_ADAS_PROFILE_LONG_ARADAS_ProfLong_MsgTyp_Latit (double value)
{
	PDU_ADAS_PROFILE_LONG_AR.ADAS_ProfLong_MsgTyp_Latit.phys = value;
	frUpdatePDU(PDU_ADAS_PROFILE_LONG_AR,1,1);
}

callback_ADAS_PROFILE_LONG_ARADAS_ProfLong_Offset_Latit (double value)
{
	PDU_ADAS_PROFILE_LONG_AR.ADAS_ProfLong_Offset_Latit.phys = value;
	frUpdatePDU(PDU_ADAS_PROFILE_LONG_AR,1,1);
}

callback_ADAS_PROFILE_LONG_ARADAS_ProfLong_PathIdx_Latit (double value)
{
	PDU_ADAS_PROFILE_LONG_AR.ADAS_ProfLong_PathIdx_Latit.phys = value;
	frUpdatePDU(PDU_ADAS_PROFILE_LONG_AR,1,1);
}

callback_ADAS_PROFILE_LONG_ARADAS_ProfLong_CycCnt_Latit (double value)
{
	PDU_ADAS_PROFILE_LONG_AR.ADAS_ProfLong_CycCnt_Latit.phys = value;
	frUpdatePDU(PDU_ADAS_PROFILE_LONG_AR,1,1);
}

callback_ADAS_PROFILE_LONG_ARADAS_ProfLong_Updt_Latit (double value)
{
	PDU_ADAS_PROFILE_LONG_AR.ADAS_ProfLong_Updt_Latit.phys = value;
	frUpdatePDU(PDU_ADAS_PROFILE_LONG_AR,1,1);
}

callback_ADAS_PROFILE_LONG_ARADAS_ProfLong_ReTr_Latit (double value)
{
	PDU_ADAS_PROFILE_LONG_AR.ADAS_ProfLong_ReTr_Latit.phys = value;
	frUpdatePDU(PDU_ADAS_PROFILE_LONG_AR,1,1);
}

callback_ADAS_PROFILE_LONG_ARADAS_ProfLong_CtrlPoint_Latit (double value)
{
	PDU_ADAS_PROFILE_LONG_AR.ADAS_ProfLong_CtrlPoint_Latit.phys = value;
	frUpdatePDU(PDU_ADAS_PROFILE_LONG_AR,1,1);
}

callback_ADAS_PROFILE_LONG_ARADAS_ProfLong_Val_Latit (double value)
{
	PDU_ADAS_PROFILE_LONG_AR.ADAS_ProfLong_Val_Latit.phys = value;
	frUpdatePDU(PDU_ADAS_PROFILE_LONG_AR,1,1);
}

callback_ADAS_PROFILE_LONG_ARADAS_ProfLong_MsgTyp_ExtLane (double value)
{
	PDU_ADAS_PROFILE_LONG_AR.ADAS_ProfLong_MsgTyp_ExtLane.phys = value;
	frUpdatePDU(PDU_ADAS_PROFILE_LONG_AR,1,1);
}

callback_ADAS_PROFILE_LONG_ARADAS_ProfLong_Offset_ExtLane (double value)
{
	PDU_ADAS_PROFILE_LONG_AR.ADAS_ProfLong_Offset_ExtLane.phys = value;
	frUpdatePDU(PDU_ADAS_PROFILE_LONG_AR,1,1);
}

callback_ADAS_PROFILE_LONG_ARADAS_ProfLong_PathIdx_ExtLane (double value)
{
	PDU_ADAS_PROFILE_LONG_AR.ADAS_ProfLong_PathIdx_ExtLane.phys = value;
	frUpdatePDU(PDU_ADAS_PROFILE_LONG_AR,1,1);
}

callback_ADAS_PROFILE_LONG_ARADAS_ProfLong_CycCnt_ExtLane (double value)
{
	PDU_ADAS_PROFILE_LONG_AR.ADAS_ProfLong_CycCnt_ExtLane.phys = value;
	frUpdatePDU(PDU_ADAS_PROFILE_LONG_AR,1,1);
}

callback_ADAS_PROFILE_LONG_ARADAS_ProfLong_Updt_ExtLane (double value)
{
	PDU_ADAS_PROFILE_LONG_AR.ADAS_ProfLong_Updt_ExtLane.phys = value;
	frUpdatePDU(PDU_ADAS_PROFILE_LONG_AR,1,1);
}

callback_ADAS_PROFILE_LONG_ARADAS_ProfLong_ReTr_ExtLane (double value)
{
	PDU_ADAS_PROFILE_LONG_AR.ADAS_ProfLong_ReTr_ExtLane.phys = value;
	frUpdatePDU(PDU_ADAS_PROFILE_LONG_AR,1,1);
}

callback_ADAS_PROFILE_LONG_ARADAS_ProfLong_CtrlPoint_ExtLn (double value)
{
	PDU_ADAS_PROFILE_LONG_AR.ADAS_ProfLong_CtrlPoint_ExtLn.phys = value;
	frUpdatePDU(PDU_ADAS_PROFILE_LONG_AR,1,1);
}

callback_ADAS_PROFILE_LONG_ARADAS_ProfLong_Val_LaneNum (double value)
{
	PDU_ADAS_PROFILE_LONG_AR.ADAS_ProfLong_Val_LaneNum.phys = value;
	frUpdatePDU(PDU_ADAS_PROFILE_LONG_AR,1,1);
}

callback_ADAS_PROFILE_LONG_ARADAS_ProfLong_Val_1stPredLane (double value)
{
	PDU_ADAS_PROFILE_LONG_AR.ADAS_ProfLong_Val_1stPredLane.phys = value;
	frUpdatePDU(PDU_ADAS_PROFILE_LONG_AR,1,1);
}

callback_ADAS_PROFILE_LONG_ARADAS_ProfLong_Val_LstPredLane (double value)
{
	PDU_ADAS_PROFILE_LONG_AR.ADAS_ProfLong_Val_LstPredLane.phys = value;
	frUpdatePDU(PDU_ADAS_PROFILE_LONG_AR,1,1);
}

callback_ADAS_PROFILE_LONG_ARADAS_ProfLong_Val_PrioPredLn (double value)
{
	PDU_ADAS_PROFILE_LONG_AR.ADAS_ProfLong_Val_PrioPredLn.phys = value;
	frUpdatePDU(PDU_ADAS_PROFILE_LONG_AR,1,1);
}

callback_ADAS_PROFILE_LONG_ARADAS_ProfLong_Val_ArrowMark (double value)
{
	PDU_ADAS_PROFILE_LONG_AR.ADAS_ProfLong_Val_ArrowMark.phys = value;
	frUpdatePDU(PDU_ADAS_PROFILE_LONG_AR,1,1);
}

callback_ADAS_PROFILE_LONG_ARADAS_ProfLong_Val_LaneType (double value)
{
	PDU_ADAS_PROFILE_LONG_AR.ADAS_ProfLong_Val_LaneType.phys = value;
	frUpdatePDU(PDU_ADAS_PROFILE_LONG_AR,1,1);
}

callback_ADAS_PROFILE_LONG_ARADAS_ProfLong_Val_LaneMarking (double value)
{
	PDU_ADAS_PROFILE_LONG_AR.ADAS_ProfLong_Val_LaneMarking.phys = value;
	frUpdatePDU(PDU_ADAS_PROFILE_LONG_AR,1,1);
}

callback_ADAS_PROFILE_LONG_ARADAS_ProfLong_Val_Yield (double value)
{
	PDU_ADAS_PROFILE_LONG_AR.ADAS_ProfLong_Val_Yield.phys = value;
	frUpdatePDU(PDU_ADAS_PROFILE_LONG_AR,1,1);
}

callback_ADAS_PROFILE_LONG_ARADAS_ProfLong_MsgTyp_NPSL1 (double value)
{
	PDU_ADAS_PROFILE_LONG_AR.ADAS_ProfLong_MsgTyp_NPSL1.phys = value;
	frUpdatePDU(PDU_ADAS_PROFILE_LONG_AR,1,1);
}

callback_ADAS_PROFILE_LONG_ARADAS_ProfLong_Offset_NPSL1 (double value)
{
	PDU_ADAS_PROFILE_LONG_AR.ADAS_ProfLong_Offset_NPSL1.phys = value;
	frUpdatePDU(PDU_ADAS_PROFILE_LONG_AR,1,1);
}

callback_ADAS_PROFILE_LONG_ARADAS_ProfLong_PathIdx_NPSL1 (double value)
{
	PDU_ADAS_PROFILE_LONG_AR.ADAS_ProfLong_PathIdx_NPSL1.phys = value;
	frUpdatePDU(PDU_ADAS_PROFILE_LONG_AR,1,1);
}

callback_ADAS_PROFILE_LONG_ARADAS_ProfLong_CycCnt_NPSL1 (double value)
{
	PDU_ADAS_PROFILE_LONG_AR.ADAS_ProfLong_CycCnt_NPSL1.phys = value;
	frUpdatePDU(PDU_ADAS_PROFILE_LONG_AR,1,1);
}

callback_ADAS_PROFILE_LONG_ARADAS_ProfLong_Updt_NPSL1 (double value)
{
	PDU_ADAS_PROFILE_LONG_AR.ADAS_ProfLong_Updt_NPSL1.phys = value;
	frUpdatePDU(PDU_ADAS_PROFILE_LONG_AR,1,1);
}

callback_ADAS_PROFILE_LONG_ARADAS_ProfLong_ReTr_NPSL1 (double value)
{
	PDU_ADAS_PROFILE_LONG_AR.ADAS_ProfLong_ReTr_NPSL1.phys = value;
	frUpdatePDU(PDU_ADAS_PROFILE_LONG_AR,1,1);
}

callback_ADAS_PROFILE_LONG_ARADAS_ProfLong_CtrlPoint_NPSL1 (double value)
{
	PDU_ADAS_PROFILE_LONG_AR.ADAS_ProfLong_CtrlPoint_NPSL1.phys = value;
	frUpdatePDU(PDU_ADAS_PROFILE_LONG_AR,1,1);
}

callback_ADAS_PROFILE_LONG_ARADAS_ProfLong_Val_SpdLmt (double value)
{
	PDU_ADAS_PROFILE_LONG_AR.ADAS_ProfLong_Val_SpdLmt.phys = value;
	frUpdatePDU(PDU_ADAS_PROFILE_LONG_AR,1,1);
}

callback_ADAS_PROFILE_LONG_ARADAS_ProfLong_Val_SpdUnt (double value)
{
	PDU_ADAS_PROFILE_LONG_AR.ADAS_ProfLong_Val_SpdUnt.phys = value;
	frUpdatePDU(PDU_ADAS_PROFILE_LONG_AR,1,1);
}

callback_ADAS_PROFILE_LONG_ARADAS_ProfLong_Val_SpdVld (double value)
{
	PDU_ADAS_PROFILE_LONG_AR.ADAS_ProfLong_Val_SpdVld.phys = value;
	frUpdatePDU(PDU_ADAS_PROFILE_LONG_AR,1,1);
}

callback_ADAS_PROFILE_LONG_ARADAS_ProfLong_Val_SpdTyp (double value)
{
	PDU_ADAS_PROFILE_LONG_AR.ADAS_ProfLong_Val_SpdTyp.phys = value;
	frUpdatePDU(PDU_ADAS_PROFILE_LONG_AR,1,1);
}

callback_ADAS_PROFILE_LONG_ARADAS_ProfLong_Val_SpdLmt1 (double value)
{
	PDU_ADAS_PROFILE_LONG_AR.ADAS_ProfLong_Val_SpdLmt1.phys = value;
	frUpdatePDU(PDU_ADAS_PROFILE_LONG_AR,1,1);
}

callback_ADAS_PROFILE_LONG_ARADAS_ProfLong_Val_SpdVld1 (double value)
{
	PDU_ADAS_PROFILE_LONG_AR.ADAS_ProfLong_Val_SpdVld1.phys = value;
	frUpdatePDU(PDU_ADAS_PROFILE_LONG_AR,1,1);
}

callback_ADAS_PROFILE_LONG_ARADAS_ProfLong_Val_SpdTyp1 (double value)
{
	PDU_ADAS_PROFILE_LONG_AR.ADAS_ProfLong_Val_SpdTyp1.phys = value;
	frUpdatePDU(PDU_ADAS_PROFILE_LONG_AR,1,1);
}

callback_ADAS_PROFILE_LONG_ARADAS_ProfLong_MsgTyp_NPSL2 (double value)
{
	PDU_ADAS_PROFILE_LONG_AR.ADAS_ProfLong_MsgTyp_NPSL2.phys = value;
	frUpdatePDU(PDU_ADAS_PROFILE_LONG_AR,1,1);
}

callback_ADAS_PROFILE_LONG_ARADAS_ProfLong_Offset_NPSL2 (double value)
{
	PDU_ADAS_PROFILE_LONG_AR.ADAS_ProfLong_Offset_NPSL2.phys = value;
	frUpdatePDU(PDU_ADAS_PROFILE_LONG_AR,1,1);
}

callback_ADAS_PROFILE_LONG_ARADAS_ProfLong_PathIdx_NPSL2 (double value)
{
	PDU_ADAS_PROFILE_LONG_AR.ADAS_ProfLong_PathIdx_NPSL2.phys = value;
	frUpdatePDU(PDU_ADAS_PROFILE_LONG_AR,1,1);
}

callback_ADAS_PROFILE_LONG_ARADAS_ProfLong_CycCnt_NPSL2 (double value)
{
	PDU_ADAS_PROFILE_LONG_AR.ADAS_ProfLong_CycCnt_NPSL2.phys = value;
	frUpdatePDU(PDU_ADAS_PROFILE_LONG_AR,1,1);
}

callback_ADAS_PROFILE_LONG_ARADAS_ProfLong_Updt_NPSL2 (double value)
{
	PDU_ADAS_PROFILE_LONG_AR.ADAS_ProfLong_Updt_NPSL2.phys = value;
	frUpdatePDU(PDU_ADAS_PROFILE_LONG_AR,1,1);
}

callback_ADAS_PROFILE_LONG_ARADAS_ProfLong_ReTr_NPSL2 (double value)
{
	PDU_ADAS_PROFILE_LONG_AR.ADAS_ProfLong_ReTr_NPSL2.phys = value;
	frUpdatePDU(PDU_ADAS_PROFILE_LONG_AR,1,1);
}

callback_ADAS_PROFILE_LONG_ARADAS_ProfLong_CtrlPoint_NPSL2 (double value)
{
	PDU_ADAS_PROFILE_LONG_AR.ADAS_ProfLong_CtrlPoint_NPSL2.phys = value;
	frUpdatePDU(PDU_ADAS_PROFILE_LONG_AR,1,1);
}

callback_ADAS_PROFILE_LONG_ARADAS_ProfLong_Val_SpdLmt2 (double value)
{
	PDU_ADAS_PROFILE_LONG_AR.ADAS_ProfLong_Val_SpdLmt2.phys = value;
	frUpdatePDU(PDU_ADAS_PROFILE_LONG_AR,1,1);
}

callback_ADAS_PROFILE_LONG_ARADAS_ProfLong_Val_SpdUnt2 (double value)
{
	PDU_ADAS_PROFILE_LONG_AR.ADAS_ProfLong_Val_SpdUnt2.phys = value;
	frUpdatePDU(PDU_ADAS_PROFILE_LONG_AR,1,1);
}

callback_ADAS_PROFILE_LONG_ARADAS_ProfLong_Val_SpdVld2 (double value)
{
	PDU_ADAS_PROFILE_LONG_AR.ADAS_ProfLong_Val_SpdVld2.phys = value;
	frUpdatePDU(PDU_ADAS_PROFILE_LONG_AR,1,1);
}

callback_ADAS_PROFILE_LONG_ARADAS_ProfLong_Val_SpdTyp2 (double value)
{
	PDU_ADAS_PROFILE_LONG_AR.ADAS_ProfLong_Val_SpdTyp2.phys = value;
	frUpdatePDU(PDU_ADAS_PROFILE_LONG_AR,1,1);
}

callback_ADAS_PROFILE_LONG_ARADAS_ProfLong_ProfTyp (double value)
{
	PDU_ADAS_PROFILE_LONG_AR.ADAS_ProfLong_ProfTyp.phys = value;
	frUpdatePDU(PDU_ADAS_PROFILE_LONG_AR,1,1);
}

callback_ADAS_PROFILE_SHORT_ARADAS_ProfShort_MsgTyp_CL (double value)
{
	PDU_ADAS_PROFILE_SHORT_AR.ADAS_ProfShort_MsgTyp_CL.phys = value;
	frUpdatePDU(PDU_ADAS_PROFILE_SHORT_AR,1,1);
}

callback_ADAS_PROFILE_SHORT_ARADAS_ProfShort_Offset_CL (double value)
{
	PDU_ADAS_PROFILE_SHORT_AR.ADAS_ProfShort_Offset_CL.phys = value;
	frUpdatePDU(PDU_ADAS_PROFILE_SHORT_AR,1,1);
}

callback_ADAS_PROFILE_SHORT_ARADAS_ProfShort_PathIdx_CL (double value)
{
	PDU_ADAS_PROFILE_SHORT_AR.ADAS_ProfShort_PathIdx_CL.phys = value;
	frUpdatePDU(PDU_ADAS_PROFILE_SHORT_AR,1,1);
}

callback_ADAS_PROFILE_SHORT_ARADAS_ProfShort_CycCnt_CL (double value)
{
	PDU_ADAS_PROFILE_SHORT_AR.ADAS_ProfShort_CycCnt_CL.phys = value;
	frUpdatePDU(PDU_ADAS_PROFILE_SHORT_AR,1,1);
}

callback_ADAS_PROFILE_SHORT_ARADAS_ProfShort_Updt_CL (double value)
{
	PDU_ADAS_PROFILE_SHORT_AR.ADAS_ProfShort_Updt_CL.phys = value;
	frUpdatePDU(PDU_ADAS_PROFILE_SHORT_AR,1,1);
}

callback_ADAS_PROFILE_SHORT_ARADAS_ProfShort_ReTr_CL (double value)
{
	PDU_ADAS_PROFILE_SHORT_AR.ADAS_ProfShort_ReTr_CL.phys = value;
	frUpdatePDU(PDU_ADAS_PROFILE_SHORT_AR,1,1);
}

callback_ADAS_PROFILE_SHORT_ARADAS_ProfShort_CtrlPoint_CL (double value)
{
	PDU_ADAS_PROFILE_SHORT_AR.ADAS_ProfShort_CtrlPoint_CL.phys = value;
	frUpdatePDU(PDU_ADAS_PROFILE_SHORT_AR,1,1);
}

callback_ADAS_PROFILE_SHORT_ARADAS_ProfShort_AccurClass_CL (double value)
{
	PDU_ADAS_PROFILE_SHORT_AR.ADAS_ProfShort_AccurClass_CL.phys = value;
	frUpdatePDU(PDU_ADAS_PROFILE_SHORT_AR,1,1);
}

callback_ADAS_PROFILE_SHORT_ARADAS_ProfShort_Value0_CL (double value)
{
	PDU_ADAS_PROFILE_SHORT_AR.ADAS_ProfShort_Value0_CL.phys = value;
	frUpdatePDU(PDU_ADAS_PROFILE_SHORT_AR,1,1);
}

callback_ADAS_PROFILE_SHORT_ARADAS_ProfShort_Dist1_CL (double value)
{
	PDU_ADAS_PROFILE_SHORT_AR.ADAS_ProfShort_Dist1_CL.phys = value;
	frUpdatePDU(PDU_ADAS_PROFILE_SHORT_AR,1,1);
}

callback_ADAS_PROFILE_SHORT_ARADAS_ProfShort_Value1_CL (double value)
{
	PDU_ADAS_PROFILE_SHORT_AR.ADAS_ProfShort_Value1_CL.phys = value;
	frUpdatePDU(PDU_ADAS_PROFILE_SHORT_AR,1,1);
}

callback_ADAS_PROFILE_SHORT_ARADAS_ProfShort_MsgTyp_RN (double value)
{
	PDU_ADAS_PROFILE_SHORT_AR.ADAS_ProfShort_MsgTyp_RN.phys = value;
	frUpdatePDU(PDU_ADAS_PROFILE_SHORT_AR,1,1);
}

callback_ADAS_PROFILE_SHORT_ARADAS_ProfShort_Offset_RN (double value)
{
	PDU_ADAS_PROFILE_SHORT_AR.ADAS_ProfShort_Offset_RN.phys = value;
	frUpdatePDU(PDU_ADAS_PROFILE_SHORT_AR,1,1);
}

callback_ADAS_PROFILE_SHORT_ARADAS_ProfShort_PathIdx_RN (double value)
{
	PDU_ADAS_PROFILE_SHORT_AR.ADAS_ProfShort_PathIdx_RN.phys = value;
	frUpdatePDU(PDU_ADAS_PROFILE_SHORT_AR,1,1);
}

callback_ADAS_PROFILE_SHORT_ARADAS_ProfShort_CycCnt_RN (double value)
{
	PDU_ADAS_PROFILE_SHORT_AR.ADAS_ProfShort_CycCnt_RN.phys = value;
	frUpdatePDU(PDU_ADAS_PROFILE_SHORT_AR,1,1);
}

callback_ADAS_PROFILE_SHORT_ARADAS_ProfShort_Updt_RN (double value)
{
	PDU_ADAS_PROFILE_SHORT_AR.ADAS_ProfShort_Updt_RN.phys = value;
	frUpdatePDU(PDU_ADAS_PROFILE_SHORT_AR,1,1);
}

callback_ADAS_PROFILE_SHORT_ARADAS_ProfShort_ReTr_RN (double value)
{
	PDU_ADAS_PROFILE_SHORT_AR.ADAS_ProfShort_ReTr_RN.phys = value;
	frUpdatePDU(PDU_ADAS_PROFILE_SHORT_AR,1,1);
}

callback_ADAS_PROFILE_SHORT_ARADAS_ProfShort_CtrlPoint_RN (double value)
{
	PDU_ADAS_PROFILE_SHORT_AR.ADAS_ProfShort_CtrlPoint_RN.phys = value;
	frUpdatePDU(PDU_ADAS_PROFILE_SHORT_AR,1,1);
}

callback_ADAS_PROFILE_SHORT_ARADAS_ProfShort_AccurClass_RN (double value)
{
	PDU_ADAS_PROFILE_SHORT_AR.ADAS_ProfShort_AccurClass_RN.phys = value;
	frUpdatePDU(PDU_ADAS_PROFILE_SHORT_AR,1,1);
}

callback_ADAS_PROFILE_SHORT_ARADAS_ProfShort_Value0_RN (double value)
{
	PDU_ADAS_PROFILE_SHORT_AR.ADAS_ProfShort_Value0_RN.phys = value;
	frUpdatePDU(PDU_ADAS_PROFILE_SHORT_AR,1,1);
}

callback_ADAS_PROFILE_SHORT_ARADAS_ProfShort_Dist1_RN (double value)
{
	PDU_ADAS_PROFILE_SHORT_AR.ADAS_ProfShort_Dist1_RN.phys = value;
	frUpdatePDU(PDU_ADAS_PROFILE_SHORT_AR,1,1);
}

callback_ADAS_PROFILE_SHORT_ARADAS_ProfShort_Value1_RN (double value)
{
	PDU_ADAS_PROFILE_SHORT_AR.ADAS_ProfShort_Value1_RN.phys = value;
	frUpdatePDU(PDU_ADAS_PROFILE_SHORT_AR,1,1);
}

callback_ADAS_PROFILE_SHORT_ARADAS_ProfShort_MsgTyp_SS (double value)
{
	PDU_ADAS_PROFILE_SHORT_AR.ADAS_ProfShort_MsgTyp_SS.phys = value;
	frUpdatePDU(PDU_ADAS_PROFILE_SHORT_AR,1,1);
}

callback_ADAS_PROFILE_SHORT_ARADAS_ProfShort_Offset_SS (double value)
{
	PDU_ADAS_PROFILE_SHORT_AR.ADAS_ProfShort_Offset_SS.phys = value;
	frUpdatePDU(PDU_ADAS_PROFILE_SHORT_AR,1,1);
}

callback_ADAS_PROFILE_SHORT_ARADAS_ProfShort_PathIdx_SS (double value)
{
	PDU_ADAS_PROFILE_SHORT_AR.ADAS_ProfShort_PathIdx_SS.phys = value;
	frUpdatePDU(PDU_ADAS_PROFILE_SHORT_AR,1,1);
}

callback_ADAS_PROFILE_SHORT_ARADAS_ProfShort_CycCnt_SS (double value)
{
	PDU_ADAS_PROFILE_SHORT_AR.ADAS_ProfShort_CycCnt_SS.phys = value;
	frUpdatePDU(PDU_ADAS_PROFILE_SHORT_AR,1,1);
}

callback_ADAS_PROFILE_SHORT_ARADAS_ProfShort_Updt_SS (double value)
{
	PDU_ADAS_PROFILE_SHORT_AR.ADAS_ProfShort_Updt_SS.phys = value;
	frUpdatePDU(PDU_ADAS_PROFILE_SHORT_AR,1,1);
}

callback_ADAS_PROFILE_SHORT_ARADAS_ProfShort_ReTr_SS (double value)
{
	PDU_ADAS_PROFILE_SHORT_AR.ADAS_ProfShort_ReTr_SS.phys = value;
	frUpdatePDU(PDU_ADAS_PROFILE_SHORT_AR,1,1);
}

callback_ADAS_PROFILE_SHORT_ARADAS_ProfShort_CtrlPoint_SS (double value)
{
	PDU_ADAS_PROFILE_SHORT_AR.ADAS_ProfShort_CtrlPoint_SS.phys = value;
	frUpdatePDU(PDU_ADAS_PROFILE_SHORT_AR,1,1);
}

callback_ADAS_PROFILE_SHORT_ARADAS_ProfShort_AccurClass_SS (double value)
{
	PDU_ADAS_PROFILE_SHORT_AR.ADAS_ProfShort_AccurClass_SS.phys = value;
	frUpdatePDU(PDU_ADAS_PROFILE_SHORT_AR,1,1);
}

callback_ADAS_PROFILE_SHORT_ARADAS_ProfShort_Value0_SS (double value)
{
	PDU_ADAS_PROFILE_SHORT_AR.ADAS_ProfShort_Value0_SS.phys = value;
	frUpdatePDU(PDU_ADAS_PROFILE_SHORT_AR,1,1);
}

callback_ADAS_PROFILE_SHORT_ARADAS_ProfShort_Dist1_SS (double value)
{
	PDU_ADAS_PROFILE_SHORT_AR.ADAS_ProfShort_Dist1_SS.phys = value;
	frUpdatePDU(PDU_ADAS_PROFILE_SHORT_AR,1,1);
}

callback_ADAS_PROFILE_SHORT_ARADAS_ProfShort_Value1_SS (double value)
{
	PDU_ADAS_PROFILE_SHORT_AR.ADAS_ProfShort_Value1_SS.phys = value;
	frUpdatePDU(PDU_ADAS_PROFILE_SHORT_AR,1,1);
}

callback_ADAS_PROFILE_SHORT_ARADAS_ProfShort_MsgTyp_SL (double value)
{
	PDU_ADAS_PROFILE_SHORT_AR.ADAS_ProfShort_MsgTyp_SL.phys = value;
	frUpdatePDU(PDU_ADAS_PROFILE_SHORT_AR,1,1);
}

callback_ADAS_PROFILE_SHORT_ARADAS_ProfShort_Offset_SL (double value)
{
	PDU_ADAS_PROFILE_SHORT_AR.ADAS_ProfShort_Offset_SL.phys = value;
	frUpdatePDU(PDU_ADAS_PROFILE_SHORT_AR,1,1);
}

callback_ADAS_PROFILE_SHORT_ARADAS_ProfShort_PathIdx_SL (double value)
{
	PDU_ADAS_PROFILE_SHORT_AR.ADAS_ProfShort_PathIdx_SL.phys = value;
	frUpdatePDU(PDU_ADAS_PROFILE_SHORT_AR,1,1);
}

callback_ADAS_PROFILE_SHORT_ARADAS_ProfShort_CycCnt_SL (double value)
{
	PDU_ADAS_PROFILE_SHORT_AR.ADAS_ProfShort_CycCnt_SL.phys = value;
	frUpdatePDU(PDU_ADAS_PROFILE_SHORT_AR,1,1);
}

callback_ADAS_PROFILE_SHORT_ARADAS_ProfShort_Updt_SL (double value)
{
	PDU_ADAS_PROFILE_SHORT_AR.ADAS_ProfShort_Updt_SL.phys = value;
	frUpdatePDU(PDU_ADAS_PROFILE_SHORT_AR,1,1);
}

callback_ADAS_PROFILE_SHORT_ARADAS_ProfShort_ReTr_SL (double value)
{
	PDU_ADAS_PROFILE_SHORT_AR.ADAS_ProfShort_ReTr_SL.phys = value;
	frUpdatePDU(PDU_ADAS_PROFILE_SHORT_AR,1,1);
}

callback_ADAS_PROFILE_SHORT_ARADAS_ProfShort_CtrlPoint_SL (double value)
{
	PDU_ADAS_PROFILE_SHORT_AR.ADAS_ProfShort_CtrlPoint_SL.phys = value;
	frUpdatePDU(PDU_ADAS_PROFILE_SHORT_AR,1,1);
}

callback_ADAS_PROFILE_SHORT_ARADAS_ProfShort_AccurClass_SL (double value)
{
	PDU_ADAS_PROFILE_SHORT_AR.ADAS_ProfShort_AccurClass_SL.phys = value;
	frUpdatePDU(PDU_ADAS_PROFILE_SHORT_AR,1,1);
}

callback_ADAS_PROFILE_SHORT_ARADAS_ProfShort_Value0_SL (double value)
{
	PDU_ADAS_PROFILE_SHORT_AR.ADAS_ProfShort_Value0_SL.phys = value;
	frUpdatePDU(PDU_ADAS_PROFILE_SHORT_AR,1,1);
}

callback_ADAS_PROFILE_SHORT_ARADAS_ProfShort_Dist1_SL (double value)
{
	PDU_ADAS_PROFILE_SHORT_AR.ADAS_ProfShort_Dist1_SL.phys = value;
	frUpdatePDU(PDU_ADAS_PROFILE_SHORT_AR,1,1);
}

callback_ADAS_PROFILE_SHORT_ARADAS_ProfShort_Value1_SL (double value)
{
	PDU_ADAS_PROFILE_SHORT_AR.ADAS_ProfShort_Value1_SL.phys = value;
	frUpdatePDU(PDU_ADAS_PROFILE_SHORT_AR,1,1);
}

callback_ADAS_PROFILE_SHORT_ARADAS_ProfShort_MsgTyp_RA (double value)
{
	PDU_ADAS_PROFILE_SHORT_AR.ADAS_ProfShort_MsgTyp_RA.phys = value;
	frUpdatePDU(PDU_ADAS_PROFILE_SHORT_AR,1,1);
}

callback_ADAS_PROFILE_SHORT_ARADAS_ProfShort_Offset_RA (double value)
{
	PDU_ADAS_PROFILE_SHORT_AR.ADAS_ProfShort_Offset_RA.phys = value;
	frUpdatePDU(PDU_ADAS_PROFILE_SHORT_AR,1,1);
}

callback_ADAS_PROFILE_SHORT_ARADAS_ProfShort_PathIdx_RA (double value)
{
	PDU_ADAS_PROFILE_SHORT_AR.ADAS_ProfShort_PathIdx_RA.phys = value;
	frUpdatePDU(PDU_ADAS_PROFILE_SHORT_AR,1,1);
}

callback_ADAS_PROFILE_SHORT_ARADAS_ProfShort_CycCnt_RA (double value)
{
	PDU_ADAS_PROFILE_SHORT_AR.ADAS_ProfShort_CycCnt_RA.phys = value;
	frUpdatePDU(PDU_ADAS_PROFILE_SHORT_AR,1,1);
}

callback_ADAS_PROFILE_SHORT_ARADAS_ProfShort_Updt_RA (double value)
{
	PDU_ADAS_PROFILE_SHORT_AR.ADAS_ProfShort_Updt_RA.phys = value;
	frUpdatePDU(PDU_ADAS_PROFILE_SHORT_AR,1,1);
}

callback_ADAS_PROFILE_SHORT_ARADAS_ProfShort_ReTr_RA (double value)
{
	PDU_ADAS_PROFILE_SHORT_AR.ADAS_ProfShort_ReTr_RA.phys = value;
	frUpdatePDU(PDU_ADAS_PROFILE_SHORT_AR,1,1);
}

callback_ADAS_PROFILE_SHORT_ARADAS_ProfShort_CtrlPoint_RA (double value)
{
	PDU_ADAS_PROFILE_SHORT_AR.ADAS_ProfShort_CtrlPoint_RA.phys = value;
	frUpdatePDU(PDU_ADAS_PROFILE_SHORT_AR,1,1);
}

callback_ADAS_PROFILE_SHORT_ARADAS_ProfShort_AccurClass_RA (double value)
{
	PDU_ADAS_PROFILE_SHORT_AR.ADAS_ProfShort_AccurClass_RA.phys = value;
	frUpdatePDU(PDU_ADAS_PROFILE_SHORT_AR,1,1);
}

callback_ADAS_PROFILE_SHORT_ARADAS_ProfShort_Value0_RA (double value)
{
	PDU_ADAS_PROFILE_SHORT_AR.ADAS_ProfShort_Value0_RA.phys = value;
	frUpdatePDU(PDU_ADAS_PROFILE_SHORT_AR,1,1);
}

callback_ADAS_PROFILE_SHORT_ARADAS_ProfShort_Dist1_RA (double value)
{
	PDU_ADAS_PROFILE_SHORT_AR.ADAS_ProfShort_Dist1_RA.phys = value;
	frUpdatePDU(PDU_ADAS_PROFILE_SHORT_AR,1,1);
}

callback_ADAS_PROFILE_SHORT_ARADAS_ProfShort_Value1_RA (double value)
{
	PDU_ADAS_PROFILE_SHORT_AR.ADAS_ProfShort_Value1_RA.phys = value;
	frUpdatePDU(PDU_ADAS_PROFILE_SHORT_AR,1,1);
}

callback_ADAS_PROFILE_SHORT_ARADAS_ProfShort_MsgTyp_RC (double value)
{
	PDU_ADAS_PROFILE_SHORT_AR.ADAS_ProfShort_MsgTyp_RC.phys = value;
	frUpdatePDU(PDU_ADAS_PROFILE_SHORT_AR,1,1);
}

callback_ADAS_PROFILE_SHORT_ARADAS_ProfShort_Offset_RC (double value)
{
	PDU_ADAS_PROFILE_SHORT_AR.ADAS_ProfShort_Offset_RC.phys = value;
	frUpdatePDU(PDU_ADAS_PROFILE_SHORT_AR,1,1);
}

callback_ADAS_PROFILE_SHORT_ARADAS_ProfShort_PathIdx_RC (double value)
{
	PDU_ADAS_PROFILE_SHORT_AR.ADAS_ProfShort_PathIdx_RC.phys = value;
	frUpdatePDU(PDU_ADAS_PROFILE_SHORT_AR,1,1);
}

callback_ADAS_PROFILE_SHORT_ARADAS_ProfShort_CycCnt_RC (double value)
{
	PDU_ADAS_PROFILE_SHORT_AR.ADAS_ProfShort_CycCnt_RC.phys = value;
	frUpdatePDU(PDU_ADAS_PROFILE_SHORT_AR,1,1);
}

callback_ADAS_PROFILE_SHORT_ARADAS_ProfShort_Updt_RC (double value)
{
	PDU_ADAS_PROFILE_SHORT_AR.ADAS_ProfShort_Updt_RC.phys = value;
	frUpdatePDU(PDU_ADAS_PROFILE_SHORT_AR,1,1);
}

callback_ADAS_PROFILE_SHORT_ARADAS_ProfShort_ReTr_RC (double value)
{
	PDU_ADAS_PROFILE_SHORT_AR.ADAS_ProfShort_ReTr_RC.phys = value;
	frUpdatePDU(PDU_ADAS_PROFILE_SHORT_AR,1,1);
}

callback_ADAS_PROFILE_SHORT_ARADAS_ProfShort_CtrlPoint_RC (double value)
{
	PDU_ADAS_PROFILE_SHORT_AR.ADAS_ProfShort_CtrlPoint_RC.phys = value;
	frUpdatePDU(PDU_ADAS_PROFILE_SHORT_AR,1,1);
}

callback_ADAS_PROFILE_SHORT_ARADAS_ProfShort_AccurClass_RC (double value)
{
	PDU_ADAS_PROFILE_SHORT_AR.ADAS_ProfShort_AccurClass_RC.phys = value;
	frUpdatePDU(PDU_ADAS_PROFILE_SHORT_AR,1,1);
}

callback_ADAS_PROFILE_SHORT_ARADAS_ProfShort_Value0_RC (double value)
{
	PDU_ADAS_PROFILE_SHORT_AR.ADAS_ProfShort_Value0_RC.phys = value;
	frUpdatePDU(PDU_ADAS_PROFILE_SHORT_AR,1,1);
}

callback_ADAS_PROFILE_SHORT_ARADAS_ProfShort_Dist1_RC (double value)
{
	PDU_ADAS_PROFILE_SHORT_AR.ADAS_ProfShort_Dist1_RC.phys = value;
	frUpdatePDU(PDU_ADAS_PROFILE_SHORT_AR,1,1);
}

callback_ADAS_PROFILE_SHORT_ARADAS_ProfShort_Value1_RC (double value)
{
	PDU_ADAS_PROFILE_SHORT_AR.ADAS_ProfShort_Value1_RC.phys = value;
	frUpdatePDU(PDU_ADAS_PROFILE_SHORT_AR,1,1);
}

callback_ADAS_PROFILE_SHORT_ARADAS_ProfShort_MsgTyp_VSS (double value)
{
	PDU_ADAS_PROFILE_SHORT_AR.ADAS_ProfShort_MsgTyp_VSS.phys = value;
	frUpdatePDU(PDU_ADAS_PROFILE_SHORT_AR,1,1);
}

callback_ADAS_PROFILE_SHORT_ARADAS_ProfShort_Offset_VSS (double value)
{
	PDU_ADAS_PROFILE_SHORT_AR.ADAS_ProfShort_Offset_VSS.phys = value;
	frUpdatePDU(PDU_ADAS_PROFILE_SHORT_AR,1,1);
}

callback_ADAS_PROFILE_SHORT_ARADAS_ProfShort_PathIdx_VSS (double value)
{
	PDU_ADAS_PROFILE_SHORT_AR.ADAS_ProfShort_PathIdx_VSS.phys = value;
	frUpdatePDU(PDU_ADAS_PROFILE_SHORT_AR,1,1);
}

callback_ADAS_PROFILE_SHORT_ARADAS_ProfShort_CycCnt_VSS (double value)
{
	PDU_ADAS_PROFILE_SHORT_AR.ADAS_ProfShort_CycCnt_VSS.phys = value;
	frUpdatePDU(PDU_ADAS_PROFILE_SHORT_AR,1,1);
}

callback_ADAS_PROFILE_SHORT_ARADAS_ProfShort_Updt_VSS (double value)
{
	PDU_ADAS_PROFILE_SHORT_AR.ADAS_ProfShort_Updt_VSS.phys = value;
	frUpdatePDU(PDU_ADAS_PROFILE_SHORT_AR,1,1);
}

callback_ADAS_PROFILE_SHORT_ARADAS_ProfShort_ReTr_VSS (double value)
{
	PDU_ADAS_PROFILE_SHORT_AR.ADAS_ProfShort_ReTr_VSS.phys = value;
	frUpdatePDU(PDU_ADAS_PROFILE_SHORT_AR,1,1);
}

callback_ADAS_PROFILE_SHORT_ARADAS_ProfShort_CtrlPoint_VSS (double value)
{
	PDU_ADAS_PROFILE_SHORT_AR.ADAS_ProfShort_CtrlPoint_VSS.phys = value;
	frUpdatePDU(PDU_ADAS_PROFILE_SHORT_AR,1,1);
}

callback_ADAS_PROFILE_SHORT_ARADAS_ProfShort_AccurClass_VSS (double value)
{
	PDU_ADAS_PROFILE_SHORT_AR.ADAS_ProfShort_AccurClass_VSS.phys = value;
	frUpdatePDU(PDU_ADAS_PROFILE_SHORT_AR,1,1);
}

callback_ADAS_PROFILE_SHORT_ARADAS_ProfShort_Value0_VSS (double value)
{
	PDU_ADAS_PROFILE_SHORT_AR.ADAS_ProfShort_Value0_VSS.phys = value;
	frUpdatePDU(PDU_ADAS_PROFILE_SHORT_AR,1,1);
}

callback_ADAS_PROFILE_SHORT_ARADAS_ProfShort_Dist1_VSS (double value)
{
	PDU_ADAS_PROFILE_SHORT_AR.ADAS_ProfShort_Dist1_VSS.phys = value;
	frUpdatePDU(PDU_ADAS_PROFILE_SHORT_AR,1,1);
}

callback_ADAS_PROFILE_SHORT_ARADAS_ProfShort_Value1_VSS (double value)
{
	PDU_ADAS_PROFILE_SHORT_AR.ADAS_ProfShort_Value1_VSS.phys = value;
	frUpdatePDU(PDU_ADAS_PROFILE_SHORT_AR,1,1);
}

callback_ADAS_PROFILE_SHORT_ARADAS_ProfShort_MsgTyp_HCS (double value)
{
	PDU_ADAS_PROFILE_SHORT_AR.ADAS_ProfShort_MsgTyp_HCS.phys = value;
	frUpdatePDU(PDU_ADAS_PROFILE_SHORT_AR,1,1);
}

callback_ADAS_PROFILE_SHORT_ARADAS_ProfShort_Offset_HCS (double value)
{
	PDU_ADAS_PROFILE_SHORT_AR.ADAS_ProfShort_Offset_HCS.phys = value;
	frUpdatePDU(PDU_ADAS_PROFILE_SHORT_AR,1,1);
}

callback_ADAS_PROFILE_SHORT_ARADAS_ProfShort_PathIdx_HCS (double value)
{
	PDU_ADAS_PROFILE_SHORT_AR.ADAS_ProfShort_PathIdx_HCS.phys = value;
	frUpdatePDU(PDU_ADAS_PROFILE_SHORT_AR,1,1);
}

callback_ADAS_PROFILE_SHORT_ARADAS_ProfShort_CycCnt_HCS (double value)
{
	PDU_ADAS_PROFILE_SHORT_AR.ADAS_ProfShort_CycCnt_HCS.phys = value;
	frUpdatePDU(PDU_ADAS_PROFILE_SHORT_AR,1,1);
}

callback_ADAS_PROFILE_SHORT_ARADAS_ProfShort_Updt_HCS (double value)
{
	PDU_ADAS_PROFILE_SHORT_AR.ADAS_ProfShort_Updt_HCS.phys = value;
	frUpdatePDU(PDU_ADAS_PROFILE_SHORT_AR,1,1);
}

callback_ADAS_PROFILE_SHORT_ARADAS_ProfShort_ReTr_HCS (double value)
{
	PDU_ADAS_PROFILE_SHORT_AR.ADAS_ProfShort_ReTr_HCS.phys = value;
	frUpdatePDU(PDU_ADAS_PROFILE_SHORT_AR,1,1);
}

callback_ADAS_PROFILE_SHORT_ARADAS_ProfShort_CtrlPoint_HCS (double value)
{
	PDU_ADAS_PROFILE_SHORT_AR.ADAS_ProfShort_CtrlPoint_HCS.phys = value;
	frUpdatePDU(PDU_ADAS_PROFILE_SHORT_AR,1,1);
}

callback_ADAS_PROFILE_SHORT_ARADAS_ProfShort_AccurClass_HCS (double value)
{
	PDU_ADAS_PROFILE_SHORT_AR.ADAS_ProfShort_AccurClass_HCS.phys = value;
	frUpdatePDU(PDU_ADAS_PROFILE_SHORT_AR,1,1);
}

callback_ADAS_PROFILE_SHORT_ARADAS_ProfShort_Value0_HCS (double value)
{
	PDU_ADAS_PROFILE_SHORT_AR.ADAS_ProfShort_Value0_HCS.phys = value;
	frUpdatePDU(PDU_ADAS_PROFILE_SHORT_AR,1,1);
}

callback_ADAS_PROFILE_SHORT_ARADAS_ProfShort_Dist1_HCS (double value)
{
	PDU_ADAS_PROFILE_SHORT_AR.ADAS_ProfShort_Dist1_HCS.phys = value;
	frUpdatePDU(PDU_ADAS_PROFILE_SHORT_AR,1,1);
}

callback_ADAS_PROFILE_SHORT_ARADAS_ProfShort_Value1_HCS (double value)
{
	PDU_ADAS_PROFILE_SHORT_AR.ADAS_ProfShort_Value1_HCS.phys = value;
	frUpdatePDU(PDU_ADAS_PROFILE_SHORT_AR,1,1);
}

callback_ADAS_PROFILE_SHORT_ARADAS_ProfShort_MsgTyp_LD (double value)
{
	PDU_ADAS_PROFILE_SHORT_AR.ADAS_ProfShort_MsgTyp_LD.phys = value;
	frUpdatePDU(PDU_ADAS_PROFILE_SHORT_AR,1,1);
}

callback_ADAS_PROFILE_SHORT_ARADAS_ProfShort_Offset_LD (double value)
{
	PDU_ADAS_PROFILE_SHORT_AR.ADAS_ProfShort_Offset_LD.phys = value;
	frUpdatePDU(PDU_ADAS_PROFILE_SHORT_AR,1,1);
}

callback_ADAS_PROFILE_SHORT_ARADAS_ProfShort_PathIdx_LD (double value)
{
	PDU_ADAS_PROFILE_SHORT_AR.ADAS_ProfShort_PathIdx_LD.phys = value;
	frUpdatePDU(PDU_ADAS_PROFILE_SHORT_AR,1,1);
}

callback_ADAS_PROFILE_SHORT_ARADAS_ProfShort_CycCnt_LD (double value)
{
	PDU_ADAS_PROFILE_SHORT_AR.ADAS_ProfShort_CycCnt_LD.phys = value;
	frUpdatePDU(PDU_ADAS_PROFILE_SHORT_AR,1,1);
}

callback_ADAS_PROFILE_SHORT_ARADAS_ProfShort_Updt_LD (double value)
{
	PDU_ADAS_PROFILE_SHORT_AR.ADAS_ProfShort_Updt_LD.phys = value;
	frUpdatePDU(PDU_ADAS_PROFILE_SHORT_AR,1,1);
}

callback_ADAS_PROFILE_SHORT_ARADAS_ProfShort_ReTr_LD (double value)
{
	PDU_ADAS_PROFILE_SHORT_AR.ADAS_ProfShort_ReTr_LD.phys = value;
	frUpdatePDU(PDU_ADAS_PROFILE_SHORT_AR,1,1);
}

callback_ADAS_PROFILE_SHORT_ARADAS_ProfShort_CtrlPoint_LD (double value)
{
	PDU_ADAS_PROFILE_SHORT_AR.ADAS_ProfShort_CtrlPoint_LD.phys = value;
	frUpdatePDU(PDU_ADAS_PROFILE_SHORT_AR,1,1);
}

callback_ADAS_PROFILE_SHORT_ARADAS_ProfShort_AccurClass_LD (double value)
{
	PDU_ADAS_PROFILE_SHORT_AR.ADAS_ProfShort_AccurClass_LD.phys = value;
	frUpdatePDU(PDU_ADAS_PROFILE_SHORT_AR,1,1);
}

callback_ADAS_PROFILE_SHORT_ARADAS_ProfShort_Value0_LT (double value)
{
	PDU_ADAS_PROFILE_SHORT_AR.ADAS_ProfShort_Value0_LT.phys = value;
	frUpdatePDU(PDU_ADAS_PROFILE_SHORT_AR,1,1);
}

callback_ADAS_PROFILE_SHORT_ARADAS_ProfShort_Value0_DT (double value)
{
	PDU_ADAS_PROFILE_SHORT_AR.ADAS_ProfShort_Value0_DT.phys = value;
	frUpdatePDU(PDU_ADAS_PROFILE_SHORT_AR,1,1);
}

callback_ADAS_PROFILE_SHORT_ARADAS_ProfShort_Dist1_LD (double value)
{
	PDU_ADAS_PROFILE_SHORT_AR.ADAS_ProfShort_Dist1_LD.phys = value;
	frUpdatePDU(PDU_ADAS_PROFILE_SHORT_AR,1,1);
}

callback_ADAS_PROFILE_SHORT_ARADAS_ProfShort_Value1_LT (double value)
{
	PDU_ADAS_PROFILE_SHORT_AR.ADAS_ProfShort_Value1_LT.phys = value;
	frUpdatePDU(PDU_ADAS_PROFILE_SHORT_AR,1,1);
}

callback_ADAS_PROFILE_SHORT_ARADAS_ProfShort_Value1_DT (double value)
{
	PDU_ADAS_PROFILE_SHORT_AR.ADAS_ProfShort_Value1_DT.phys = value;
	frUpdatePDU(PDU_ADAS_PROFILE_SHORT_AR,1,1);
}

callback_ADAS_PROFILE_SHORT_ARADAS_ProfShort_ProfTyp (double value)
{
	PDU_ADAS_PROFILE_SHORT_AR.ADAS_ProfShort_ProfTyp.phys = value;
	frUpdatePDU(PDU_ADAS_PROFILE_SHORT_AR,1,1);
}

callback_ADASLR_PROFILE_LONG_ARADASLR_ProfLong_MsgTyp_SpdCl (double value)
{
	PDU_ADASLR_PROFILE_LONG_AR.ADASLR_ProfLong_MsgTyp_SpdCl.phys = value;
	frUpdatePDU(PDU_ADASLR_PROFILE_LONG_AR,1,1);
}

callback_ADASLR_PROFILE_LONG_ARADASLR_ProfLong_Offset_SpdCl (double value)
{
	PDU_ADASLR_PROFILE_LONG_AR.ADASLR_ProfLong_Offset_SpdCl.phys = value;
	frUpdatePDU(PDU_ADASLR_PROFILE_LONG_AR,1,1);
}

callback_ADASLR_PROFILE_LONG_ARADASLR_ProfLong_PathIdx_SpdCl (double value)
{
	PDU_ADASLR_PROFILE_LONG_AR.ADASLR_ProfLong_PathIdx_SpdCl.phys = value;
	frUpdatePDU(PDU_ADASLR_PROFILE_LONG_AR,1,1);
}

callback_ADASLR_PROFILE_LONG_ARADASLR_ProfLong_CycCnt_SpdCl (double value)
{
	PDU_ADASLR_PROFILE_LONG_AR.ADASLR_ProfLong_CycCnt_SpdCl.phys = value;
	frUpdatePDU(PDU_ADASLR_PROFILE_LONG_AR,1,1);
}

callback_ADASLR_PROFILE_LONG_ARADASLR_ProfLong_Updt_SpdCl (double value)
{
	PDU_ADASLR_PROFILE_LONG_AR.ADASLR_ProfLong_Updt_SpdCl.phys = value;
	frUpdatePDU(PDU_ADASLR_PROFILE_LONG_AR,1,1);
}

callback_ADASLR_PROFILE_LONG_ARADASLR_ProfLong_ReTr_SpdCl (double value)
{
	PDU_ADASLR_PROFILE_LONG_AR.ADASLR_ProfLong_ReTr_SpdCl.phys = value;
	frUpdatePDU(PDU_ADASLR_PROFILE_LONG_AR,1,1);
}

callback_ADASLR_PROFILE_LONG_ARADASLR_ProfLong_CtrlPnt_SpdCl (double value)
{
	PDU_ADASLR_PROFILE_LONG_AR.ADASLR_ProfLong_CtrlPnt_SpdCl.phys = value;
	frUpdatePDU(PDU_ADASLR_PROFILE_LONG_AR,1,1);
}

callback_ADASLR_PROFILE_LONG_ARADASLR_ProfLong_Val_SpdCl (double value)
{
	PDU_ADASLR_PROFILE_LONG_AR.ADASLR_ProfLong_Val_SpdCl.phys = value;
	frUpdatePDU(PDU_ADASLR_PROFILE_LONG_AR,1,1);
}

callback_ADASLR_PROFILE_LONG_ARADASLR_ProfLong_MsgTyp_Hght (double value)
{
	PDU_ADASLR_PROFILE_LONG_AR.ADASLR_ProfLong_MsgTyp_Hght.phys = value;
	frUpdatePDU(PDU_ADASLR_PROFILE_LONG_AR,1,1);
}

callback_ADASLR_PROFILE_LONG_ARADASLR_ProfLong_Offset_Hght (double value)
{
	PDU_ADASLR_PROFILE_LONG_AR.ADASLR_ProfLong_Offset_Hght.phys = value;
	frUpdatePDU(PDU_ADASLR_PROFILE_LONG_AR,1,1);
}

callback_ADASLR_PROFILE_LONG_ARADASLR_ProfLong_PathIdx_Hght (double value)
{
	PDU_ADASLR_PROFILE_LONG_AR.ADASLR_ProfLong_PathIdx_Hght.phys = value;
	frUpdatePDU(PDU_ADASLR_PROFILE_LONG_AR,1,1);
}

callback_ADASLR_PROFILE_LONG_ARADASLR_ProfLong_CycCnt_Hght (double value)
{
	PDU_ADASLR_PROFILE_LONG_AR.ADASLR_ProfLong_CycCnt_Hght.phys = value;
	frUpdatePDU(PDU_ADASLR_PROFILE_LONG_AR,1,1);
}

callback_ADASLR_PROFILE_LONG_ARADASLR_ProfLong_Updt_Hght (double value)
{
	PDU_ADASLR_PROFILE_LONG_AR.ADASLR_ProfLong_Updt_Hght.phys = value;
	frUpdatePDU(PDU_ADASLR_PROFILE_LONG_AR,1,1);
}

callback_ADASLR_PROFILE_LONG_ARADASLR_ProfLong_ReTr_Hght (double value)
{
	PDU_ADASLR_PROFILE_LONG_AR.ADASLR_ProfLong_ReTr_Hght.phys = value;
	frUpdatePDU(PDU_ADASLR_PROFILE_LONG_AR,1,1);
}

callback_ADASLR_PROFILE_LONG_ARADASLR_ProfLong_CtrlPnt_Hght (double value)
{
	PDU_ADASLR_PROFILE_LONG_AR.ADASLR_ProfLong_CtrlPnt_Hght.phys = value;
	frUpdatePDU(PDU_ADASLR_PROFILE_LONG_AR,1,1);
}

callback_ADASLR_PROFILE_LONG_ARADASLR_ProfLong_Val_Hght (double value)
{
	PDU_ADASLR_PROFILE_LONG_AR.ADASLR_ProfLong_Val_Hght.phys = value;
	frUpdatePDU(PDU_ADASLR_PROFILE_LONG_AR,1,1);
}

callback_ADASLR_PROFILE_LONG_ARADASLR_ProfLong_MsgTyp_SpecZ (double value)
{
	PDU_ADASLR_PROFILE_LONG_AR.ADASLR_ProfLong_MsgTyp_SpecZ.phys = value;
	frUpdatePDU(PDU_ADASLR_PROFILE_LONG_AR,1,1);
}

callback_ADASLR_PROFILE_LONG_ARADASLR_ProfLong_Offset_SpecZ (double value)
{
	PDU_ADASLR_PROFILE_LONG_AR.ADASLR_ProfLong_Offset_SpecZ.phys = value;
	frUpdatePDU(PDU_ADASLR_PROFILE_LONG_AR,1,1);
}

callback_ADASLR_PROFILE_LONG_ARADASLR_ProfLong_PathIdx_SpecZ (double value)
{
	PDU_ADASLR_PROFILE_LONG_AR.ADASLR_ProfLong_PathIdx_SpecZ.phys = value;
	frUpdatePDU(PDU_ADASLR_PROFILE_LONG_AR,1,1);
}

callback_ADASLR_PROFILE_LONG_ARADASLR_ProfLong_CycCnt_SpecZ (double value)
{
	PDU_ADASLR_PROFILE_LONG_AR.ADASLR_ProfLong_CycCnt_SpecZ.phys = value;
	frUpdatePDU(PDU_ADASLR_PROFILE_LONG_AR,1,1);
}

callback_ADASLR_PROFILE_LONG_ARADASLR_ProfLong_Updt_SpecZ (double value)
{
	PDU_ADASLR_PROFILE_LONG_AR.ADASLR_ProfLong_Updt_SpecZ.phys = value;
	frUpdatePDU(PDU_ADASLR_PROFILE_LONG_AR,1,1);
}

callback_ADASLR_PROFILE_LONG_ARADASLR_ProfLong_ReTr_SpecZ (double value)
{
	PDU_ADASLR_PROFILE_LONG_AR.ADASLR_ProfLong_ReTr_SpecZ.phys = value;
	frUpdatePDU(PDU_ADASLR_PROFILE_LONG_AR,1,1);
}

callback_ADASLR_PROFILE_LONG_ARADASLR_ProfLong_CtrlPnt_SpecZ (double value)
{
	PDU_ADASLR_PROFILE_LONG_AR.ADASLR_ProfLong_CtrlPnt_SpecZ.phys = value;
	frUpdatePDU(PDU_ADASLR_PROFILE_LONG_AR,1,1);
}

callback_ADASLR_PROFILE_LONG_ARADASLR_ProfLong_Val_SpecZ (double value)
{
	PDU_ADASLR_PROFILE_LONG_AR.ADASLR_ProfLong_Val_SpecZ.phys = value;
	frUpdatePDU(PDU_ADASLR_PROFILE_LONG_AR,1,1);
}

callback_ADASLR_PROFILE_LONG_ARADASLR_ProfLong_Dest_SpecZ (double value)
{
	PDU_ADASLR_PROFILE_LONG_AR.ADASLR_ProfLong_Dest_SpecZ.phys = value;
	frUpdatePDU(PDU_ADASLR_PROFILE_LONG_AR,1,1);
}

callback_ADASLR_PROFILE_LONG_ARADASLR_ProfLong_BuA_SpecZ (double value)
{
	PDU_ADASLR_PROFILE_LONG_AR.ADASLR_ProfLong_BuA_SpecZ.phys = value;
	frUpdatePDU(PDU_ADASLR_PROFILE_LONG_AR,1,1);
}

callback_ADASLR_PROFILE_LONG_ARADASLR_ProfLong_MsgTyp_RestA (double value)
{
	PDU_ADASLR_PROFILE_LONG_AR.ADASLR_ProfLong_MsgTyp_RestA.phys = value;
	frUpdatePDU(PDU_ADASLR_PROFILE_LONG_AR,1,1);
}

callback_ADASLR_PROFILE_LONG_ARADASLR_ProfLong_Offset_RestA (double value)
{
	PDU_ADASLR_PROFILE_LONG_AR.ADASLR_ProfLong_Offset_RestA.phys = value;
	frUpdatePDU(PDU_ADASLR_PROFILE_LONG_AR,1,1);
}

callback_ADASLR_PROFILE_LONG_ARADASLR_ProfLong_PathIdx_RestA (double value)
{
	PDU_ADASLR_PROFILE_LONG_AR.ADASLR_ProfLong_PathIdx_RestA.phys = value;
	frUpdatePDU(PDU_ADASLR_PROFILE_LONG_AR,1,1);
}

callback_ADASLR_PROFILE_LONG_ARADASLR_ProfLong_CycCnt_RestA (double value)
{
	PDU_ADASLR_PROFILE_LONG_AR.ADASLR_ProfLong_CycCnt_RestA.phys = value;
	frUpdatePDU(PDU_ADASLR_PROFILE_LONG_AR,1,1);
}

callback_ADASLR_PROFILE_LONG_ARADASLR_ProfLong_Updt_RestA (double value)
{
	PDU_ADASLR_PROFILE_LONG_AR.ADASLR_ProfLong_Updt_RestA.phys = value;
	frUpdatePDU(PDU_ADASLR_PROFILE_LONG_AR,1,1);
}

callback_ADASLR_PROFILE_LONG_ARADASLR_ProfLong_ReTr_RestA (double value)
{
	PDU_ADASLR_PROFILE_LONG_AR.ADASLR_ProfLong_ReTr_RestA.phys = value;
	frUpdatePDU(PDU_ADASLR_PROFILE_LONG_AR,1,1);
}

callback_ADASLR_PROFILE_LONG_ARADASLR_ProfLong_CtrlPnt_RestA (double value)
{
	PDU_ADASLR_PROFILE_LONG_AR.ADASLR_ProfLong_CtrlPnt_RestA.phys = value;
	frUpdatePDU(PDU_ADASLR_PROFILE_LONG_AR,1,1);
}

callback_ADASLR_PROFILE_LONG_ARADASLR_ProfLong_Val_RestA (double value)
{
	PDU_ADASLR_PROFILE_LONG_AR.ADASLR_ProfLong_Val_RestA.phys = value;
	frUpdatePDU(PDU_ADASLR_PROFILE_LONG_AR,1,1);
}

callback_ADASLR_PROFILE_LONG_ARADASLR_ProfLong_MsgTyp_PTData (double value)
{
	PDU_ADASLR_PROFILE_LONG_AR.ADASLR_ProfLong_MsgTyp_PTData.phys = value;
	frUpdatePDU(PDU_ADASLR_PROFILE_LONG_AR,1,1);
}

callback_ADASLR_PROFILE_LONG_ARADASLR_ProfLong_Offset_PTData (double value)
{
	PDU_ADASLR_PROFILE_LONG_AR.ADASLR_ProfLong_Offset_PTData.phys = value;
	frUpdatePDU(PDU_ADASLR_PROFILE_LONG_AR,1,1);
}

callback_ADASLR_PROFILE_LONG_ARADASLR_ProfLong_PathIdx_PTData (double value)
{
	PDU_ADASLR_PROFILE_LONG_AR.ADASLR_ProfLong_PathIdx_PTData.phys = value;
	frUpdatePDU(PDU_ADASLR_PROFILE_LONG_AR,1,1);
}

callback_ADASLR_PROFILE_LONG_ARADASLR_ProfLong_CycCnt_PTData (double value)
{
	PDU_ADASLR_PROFILE_LONG_AR.ADASLR_ProfLong_CycCnt_PTData.phys = value;
	frUpdatePDU(PDU_ADASLR_PROFILE_LONG_AR,1,1);
}

callback_ADASLR_PROFILE_LONG_ARADASLR_ProfLong_Updt_PTData (double value)
{
	PDU_ADASLR_PROFILE_LONG_AR.ADASLR_ProfLong_Updt_PTData.phys = value;
	frUpdatePDU(PDU_ADASLR_PROFILE_LONG_AR,1,1);
}

callback_ADASLR_PROFILE_LONG_ARADASLR_ProfLong_ReTr_PTData (double value)
{
	PDU_ADASLR_PROFILE_LONG_AR.ADASLR_ProfLong_ReTr_PTData.phys = value;
	frUpdatePDU(PDU_ADASLR_PROFILE_LONG_AR,1,1);
}

callback_ADASLR_PROFILE_LONG_ARADASLR_ProfLong_CtrlPnt_PTData (double value)
{
	PDU_ADASLR_PROFILE_LONG_AR.ADASLR_ProfLong_CtrlPnt_PTData.phys = value;
	frUpdatePDU(PDU_ADASLR_PROFILE_LONG_AR,1,1);
}

callback_ADASLR_PROFILE_LONG_ARADASLR_ProfLong_Val_AttrOfst_PTData (double value)
{
	PDU_ADASLR_PROFILE_LONG_AR.ADASLR_ProfLong_Val_AttrOfst_PTData.phys = value;
	frUpdatePDU(PDU_ADASLR_PROFILE_LONG_AR,1,1);
}

callback_ADASLR_PROFILE_LONG_ARADASLR_ProfLong_Val_ComRtNum_PTData (double value)
{
	PDU_ADASLR_PROFILE_LONG_AR.ADASLR_ProfLong_Val_ComRtNum_PTData.phys = value;
	frUpdatePDU(PDU_ADASLR_PROFILE_LONG_AR,1,1);
}

callback_ADASLR_PROFILE_LONG_ARADASLR_ProfLong_Val_PTData (double value)
{
	PDU_ADASLR_PROFILE_LONG_AR.ADASLR_ProfLong_Val_PTData.phys = value;
	frUpdatePDU(PDU_ADASLR_PROFILE_LONG_AR,1,1);
}

callback_ADASLR_PROFILE_LONG_ARADASLR_ProfLong_Val_AttrId_PTData (double value)
{
	PDU_ADASLR_PROFILE_LONG_AR.ADASLR_ProfLong_Val_AttrId_PTData.phys = value;
	frUpdatePDU(PDU_ADASLR_PROFILE_LONG_AR,1,1);
}

callback_ADASLR_PROFILE_LONG_ARADASLR_ProfLong_ProfTyp (double value)
{
	PDU_ADASLR_PROFILE_LONG_AR.ADASLR_ProfLong_ProfTyp.phys = value;
	frUpdatePDU(PDU_ADASLR_PROFILE_LONG_AR,1,1);
}

callback_TC_Distance_ARTC_GasFuelTankLvl (double value)
{
	PDU_TC_Distance_AR.TC_GasFuelTankLvl.phys = value;
	frUpdatePDU(PDU_TC_Distance_AR,1,1);
}

callback_TC_Distance_ARTC_GasFuelDist_Reset (double value)
{
	PDU_TC_Distance_AR.TC_GasFuelDist_Reset.phys = value;
	frUpdatePDU(PDU_TC_Distance_AR,1,1);
}

callback_TC_Distance_ARTC_GasFuelDist_Start (double value)
{
	PDU_TC_Distance_AR.TC_GasFuelDist_Start.phys = value;
	frUpdatePDU(PDU_TC_Distance_AR,1,1);
}

callback_TC_Distance_ARTC_LiquidFuelRefillEvent_Dtct (double value)
{
	PDU_TC_Distance_AR.TC_LiquidFuelRefillEvent_Dtct.phys = value;
	frUpdatePDU(PDU_TC_Distance_AR,1,1);
}

callback_TC_Distance_ARTC_LiquidFuelTankLvl (double value)
{
	PDU_TC_Distance_AR.TC_LiquidFuelTankLvl.phys = value;
	frUpdatePDU(PDU_TC_Distance_AR,1,1);
}

callback_TC_Distance_ARTC_LiquidFuelDist_Reset (double value)
{
	PDU_TC_Distance_AR.TC_LiquidFuelDist_Reset.phys = value;
	frUpdatePDU(PDU_TC_Distance_AR,1,1);
}

callback_TC_Distance_ARTC_LiquidFuelDist_Start (double value)
{
	PDU_TC_Distance_AR.TC_LiquidFuelDist_Start.phys = value;
	frUpdatePDU(PDU_TC_Distance_AR,1,1);
}

callback_TC_Distance_ARTC_ElecEnergyDist_Reset (double value)
{
	PDU_TC_Distance_AR.TC_ElecEnergyDist_Reset.phys = value;
	frUpdatePDU(PDU_TC_Distance_AR,1,1);
}

callback_TC_Distance_ARTC_ElecEnergyDist_Start (double value)
{
	PDU_TC_Distance_AR.TC_ElecEnergyDist_Start.phys = value;
	frUpdatePDU(PDU_TC_Distance_AR,1,1);
}

callback_TC_Distance_ARTC_FuelType_TC_DIST (double value)
{
	PDU_TC_Distance_AR.TC_FuelType_TC_DIST.phys = value;
	frUpdatePDU(PDU_TC_Distance_AR,1,1);
}
on frPDU MsgChannel1.CHASSIS::ActvComf_Rq_AR2
{
}

on frPDU MsgChannel1.CHASSIS::ADAS_CURRENT_ATTRIBUTES_AR
{
}

on frPDU MsgChannel1.CHASSIS::ADAS_POSITION_AR
{
}

on frPDU MsgChannel1.CHASSIS::ADAS_PREDICTION_AR
{
}

on frPDU MsgChannel1.CHASSIS::ADAS_PROFILE_LONG_AR
{
}

on frPDU MsgChannel1.CHASSIS::ADAS_PROFILE_SHORT_AR
{
}

on frPDU MsgChannel1.CHASSIS::ADASLR_POSITION_AR
{
}

on frPDU MsgChannel1.CHASSIS::ADASLR_PROFILE_LONG_AR
{
}

on frPDU MsgChannel1.CHASSIS::Assyst_Rq_AR2
{
}

on frPDU MsgChannel1.CHASSIS::BC_F_Disp_Rq_AR
{
}

on frPDU MsgChannel1.CHASSIS::BC_F_Stat1_AR
{
}

on frPDU MsgChannel1.CHASSIS::BC_F_Stat2_AR2
{
}

on frPDU MsgChannel1.CHASSIS::BC_R_Stat1_AR
{
}

on frPDU MsgChannel1.CHASSIS::BLSM_Disp_Stat_AR
{
}

on frPDU MsgChannel1.CHASSIS::BODY_CHASSIS_R1_AR
{
}

on frPDU MsgChannel1.CHASSIS::BSM_Disp_Warn_Rq_AR2
{
}

on frPDU MsgChannel1.CHASSIS::CamLane_Disp_Warn_Rq_AR2
{
}

on frPDU MsgChannel1.CHASSIS::CamLane_LaneAttr1_AR2
{
}

on frPDU MsgChannel1.CHASSIS::CamLane_LaneAttr2_AR2
{
}

on frPDU MsgChannel1.CHASSIS::CamLane_LaneAttr3_AR2
{
}

on frPDU MsgChannel1.CHASSIS::CamLane_LaneAttr6_AR2
{
}

on frPDU MsgChannel1.CHASSIS::CamLane_LaneAttr7_AR2
{
}

on frPDU MsgChannel1.CHASSIS::CLkS_Rq_AR
{
}

on frPDU MsgChannel1.CHASSIS::CLkS_State_AR
{
}

on frPDU MsgChannel1.CHASSIS::ClockSync_Stat_FR2
{
}

on frPDU MsgChannel1.CHASSIS::CMS_PI_State_Gw_AR2
{
}

on frPDU MsgChannel1.CHASSIS::Config_HU4_AR2
{
}

on frPDU MsgChannel1.CHASSIS::Config_HU5_AR2
{
}

on frPDU MsgChannel1.CHASSIS::CRCM_Stat_AR
{
}

on frPDU MsgChannel1.CHASSIS::CTRL_C_Stat1_AR
{
	if (@sysvar::CH_Nodes::CH_EISOnKey_PsdCTRL_C_St_UB_AUTO == 0)
	{
		if ($OnKey_Psd != OldVal_OnKey_Psd)
		{
			DisturbUB("CTRL_C_Stat1_AR", "OnKey_Psd_UB", 1, 1);
			OldVal_OnKey_Psd = $OnKey_Psd;
		}
		else
		{
			DisturbUB("CTRL_C_Stat1_AR", "OnKey_Psd_UB", -1, 0);
		}
	}	if (@sysvar::CH_Nodes::CH_EISPhoneKey_PsdCTRL_C_UB_AUTO == 0)
	{
		if ($PhoneKey_Psd != OldVal_PhoneKey_Psd)
		{
			DisturbUB("CTRL_C_Stat1_AR", "PhoneKey_Psd_UB", 1, 1);
			OldVal_PhoneKey_Psd = $PhoneKey_Psd;
		}
		else
		{
			DisturbUB("CTRL_C_Stat1_AR", "PhoneKey_Psd_UB", -1, 0);
		}
	}	if (@sysvar::CH_Nodes::CH_EISRadioKey_PsdCTRL_C_UB_AUTO == 0)
	{
		if ($RadioKey_Psd != OldVal_RadioKey_Psd)
		{
			DisturbUB("CTRL_C_Stat1_AR", "RadioKey_Psd_UB", 1, 1);
			OldVal_RadioKey_Psd = $RadioKey_Psd;
		}
		else
		{
			DisturbUB("CTRL_C_Stat1_AR", "RadioKey_Psd_UB", -1, 0);
		}
	}	if (@sysvar::CH_Nodes::CH_EISSeatKey_PsdCTRL_C__UB_AUTO == 0)
	{
		if ($SeatKey_Psd != OldVal_SeatKey_Psd)
		{
			DisturbUB("CTRL_C_Stat1_AR", "SeatKey_Psd_UB", 1, 1);
			OldVal_SeatKey_Psd = $SeatKey_Psd;
		}
		else
		{
			DisturbUB("CTRL_C_Stat1_AR", "SeatKey_Psd_UB", -1, 0);
		}
	}	if (@sysvar::CH_Nodes::CH_EISNaviKey_PsdCTRL_C__UB_AUTO == 0)
	{
		if ($NaviKey_Psd != OldVal_NaviKey_Psd)
		{
			DisturbUB("CTRL_C_Stat1_AR", "NaviKey_Psd_UB", 1, 1);
			OldVal_NaviKey_Psd = $NaviKey_Psd;
		}
		else
		{
			DisturbUB("CTRL_C_Stat1_AR", "NaviKey_Psd_UB", -1, 0);
		}
	}	if (@sysvar::CH_Nodes::CH_EISMediaKey_PsdCTRL_C_UB_AUTO == 0)
	{
		if ($MediaKey_Psd != OldVal_MediaKey_Psd)
		{
			DisturbUB("CTRL_C_Stat1_AR", "MediaKey_Psd_UB", 1, 1);
			OldVal_MediaKey_Psd = $MediaKey_Psd;
		}
		else
		{
			DisturbUB("CTRL_C_Stat1_AR", "MediaKey_Psd_UB", -1, 0);
		}
	}	if (@sysvar::CH_Nodes::CH_EISCarKey_PsdCTRL_C_S_UB_AUTO == 0)
	{
		if ($CarKey_Psd != OldVal_CarKey_Psd)
		{
			DisturbUB("CTRL_C_Stat1_AR", "CarKey_Psd_UB", 1, 1);
			OldVal_CarKey_Psd = $CarKey_Psd;
		}
		else
		{
			DisturbUB("CTRL_C_Stat1_AR", "CarKey_Psd_UB", -1, 0);
		}
	}	if (@sysvar::CH_Nodes::CH_EISReturnKey_PsdCTRL__UB_AUTO == 0)
	{
		if ($ReturnKey_Psd != OldVal_ReturnKey_Psd)
		{
			DisturbUB("CTRL_C_Stat1_AR", "ReturnKey_Psd_UB", 1, 1);
			OldVal_ReturnKey_Psd = $ReturnKey_Psd;
		}
		else
		{
			DisturbUB("CTRL_C_Stat1_AR", "ReturnKey_Psd_UB", -1, 0);
		}
	}	if (@sysvar::CH_Nodes::CH_EISMenuKey_PsdCTRL_C__UB_AUTO == 0)
	{
		if ($MenuKey_Psd != OldVal_MenuKey_Psd)
		{
			DisturbUB("CTRL_C_Stat1_AR", "MenuKey_Psd_UB", 1, 1);
			OldVal_MenuKey_Psd = $MenuKey_Psd;
		}
		else
		{
			DisturbUB("CTRL_C_Stat1_AR", "MenuKey_Psd_UB", -1, 0);
		}
	}	if (@sysvar::CH_Nodes::CH_EISMuteKey_PsdCTRL_C__UB_AUTO == 0)
	{
		if ($MuteKey_Psd != OldVal_MuteKey_Psd)
		{
			DisturbUB("CTRL_C_Stat1_AR", "MuteKey_Psd_UB", 1, 1);
			OldVal_MuteKey_Psd = $MuteKey_Psd;
		}
		else
		{
			DisturbUB("CTRL_C_Stat1_AR", "MuteKey_Psd_UB", -1, 0);
		}
	}}

on frPDU MsgChannel1.CHASSIS::DAC4_ECM_AR
{
}

on frPDU MsgChannel1.CHASSIS::DAC4_EM2_AR
{
}

on frPDU MsgChannel1.CHASSIS::DAC4_ISM_AR
{
}

on frPDU MsgChannel1.CHASSIS::DAC4_TCM_AR
{
}

on frPDU MsgChannel1.CHASSIS::Dimming_Stat_AR2
{
}

on frPDU MsgChannel1.CHASSIS::Door_FL_Stat_AR2
{
}

on frPDU MsgChannel1.CHASSIS::Door_FR_Stat_AR2
{
}

on frPDU MsgChannel1.CHASSIS::Door_RL_Stat_AR2
{
}

on frPDU MsgChannel1.CHASSIS::Door_RR_Stat_AR2
{
}

on frPDU MsgChannel1.CHASSIS::DPC_IndMd_Rq_AR
{
}

on frPDU MsgChannel1.CHASSIS::EAC_Stat_AR
{
}

on frPDU MsgChannel1.CHASSIS::EL_Stat_AR2
{
}

on frPDU MsgChannel1.CHASSIS::EL_TurnInd_Rq_AR2
{
}

on frPDU MsgChannel1.CHASSIS::EPKB_Stat_AR2
{
}

on frPDU MsgChannel1.CHASSIS::EVC_CfgBit_01_32_AR2
{
}

on frPDU MsgChannel1.CHASSIS::EVC_CfgBit_33_64_AR2
{
}

on frPDU MsgChannel1.CHASSIS::EVC_CfgBit_65_96_AR2
{
}

on frPDU MsgChannel1.CHASSIS::EVC_CfgBit_97_C8_AR2
{
}

on frPDU MsgChannel1.CHASSIS::EVC_CfgList_01_0C_AR2
{
}

on frPDU MsgChannel1.CHASSIS::FCW_Disp_Rq_AR
{
}

on frPDU MsgChannel1.CHASSIS::HMI_CHASSIS_R1_AR2
{
	if (@sysvar::CH_Nodes::CH_EISPark_Disp_StatHMI__UB_AUTO == 0)
	{
		if ($Park_Disp_Stat != OldVal_Park_Disp_Stat)
		{
			DisturbUB("HMI_CHASSIS_R1_AR2", "Park_Disp_Stat_UB", 1, 1);
			OldVal_Park_Disp_Stat = $Park_Disp_Stat;
		}
		else
		{
			DisturbUB("HMI_CHASSIS_R1_AR2", "Park_Disp_Stat_UB", -1, 0);
		}
	}}

on frPDU MsgChannel1.CHASSIS::HU_Comf_Rq_AR2
{
}

on frPDU MsgChannel1.CHASSIS::HU_State_AR
{
}

on frPDU MsgChannel1.CHASSIS::HVAC_Disp_Stat1_AR
{
}

on frPDU MsgChannel1.CHASSIS::HVAC_OBD_DTC_AR
{
}

on frPDU MsgChannel1.CHASSIS::HVAC_Rs2_AR
{
}

on frPDU MsgChannel1.CHASSIS::HVAC_Rs3_AR2
{
}

on frPDU MsgChannel1.CHASSIS::HVAC_Rs_AR2
{
}

on frPDU MsgChannel1.CHASSIS::HVAC_State1_AR
{
}

on frPDU MsgChannel1.CHASSIS::IC_BasicInfo_AR2
{
}

on frPDU MsgChannel1.CHASSIS::IC_DriveAssistSys_AR2
{
}

on frPDU MsgChannel1.CHASSIS::IC_Settings_AR2
{
}

on frPDU MsgChannel1.CHASSIS::ICH_Stat_AR
{
}

on frPDU MsgChannel1.CHASSIS::Ign_Veh_Stat_AR2
{
}

on frPDU MsgChannel1.CHASSIS::IHC_Lgt_Stat_HLI_2_AR2
{
}

on frPDU MsgChannel1.CHASSIS::IHC_Lgt_Stat_HLI_AR2
{
}

on frPDU MsgChannel1.CHASSIS::KG_State_AR2
{
}

on frPDU MsgChannel1.CHASSIS::LDC_Disp_Stat_IC_AR2
{
}

on frPDU MsgChannel1.CHASSIS::LgtSens_State_AR
{
}

on frPDU MsgChannel1.CHASSIS::Mirr_Adj_Lt_Rq_AR
{
}

on frPDU MsgChannel1.CHASSIS::Mirr_Adj_Rt_Rq_AR
{
}

on frPDU MsgChannel1.CHASSIS::NAVI_Pos1_AR
{
}

on frPDU MsgChannel1.CHASSIS::NAVI_Pos2_AR
{
}

on frPDU MsgChannel1.CHASSIS::NAVI_Pos3_AR
{
}

on frPDU MsgChannel1.CHASSIS::NAVI_Pos4_AR
{
}

on frPDU MsgChannel1.CHASSIS::NAVI_Pos5_AR
{
}

on frPDU MsgChannel1.CHASSIS::NVP_Stat1_AR2
{
}

on frPDU MsgChannel1.CHASSIS::OHCM_Stat_AR2
{
}

on frPDU MsgChannel1.CHASSIS::ORC_Disp_Stat_AR2
{
}

on frPDU MsgChannel1.CHASSIS::ORC_Impact_AR2
{
}

on frPDU MsgChannel1.CHASSIS::Park_Disp_Rs_AR2
{
}

on frPDU MsgChannel1.CHASSIS::PHB_IHC_Plus_Tunnel_3_4_AR2
{
}

on frPDU MsgChannel1.CHASSIS::PHB_IHC_Plus_Tunnel_AR2
{
}

on frPDU MsgChannel1.CHASSIS::PN14_Disp_Rq_AR
{
}

on frPDU MsgChannel1.CHASSIS::PN14_Rs1_AR2
{
}

on frPDU MsgChannel1.CHASSIS::PN14_Rs2_AR
{
}

on frPDU MsgChannel1.CHASSIS::PN14_Stat2_AR2
{
}

on frPDU MsgChannel1.CHASSIS::PN14_Stat_AR
{
}

on frPDU MsgChannel1.CHASSIS::PN48_Bat_Stat2_AR2
{
}

on frPDU MsgChannel1.CHASSIS::PN48_Bat_Stat_AR
{
}

on frPDU MsgChannel1.CHASSIS::PN48_BatLim_Stat_AR
{
}

on frPDU MsgChannel1.CHASSIS::PN48_DCDC48_LISB48_Stat_AR
{
}

on frPDU MsgChannel1.CHASSIS::PN48_Stat_AR
{
}

on frPDU MsgChannel1.CHASSIS::PNHV_WeekDepTmTbl_Rq_HU_AR2
{
}

on frPDU MsgChannel1.CHASSIS::PreCond_On_Rq_AR
{
}

on frPDU MsgChannel1.CHASSIS::PreCond_Rq_HU_AR2
{
}

on frPDU MsgChannel1.CHASSIS::PreCond_Stat_AR
{
}

on frPDU MsgChannel1.CHASSIS::PT_ObjIntrst_Gw_AR2
{
}

on frPDU MsgChannel1.CHASSIS::RemPark_Auth_Rs_AR2
{
}

on frPDU MsgChannel1.CHASSIS::RemPark_Stat_EIS_AR2
{
}

on frPDU MsgChannel1.CHASSIS::RTC_Date_Time_AR2
{
}

on frPDU MsgChannel1.CHASSIS::RTC_Stat1_AR2
{
}

on frPDU MsgChannel1.CHASSIS::SADR_Trgr_FCW_AR2
{
}

on frPDU MsgChannel1.CHASSIS::SeatAdj_FL_Rq_AR
{
}

on frPDU MsgChannel1.CHASSIS::SeatAdj_FR_Rq_AR
{
}

on frPDU MsgChannel1.CHASSIS::SPCR_Stat_BC_F_AR2
{
}

on frPDU MsgChannel1.CHASSIS::SPL_Obj1_Obj2_NV_AR2
{
}

on frPDU MsgChannel1.CHASSIS::SPV_Actn_Rq_AR2
{
}

on frPDU MsgChannel1.CHASSIS::SPV_Alm_Rq_AR
{
}

on frPDU MsgChannel1.CHASSIS::SPV_Stat_AR2
{
}

on frPDU MsgChannel1.CHASSIS::SVS_Rq_HU_AR2
{
}

on frPDU MsgChannel1.CHASSIS::TBCSC_DAC_EPS_AR2
{
}

on frPDU MsgChannel1.CHASSIS::TBCSC_DAC_ESP_AR2
{
}

on frPDU MsgChannel1.CHASSIS::TBCSC_Hi_Rq1_AR2
{
}

on frPDU MsgChannel1.CHASSIS::TBCSC_Hi_Rq2_AR2
{
}

on frPDU MsgChannel1.CHASSIS::TBCSC_Lo_Rq1_AR2
{
}

on frPDU MsgChannel1.CHASSIS::TBCSC_Lo_Rq2_AR2
{
}

on frPDU MsgChannel1.CHASSIS::TC_Distance_AR
{
}

on frPDU MsgChannel1.CHASSIS::TGW_DateTm_Stat_AR
{
}

on frPDU MsgChannel1.CHASSIS::Tire_State_AR2
{
}

on frPDU MsgChannel1.CHASSIS::TrafficInfo_AR
{
}

on frPDU MsgChannel1.CHASSIS::Trailer_Stat_AR2
{
}

on frPDU MsgChannel1.CHASSIS::TSA_Disp_Rq1_AR2
{
}

on frPDU MsgChannel1.CHASSIS::TSA_Disp_Rq2_AR
{
}

on frPDU MsgChannel1.CHASSIS::TSA_Disp_Rq3_AR
{
}

on frPDU MsgChannel1.CHASSIS::VehAccel_X_Rq_Gw_AR2
{
}

on frPDU MsgChannel1.CHASSIS::VIN_AR
{
}

on frPDU MsgChannel1.CHASSIS::Wiper_Stat_AR
{
}

on frPDU MsgChannel1.CHASSIS::WUDOP_EIS_FR
{
}

on frPDU MsgChannel1.CHASSIS::YMAS_Rq_MPC_AR2
{
}

on signal Ign_Veh_Stat_AR2::ISw_Stat
{
	if ($Ign_Veh_Stat_AR2::ISw_Stat == 4)
	{
		$Ign_Veh_Stat_AR2::Ign_On_StartProc_Inact = 1;
	}
	else
	{
		$Ign_Veh_Stat_AR2::Ign_On_StartProc_Inact = 0;
	}
}

