/*@@includes:*/
includes
{
	#include "ASR_FR_NM_IL.CIN"
}
/*@@end*/

/*@@var:*/
/*
|==========================================================================================|
|                                                                                          |
|                                                                                          |
|                                         COPYRIGHT                                        |
|                                                                                          |
|                   Copyright (c) by Daimler AG Abt. RD/EEV 2015                           |
|                                                                                          |
|                                                                                          |
|==========================================================================================|
|                                                                                          |
|                                   CAPL AUTHOR IDENTITY                                   |
|                                   --------------------                                   |
|                                                                                          |
| Initials   | Name                 | Company                                              |
| -----------+----------------------+----------------------------------------------------- |
| BH         | Björn Haßelkus       | Firma TZM (EXTERN im Auftrag der Daimler AG)         |
| RS         | Rainer Schulte       | Firma TZM (EXTERN im Auftrag der Daimler AG)         |
|            |                      |                                                      |
|                                                                                          |
|==========================================================================================|
|                                                                                          |
|                                     REVISION HISTORY                                     |
|                                     ----------------                                     |
|                                                                                          |
| Date       | Ver   | Author       | Description                                          |
| -----------+-------+--------------+----------------------------------------------------- |
| 27.04.15   | 1.0   | RS           | creation                                             |
|            |       |              |                                                      |
|                                                                                          |
|------------------------------------------------------------------------------------------|
*/

variables
{
	long ret_Register;
	// global variable for getting (showing) results auf dll-Functions
	long result;

	int CRC_Cam_Stat_Pr2;
	dword CounterValForCRC_Cam_Stat_Pr2;
	int SQC_VAL_Cam_Stat_Pr2;
	int SQC_Cam_Stat_Pr2;
	int CRC_CamLane_Disp_Warn_Rq_Pr2;
	dword CounterValForCRC_CamLane_Disp_Warn_Rq_Pr2;
	int SQC_VAL_CamLane_Disp_Warn_Rq_Pr2;
	int SQC_CamLane_Disp_Warn_Rq_Pr2;
	int CRC_CamLane_FastAttr1_Pr2;
	dword CounterValForCRC_CamLane_FastAttr1_Pr2;
	int SQC_VAL_CamLane_FastAttr1_Pr2;
	int SQC_CamLane_FastAttr1_Pr2;
	int CRC_CamLane_FastAttr2_Pr2;
	dword CounterValForCRC_CamLane_FastAttr2_Pr2;
	int SQC_VAL_CamLane_FastAttr2_Pr2;
	int SQC_CamLane_FastAttr2_Pr2;
	int CRC_CamLane_LaneAttr1_Pr2;
	dword CounterValForCRC_CamLane_LaneAttr1_Pr2;
	int SQC_VAL_CamLane_LaneAttr1_Pr2;
	int SQC_CamLane_LaneAttr1_Pr2;
	int CRC_CamLane_LaneAttr2_Pr2;
	dword CounterValForCRC_CamLane_LaneAttr2_Pr2;
	int SQC_VAL_CamLane_LaneAttr2_Pr2;
	int SQC_CamLane_LaneAttr2_Pr2;
	int CRC_CamLane_LaneAttr3_Pr2;
	dword CounterValForCRC_CamLane_LaneAttr3_Pr2;
	int SQC_VAL_CamLane_LaneAttr3_Pr2;
	int SQC_CamLane_LaneAttr3_Pr2;
	int CRC_CamLane_LaneAttr4_Pr2;
	dword CounterValForCRC_CamLane_LaneAttr4_Pr2;
	int SQC_VAL_CamLane_LaneAttr4_Pr2;
	int SQC_CamLane_LaneAttr4_Pr2;
	int CRC_CamLane_LaneAttr5_Pr2;
	dword CounterValForCRC_CamLane_LaneAttr5_Pr2;
	int SQC_VAL_CamLane_LaneAttr5_Pr2;
	int SQC_CamLane_LaneAttr5_Pr2;
	int CRC_CamLane_LaneAttr6_Pr2;
	dword CounterValForCRC_CamLane_LaneAttr6_Pr2;
	int SQC_VAL_CamLane_LaneAttr6_Pr2;
	int SQC_CamLane_LaneAttr6_Pr2;
	int CRC_CamLane_LaneAttr7_Pr2;
	dword CounterValForCRC_CamLane_LaneAttr7_Pr2;
	int SQC_VAL_CamLane_LaneAttr7_Pr2;
	int SQC_CamLane_LaneAttr7_Pr2;
	int CRC_CamObj_A_Mtn_Pr2;
	dword CounterValForCRC_CamObj_A_Mtn_Pr2;
	int SQC_VAL_CamObj_A_Mtn_Pr2;
	int SQC_CamObj_A_Mtn_Pr2;
	int CRC_CamObj_A_Posn_Pr2;
	dword CounterValForCRC_CamObj_A_Posn_Pr2;
	int SQC_VAL_CamObj_A_Posn_Pr2;
	int SQC_CamObj_A_Posn_Pr2;
	int CRC_CamObj_B_Mtn_Pr2;
	dword CounterValForCRC_CamObj_B_Mtn_Pr2;
	int SQC_VAL_CamObj_B_Mtn_Pr2;
	int SQC_CamObj_B_Mtn_Pr2;
	int CRC_CamObj_B_Posn_Pr2;
	dword CounterValForCRC_CamObj_B_Posn_Pr2;
	int SQC_VAL_CamObj_B_Posn_Pr2;
	int SQC_CamObj_B_Posn_Pr2;
	int CRC_CamObj_C_Mtn_Pr2;
	dword CounterValForCRC_CamObj_C_Mtn_Pr2;
	int SQC_VAL_CamObj_C_Mtn_Pr2;
	int SQC_CamObj_C_Mtn_Pr2;
	int CRC_CamObj_C_Posn_Pr2;
	dword CounterValForCRC_CamObj_C_Posn_Pr2;
	int SQC_VAL_CamObj_C_Posn_Pr2;
	int SQC_CamObj_C_Posn_Pr2;
	int CRC_IHC_Lgt_Stat_MPC_Pr2;
	dword CounterValForCRC_IHC_Lgt_Stat_MPC_Pr2;
	int SQC_VAL_IHC_Lgt_Stat_MPC_Pr2;
	int SQC_IHC_Lgt_Stat_MPC_Pr2;
	int CRC_IHC_Plus_HL_Stat_Pr2;
	dword CounterValForCRC_IHC_Plus_HL_Stat_Pr2;
	int SQC_VAL_IHC_Plus_HL_Stat_Pr2;
	int SQC_IHC_Plus_HL_Stat_Pr2;
	int CRC_IHC_Plus_Tunnel_3_4_Pr2;
	dword CounterValForCRC_IHC_Plus_Tunnel_3_4_Pr2;
	int SQC_VAL_IHC_Plus_Tunnel_3_4_Pr2;
	int SQC_IHC_Plus_Tunnel_3_4_Pr2;
	int CRC_IHC_Plus_Tunnel_Pr2;
	dword CounterValForCRC_IHC_Plus_Tunnel_Pr2;
	int SQC_VAL_IHC_Plus_Tunnel_Pr2;
	int SQC_IHC_Plus_Tunnel_Pr2;
	int CRC_Preview_Header1_Pr2;
	dword CounterValForCRC_Preview_Header1_Pr2;
	int SQC_VAL_Preview_Header1_Pr2;
	int SQC_Preview_Header1_Pr2;
	int CRC_Preview_Header2_Pr2;
	dword CounterValForCRC_Preview_Header2_Pr2;
	int SQC_VAL_Preview_Header2_Pr2;
	int SQC_Preview_Header2_Pr2;
	int CRC_Preview_ProfData1_Pr2;
	dword CounterValForCRC_Preview_ProfData1_Pr2;
	int SQC_VAL_Preview_ProfData1_Pr2;
	int SQC_Preview_ProfData1_Pr2;
	int CRC_Preview_ProfData2_Pr2;
	dword CounterValForCRC_Preview_ProfData2_Pr2;
	int SQC_VAL_Preview_ProfData2_Pr2;
	int SQC_Preview_ProfData2_Pr2;
	int CRC_SPL_Obj1_Obj2_MPC_Pr2;
	dword CounterValForCRC_SPL_Obj1_Obj2_MPC_Pr2;
	int SQC_VAL_SPL_Obj1_Obj2_MPC_Pr2;
	int SQC_SPL_Obj1_Obj2_MPC_Pr2;
	int CRC_YMAS_Rq_MPC_Pr2;
	dword CounterValForCRC_YMAS_Rq_MPC_Pr2;
	int SQC_VAL_YMAS_Rq_MPC_Pr2;
	int SQC_YMAS_Rq_MPC_Pr2;

	msTimer Timer_MPC_Cam_Stat_AR2;
	msTimer Timer_MPC_CamLane_Disp_Warn_Rq_Gw_AR2;
	msTimer Timer_MPC_CamLane_FastAttr1_FR2;
	msTimer Timer_MPC_CamLane_FastAttr2_FR2;
	msTimer Timer_MPC_CamLane_LaneAttr1_Gw_AR2;
	msTimer Timer_MPC_CamLane_LaneAttr2_Gw_AR2;
	msTimer Timer_MPC_CamLane_LaneAttr3_Gw_AR2;
	msTimer Timer_MPC_CamLane_LaneAttr4_FR2;
	msTimer Timer_MPC_CamLane_LaneAttr5_FR2;
	msTimer Timer_MPC_CamLane_LaneAttr6_Gw_AR2;
	msTimer Timer_MPC_CamLane_LaneAttr7_Gw_AR2;
	msTimer Timer_MPC_CamObj_A_Mtn_FR2;
	msTimer Timer_MPC_CamObj_A_Posn_FR2;
	msTimer Timer_MPC_CamObj_B_Mtn_FR2;
	msTimer Timer_MPC_CamObj_B_Posn_FR2;
	msTimer Timer_MPC_CamObj_C_Mtn_FR2;
	msTimer Timer_MPC_CamObj_C_Posn_FR2;
	msTimer Timer_MPC_IHC_Lgt_Stat_MPC_Gw_AR2;
	msTimer Timer_MPC_IHC_Plus_HL_Stat_AR2;
	msTimer Timer_MPC_IHC_Plus_Tunnel_3_4_AR2;
	msTimer Timer_MPC_IHC_Plus_Tunnel_AR2;
	msTimer Timer_MPC_Preview_Header1_FR2;
	msTimer Timer_MPC_Preview_Header2_FR2;
	msTimer Timer_MPC_Preview_ProfData1_FR2;
	msTimer Timer_MPC_Preview_ProfData2_FR2;
	msTimer Timer_MPC_ROE_SMPC;
	msTimer Timer_MPC_SPL_Obj1_Obj2_MPC_AR2;
	msTimer Timer_MPC_TSA_Disp_Rq1_Gw_AR2;
	msTimer Timer_MPC_TSA_Disp_Rq2_Gw_AR;
	msTimer Timer_MPC_TSA_Disp_Rq3_Gw_AR;
	msTimer Timer_MPC_YMAS_Rq_MPC_Gw_AR2;

   byte  crctable[256] = {
      0x00, 0x1D, 0x3A, 0x27, 0x74, 0x69, 0x4E, 0x53,
      0xE8, 0xF5, 0xD2, 0xCF, 0x9C, 0x81, 0xA6, 0xBB,
      0xCD, 0xD0, 0xF7, 0xEA, 0xB9, 0xA4, 0x83, 0x9E,
      0x25, 0x38, 0x1F, 0x02, 0x51, 0x4C, 0x6B, 0x76,
      0x87, 0x9A, 0xBD, 0xA0, 0xF3, 0xEE, 0xC9, 0xD4,
      0x6F, 0x72, 0x55, 0x48, 0x1B, 0x06, 0x21, 0x3C,
      0x4A, 0x57, 0x70, 0x6D, 0x3E, 0x23, 0x04, 0x19,
      0xA2, 0xBF, 0x98, 0x85, 0xD6, 0xCB, 0xEC, 0xF1,
      0x13, 0x0E, 0x29, 0x34, 0x67, 0x7A, 0x5D, 0x40,
      0xFB, 0xE6, 0xC1, 0xDC, 0x8F, 0x92, 0xB5, 0xA8,
      0xDE, 0xC3, 0xE4, 0xF9, 0xAA, 0xB7, 0x90, 0x8D,
      0x36, 0x2B, 0x0C, 0x11, 0x42, 0x5F, 0x78, 0x65,
      0x94, 0x89, 0xAE, 0xB3, 0xE0, 0xFD, 0xDA, 0xC7,
      0x7C, 0x61, 0x46, 0x5B, 0x08, 0x15, 0x32, 0x2F,
      0x59, 0x44, 0x63, 0x7E, 0x2D, 0x30, 0x17, 0x0A,
      0xB1, 0xAC, 0x8B, 0x96, 0xC5, 0xD8, 0xFF, 0xE2,
      0x26, 0x3B, 0x1C, 0x01, 0x52, 0x4F, 0x68, 0x75,
      0xCE, 0xD3, 0xF4, 0xE9, 0xBA, 0xA7, 0x80, 0x9D,
      0xEB, 0xF6, 0xD1, 0xCC, 0x9F, 0x82, 0xA5, 0xB8,
      0x03, 0x1E, 0x39, 0x24, 0x77, 0x6A, 0x4D, 0x50,
      0xA1, 0xBC, 0x9B, 0x86, 0xD5, 0xC8, 0xEF, 0xF2,
      0x49, 0x54, 0x73, 0x6E, 0x3D, 0x20, 0x07, 0x1A,
      0x6C, 0x71, 0x56, 0x4B, 0x18, 0x05, 0x22, 0x3F,
      0x84, 0x99, 0xBE, 0xA3, 0xF0, 0xED, 0xCA, 0xD7,
      0x35, 0x28, 0x0F, 0x12, 0x41, 0x5C, 0x7B, 0x66,
      0xDD, 0xC0, 0xE7, 0xFA, 0xA9, 0xB4, 0x93, 0x8E,
      0xF8, 0xE5, 0xC2, 0xDF, 0x8C, 0x91, 0xB6, 0xAB,
      0x10, 0x0D, 0x2A, 0x37, 0x64, 0x79, 0x5E, 0x43,
      0xB2, 0xAF, 0x88, 0x95, 0xC6, 0xDB, 0xFC, 0xE1,
      0x5A, 0x47, 0x60, 0x7D, 0x2E, 0x33, 0x14, 0x09,
      0x7F, 0x62, 0x45, 0x58, 0x0B, 0x16, 0x31, 0x2C,
      0x97, 0x8A, 0xAD, 0xB0, 0xE3, 0xFE, 0xD9, 0xC4
   };

   byte  crctableProfTwo[256] = {
			0x00, 0x2F, 0x5E, 0x71, 0xBC, 0x93, 0xE2, 0xCD,
			0x57, 0x78, 0x09, 0x26, 0xEB, 0xC4, 0xB5, 0x9A,
			0xAE, 0x81, 0xF0, 0xDF, 0x12, 0x3D, 0x4C, 0x63,
			0xF9, 0xD6, 0xA7, 0x88, 0x45, 0x6A, 0x1B, 0x34,
			0x73, 0x5C, 0x2D, 0x02, 0xCF, 0xE0, 0x91, 0xBE,
			0x24, 0x0B, 0x7A, 0x55, 0x98, 0xB7, 0xC6, 0xE9,
			0xDD, 0xF2, 0x83, 0xAC, 0x61, 0x4E, 0x3F, 0x10,
			0x8A, 0xA5, 0xD4, 0xFB, 0x36, 0x19, 0x68, 0x47,
			0xE6, 0xC9, 0xB8, 0x97, 0x5A, 0x75, 0x04, 0x2B,
			0xB1, 0x9E, 0xEF, 0xC0, 0x0D, 0x22, 0x53, 0x7C,
			0x48, 0x67, 0x16, 0x39, 0xF4, 0xDB, 0xAA, 0x85,
			0x1F, 0x30, 0x41, 0x6E, 0xA3, 0x8C, 0xFD, 0xD2,
			0x95, 0xBA, 0xCB, 0xE4, 0x29, 0x06, 0x77, 0x58,
			0xC2, 0xED, 0x9C, 0xB3, 0x7E, 0x51, 0x20, 0x0F,
			0x3B, 0x14, 0x65, 0x4A, 0x87, 0xA8, 0xD9, 0xF6,
			0x6C, 0x43, 0x32, 0x1D, 0xD0, 0xFF, 0x8E, 0xA1,
			0xE3, 0xCC, 0xBD, 0x92, 0x5F, 0x70, 0x01, 0x2E,
			0xB4, 0x9B, 0xEA, 0xC5, 0x08, 0x27, 0x56, 0x79,
			0x4D, 0x62, 0x13, 0x3C, 0xF1, 0xDE, 0xAF, 0x80,
			0x1A, 0x35, 0x44, 0x6B, 0xA6, 0x89, 0xF8, 0xD7,
			0x90, 0xBF, 0xCE, 0xE1, 0x2C, 0x03, 0x72, 0x5D,
			0xC7, 0xE8, 0x99, 0xB6, 0x7B, 0x54, 0x25, 0x0A,
			0x3E, 0x11, 0x60, 0x4F, 0x82, 0xAD, 0xDC, 0xF3,
			0x69, 0x46, 0x37, 0x18, 0xD5, 0xFA, 0x8B, 0xA4,
			0x05, 0x2A, 0x5B, 0x74, 0xB9, 0x96, 0xE7, 0xC8,
			0x52, 0x7D, 0x0C, 0x23, 0xEE, 0xC1, 0xB0, 0x9F,
			0xAB, 0x84, 0xF5, 0xDA, 0x17, 0x38, 0x49, 0x66,
			0xFC, 0xD3, 0xA2, 0x8D, 0x40, 0x6F, 0x1E, 0x31,
			0x76, 0x59, 0x28, 0x07, 0xCA, 0xE5, 0x94, 0xBB,
			0x21, 0x0E, 0x7F, 0x50, 0x9D, 0xB2, 0xC3, 0xEC,
			0xD8, 0xF7, 0x86, 0xA9, 0x64, 0x4B, 0x3A, 0x15,
			0x8F, 0xA0, 0xD1, 0xFE, 0x33, 0x1C, 0x6D, 0x42
   };
}
/*@@end*/

/*@@startStart:Start:*/
on start
{
	result = EnableCRC("", 0); // 1 = on, 0 = off
	result = EnableTGL("", 0); // 1 = on, 0 = off 
	result = EnableSQC("", 0); // 1 = on, 0 = off 
	result = EnableMC("", 0); // 1 = on, 0 = off 

	if (@sysvar::CH_Nodes::CH_MPCCRC_Cam_Stat_Pr2Cam_S_AUTO == 0)
	{
		//Automatisch
		enableControl("Cam_Stat_AR2", "CH_MPCCRC_Cam_Stat_Pr2Cam_Stat__", 0); //1: enable; 0: disable
	}
	else
	{
		//Manuel
		enableControl("Cam_Stat_AR2", "CH_MPCCRC_Cam_Stat_Pr2Cam_Stat__", 1); //1: enable; 0: disable
	}
	if (@sysvar::CH_Nodes::CH_MPCSQC_Cam_Stat_Pr2Cam_S_AUTO == 0)
	{
		//Automatisch
		enableControl("Cam_Stat_AR2", "CH_MPCSQC_Cam_Stat_Pr2Cam_Stat__", 0); //1: enable; 0: disable
	}
	else
	{
		//Manuel
		enableControl("Cam_Stat_AR2", "CH_MPCSQC_Cam_Stat_Pr2Cam_Stat__", 1); //1: enable; 0: disable
	}
	@sysvar::CH_Nodes::CH__PDURECEIPT_SIM_MPC_Cam_Stat_AR2 = 1;
	if (@sysvar::CH_Nodes::CH_MPCCRC_CamLane_Disp_Warn_AUTO == 0)
	{
		//Automatisch
		enableControl("CamLane_Disp_Warn_Rq_Gw_AR2", "CH_MPCCRC_CamLane_Disp_Warn_Rq__", 0); //1: enable; 0: disable
	}
	else
	{
		//Manuel
		enableControl("CamLane_Disp_Warn_Rq_Gw_AR2", "CH_MPCCRC_CamLane_Disp_Warn_Rq__", 1); //1: enable; 0: disable
	}
	if (@sysvar::CH_Nodes::CH_MPCSQC_CamLane_Disp_Warn_AUTO == 0)
	{
		//Automatisch
		enableControl("CamLane_Disp_Warn_Rq_Gw_AR2", "CH_MPCSQC_CamLane_Disp_Warn_Rq__", 0); //1: enable; 0: disable
	}
	else
	{
		//Manuel
		enableControl("CamLane_Disp_Warn_Rq_Gw_AR2", "CH_MPCSQC_CamLane_Disp_Warn_Rq__", 1); //1: enable; 0: disable
	}
	@sysvar::CH_Nodes::CH__PDURECEIPT_SIM_MPC_CamLane_Disp_Warn_Rq_Gw_AR2 = 1;
	if (@sysvar::CH_Nodes::CH_MPCCRC_CamLane_FastAttr1_AUTO == 0)
	{
		//Automatisch
		enableControl("CamLane_FastAttr1_FR2", "CH_MPCCRC_CamLane_FastAttr1_Pr2_", 0); //1: enable; 0: disable
	}
	else
	{
		//Manuel
		enableControl("CamLane_FastAttr1_FR2", "CH_MPCCRC_CamLane_FastAttr1_Pr2_", 1); //1: enable; 0: disable
	}
	if (@sysvar::CH_Nodes::CH_MPCSQC_CamLane_FastAttr1_AUTO == 0)
	{
		//Automatisch
		enableControl("CamLane_FastAttr1_FR2", "CH_MPCSQC_CamLane_FastAttr1_Pr2_", 0); //1: enable; 0: disable
	}
	else
	{
		//Manuel
		enableControl("CamLane_FastAttr1_FR2", "CH_MPCSQC_CamLane_FastAttr1_Pr2_", 1); //1: enable; 0: disable
	}
	@sysvar::CH_Nodes::CH__PDURECEIPT_SIM_MPC_CamLane_FastAttr1_FR2 = 1;
	if (@sysvar::CH_Nodes::CH_MPCCRC_CamLane_FastAttr2_AUTO == 0)
	{
		//Automatisch
		enableControl("CamLane_FastAttr2_FR2", "CH_MPCCRC_CamLane_FastAttr2_Pr2_", 0); //1: enable; 0: disable
	}
	else
	{
		//Manuel
		enableControl("CamLane_FastAttr2_FR2", "CH_MPCCRC_CamLane_FastAttr2_Pr2_", 1); //1: enable; 0: disable
	}
	if (@sysvar::CH_Nodes::CH_MPCSQC_CamLane_FastAttr2_AUTO == 0)
	{
		//Automatisch
		enableControl("CamLane_FastAttr2_FR2", "CH_MPCSQC_CamLane_FastAttr2_Pr2_", 0); //1: enable; 0: disable
	}
	else
	{
		//Manuel
		enableControl("CamLane_FastAttr2_FR2", "CH_MPCSQC_CamLane_FastAttr2_Pr2_", 1); //1: enable; 0: disable
	}
	@sysvar::CH_Nodes::CH__PDURECEIPT_SIM_MPC_CamLane_FastAttr2_FR2 = 1;
	if (@sysvar::CH_Nodes::CH_MPCCRC_CamLane_LaneAttr1_AUTO == 0)
	{
		//Automatisch
		enableControl("CamLane_LaneAttr1_Gw_AR2", "CH_MPCCRC_CamLane_LaneAttr1_Pr2_", 0); //1: enable; 0: disable
	}
	else
	{
		//Manuel
		enableControl("CamLane_LaneAttr1_Gw_AR2", "CH_MPCCRC_CamLane_LaneAttr1_Pr2_", 1); //1: enable; 0: disable
	}
	if (@sysvar::CH_Nodes::CH_MPCSQC_CamLane_LaneAttr1_AUTO == 0)
	{
		//Automatisch
		enableControl("CamLane_LaneAttr1_Gw_AR2", "CH_MPCSQC_CamLane_LaneAttr1_Pr2_", 0); //1: enable; 0: disable
	}
	else
	{
		//Manuel
		enableControl("CamLane_LaneAttr1_Gw_AR2", "CH_MPCSQC_CamLane_LaneAttr1_Pr2_", 1); //1: enable; 0: disable
	}
	@sysvar::CH_Nodes::CH__PDURECEIPT_SIM_MPC_CamLane_LaneAttr1_Gw_AR2 = 1;
	if (@sysvar::CH_Nodes::CH_MPCCRC_CamLane_LaneAttr2_AUTO == 0)
	{
		//Automatisch
		enableControl("CamLane_LaneAttr2_Gw_AR2", "CH_MPCCRC_CamLane_LaneAttr2_Pr2_", 0); //1: enable; 0: disable
	}
	else
	{
		//Manuel
		enableControl("CamLane_LaneAttr2_Gw_AR2", "CH_MPCCRC_CamLane_LaneAttr2_Pr2_", 1); //1: enable; 0: disable
	}
	if (@sysvar::CH_Nodes::CH_MPCSQC_CamLane_LaneAttr2_AUTO == 0)
	{
		//Automatisch
		enableControl("CamLane_LaneAttr2_Gw_AR2", "CH_MPCSQC_CamLane_LaneAttr2_Pr2_", 0); //1: enable; 0: disable
	}
	else
	{
		//Manuel
		enableControl("CamLane_LaneAttr2_Gw_AR2", "CH_MPCSQC_CamLane_LaneAttr2_Pr2_", 1); //1: enable; 0: disable
	}
	@sysvar::CH_Nodes::CH__PDURECEIPT_SIM_MPC_CamLane_LaneAttr2_Gw_AR2 = 1;
	if (@sysvar::CH_Nodes::CH_MPCCRC_CamLane_LaneAttr3_AUTO == 0)
	{
		//Automatisch
		enableControl("CamLane_LaneAttr3_Gw_AR2", "CH_MPCCRC_CamLane_LaneAttr3_Pr2_", 0); //1: enable; 0: disable
	}
	else
	{
		//Manuel
		enableControl("CamLane_LaneAttr3_Gw_AR2", "CH_MPCCRC_CamLane_LaneAttr3_Pr2_", 1); //1: enable; 0: disable
	}
	if (@sysvar::CH_Nodes::CH_MPCSQC_CamLane_LaneAttr3_AUTO == 0)
	{
		//Automatisch
		enableControl("CamLane_LaneAttr3_Gw_AR2", "CH_MPCSQC_CamLane_LaneAttr3_Pr2_", 0); //1: enable; 0: disable
	}
	else
	{
		//Manuel
		enableControl("CamLane_LaneAttr3_Gw_AR2", "CH_MPCSQC_CamLane_LaneAttr3_Pr2_", 1); //1: enable; 0: disable
	}
	@sysvar::CH_Nodes::CH__PDURECEIPT_SIM_MPC_CamLane_LaneAttr3_Gw_AR2 = 1;
	if (@sysvar::CH_Nodes::CH_MPCCRC_CamLane_LaneAttr4_AUTO == 0)
	{
		//Automatisch
		enableControl("CamLane_LaneAttr4_FR2", "CH_MPCCRC_CamLane_LaneAttr4_Pr2_", 0); //1: enable; 0: disable
	}
	else
	{
		//Manuel
		enableControl("CamLane_LaneAttr4_FR2", "CH_MPCCRC_CamLane_LaneAttr4_Pr2_", 1); //1: enable; 0: disable
	}
	if (@sysvar::CH_Nodes::CH_MPCSQC_CamLane_LaneAttr4_AUTO == 0)
	{
		//Automatisch
		enableControl("CamLane_LaneAttr4_FR2", "CH_MPCSQC_CamLane_LaneAttr4_Pr2_", 0); //1: enable; 0: disable
	}
	else
	{
		//Manuel
		enableControl("CamLane_LaneAttr4_FR2", "CH_MPCSQC_CamLane_LaneAttr4_Pr2_", 1); //1: enable; 0: disable
	}
	@sysvar::CH_Nodes::CH__PDURECEIPT_SIM_MPC_CamLane_LaneAttr4_FR2 = 1;
	if (@sysvar::CH_Nodes::CH_MPCCRC_CamLane_LaneAttr5_AUTO == 0)
	{
		//Automatisch
		enableControl("CamLane_LaneAttr5_FR2", "CH_MPCCRC_CamLane_LaneAttr5_Pr2_", 0); //1: enable; 0: disable
	}
	else
	{
		//Manuel
		enableControl("CamLane_LaneAttr5_FR2", "CH_MPCCRC_CamLane_LaneAttr5_Pr2_", 1); //1: enable; 0: disable
	}
	if (@sysvar::CH_Nodes::CH_MPCSQC_CamLane_LaneAttr5_AUTO == 0)
	{
		//Automatisch
		enableControl("CamLane_LaneAttr5_FR2", "CH_MPCSQC_CamLane_LaneAttr5_Pr2_", 0); //1: enable; 0: disable
	}
	else
	{
		//Manuel
		enableControl("CamLane_LaneAttr5_FR2", "CH_MPCSQC_CamLane_LaneAttr5_Pr2_", 1); //1: enable; 0: disable
	}
	@sysvar::CH_Nodes::CH__PDURECEIPT_SIM_MPC_CamLane_LaneAttr5_FR2 = 1;
	if (@sysvar::CH_Nodes::CH_MPCCRC_CamLane_LaneAttr6_AUTO == 0)
	{
		//Automatisch
		enableControl("CamLane_LaneAttr6_Gw_AR2", "CH_MPCCRC_CamLane_LaneAttr6_Pr2_", 0); //1: enable; 0: disable
	}
	else
	{
		//Manuel
		enableControl("CamLane_LaneAttr6_Gw_AR2", "CH_MPCCRC_CamLane_LaneAttr6_Pr2_", 1); //1: enable; 0: disable
	}
	if (@sysvar::CH_Nodes::CH_MPCSQC_CamLane_LaneAttr6_AUTO == 0)
	{
		//Automatisch
		enableControl("CamLane_LaneAttr6_Gw_AR2", "CH_MPCSQC_CamLane_LaneAttr6_Pr2_", 0); //1: enable; 0: disable
	}
	else
	{
		//Manuel
		enableControl("CamLane_LaneAttr6_Gw_AR2", "CH_MPCSQC_CamLane_LaneAttr6_Pr2_", 1); //1: enable; 0: disable
	}
	@sysvar::CH_Nodes::CH__PDURECEIPT_SIM_MPC_CamLane_LaneAttr6_Gw_AR2 = 1;
	if (@sysvar::CH_Nodes::CH_MPCCRC_CamLane_LaneAttr7_AUTO == 0)
	{
		//Automatisch
		enableControl("CamLane_LaneAttr7_Gw_AR2", "CH_MPCCRC_CamLane_LaneAttr7_Pr2_", 0); //1: enable; 0: disable
	}
	else
	{
		//Manuel
		enableControl("CamLane_LaneAttr7_Gw_AR2", "CH_MPCCRC_CamLane_LaneAttr7_Pr2_", 1); //1: enable; 0: disable
	}
	if (@sysvar::CH_Nodes::CH_MPCSQC_CamLane_LaneAttr7_AUTO == 0)
	{
		//Automatisch
		enableControl("CamLane_LaneAttr7_Gw_AR2", "CH_MPCSQC_CamLane_LaneAttr7_Pr2_", 0); //1: enable; 0: disable
	}
	else
	{
		//Manuel
		enableControl("CamLane_LaneAttr7_Gw_AR2", "CH_MPCSQC_CamLane_LaneAttr7_Pr2_", 1); //1: enable; 0: disable
	}
	@sysvar::CH_Nodes::CH__PDURECEIPT_SIM_MPC_CamLane_LaneAttr7_Gw_AR2 = 1;
	if (@sysvar::CH_Nodes::CH_MPCCRC_CamObj_A_Mtn_Pr2C_AUTO == 0)
	{
		//Automatisch
		enableControl("CamObj_A_Mtn_FR2", "CH_MPCCRC_CamObj_A_Mtn_Pr2CamOb_", 0); //1: enable; 0: disable
	}
	else
	{
		//Manuel
		enableControl("CamObj_A_Mtn_FR2", "CH_MPCCRC_CamObj_A_Mtn_Pr2CamOb_", 1); //1: enable; 0: disable
	}
	if (@sysvar::CH_Nodes::CH_MPCSQC_CamObj_A_Mtn_Pr2C_AUTO == 0)
	{
		//Automatisch
		enableControl("CamObj_A_Mtn_FR2", "CH_MPCSQC_CamObj_A_Mtn_Pr2CamOb_", 0); //1: enable; 0: disable
	}
	else
	{
		//Manuel
		enableControl("CamObj_A_Mtn_FR2", "CH_MPCSQC_CamObj_A_Mtn_Pr2CamOb_", 1); //1: enable; 0: disable
	}
	@sysvar::CH_Nodes::CH__PDURECEIPT_SIM_MPC_CamObj_A_Mtn_FR2 = 1;
	if (@sysvar::CH_Nodes::CH_MPCCRC_CamObj_A_Posn_Pr2_AUTO == 0)
	{
		//Automatisch
		enableControl("CamObj_A_Posn_FR2", "CH_MPCCRC_CamObj_A_Posn_Pr2CamO_", 0); //1: enable; 0: disable
	}
	else
	{
		//Manuel
		enableControl("CamObj_A_Posn_FR2", "CH_MPCCRC_CamObj_A_Posn_Pr2CamO_", 1); //1: enable; 0: disable
	}
	if (@sysvar::CH_Nodes::CH_MPCSQC_CamObj_A_Posn_Pr2_AUTO == 0)
	{
		//Automatisch
		enableControl("CamObj_A_Posn_FR2", "CH_MPCSQC_CamObj_A_Posn_Pr2CamO_", 0); //1: enable; 0: disable
	}
	else
	{
		//Manuel
		enableControl("CamObj_A_Posn_FR2", "CH_MPCSQC_CamObj_A_Posn_Pr2CamO_", 1); //1: enable; 0: disable
	}
	@sysvar::CH_Nodes::CH__PDURECEIPT_SIM_MPC_CamObj_A_Posn_FR2 = 1;
	if (@sysvar::CH_Nodes::CH_MPCCRC_CamObj_B_Mtn_Pr2C_AUTO == 0)
	{
		//Automatisch
		enableControl("CamObj_B_Mtn_FR2", "CH_MPCCRC_CamObj_B_Mtn_Pr2CamOb_", 0); //1: enable; 0: disable
	}
	else
	{
		//Manuel
		enableControl("CamObj_B_Mtn_FR2", "CH_MPCCRC_CamObj_B_Mtn_Pr2CamOb_", 1); //1: enable; 0: disable
	}
	if (@sysvar::CH_Nodes::CH_MPCSQC_CamObj_B_Mtn_Pr2C_AUTO == 0)
	{
		//Automatisch
		enableControl("CamObj_B_Mtn_FR2", "CH_MPCSQC_CamObj_B_Mtn_Pr2CamOb_", 0); //1: enable; 0: disable
	}
	else
	{
		//Manuel
		enableControl("CamObj_B_Mtn_FR2", "CH_MPCSQC_CamObj_B_Mtn_Pr2CamOb_", 1); //1: enable; 0: disable
	}
	@sysvar::CH_Nodes::CH__PDURECEIPT_SIM_MPC_CamObj_B_Mtn_FR2 = 1;
	if (@sysvar::CH_Nodes::CH_MPCCRC_CamObj_B_Posn_Pr2_AUTO == 0)
	{
		//Automatisch
		enableControl("CamObj_B_Posn_FR2", "CH_MPCCRC_CamObj_B_Posn_Pr2CamO_", 0); //1: enable; 0: disable
	}
	else
	{
		//Manuel
		enableControl("CamObj_B_Posn_FR2", "CH_MPCCRC_CamObj_B_Posn_Pr2CamO_", 1); //1: enable; 0: disable
	}
	if (@sysvar::CH_Nodes::CH_MPCSQC_CamObj_B_Posn_Pr2_AUTO == 0)
	{
		//Automatisch
		enableControl("CamObj_B_Posn_FR2", "CH_MPCSQC_CamObj_B_Posn_Pr2CamO_", 0); //1: enable; 0: disable
	}
	else
	{
		//Manuel
		enableControl("CamObj_B_Posn_FR2", "CH_MPCSQC_CamObj_B_Posn_Pr2CamO_", 1); //1: enable; 0: disable
	}
	@sysvar::CH_Nodes::CH__PDURECEIPT_SIM_MPC_CamObj_B_Posn_FR2 = 1;
	if (@sysvar::CH_Nodes::CH_MPCCRC_CamObj_C_Mtn_Pr2C_AUTO == 0)
	{
		//Automatisch
		enableControl("CamObj_C_Mtn_FR2", "CH_MPCCRC_CamObj_C_Mtn_Pr2CamOb_", 0); //1: enable; 0: disable
	}
	else
	{
		//Manuel
		enableControl("CamObj_C_Mtn_FR2", "CH_MPCCRC_CamObj_C_Mtn_Pr2CamOb_", 1); //1: enable; 0: disable
	}
	if (@sysvar::CH_Nodes::CH_MPCSQC_CamObj_C_Mtn_Pr2C_AUTO == 0)
	{
		//Automatisch
		enableControl("CamObj_C_Mtn_FR2", "CH_MPCSQC_CamObj_C_Mtn_Pr2CamOb_", 0); //1: enable; 0: disable
	}
	else
	{
		//Manuel
		enableControl("CamObj_C_Mtn_FR2", "CH_MPCSQC_CamObj_C_Mtn_Pr2CamOb_", 1); //1: enable; 0: disable
	}
	@sysvar::CH_Nodes::CH__PDURECEIPT_SIM_MPC_CamObj_C_Mtn_FR2 = 1;
	if (@sysvar::CH_Nodes::CH_MPCCRC_CamObj_C_Posn_Pr2_AUTO == 0)
	{
		//Automatisch
		enableControl("CamObj_C_Posn_FR2", "CH_MPCCRC_CamObj_C_Posn_Pr2CamO_", 0); //1: enable; 0: disable
	}
	else
	{
		//Manuel
		enableControl("CamObj_C_Posn_FR2", "CH_MPCCRC_CamObj_C_Posn_Pr2CamO_", 1); //1: enable; 0: disable
	}
	if (@sysvar::CH_Nodes::CH_MPCSQC_CamObj_C_Posn_Pr2_AUTO == 0)
	{
		//Automatisch
		enableControl("CamObj_C_Posn_FR2", "CH_MPCSQC_CamObj_C_Posn_Pr2CamO_", 0); //1: enable; 0: disable
	}
	else
	{
		//Manuel
		enableControl("CamObj_C_Posn_FR2", "CH_MPCSQC_CamObj_C_Posn_Pr2CamO_", 1); //1: enable; 0: disable
	}
	@sysvar::CH_Nodes::CH__PDURECEIPT_SIM_MPC_CamObj_C_Posn_FR2 = 1;
	if (@sysvar::CH_Nodes::CH_MPCCRC_IHC_Lgt_Stat_MPC__AUTO == 0)
	{
		//Automatisch
		enableControl("IHC_Lgt_Stat_MPC_Gw_AR2", "CH_MPCCRC_IHC_Lgt_Stat_MPC_Pr2I_", 0); //1: enable; 0: disable
	}
	else
	{
		//Manuel
		enableControl("IHC_Lgt_Stat_MPC_Gw_AR2", "CH_MPCCRC_IHC_Lgt_Stat_MPC_Pr2I_", 1); //1: enable; 0: disable
	}
	if (@sysvar::CH_Nodes::CH_MPCSQC_IHC_Lgt_Stat_MPC__AUTO == 0)
	{
		//Automatisch
		enableControl("IHC_Lgt_Stat_MPC_Gw_AR2", "CH_MPCSQC_IHC_Lgt_Stat_MPC_Pr2I_", 0); //1: enable; 0: disable
	}
	else
	{
		//Manuel
		enableControl("IHC_Lgt_Stat_MPC_Gw_AR2", "CH_MPCSQC_IHC_Lgt_Stat_MPC_Pr2I_", 1); //1: enable; 0: disable
	}
	@sysvar::CH_Nodes::CH__PDURECEIPT_SIM_MPC_IHC_Lgt_Stat_MPC_Gw_AR2 = 1;
	if (@sysvar::CH_Nodes::CH_MPCCRC_IHC_Plus_HL_Stat__AUTO == 0)
	{
		//Automatisch
		enableControl("IHC_Plus_HL_Stat_AR2", "CH_MPCCRC_IHC_Plus_HL_Stat_Pr2I_", 0); //1: enable; 0: disable
	}
	else
	{
		//Manuel
		enableControl("IHC_Plus_HL_Stat_AR2", "CH_MPCCRC_IHC_Plus_HL_Stat_Pr2I_", 1); //1: enable; 0: disable
	}
	if (@sysvar::CH_Nodes::CH_MPCSQC_IHC_Plus_HL_Stat__AUTO == 0)
	{
		//Automatisch
		enableControl("IHC_Plus_HL_Stat_AR2", "CH_MPCSQC_IHC_Plus_HL_Stat_Pr2I_", 0); //1: enable; 0: disable
	}
	else
	{
		//Manuel
		enableControl("IHC_Plus_HL_Stat_AR2", "CH_MPCSQC_IHC_Plus_HL_Stat_Pr2I_", 1); //1: enable; 0: disable
	}
	@sysvar::CH_Nodes::CH__PDURECEIPT_SIM_MPC_IHC_Plus_HL_Stat_AR2 = 1;
	if (@sysvar::CH_Nodes::CH_MPCCRC_IHC_Plus_Tunnel_3_AUTO == 0)
	{
		//Automatisch
		enableControl("IHC_Plus_Tunnel_3_4_AR2", "CH_MPCCRC_IHC_Plus_Tunnel_3_4_P_", 0); //1: enable; 0: disable
	}
	else
	{
		//Manuel
		enableControl("IHC_Plus_Tunnel_3_4_AR2", "CH_MPCCRC_IHC_Plus_Tunnel_3_4_P_", 1); //1: enable; 0: disable
	}
	if (@sysvar::CH_Nodes::CH_MPCSQC_IHC_Plus_Tunnel_3_AUTO == 0)
	{
		//Automatisch
		enableControl("IHC_Plus_Tunnel_3_4_AR2", "CH_MPCSQC_IHC_Plus_Tunnel_3_4_P_", 0); //1: enable; 0: disable
	}
	else
	{
		//Manuel
		enableControl("IHC_Plus_Tunnel_3_4_AR2", "CH_MPCSQC_IHC_Plus_Tunnel_3_4_P_", 1); //1: enable; 0: disable
	}
	@sysvar::CH_Nodes::CH__PDURECEIPT_SIM_MPC_IHC_Plus_Tunnel_3_4_AR2 = 1;
	if (@sysvar::CH_Nodes::CH_MPCCRC_IHC_Plus_Tunnel_P_AUTO == 0)
	{
		//Automatisch
		enableControl("IHC_Plus_Tunnel_AR2", "CH_MPCCRC_IHC_Plus_Tunnel_Pr2IH_", 0); //1: enable; 0: disable
	}
	else
	{
		//Manuel
		enableControl("IHC_Plus_Tunnel_AR2", "CH_MPCCRC_IHC_Plus_Tunnel_Pr2IH_", 1); //1: enable; 0: disable
	}
	if (@sysvar::CH_Nodes::CH_MPCSQC_IHC_Plus_Tunnel_P_AUTO == 0)
	{
		//Automatisch
		enableControl("IHC_Plus_Tunnel_AR2", "CH_MPCSQC_IHC_Plus_Tunnel_Pr2IH_", 0); //1: enable; 0: disable
	}
	else
	{
		//Manuel
		enableControl("IHC_Plus_Tunnel_AR2", "CH_MPCSQC_IHC_Plus_Tunnel_Pr2IH_", 1); //1: enable; 0: disable
	}
	@sysvar::CH_Nodes::CH__PDURECEIPT_SIM_MPC_IHC_Plus_Tunnel_AR2 = 1;
	if (@sysvar::CH_Nodes::CH_MPCCRC_Preview_Header1_P_AUTO == 0)
	{
		//Automatisch
		enableControl("Preview_Header1_FR2", "CH_MPCCRC_Preview_Header1_Pr2Pr_", 0); //1: enable; 0: disable
	}
	else
	{
		//Manuel
		enableControl("Preview_Header1_FR2", "CH_MPCCRC_Preview_Header1_Pr2Pr_", 1); //1: enable; 0: disable
	}
	if (@sysvar::CH_Nodes::CH_MPCSQC_Preview_Header1_P_AUTO == 0)
	{
		//Automatisch
		enableControl("Preview_Header1_FR2", "CH_MPCSQC_Preview_Header1_Pr2Pr_", 0); //1: enable; 0: disable
	}
	else
	{
		//Manuel
		enableControl("Preview_Header1_FR2", "CH_MPCSQC_Preview_Header1_Pr2Pr_", 1); //1: enable; 0: disable
	}
	@sysvar::CH_Nodes::CH__PDURECEIPT_SIM_MPC_Preview_Header1_FR2 = 1;
	if (@sysvar::CH_Nodes::CH_MPCCRC_Preview_Header2_P_AUTO == 0)
	{
		//Automatisch
		enableControl("Preview_Header2_FR2", "CH_MPCCRC_Preview_Header2_Pr2Pr_", 0); //1: enable; 0: disable
	}
	else
	{
		//Manuel
		enableControl("Preview_Header2_FR2", "CH_MPCCRC_Preview_Header2_Pr2Pr_", 1); //1: enable; 0: disable
	}
	if (@sysvar::CH_Nodes::CH_MPCSQC_Preview_Header2_P_AUTO == 0)
	{
		//Automatisch
		enableControl("Preview_Header2_FR2", "CH_MPCSQC_Preview_Header2_Pr2Pr_", 0); //1: enable; 0: disable
	}
	else
	{
		//Manuel
		enableControl("Preview_Header2_FR2", "CH_MPCSQC_Preview_Header2_Pr2Pr_", 1); //1: enable; 0: disable
	}
	@sysvar::CH_Nodes::CH__PDURECEIPT_SIM_MPC_Preview_Header2_FR2 = 1;
	if (@sysvar::CH_Nodes::CH_MPCCRC_Preview_ProfData1_AUTO == 0)
	{
		//Automatisch
		enableControl("Preview_ProfData1_FR2", "CH_MPCCRC_Preview_ProfData1_Pr2_", 0); //1: enable; 0: disable
	}
	else
	{
		//Manuel
		enableControl("Preview_ProfData1_FR2", "CH_MPCCRC_Preview_ProfData1_Pr2_", 1); //1: enable; 0: disable
	}
	if (@sysvar::CH_Nodes::CH_MPCSQC_Preview_ProfData1_AUTO == 0)
	{
		//Automatisch
		enableControl("Preview_ProfData1_FR2", "CH_MPCSQC_Preview_ProfData1_Pr2_", 0); //1: enable; 0: disable
	}
	else
	{
		//Manuel
		enableControl("Preview_ProfData1_FR2", "CH_MPCSQC_Preview_ProfData1_Pr2_", 1); //1: enable; 0: disable
	}
	@sysvar::CH_Nodes::CH__PDURECEIPT_SIM_MPC_Preview_ProfData1_FR2 = 1;
	if (@sysvar::CH_Nodes::CH_MPCCRC_Preview_ProfData2_AUTO == 0)
	{
		//Automatisch
		enableControl("Preview_ProfData2_FR2", "CH_MPCCRC_Preview_ProfData2_Pr2_", 0); //1: enable; 0: disable
	}
	else
	{
		//Manuel
		enableControl("Preview_ProfData2_FR2", "CH_MPCCRC_Preview_ProfData2_Pr2_", 1); //1: enable; 0: disable
	}
	if (@sysvar::CH_Nodes::CH_MPCSQC_Preview_ProfData2_AUTO == 0)
	{
		//Automatisch
		enableControl("Preview_ProfData2_FR2", "CH_MPCSQC_Preview_ProfData2_Pr2_", 0); //1: enable; 0: disable
	}
	else
	{
		//Manuel
		enableControl("Preview_ProfData2_FR2", "CH_MPCSQC_Preview_ProfData2_Pr2_", 1); //1: enable; 0: disable
	}
	@sysvar::CH_Nodes::CH__PDURECEIPT_SIM_MPC_Preview_ProfData2_FR2 = 1;
	@sysvar::CH_Nodes::CH__PDURECEIPT_SIM_MPC_ROE_SMPC = 1;
	if (@sysvar::CH_Nodes::CH_MPCCRC_SPL_Obj1_Obj2_MPC_AUTO == 0)
	{
		//Automatisch
		enableControl("SPL_Obj1_Obj2_MPC_AR2", "CH_MPCCRC_SPL_Obj1_Obj2_MPC_Pr2_", 0); //1: enable; 0: disable
	}
	else
	{
		//Manuel
		enableControl("SPL_Obj1_Obj2_MPC_AR2", "CH_MPCCRC_SPL_Obj1_Obj2_MPC_Pr2_", 1); //1: enable; 0: disable
	}
	if (@sysvar::CH_Nodes::CH_MPCSQC_SPL_Obj1_Obj2_MPC_AUTO == 0)
	{
		//Automatisch
		enableControl("SPL_Obj1_Obj2_MPC_AR2", "CH_MPCSQC_SPL_Obj1_Obj2_MPC_Pr2_", 0); //1: enable; 0: disable
	}
	else
	{
		//Manuel
		enableControl("SPL_Obj1_Obj2_MPC_AR2", "CH_MPCSQC_SPL_Obj1_Obj2_MPC_Pr2_", 1); //1: enable; 0: disable
	}
	@sysvar::CH_Nodes::CH__PDURECEIPT_SIM_MPC_SPL_Obj1_Obj2_MPC_AR2 = 1;
	@sysvar::CH_Nodes::CH__PDURECEIPT_SIM_MPC_TSA_Disp_Rq1_Gw_AR2 = 1;
	@sysvar::CH_Nodes::CH__PDURECEIPT_SIM_MPC_TSA_Disp_Rq2_Gw_AR = 1;
	@sysvar::CH_Nodes::CH__PDURECEIPT_SIM_MPC_TSA_Disp_Rq3_Gw_AR = 1;
	if (@sysvar::CH_Nodes::CH_MPCCRC_YMAS_Rq_MPC_Pr2YM_AUTO == 0)
	{
		//Automatisch
		enableControl("YMAS_Rq_MPC_Gw_AR2", "CH_MPCCRC_YMAS_Rq_MPC_Pr2YMAS_R_", 0); //1: enable; 0: disable
	}
	else
	{
		//Manuel
		enableControl("YMAS_Rq_MPC_Gw_AR2", "CH_MPCCRC_YMAS_Rq_MPC_Pr2YMAS_R_", 1); //1: enable; 0: disable
	}
	if (@sysvar::CH_Nodes::CH_MPCSQC_YMAS_Rq_MPC_Pr2YM_AUTO == 0)
	{
		//Automatisch
		enableControl("YMAS_Rq_MPC_Gw_AR2", "CH_MPCSQC_YMAS_Rq_MPC_Pr2YMAS_R_", 0); //1: enable; 0: disable
	}
	else
	{
		//Manuel
		enableControl("YMAS_Rq_MPC_Gw_AR2", "CH_MPCSQC_YMAS_Rq_MPC_Pr2YMAS_R_", 1); //1: enable; 0: disable
	}
	@sysvar::CH_Nodes::CH__PDURECEIPT_SIM_MPC_YMAS_Rq_MPC_Gw_AR2 = 1;
	// netzwerk management

	enableControl("CHASSIS_FR Netzmanagement", "CH__NMActive_MPC", 1);
}
/*@@end*/

/*@@preStart:PreStart:*/
on preStart
{


}
/*@@end*/

/*@@timer:Timer_MPC_Cam_Stat_AR2:*/
on timer Timer_MPC_Cam_Stat_AR2
{
	@sysvar::CH_Nodes::CH__STPDU_MPC_Cam_Stat_AR2 = 0;
}
/*@@end*/

/*@@timer:Timer_MPC_CamLane_Disp_Warn_Rq_Gw_AR2:*/
on timer Timer_MPC_CamLane_Disp_Warn_Rq_Gw_AR2
{
	@sysvar::CH_Nodes::CH__STPDU_MPC_CamLane_Disp_Warn_Rq_Gw_AR2 = 0;
}
/*@@end*/

/*@@timer:Timer_MPC_CamLane_FastAttr1_FR2:*/
on timer Timer_MPC_CamLane_FastAttr1_FR2
{
	@sysvar::CH_Nodes::CH__STPDU_MPC_CamLane_FastAttr1_FR2 = 0;
}
/*@@end*/

/*@@timer:Timer_MPC_CamLane_FastAttr2_FR2:*/
on timer Timer_MPC_CamLane_FastAttr2_FR2
{
	@sysvar::CH_Nodes::CH__STPDU_MPC_CamLane_FastAttr2_FR2 = 0;
}
/*@@end*/

/*@@timer:Timer_MPC_CamLane_LaneAttr1_Gw_AR2:*/
on timer Timer_MPC_CamLane_LaneAttr1_Gw_AR2
{
	@sysvar::CH_Nodes::CH__STPDU_MPC_CamLane_LaneAttr1_Gw_AR2 = 0;
}
/*@@end*/

/*@@timer:Timer_MPC_CamLane_LaneAttr2_Gw_AR2:*/
on timer Timer_MPC_CamLane_LaneAttr2_Gw_AR2
{
	@sysvar::CH_Nodes::CH__STPDU_MPC_CamLane_LaneAttr2_Gw_AR2 = 0;
}
/*@@end*/

/*@@timer:Timer_MPC_CamLane_LaneAttr3_Gw_AR2:*/
on timer Timer_MPC_CamLane_LaneAttr3_Gw_AR2
{
	@sysvar::CH_Nodes::CH__STPDU_MPC_CamLane_LaneAttr3_Gw_AR2 = 0;
}
/*@@end*/

/*@@timer:Timer_MPC_CamLane_LaneAttr4_FR2:*/
on timer Timer_MPC_CamLane_LaneAttr4_FR2
{
	@sysvar::CH_Nodes::CH__STPDU_MPC_CamLane_LaneAttr4_FR2 = 0;
}
/*@@end*/

/*@@timer:Timer_MPC_CamLane_LaneAttr5_FR2:*/
on timer Timer_MPC_CamLane_LaneAttr5_FR2
{
	@sysvar::CH_Nodes::CH__STPDU_MPC_CamLane_LaneAttr5_FR2 = 0;
}
/*@@end*/

/*@@timer:Timer_MPC_CamLane_LaneAttr6_Gw_AR2:*/
on timer Timer_MPC_CamLane_LaneAttr6_Gw_AR2
{
	@sysvar::CH_Nodes::CH__STPDU_MPC_CamLane_LaneAttr6_Gw_AR2 = 0;
}
/*@@end*/

/*@@timer:Timer_MPC_CamLane_LaneAttr7_Gw_AR2:*/
on timer Timer_MPC_CamLane_LaneAttr7_Gw_AR2
{
	@sysvar::CH_Nodes::CH__STPDU_MPC_CamLane_LaneAttr7_Gw_AR2 = 0;
}
/*@@end*/

/*@@timer:Timer_MPC_CamObj_A_Mtn_FR2:*/
on timer Timer_MPC_CamObj_A_Mtn_FR2
{
	@sysvar::CH_Nodes::CH__STPDU_MPC_CamObj_A_Mtn_FR2 = 0;
}
/*@@end*/

/*@@timer:Timer_MPC_CamObj_A_Posn_FR2:*/
on timer Timer_MPC_CamObj_A_Posn_FR2
{
	@sysvar::CH_Nodes::CH__STPDU_MPC_CamObj_A_Posn_FR2 = 0;
}
/*@@end*/

/*@@timer:Timer_MPC_CamObj_B_Mtn_FR2:*/
on timer Timer_MPC_CamObj_B_Mtn_FR2
{
	@sysvar::CH_Nodes::CH__STPDU_MPC_CamObj_B_Mtn_FR2 = 0;
}
/*@@end*/

/*@@timer:Timer_MPC_CamObj_B_Posn_FR2:*/
on timer Timer_MPC_CamObj_B_Posn_FR2
{
	@sysvar::CH_Nodes::CH__STPDU_MPC_CamObj_B_Posn_FR2 = 0;
}
/*@@end*/

/*@@timer:Timer_MPC_CamObj_C_Mtn_FR2:*/
on timer Timer_MPC_CamObj_C_Mtn_FR2
{
	@sysvar::CH_Nodes::CH__STPDU_MPC_CamObj_C_Mtn_FR2 = 0;
}
/*@@end*/

/*@@timer:Timer_MPC_CamObj_C_Posn_FR2:*/
on timer Timer_MPC_CamObj_C_Posn_FR2
{
	@sysvar::CH_Nodes::CH__STPDU_MPC_CamObj_C_Posn_FR2 = 0;
}
/*@@end*/

/*@@timer:Timer_MPC_IHC_Lgt_Stat_MPC_Gw_AR2:*/
on timer Timer_MPC_IHC_Lgt_Stat_MPC_Gw_AR2
{
	@sysvar::CH_Nodes::CH__STPDU_MPC_IHC_Lgt_Stat_MPC_Gw_AR2 = 0;
}
/*@@end*/

/*@@timer:Timer_MPC_IHC_Plus_HL_Stat_AR2:*/
on timer Timer_MPC_IHC_Plus_HL_Stat_AR2
{
	@sysvar::CH_Nodes::CH__STPDU_MPC_IHC_Plus_HL_Stat_AR2 = 0;
}
/*@@end*/

/*@@timer:Timer_MPC_IHC_Plus_Tunnel_3_4_AR2:*/
on timer Timer_MPC_IHC_Plus_Tunnel_3_4_AR2
{
	@sysvar::CH_Nodes::CH__STPDU_MPC_IHC_Plus_Tunnel_3_4_AR2 = 0;
}
/*@@end*/

/*@@timer:Timer_MPC_IHC_Plus_Tunnel_AR2:*/
on timer Timer_MPC_IHC_Plus_Tunnel_AR2
{
	@sysvar::CH_Nodes::CH__STPDU_MPC_IHC_Plus_Tunnel_AR2 = 0;
}
/*@@end*/

/*@@timer:Timer_MPC_Preview_Header1_FR2:*/
on timer Timer_MPC_Preview_Header1_FR2
{
	@sysvar::CH_Nodes::CH__STPDU_MPC_Preview_Header1_FR2 = 0;
}
/*@@end*/

/*@@timer:Timer_MPC_Preview_Header2_FR2:*/
on timer Timer_MPC_Preview_Header2_FR2
{
	@sysvar::CH_Nodes::CH__STPDU_MPC_Preview_Header2_FR2 = 0;
}
/*@@end*/

/*@@timer:Timer_MPC_Preview_ProfData1_FR2:*/
on timer Timer_MPC_Preview_ProfData1_FR2
{
	@sysvar::CH_Nodes::CH__STPDU_MPC_Preview_ProfData1_FR2 = 0;
}
/*@@end*/

/*@@timer:Timer_MPC_Preview_ProfData2_FR2:*/
on timer Timer_MPC_Preview_ProfData2_FR2
{
	@sysvar::CH_Nodes::CH__STPDU_MPC_Preview_ProfData2_FR2 = 0;
}
/*@@end*/

/*@@timer:Timer_MPC_ROE_SMPC:*/
on timer Timer_MPC_ROE_SMPC
{
	@sysvar::CH_Nodes::CH__STPDU_MPC_ROE_SMPC = 0;
}
/*@@end*/

/*@@timer:Timer_MPC_SPL_Obj1_Obj2_MPC_AR2:*/
on timer Timer_MPC_SPL_Obj1_Obj2_MPC_AR2
{
	@sysvar::CH_Nodes::CH__STPDU_MPC_SPL_Obj1_Obj2_MPC_AR2 = 0;
}
/*@@end*/

/*@@timer:Timer_MPC_TSA_Disp_Rq1_Gw_AR2:*/
on timer Timer_MPC_TSA_Disp_Rq1_Gw_AR2
{
	@sysvar::CH_Nodes::CH__STPDU_MPC_TSA_Disp_Rq1_Gw_AR2 = 0;
}
/*@@end*/

/*@@timer:Timer_MPC_TSA_Disp_Rq2_Gw_AR:*/
on timer Timer_MPC_TSA_Disp_Rq2_Gw_AR
{
	@sysvar::CH_Nodes::CH__STPDU_MPC_TSA_Disp_Rq2_Gw_AR = 0;
}
/*@@end*/

/*@@timer:Timer_MPC_TSA_Disp_Rq3_Gw_AR:*/
on timer Timer_MPC_TSA_Disp_Rq3_Gw_AR
{
	@sysvar::CH_Nodes::CH__STPDU_MPC_TSA_Disp_Rq3_Gw_AR = 0;
}
/*@@end*/

/*@@timer:Timer_MPC_YMAS_Rq_MPC_Gw_AR2:*/
on timer Timer_MPC_YMAS_Rq_MPC_Gw_AR2
{
	@sysvar::CH_Nodes::CH__STPDU_MPC_YMAS_Rq_MPC_Gw_AR2 = 0;
}
/*@@end*/



/*@@sysvarChange:CH_Nodes::CH__STPDU_MPC_Cam_Stat_AR2:*/
on sysvar sysvar::CH_Nodes::CH__STPDU_MPC_Cam_Stat_AR2
{
	long res;
	long tDelay;
	switch (@this)
	{
		case (0):
			res = ResetTimingCyclic("Cam_Stat_AR2");
			res = ResetTimingEvtTrg("Cam_Stat_AR2");
			res = EnableTimingCyclic("Cam_Stat_AR2", 1);
			res = EnableTimingEvtTrg("Cam_Stat_AR2", 1);
			break;
		case (1):
			tDelay = @sysvar::CH_Nodes::CH__STPDU_T_MPC_Cam_Stat_AR2;
			if (tDelay > 0)
			{
				if (isTimerActive(Timer_MPC_Cam_Stat_AR2) == 0)
				{
					res = SetTimingCyclic("Cam_Stat_AR2", 1, tDelay, 1);
					setTimer (Timer_MPC_Cam_Stat_AR2, tDelay);
					@sysvar::CH_Nodes::CH__STPDU_MPC_Cam_Stat_AR2 = 2;
				}
			}
			else if (tDelay == 0)
			{
				if (isTimerActive(Timer_MPC_Cam_Stat_AR2) == 0)
				{
					res = EnableTimingCyclic("Cam_Stat_AR2", 0);
					res = EnableTimingEvtTrg("Cam_Stat_AR2", 0);
				}
			}
			break;
		case (2):
			break;
		default:
			Write("error: wrong parameter (%d)", @this);
			stop();
			break;
	}
}
/*@@end*/

/*@@sysvarChange:CH_Nodes::CH__STPDU_MPC_CamLane_Disp_Warn_Rq_Gw_AR2:*/
on sysvar sysvar::CH_Nodes::CH__STPDU_MPC_CamLane_Disp_Warn_Rq_Gw_AR2
{
	long res;
	long tDelay;
	switch (@this)
	{
		case (0):
			res = ResetTimingCyclic("CamLane_Disp_Warn_Rq_Gw_AR2");
			res = ResetTimingEvtTrg("CamLane_Disp_Warn_Rq_Gw_AR2");
			res = EnableTimingCyclic("CamLane_Disp_Warn_Rq_Gw_AR2", 1);
			res = EnableTimingEvtTrg("CamLane_Disp_Warn_Rq_Gw_AR2", 1);
			break;
		case (1):
			tDelay = @sysvar::CH_Nodes::CH__STPDU_T_MPC_CamLane_Disp_Warn_Rq_Gw_AR2;
			if (tDelay > 0)
			{
				if (isTimerActive(Timer_MPC_CamLane_Disp_Warn_Rq_Gw_AR2) == 0)
				{
					res = SetTimingCyclic("CamLane_Disp_Warn_Rq_Gw_AR2", 1, tDelay, 1);
					setTimer (Timer_MPC_CamLane_Disp_Warn_Rq_Gw_AR2, tDelay);
					@sysvar::CH_Nodes::CH__STPDU_MPC_CamLane_Disp_Warn_Rq_Gw_AR2 = 2;
				}
			}
			else if (tDelay == 0)
			{
				if (isTimerActive(Timer_MPC_CamLane_Disp_Warn_Rq_Gw_AR2) == 0)
				{
					res = EnableTimingCyclic("CamLane_Disp_Warn_Rq_Gw_AR2", 0);
					res = EnableTimingEvtTrg("CamLane_Disp_Warn_Rq_Gw_AR2", 0);
				}
			}
			break;
		case (2):
			break;
		default:
			Write("error: wrong parameter (%d)", @this);
			stop();
			break;
	}
}
/*@@end*/

/*@@sysvarChange:CH_Nodes::CH__STPDU_MPC_CamLane_FastAttr1_FR2:*/
on sysvar sysvar::CH_Nodes::CH__STPDU_MPC_CamLane_FastAttr1_FR2
{
	long res;
	long tDelay;
	switch (@this)
	{
		case (0):
			res = ResetTimingCyclic("CamLane_FastAttr1_FR2");
			res = ResetTimingEvtTrg("CamLane_FastAttr1_FR2");
			res = EnableTimingCyclic("CamLane_FastAttr1_FR2", 1);
			res = EnableTimingEvtTrg("CamLane_FastAttr1_FR2", 1);
			break;
		case (1):
			tDelay = @sysvar::CH_Nodes::CH__STPDU_T_MPC_CamLane_FastAttr1_FR2;
			if (tDelay > 0)
			{
				if (isTimerActive(Timer_MPC_CamLane_FastAttr1_FR2) == 0)
				{
					res = SetTimingCyclic("CamLane_FastAttr1_FR2", 1, tDelay, 1);
					setTimer (Timer_MPC_CamLane_FastAttr1_FR2, tDelay);
					@sysvar::CH_Nodes::CH__STPDU_MPC_CamLane_FastAttr1_FR2 = 2;
				}
			}
			else if (tDelay == 0)
			{
				if (isTimerActive(Timer_MPC_CamLane_FastAttr1_FR2) == 0)
				{
					res = EnableTimingCyclic("CamLane_FastAttr1_FR2", 0);
					res = EnableTimingEvtTrg("CamLane_FastAttr1_FR2", 0);
				}
			}
			break;
		case (2):
			break;
		default:
			Write("error: wrong parameter (%d)", @this);
			stop();
			break;
	}
}
/*@@end*/

/*@@sysvarChange:CH_Nodes::CH__STPDU_MPC_CamLane_FastAttr2_FR2:*/
on sysvar sysvar::CH_Nodes::CH__STPDU_MPC_CamLane_FastAttr2_FR2
{
	long res;
	long tDelay;
	switch (@this)
	{
		case (0):
			res = ResetTimingCyclic("CamLane_FastAttr2_FR2");
			res = ResetTimingEvtTrg("CamLane_FastAttr2_FR2");
			res = EnableTimingCyclic("CamLane_FastAttr2_FR2", 1);
			res = EnableTimingEvtTrg("CamLane_FastAttr2_FR2", 1);
			break;
		case (1):
			tDelay = @sysvar::CH_Nodes::CH__STPDU_T_MPC_CamLane_FastAttr2_FR2;
			if (tDelay > 0)
			{
				if (isTimerActive(Timer_MPC_CamLane_FastAttr2_FR2) == 0)
				{
					res = SetTimingCyclic("CamLane_FastAttr2_FR2", 1, tDelay, 1);
					setTimer (Timer_MPC_CamLane_FastAttr2_FR2, tDelay);
					@sysvar::CH_Nodes::CH__STPDU_MPC_CamLane_FastAttr2_FR2 = 2;
				}
			}
			else if (tDelay == 0)
			{
				if (isTimerActive(Timer_MPC_CamLane_FastAttr2_FR2) == 0)
				{
					res = EnableTimingCyclic("CamLane_FastAttr2_FR2", 0);
					res = EnableTimingEvtTrg("CamLane_FastAttr2_FR2", 0);
				}
			}
			break;
		case (2):
			break;
		default:
			Write("error: wrong parameter (%d)", @this);
			stop();
			break;
	}
}
/*@@end*/

/*@@sysvarChange:CH_Nodes::CH__STPDU_MPC_CamLane_LaneAttr1_Gw_AR2:*/
on sysvar sysvar::CH_Nodes::CH__STPDU_MPC_CamLane_LaneAttr1_Gw_AR2
{
	long res;
	long tDelay;
	switch (@this)
	{
		case (0):
			res = ResetTimingCyclic("CamLane_LaneAttr1_Gw_AR2");
			res = ResetTimingEvtTrg("CamLane_LaneAttr1_Gw_AR2");
			res = EnableTimingCyclic("CamLane_LaneAttr1_Gw_AR2", 1);
			res = EnableTimingEvtTrg("CamLane_LaneAttr1_Gw_AR2", 1);
			break;
		case (1):
			tDelay = @sysvar::CH_Nodes::CH__STPDU_T_MPC_CamLane_LaneAttr1_Gw_AR2;
			if (tDelay > 0)
			{
				if (isTimerActive(Timer_MPC_CamLane_LaneAttr1_Gw_AR2) == 0)
				{
					res = SetTimingCyclic("CamLane_LaneAttr1_Gw_AR2", 1, tDelay, 1);
					setTimer (Timer_MPC_CamLane_LaneAttr1_Gw_AR2, tDelay);
					@sysvar::CH_Nodes::CH__STPDU_MPC_CamLane_LaneAttr1_Gw_AR2 = 2;
				}
			}
			else if (tDelay == 0)
			{
				if (isTimerActive(Timer_MPC_CamLane_LaneAttr1_Gw_AR2) == 0)
				{
					res = EnableTimingCyclic("CamLane_LaneAttr1_Gw_AR2", 0);
					res = EnableTimingEvtTrg("CamLane_LaneAttr1_Gw_AR2", 0);
				}
			}
			break;
		case (2):
			break;
		default:
			Write("error: wrong parameter (%d)", @this);
			stop();
			break;
	}
}
/*@@end*/

/*@@sysvarChange:CH_Nodes::CH__STPDU_MPC_CamLane_LaneAttr2_Gw_AR2:*/
on sysvar sysvar::CH_Nodes::CH__STPDU_MPC_CamLane_LaneAttr2_Gw_AR2
{
	long res;
	long tDelay;
	switch (@this)
	{
		case (0):
			res = ResetTimingCyclic("CamLane_LaneAttr2_Gw_AR2");
			res = ResetTimingEvtTrg("CamLane_LaneAttr2_Gw_AR2");
			res = EnableTimingCyclic("CamLane_LaneAttr2_Gw_AR2", 1);
			res = EnableTimingEvtTrg("CamLane_LaneAttr2_Gw_AR2", 1);
			break;
		case (1):
			tDelay = @sysvar::CH_Nodes::CH__STPDU_T_MPC_CamLane_LaneAttr2_Gw_AR2;
			if (tDelay > 0)
			{
				if (isTimerActive(Timer_MPC_CamLane_LaneAttr2_Gw_AR2) == 0)
				{
					res = SetTimingCyclic("CamLane_LaneAttr2_Gw_AR2", 1, tDelay, 1);
					setTimer (Timer_MPC_CamLane_LaneAttr2_Gw_AR2, tDelay);
					@sysvar::CH_Nodes::CH__STPDU_MPC_CamLane_LaneAttr2_Gw_AR2 = 2;
				}
			}
			else if (tDelay == 0)
			{
				if (isTimerActive(Timer_MPC_CamLane_LaneAttr2_Gw_AR2) == 0)
				{
					res = EnableTimingCyclic("CamLane_LaneAttr2_Gw_AR2", 0);
					res = EnableTimingEvtTrg("CamLane_LaneAttr2_Gw_AR2", 0);
				}
			}
			break;
		case (2):
			break;
		default:
			Write("error: wrong parameter (%d)", @this);
			stop();
			break;
	}
}
/*@@end*/

/*@@sysvarChange:CH_Nodes::CH__STPDU_MPC_CamLane_LaneAttr3_Gw_AR2:*/
on sysvar sysvar::CH_Nodes::CH__STPDU_MPC_CamLane_LaneAttr3_Gw_AR2
{
	long res;
	long tDelay;
	switch (@this)
	{
		case (0):
			res = ResetTimingCyclic("CamLane_LaneAttr3_Gw_AR2");
			res = ResetTimingEvtTrg("CamLane_LaneAttr3_Gw_AR2");
			res = EnableTimingCyclic("CamLane_LaneAttr3_Gw_AR2", 1);
			res = EnableTimingEvtTrg("CamLane_LaneAttr3_Gw_AR2", 1);
			break;
		case (1):
			tDelay = @sysvar::CH_Nodes::CH__STPDU_T_MPC_CamLane_LaneAttr3_Gw_AR2;
			if (tDelay > 0)
			{
				if (isTimerActive(Timer_MPC_CamLane_LaneAttr3_Gw_AR2) == 0)
				{
					res = SetTimingCyclic("CamLane_LaneAttr3_Gw_AR2", 1, tDelay, 1);
					setTimer (Timer_MPC_CamLane_LaneAttr3_Gw_AR2, tDelay);
					@sysvar::CH_Nodes::CH__STPDU_MPC_CamLane_LaneAttr3_Gw_AR2 = 2;
				}
			}
			else if (tDelay == 0)
			{
				if (isTimerActive(Timer_MPC_CamLane_LaneAttr3_Gw_AR2) == 0)
				{
					res = EnableTimingCyclic("CamLane_LaneAttr3_Gw_AR2", 0);
					res = EnableTimingEvtTrg("CamLane_LaneAttr3_Gw_AR2", 0);
				}
			}
			break;
		case (2):
			break;
		default:
			Write("error: wrong parameter (%d)", @this);
			stop();
			break;
	}
}
/*@@end*/

/*@@sysvarChange:CH_Nodes::CH__STPDU_MPC_CamLane_LaneAttr4_FR2:*/
on sysvar sysvar::CH_Nodes::CH__STPDU_MPC_CamLane_LaneAttr4_FR2
{
	long res;
	long tDelay;
	switch (@this)
	{
		case (0):
			res = ResetTimingCyclic("CamLane_LaneAttr4_FR2");
			res = ResetTimingEvtTrg("CamLane_LaneAttr4_FR2");
			res = EnableTimingCyclic("CamLane_LaneAttr4_FR2", 1);
			res = EnableTimingEvtTrg("CamLane_LaneAttr4_FR2", 1);
			break;
		case (1):
			tDelay = @sysvar::CH_Nodes::CH__STPDU_T_MPC_CamLane_LaneAttr4_FR2;
			if (tDelay > 0)
			{
				if (isTimerActive(Timer_MPC_CamLane_LaneAttr4_FR2) == 0)
				{
					res = SetTimingCyclic("CamLane_LaneAttr4_FR2", 1, tDelay, 1);
					setTimer (Timer_MPC_CamLane_LaneAttr4_FR2, tDelay);
					@sysvar::CH_Nodes::CH__STPDU_MPC_CamLane_LaneAttr4_FR2 = 2;
				}
			}
			else if (tDelay == 0)
			{
				if (isTimerActive(Timer_MPC_CamLane_LaneAttr4_FR2) == 0)
				{
					res = EnableTimingCyclic("CamLane_LaneAttr4_FR2", 0);
					res = EnableTimingEvtTrg("CamLane_LaneAttr4_FR2", 0);
				}
			}
			break;
		case (2):
			break;
		default:
			Write("error: wrong parameter (%d)", @this);
			stop();
			break;
	}
}
/*@@end*/

/*@@sysvarChange:CH_Nodes::CH__STPDU_MPC_CamLane_LaneAttr5_FR2:*/
on sysvar sysvar::CH_Nodes::CH__STPDU_MPC_CamLane_LaneAttr5_FR2
{
	long res;
	long tDelay;
	switch (@this)
	{
		case (0):
			res = ResetTimingCyclic("CamLane_LaneAttr5_FR2");
			res = ResetTimingEvtTrg("CamLane_LaneAttr5_FR2");
			res = EnableTimingCyclic("CamLane_LaneAttr5_FR2", 1);
			res = EnableTimingEvtTrg("CamLane_LaneAttr5_FR2", 1);
			break;
		case (1):
			tDelay = @sysvar::CH_Nodes::CH__STPDU_T_MPC_CamLane_LaneAttr5_FR2;
			if (tDelay > 0)
			{
				if (isTimerActive(Timer_MPC_CamLane_LaneAttr5_FR2) == 0)
				{
					res = SetTimingCyclic("CamLane_LaneAttr5_FR2", 1, tDelay, 1);
					setTimer (Timer_MPC_CamLane_LaneAttr5_FR2, tDelay);
					@sysvar::CH_Nodes::CH__STPDU_MPC_CamLane_LaneAttr5_FR2 = 2;
				}
			}
			else if (tDelay == 0)
			{
				if (isTimerActive(Timer_MPC_CamLane_LaneAttr5_FR2) == 0)
				{
					res = EnableTimingCyclic("CamLane_LaneAttr5_FR2", 0);
					res = EnableTimingEvtTrg("CamLane_LaneAttr5_FR2", 0);
				}
			}
			break;
		case (2):
			break;
		default:
			Write("error: wrong parameter (%d)", @this);
			stop();
			break;
	}
}
/*@@end*/

/*@@sysvarChange:CH_Nodes::CH__STPDU_MPC_CamLane_LaneAttr6_Gw_AR2:*/
on sysvar sysvar::CH_Nodes::CH__STPDU_MPC_CamLane_LaneAttr6_Gw_AR2
{
	long res;
	long tDelay;
	switch (@this)
	{
		case (0):
			res = ResetTimingCyclic("CamLane_LaneAttr6_Gw_AR2");
			res = ResetTimingEvtTrg("CamLane_LaneAttr6_Gw_AR2");
			res = EnableTimingCyclic("CamLane_LaneAttr6_Gw_AR2", 1);
			res = EnableTimingEvtTrg("CamLane_LaneAttr6_Gw_AR2", 1);
			break;
		case (1):
			tDelay = @sysvar::CH_Nodes::CH__STPDU_T_MPC_CamLane_LaneAttr6_Gw_AR2;
			if (tDelay > 0)
			{
				if (isTimerActive(Timer_MPC_CamLane_LaneAttr6_Gw_AR2) == 0)
				{
					res = SetTimingCyclic("CamLane_LaneAttr6_Gw_AR2", 1, tDelay, 1);
					setTimer (Timer_MPC_CamLane_LaneAttr6_Gw_AR2, tDelay);
					@sysvar::CH_Nodes::CH__STPDU_MPC_CamLane_LaneAttr6_Gw_AR2 = 2;
				}
			}
			else if (tDelay == 0)
			{
				if (isTimerActive(Timer_MPC_CamLane_LaneAttr6_Gw_AR2) == 0)
				{
					res = EnableTimingCyclic("CamLane_LaneAttr6_Gw_AR2", 0);
					res = EnableTimingEvtTrg("CamLane_LaneAttr6_Gw_AR2", 0);
				}
			}
			break;
		case (2):
			break;
		default:
			Write("error: wrong parameter (%d)", @this);
			stop();
			break;
	}
}
/*@@end*/

/*@@sysvarChange:CH_Nodes::CH__STPDU_MPC_CamLane_LaneAttr7_Gw_AR2:*/
on sysvar sysvar::CH_Nodes::CH__STPDU_MPC_CamLane_LaneAttr7_Gw_AR2
{
	long res;
	long tDelay;
	switch (@this)
	{
		case (0):
			res = ResetTimingCyclic("CamLane_LaneAttr7_Gw_AR2");
			res = ResetTimingEvtTrg("CamLane_LaneAttr7_Gw_AR2");
			res = EnableTimingCyclic("CamLane_LaneAttr7_Gw_AR2", 1);
			res = EnableTimingEvtTrg("CamLane_LaneAttr7_Gw_AR2", 1);
			break;
		case (1):
			tDelay = @sysvar::CH_Nodes::CH__STPDU_T_MPC_CamLane_LaneAttr7_Gw_AR2;
			if (tDelay > 0)
			{
				if (isTimerActive(Timer_MPC_CamLane_LaneAttr7_Gw_AR2) == 0)
				{
					res = SetTimingCyclic("CamLane_LaneAttr7_Gw_AR2", 1, tDelay, 1);
					setTimer (Timer_MPC_CamLane_LaneAttr7_Gw_AR2, tDelay);
					@sysvar::CH_Nodes::CH__STPDU_MPC_CamLane_LaneAttr7_Gw_AR2 = 2;
				}
			}
			else if (tDelay == 0)
			{
				if (isTimerActive(Timer_MPC_CamLane_LaneAttr7_Gw_AR2) == 0)
				{
					res = EnableTimingCyclic("CamLane_LaneAttr7_Gw_AR2", 0);
					res = EnableTimingEvtTrg("CamLane_LaneAttr7_Gw_AR2", 0);
				}
			}
			break;
		case (2):
			break;
		default:
			Write("error: wrong parameter (%d)", @this);
			stop();
			break;
	}
}
/*@@end*/

/*@@sysvarChange:CH_Nodes::CH__STPDU_MPC_CamObj_A_Mtn_FR2:*/
on sysvar sysvar::CH_Nodes::CH__STPDU_MPC_CamObj_A_Mtn_FR2
{
	long res;
	long tDelay;
	switch (@this)
	{
		case (0):
			res = ResetTimingCyclic("CamObj_A_Mtn_FR2");
			res = ResetTimingEvtTrg("CamObj_A_Mtn_FR2");
			res = EnableTimingCyclic("CamObj_A_Mtn_FR2", 1);
			res = EnableTimingEvtTrg("CamObj_A_Mtn_FR2", 1);
			break;
		case (1):
			tDelay = @sysvar::CH_Nodes::CH__STPDU_T_MPC_CamObj_A_Mtn_FR2;
			if (tDelay > 0)
			{
				if (isTimerActive(Timer_MPC_CamObj_A_Mtn_FR2) == 0)
				{
					res = SetTimingCyclic("CamObj_A_Mtn_FR2", 1, tDelay, 1);
					setTimer (Timer_MPC_CamObj_A_Mtn_FR2, tDelay);
					@sysvar::CH_Nodes::CH__STPDU_MPC_CamObj_A_Mtn_FR2 = 2;
				}
			}
			else if (tDelay == 0)
			{
				if (isTimerActive(Timer_MPC_CamObj_A_Mtn_FR2) == 0)
				{
					res = EnableTimingCyclic("CamObj_A_Mtn_FR2", 0);
					res = EnableTimingEvtTrg("CamObj_A_Mtn_FR2", 0);
				}
			}
			break;
		case (2):
			break;
		default:
			Write("error: wrong parameter (%d)", @this);
			stop();
			break;
	}
}
/*@@end*/

/*@@sysvarChange:CH_Nodes::CH__STPDU_MPC_CamObj_A_Posn_FR2:*/
on sysvar sysvar::CH_Nodes::CH__STPDU_MPC_CamObj_A_Posn_FR2
{
	long res;
	long tDelay;
	switch (@this)
	{
		case (0):
			res = ResetTimingCyclic("CamObj_A_Posn_FR2");
			res = ResetTimingEvtTrg("CamObj_A_Posn_FR2");
			res = EnableTimingCyclic("CamObj_A_Posn_FR2", 1);
			res = EnableTimingEvtTrg("CamObj_A_Posn_FR2", 1);
			break;
		case (1):
			tDelay = @sysvar::CH_Nodes::CH__STPDU_T_MPC_CamObj_A_Posn_FR2;
			if (tDelay > 0)
			{
				if (isTimerActive(Timer_MPC_CamObj_A_Posn_FR2) == 0)
				{
					res = SetTimingCyclic("CamObj_A_Posn_FR2", 1, tDelay, 1);
					setTimer (Timer_MPC_CamObj_A_Posn_FR2, tDelay);
					@sysvar::CH_Nodes::CH__STPDU_MPC_CamObj_A_Posn_FR2 = 2;
				}
			}
			else if (tDelay == 0)
			{
				if (isTimerActive(Timer_MPC_CamObj_A_Posn_FR2) == 0)
				{
					res = EnableTimingCyclic("CamObj_A_Posn_FR2", 0);
					res = EnableTimingEvtTrg("CamObj_A_Posn_FR2", 0);
				}
			}
			break;
		case (2):
			break;
		default:
			Write("error: wrong parameter (%d)", @this);
			stop();
			break;
	}
}
/*@@end*/

/*@@sysvarChange:CH_Nodes::CH__STPDU_MPC_CamObj_B_Mtn_FR2:*/
on sysvar sysvar::CH_Nodes::CH__STPDU_MPC_CamObj_B_Mtn_FR2
{
	long res;
	long tDelay;
	switch (@this)
	{
		case (0):
			res = ResetTimingCyclic("CamObj_B_Mtn_FR2");
			res = ResetTimingEvtTrg("CamObj_B_Mtn_FR2");
			res = EnableTimingCyclic("CamObj_B_Mtn_FR2", 1);
			res = EnableTimingEvtTrg("CamObj_B_Mtn_FR2", 1);
			break;
		case (1):
			tDelay = @sysvar::CH_Nodes::CH__STPDU_T_MPC_CamObj_B_Mtn_FR2;
			if (tDelay > 0)
			{
				if (isTimerActive(Timer_MPC_CamObj_B_Mtn_FR2) == 0)
				{
					res = SetTimingCyclic("CamObj_B_Mtn_FR2", 1, tDelay, 1);
					setTimer (Timer_MPC_CamObj_B_Mtn_FR2, tDelay);
					@sysvar::CH_Nodes::CH__STPDU_MPC_CamObj_B_Mtn_FR2 = 2;
				}
			}
			else if (tDelay == 0)
			{
				if (isTimerActive(Timer_MPC_CamObj_B_Mtn_FR2) == 0)
				{
					res = EnableTimingCyclic("CamObj_B_Mtn_FR2", 0);
					res = EnableTimingEvtTrg("CamObj_B_Mtn_FR2", 0);
				}
			}
			break;
		case (2):
			break;
		default:
			Write("error: wrong parameter (%d)", @this);
			stop();
			break;
	}
}
/*@@end*/

/*@@sysvarChange:CH_Nodes::CH__STPDU_MPC_CamObj_B_Posn_FR2:*/
on sysvar sysvar::CH_Nodes::CH__STPDU_MPC_CamObj_B_Posn_FR2
{
	long res;
	long tDelay;
	switch (@this)
	{
		case (0):
			res = ResetTimingCyclic("CamObj_B_Posn_FR2");
			res = ResetTimingEvtTrg("CamObj_B_Posn_FR2");
			res = EnableTimingCyclic("CamObj_B_Posn_FR2", 1);
			res = EnableTimingEvtTrg("CamObj_B_Posn_FR2", 1);
			break;
		case (1):
			tDelay = @sysvar::CH_Nodes::CH__STPDU_T_MPC_CamObj_B_Posn_FR2;
			if (tDelay > 0)
			{
				if (isTimerActive(Timer_MPC_CamObj_B_Posn_FR2) == 0)
				{
					res = SetTimingCyclic("CamObj_B_Posn_FR2", 1, tDelay, 1);
					setTimer (Timer_MPC_CamObj_B_Posn_FR2, tDelay);
					@sysvar::CH_Nodes::CH__STPDU_MPC_CamObj_B_Posn_FR2 = 2;
				}
			}
			else if (tDelay == 0)
			{
				if (isTimerActive(Timer_MPC_CamObj_B_Posn_FR2) == 0)
				{
					res = EnableTimingCyclic("CamObj_B_Posn_FR2", 0);
					res = EnableTimingEvtTrg("CamObj_B_Posn_FR2", 0);
				}
			}
			break;
		case (2):
			break;
		default:
			Write("error: wrong parameter (%d)", @this);
			stop();
			break;
	}
}
/*@@end*/

/*@@sysvarChange:CH_Nodes::CH__STPDU_MPC_CamObj_C_Mtn_FR2:*/
on sysvar sysvar::CH_Nodes::CH__STPDU_MPC_CamObj_C_Mtn_FR2
{
	long res;
	long tDelay;
	switch (@this)
	{
		case (0):
			res = ResetTimingCyclic("CamObj_C_Mtn_FR2");
			res = ResetTimingEvtTrg("CamObj_C_Mtn_FR2");
			res = EnableTimingCyclic("CamObj_C_Mtn_FR2", 1);
			res = EnableTimingEvtTrg("CamObj_C_Mtn_FR2", 1);
			break;
		case (1):
			tDelay = @sysvar::CH_Nodes::CH__STPDU_T_MPC_CamObj_C_Mtn_FR2;
			if (tDelay > 0)
			{
				if (isTimerActive(Timer_MPC_CamObj_C_Mtn_FR2) == 0)
				{
					res = SetTimingCyclic("CamObj_C_Mtn_FR2", 1, tDelay, 1);
					setTimer (Timer_MPC_CamObj_C_Mtn_FR2, tDelay);
					@sysvar::CH_Nodes::CH__STPDU_MPC_CamObj_C_Mtn_FR2 = 2;
				}
			}
			else if (tDelay == 0)
			{
				if (isTimerActive(Timer_MPC_CamObj_C_Mtn_FR2) == 0)
				{
					res = EnableTimingCyclic("CamObj_C_Mtn_FR2", 0);
					res = EnableTimingEvtTrg("CamObj_C_Mtn_FR2", 0);
				}
			}
			break;
		case (2):
			break;
		default:
			Write("error: wrong parameter (%d)", @this);
			stop();
			break;
	}
}
/*@@end*/

/*@@sysvarChange:CH_Nodes::CH__STPDU_MPC_CamObj_C_Posn_FR2:*/
on sysvar sysvar::CH_Nodes::CH__STPDU_MPC_CamObj_C_Posn_FR2
{
	long res;
	long tDelay;
	switch (@this)
	{
		case (0):
			res = ResetTimingCyclic("CamObj_C_Posn_FR2");
			res = ResetTimingEvtTrg("CamObj_C_Posn_FR2");
			res = EnableTimingCyclic("CamObj_C_Posn_FR2", 1);
			res = EnableTimingEvtTrg("CamObj_C_Posn_FR2", 1);
			break;
		case (1):
			tDelay = @sysvar::CH_Nodes::CH__STPDU_T_MPC_CamObj_C_Posn_FR2;
			if (tDelay > 0)
			{
				if (isTimerActive(Timer_MPC_CamObj_C_Posn_FR2) == 0)
				{
					res = SetTimingCyclic("CamObj_C_Posn_FR2", 1, tDelay, 1);
					setTimer (Timer_MPC_CamObj_C_Posn_FR2, tDelay);
					@sysvar::CH_Nodes::CH__STPDU_MPC_CamObj_C_Posn_FR2 = 2;
				}
			}
			else if (tDelay == 0)
			{
				if (isTimerActive(Timer_MPC_CamObj_C_Posn_FR2) == 0)
				{
					res = EnableTimingCyclic("CamObj_C_Posn_FR2", 0);
					res = EnableTimingEvtTrg("CamObj_C_Posn_FR2", 0);
				}
			}
			break;
		case (2):
			break;
		default:
			Write("error: wrong parameter (%d)", @this);
			stop();
			break;
	}
}
/*@@end*/

/*@@sysvarChange:CH_Nodes::CH__STPDU_MPC_IHC_Lgt_Stat_MPC_Gw_AR2:*/
on sysvar sysvar::CH_Nodes::CH__STPDU_MPC_IHC_Lgt_Stat_MPC_Gw_AR2
{
	long res;
	long tDelay;
	switch (@this)
	{
		case (0):
			res = ResetTimingCyclic("IHC_Lgt_Stat_MPC_Gw_AR2");
			res = ResetTimingEvtTrg("IHC_Lgt_Stat_MPC_Gw_AR2");
			res = EnableTimingCyclic("IHC_Lgt_Stat_MPC_Gw_AR2", 1);
			res = EnableTimingEvtTrg("IHC_Lgt_Stat_MPC_Gw_AR2", 1);
			break;
		case (1):
			tDelay = @sysvar::CH_Nodes::CH__STPDU_T_MPC_IHC_Lgt_Stat_MPC_Gw_AR2;
			if (tDelay > 0)
			{
				if (isTimerActive(Timer_MPC_IHC_Lgt_Stat_MPC_Gw_AR2) == 0)
				{
					res = SetTimingCyclic("IHC_Lgt_Stat_MPC_Gw_AR2", 1, tDelay, 1);
					setTimer (Timer_MPC_IHC_Lgt_Stat_MPC_Gw_AR2, tDelay);
					@sysvar::CH_Nodes::CH__STPDU_MPC_IHC_Lgt_Stat_MPC_Gw_AR2 = 2;
				}
			}
			else if (tDelay == 0)
			{
				if (isTimerActive(Timer_MPC_IHC_Lgt_Stat_MPC_Gw_AR2) == 0)
				{
					res = EnableTimingCyclic("IHC_Lgt_Stat_MPC_Gw_AR2", 0);
					res = EnableTimingEvtTrg("IHC_Lgt_Stat_MPC_Gw_AR2", 0);
				}
			}
			break;
		case (2):
			break;
		default:
			Write("error: wrong parameter (%d)", @this);
			stop();
			break;
	}
}
/*@@end*/

/*@@sysvarChange:CH_Nodes::CH__STPDU_MPC_IHC_Plus_HL_Stat_AR2:*/
on sysvar sysvar::CH_Nodes::CH__STPDU_MPC_IHC_Plus_HL_Stat_AR2
{
	long res;
	long tDelay;
	switch (@this)
	{
		case (0):
			res = ResetTimingCyclic("IHC_Plus_HL_Stat_AR2");
			res = ResetTimingEvtTrg("IHC_Plus_HL_Stat_AR2");
			res = EnableTimingCyclic("IHC_Plus_HL_Stat_AR2", 1);
			res = EnableTimingEvtTrg("IHC_Plus_HL_Stat_AR2", 1);
			break;
		case (1):
			tDelay = @sysvar::CH_Nodes::CH__STPDU_T_MPC_IHC_Plus_HL_Stat_AR2;
			if (tDelay > 0)
			{
				if (isTimerActive(Timer_MPC_IHC_Plus_HL_Stat_AR2) == 0)
				{
					res = SetTimingCyclic("IHC_Plus_HL_Stat_AR2", 1, tDelay, 1);
					setTimer (Timer_MPC_IHC_Plus_HL_Stat_AR2, tDelay);
					@sysvar::CH_Nodes::CH__STPDU_MPC_IHC_Plus_HL_Stat_AR2 = 2;
				}
			}
			else if (tDelay == 0)
			{
				if (isTimerActive(Timer_MPC_IHC_Plus_HL_Stat_AR2) == 0)
				{
					res = EnableTimingCyclic("IHC_Plus_HL_Stat_AR2", 0);
					res = EnableTimingEvtTrg("IHC_Plus_HL_Stat_AR2", 0);
				}
			}
			break;
		case (2):
			break;
		default:
			Write("error: wrong parameter (%d)", @this);
			stop();
			break;
	}
}
/*@@end*/

/*@@sysvarChange:CH_Nodes::CH__STPDU_MPC_IHC_Plus_Tunnel_3_4_AR2:*/
on sysvar sysvar::CH_Nodes::CH__STPDU_MPC_IHC_Plus_Tunnel_3_4_AR2
{
	long res;
	long tDelay;
	switch (@this)
	{
		case (0):
			res = ResetTimingCyclic("IHC_Plus_Tunnel_3_4_AR2");
			res = ResetTimingEvtTrg("IHC_Plus_Tunnel_3_4_AR2");
			res = EnableTimingCyclic("IHC_Plus_Tunnel_3_4_AR2", 1);
			res = EnableTimingEvtTrg("IHC_Plus_Tunnel_3_4_AR2", 1);
			break;
		case (1):
			tDelay = @sysvar::CH_Nodes::CH__STPDU_T_MPC_IHC_Plus_Tunnel_3_4_AR2;
			if (tDelay > 0)
			{
				if (isTimerActive(Timer_MPC_IHC_Plus_Tunnel_3_4_AR2) == 0)
				{
					res = SetTimingCyclic("IHC_Plus_Tunnel_3_4_AR2", 1, tDelay, 1);
					setTimer (Timer_MPC_IHC_Plus_Tunnel_3_4_AR2, tDelay);
					@sysvar::CH_Nodes::CH__STPDU_MPC_IHC_Plus_Tunnel_3_4_AR2 = 2;
				}
			}
			else if (tDelay == 0)
			{
				if (isTimerActive(Timer_MPC_IHC_Plus_Tunnel_3_4_AR2) == 0)
				{
					res = EnableTimingCyclic("IHC_Plus_Tunnel_3_4_AR2", 0);
					res = EnableTimingEvtTrg("IHC_Plus_Tunnel_3_4_AR2", 0);
				}
			}
			break;
		case (2):
			break;
		default:
			Write("error: wrong parameter (%d)", @this);
			stop();
			break;
	}
}
/*@@end*/

/*@@sysvarChange:CH_Nodes::CH__STPDU_MPC_IHC_Plus_Tunnel_AR2:*/
on sysvar sysvar::CH_Nodes::CH__STPDU_MPC_IHC_Plus_Tunnel_AR2
{
	long res;
	long tDelay;
	switch (@this)
	{
		case (0):
			res = ResetTimingCyclic("IHC_Plus_Tunnel_AR2");
			res = ResetTimingEvtTrg("IHC_Plus_Tunnel_AR2");
			res = EnableTimingCyclic("IHC_Plus_Tunnel_AR2", 1);
			res = EnableTimingEvtTrg("IHC_Plus_Tunnel_AR2", 1);
			break;
		case (1):
			tDelay = @sysvar::CH_Nodes::CH__STPDU_T_MPC_IHC_Plus_Tunnel_AR2;
			if (tDelay > 0)
			{
				if (isTimerActive(Timer_MPC_IHC_Plus_Tunnel_AR2) == 0)
				{
					res = SetTimingCyclic("IHC_Plus_Tunnel_AR2", 1, tDelay, 1);
					setTimer (Timer_MPC_IHC_Plus_Tunnel_AR2, tDelay);
					@sysvar::CH_Nodes::CH__STPDU_MPC_IHC_Plus_Tunnel_AR2 = 2;
				}
			}
			else if (tDelay == 0)
			{
				if (isTimerActive(Timer_MPC_IHC_Plus_Tunnel_AR2) == 0)
				{
					res = EnableTimingCyclic("IHC_Plus_Tunnel_AR2", 0);
					res = EnableTimingEvtTrg("IHC_Plus_Tunnel_AR2", 0);
				}
			}
			break;
		case (2):
			break;
		default:
			Write("error: wrong parameter (%d)", @this);
			stop();
			break;
	}
}
/*@@end*/

/*@@sysvarChange:CH_Nodes::CH__STPDU_MPC_Preview_Header1_FR2:*/
on sysvar sysvar::CH_Nodes::CH__STPDU_MPC_Preview_Header1_FR2
{
	long res;
	long tDelay;
	switch (@this)
	{
		case (0):
			res = ResetTimingCyclic("Preview_Header1_FR2");
			res = ResetTimingEvtTrg("Preview_Header1_FR2");
			res = EnableTimingCyclic("Preview_Header1_FR2", 1);
			res = EnableTimingEvtTrg("Preview_Header1_FR2", 1);
			break;
		case (1):
			tDelay = @sysvar::CH_Nodes::CH__STPDU_T_MPC_Preview_Header1_FR2;
			if (tDelay > 0)
			{
				if (isTimerActive(Timer_MPC_Preview_Header1_FR2) == 0)
				{
					res = SetTimingCyclic("Preview_Header1_FR2", 1, tDelay, 1);
					setTimer (Timer_MPC_Preview_Header1_FR2, tDelay);
					@sysvar::CH_Nodes::CH__STPDU_MPC_Preview_Header1_FR2 = 2;
				}
			}
			else if (tDelay == 0)
			{
				if (isTimerActive(Timer_MPC_Preview_Header1_FR2) == 0)
				{
					res = EnableTimingCyclic("Preview_Header1_FR2", 0);
					res = EnableTimingEvtTrg("Preview_Header1_FR2", 0);
				}
			}
			break;
		case (2):
			break;
		default:
			Write("error: wrong parameter (%d)", @this);
			stop();
			break;
	}
}
/*@@end*/

/*@@sysvarChange:CH_Nodes::CH__STPDU_MPC_Preview_Header2_FR2:*/
on sysvar sysvar::CH_Nodes::CH__STPDU_MPC_Preview_Header2_FR2
{
	long res;
	long tDelay;
	switch (@this)
	{
		case (0):
			res = ResetTimingCyclic("Preview_Header2_FR2");
			res = ResetTimingEvtTrg("Preview_Header2_FR2");
			res = EnableTimingCyclic("Preview_Header2_FR2", 1);
			res = EnableTimingEvtTrg("Preview_Header2_FR2", 1);
			break;
		case (1):
			tDelay = @sysvar::CH_Nodes::CH__STPDU_T_MPC_Preview_Header2_FR2;
			if (tDelay > 0)
			{
				if (isTimerActive(Timer_MPC_Preview_Header2_FR2) == 0)
				{
					res = SetTimingCyclic("Preview_Header2_FR2", 1, tDelay, 1);
					setTimer (Timer_MPC_Preview_Header2_FR2, tDelay);
					@sysvar::CH_Nodes::CH__STPDU_MPC_Preview_Header2_FR2 = 2;
				}
			}
			else if (tDelay == 0)
			{
				if (isTimerActive(Timer_MPC_Preview_Header2_FR2) == 0)
				{
					res = EnableTimingCyclic("Preview_Header2_FR2", 0);
					res = EnableTimingEvtTrg("Preview_Header2_FR2", 0);
				}
			}
			break;
		case (2):
			break;
		default:
			Write("error: wrong parameter (%d)", @this);
			stop();
			break;
	}
}
/*@@end*/

/*@@sysvarChange:CH_Nodes::CH__STPDU_MPC_Preview_ProfData1_FR2:*/
on sysvar sysvar::CH_Nodes::CH__STPDU_MPC_Preview_ProfData1_FR2
{
	long res;
	long tDelay;
	switch (@this)
	{
		case (0):
			res = ResetTimingCyclic("Preview_ProfData1_FR2");
			res = ResetTimingEvtTrg("Preview_ProfData1_FR2");
			res = EnableTimingCyclic("Preview_ProfData1_FR2", 1);
			res = EnableTimingEvtTrg("Preview_ProfData1_FR2", 1);
			break;
		case (1):
			tDelay = @sysvar::CH_Nodes::CH__STPDU_T_MPC_Preview_ProfData1_FR2;
			if (tDelay > 0)
			{
				if (isTimerActive(Timer_MPC_Preview_ProfData1_FR2) == 0)
				{
					res = SetTimingCyclic("Preview_ProfData1_FR2", 1, tDelay, 1);
					setTimer (Timer_MPC_Preview_ProfData1_FR2, tDelay);
					@sysvar::CH_Nodes::CH__STPDU_MPC_Preview_ProfData1_FR2 = 2;
				}
			}
			else if (tDelay == 0)
			{
				if (isTimerActive(Timer_MPC_Preview_ProfData1_FR2) == 0)
				{
					res = EnableTimingCyclic("Preview_ProfData1_FR2", 0);
					res = EnableTimingEvtTrg("Preview_ProfData1_FR2", 0);
				}
			}
			break;
		case (2):
			break;
		default:
			Write("error: wrong parameter (%d)", @this);
			stop();
			break;
	}
}
/*@@end*/

/*@@sysvarChange:CH_Nodes::CH__STPDU_MPC_Preview_ProfData2_FR2:*/
on sysvar sysvar::CH_Nodes::CH__STPDU_MPC_Preview_ProfData2_FR2
{
	long res;
	long tDelay;
	switch (@this)
	{
		case (0):
			res = ResetTimingCyclic("Preview_ProfData2_FR2");
			res = ResetTimingEvtTrg("Preview_ProfData2_FR2");
			res = EnableTimingCyclic("Preview_ProfData2_FR2", 1);
			res = EnableTimingEvtTrg("Preview_ProfData2_FR2", 1);
			break;
		case (1):
			tDelay = @sysvar::CH_Nodes::CH__STPDU_T_MPC_Preview_ProfData2_FR2;
			if (tDelay > 0)
			{
				if (isTimerActive(Timer_MPC_Preview_ProfData2_FR2) == 0)
				{
					res = SetTimingCyclic("Preview_ProfData2_FR2", 1, tDelay, 1);
					setTimer (Timer_MPC_Preview_ProfData2_FR2, tDelay);
					@sysvar::CH_Nodes::CH__STPDU_MPC_Preview_ProfData2_FR2 = 2;
				}
			}
			else if (tDelay == 0)
			{
				if (isTimerActive(Timer_MPC_Preview_ProfData2_FR2) == 0)
				{
					res = EnableTimingCyclic("Preview_ProfData2_FR2", 0);
					res = EnableTimingEvtTrg("Preview_ProfData2_FR2", 0);
				}
			}
			break;
		case (2):
			break;
		default:
			Write("error: wrong parameter (%d)", @this);
			stop();
			break;
	}
}
/*@@end*/

/*@@sysvarChange:CH_Nodes::CH__STPDU_MPC_ROE_SMPC:*/
on sysvar sysvar::CH_Nodes::CH__STPDU_MPC_ROE_SMPC
{
	long res;
	long tDelay;
	switch (@this)
	{
		case (0):
			res = ResetTimingCyclic("ROE_SMPC");
			res = ResetTimingEvtTrg("ROE_SMPC");
			res = EnableTimingCyclic("ROE_SMPC", 1);
			res = EnableTimingEvtTrg("ROE_SMPC", 1);
			break;
		case (1):
			tDelay = @sysvar::CH_Nodes::CH__STPDU_T_MPC_ROE_SMPC;
			if (tDelay > 0)
			{
				if (isTimerActive(Timer_MPC_ROE_SMPC) == 0)
				{
					res = SetTimingCyclic("ROE_SMPC", 1, tDelay, 1);
					setTimer (Timer_MPC_ROE_SMPC, tDelay);
					@sysvar::CH_Nodes::CH__STPDU_MPC_ROE_SMPC = 2;
				}
			}
			else if (tDelay == 0)
			{
				if (isTimerActive(Timer_MPC_ROE_SMPC) == 0)
				{
					res = EnableTimingCyclic("ROE_SMPC", 0);
					res = EnableTimingEvtTrg("ROE_SMPC", 0);
				}
			}
			break;
		case (2):
			break;
		default:
			Write("error: wrong parameter (%d)", @this);
			stop();
			break;
	}
}
/*@@end*/

/*@@sysvarChange:CH_Nodes::CH__STPDU_MPC_SPL_Obj1_Obj2_MPC_AR2:*/
on sysvar sysvar::CH_Nodes::CH__STPDU_MPC_SPL_Obj1_Obj2_MPC_AR2
{
	long res;
	long tDelay;
	switch (@this)
	{
		case (0):
			res = ResetTimingCyclic("SPL_Obj1_Obj2_MPC_AR2");
			res = ResetTimingEvtTrg("SPL_Obj1_Obj2_MPC_AR2");
			res = EnableTimingCyclic("SPL_Obj1_Obj2_MPC_AR2", 1);
			res = EnableTimingEvtTrg("SPL_Obj1_Obj2_MPC_AR2", 1);
			break;
		case (1):
			tDelay = @sysvar::CH_Nodes::CH__STPDU_T_MPC_SPL_Obj1_Obj2_MPC_AR2;
			if (tDelay > 0)
			{
				if (isTimerActive(Timer_MPC_SPL_Obj1_Obj2_MPC_AR2) == 0)
				{
					res = SetTimingCyclic("SPL_Obj1_Obj2_MPC_AR2", 1, tDelay, 1);
					setTimer (Timer_MPC_SPL_Obj1_Obj2_MPC_AR2, tDelay);
					@sysvar::CH_Nodes::CH__STPDU_MPC_SPL_Obj1_Obj2_MPC_AR2 = 2;
				}
			}
			else if (tDelay == 0)
			{
				if (isTimerActive(Timer_MPC_SPL_Obj1_Obj2_MPC_AR2) == 0)
				{
					res = EnableTimingCyclic("SPL_Obj1_Obj2_MPC_AR2", 0);
					res = EnableTimingEvtTrg("SPL_Obj1_Obj2_MPC_AR2", 0);
				}
			}
			break;
		case (2):
			break;
		default:
			Write("error: wrong parameter (%d)", @this);
			stop();
			break;
	}
}
/*@@end*/

/*@@sysvarChange:CH_Nodes::CH__STPDU_MPC_TSA_Disp_Rq1_Gw_AR2:*/
on sysvar sysvar::CH_Nodes::CH__STPDU_MPC_TSA_Disp_Rq1_Gw_AR2
{
	long res;
	long tDelay;
	switch (@this)
	{
		case (0):
			res = ResetTimingCyclic("TSA_Disp_Rq1_Gw_AR2");
			res = ResetTimingEvtTrg("TSA_Disp_Rq1_Gw_AR2");
			res = EnableTimingCyclic("TSA_Disp_Rq1_Gw_AR2", 1);
			res = EnableTimingEvtTrg("TSA_Disp_Rq1_Gw_AR2", 1);
			break;
		case (1):
			tDelay = @sysvar::CH_Nodes::CH__STPDU_T_MPC_TSA_Disp_Rq1_Gw_AR2;
			if (tDelay > 0)
			{
				if (isTimerActive(Timer_MPC_TSA_Disp_Rq1_Gw_AR2) == 0)
				{
					res = SetTimingCyclic("TSA_Disp_Rq1_Gw_AR2", 1, tDelay, 1);
					setTimer (Timer_MPC_TSA_Disp_Rq1_Gw_AR2, tDelay);
					@sysvar::CH_Nodes::CH__STPDU_MPC_TSA_Disp_Rq1_Gw_AR2 = 2;
				}
			}
			else if (tDelay == 0)
			{
				if (isTimerActive(Timer_MPC_TSA_Disp_Rq1_Gw_AR2) == 0)
				{
					res = EnableTimingCyclic("TSA_Disp_Rq1_Gw_AR2", 0);
					res = EnableTimingEvtTrg("TSA_Disp_Rq1_Gw_AR2", 0);
				}
			}
			break;
		case (2):
			break;
		default:
			Write("error: wrong parameter (%d)", @this);
			stop();
			break;
	}
}
/*@@end*/

/*@@sysvarChange:CH_Nodes::CH__STPDU_MPC_TSA_Disp_Rq2_Gw_AR:*/
on sysvar sysvar::CH_Nodes::CH__STPDU_MPC_TSA_Disp_Rq2_Gw_AR
{
	long res;
	long tDelay;
	switch (@this)
	{
		case (0):
			res = ResetTimingCyclic("TSA_Disp_Rq2_Gw_AR");
			res = ResetTimingEvtTrg("TSA_Disp_Rq2_Gw_AR");
			res = EnableTimingCyclic("TSA_Disp_Rq2_Gw_AR", 1);
			res = EnableTimingEvtTrg("TSA_Disp_Rq2_Gw_AR", 1);
			break;
		case (1):
			tDelay = @sysvar::CH_Nodes::CH__STPDU_T_MPC_TSA_Disp_Rq2_Gw_AR;
			if (tDelay > 0)
			{
				if (isTimerActive(Timer_MPC_TSA_Disp_Rq2_Gw_AR) == 0)
				{
					res = SetTimingCyclic("TSA_Disp_Rq2_Gw_AR", 1, tDelay, 1);
					setTimer (Timer_MPC_TSA_Disp_Rq2_Gw_AR, tDelay);
					@sysvar::CH_Nodes::CH__STPDU_MPC_TSA_Disp_Rq2_Gw_AR = 2;
				}
			}
			else if (tDelay == 0)
			{
				if (isTimerActive(Timer_MPC_TSA_Disp_Rq2_Gw_AR) == 0)
				{
					res = EnableTimingCyclic("TSA_Disp_Rq2_Gw_AR", 0);
					res = EnableTimingEvtTrg("TSA_Disp_Rq2_Gw_AR", 0);
				}
			}
			break;
		case (2):
			break;
		default:
			Write("error: wrong parameter (%d)", @this);
			stop();
			break;
	}
}
/*@@end*/

/*@@sysvarChange:CH_Nodes::CH__STPDU_MPC_TSA_Disp_Rq3_Gw_AR:*/
on sysvar sysvar::CH_Nodes::CH__STPDU_MPC_TSA_Disp_Rq3_Gw_AR
{
	long res;
	long tDelay;
	switch (@this)
	{
		case (0):
			res = ResetTimingCyclic("TSA_Disp_Rq3_Gw_AR");
			res = ResetTimingEvtTrg("TSA_Disp_Rq3_Gw_AR");
			res = EnableTimingCyclic("TSA_Disp_Rq3_Gw_AR", 1);
			res = EnableTimingEvtTrg("TSA_Disp_Rq3_Gw_AR", 1);
			break;
		case (1):
			tDelay = @sysvar::CH_Nodes::CH__STPDU_T_MPC_TSA_Disp_Rq3_Gw_AR;
			if (tDelay > 0)
			{
				if (isTimerActive(Timer_MPC_TSA_Disp_Rq3_Gw_AR) == 0)
				{
					res = SetTimingCyclic("TSA_Disp_Rq3_Gw_AR", 1, tDelay, 1);
					setTimer (Timer_MPC_TSA_Disp_Rq3_Gw_AR, tDelay);
					@sysvar::CH_Nodes::CH__STPDU_MPC_TSA_Disp_Rq3_Gw_AR = 2;
				}
			}
			else if (tDelay == 0)
			{
				if (isTimerActive(Timer_MPC_TSA_Disp_Rq3_Gw_AR) == 0)
				{
					res = EnableTimingCyclic("TSA_Disp_Rq3_Gw_AR", 0);
					res = EnableTimingEvtTrg("TSA_Disp_Rq3_Gw_AR", 0);
				}
			}
			break;
		case (2):
			break;
		default:
			Write("error: wrong parameter (%d)", @this);
			stop();
			break;
	}
}
/*@@end*/

/*@@sysvarChange:CH_Nodes::CH__STPDU_MPC_YMAS_Rq_MPC_Gw_AR2:*/
on sysvar sysvar::CH_Nodes::CH__STPDU_MPC_YMAS_Rq_MPC_Gw_AR2
{
	long res;
	long tDelay;
	switch (@this)
	{
		case (0):
			res = ResetTimingCyclic("YMAS_Rq_MPC_Gw_AR2");
			res = ResetTimingEvtTrg("YMAS_Rq_MPC_Gw_AR2");
			res = EnableTimingCyclic("YMAS_Rq_MPC_Gw_AR2", 1);
			res = EnableTimingEvtTrg("YMAS_Rq_MPC_Gw_AR2", 1);
			break;
		case (1):
			tDelay = @sysvar::CH_Nodes::CH__STPDU_T_MPC_YMAS_Rq_MPC_Gw_AR2;
			if (tDelay > 0)
			{
				if (isTimerActive(Timer_MPC_YMAS_Rq_MPC_Gw_AR2) == 0)
				{
					res = SetTimingCyclic("YMAS_Rq_MPC_Gw_AR2", 1, tDelay, 1);
					setTimer (Timer_MPC_YMAS_Rq_MPC_Gw_AR2, tDelay);
					@sysvar::CH_Nodes::CH__STPDU_MPC_YMAS_Rq_MPC_Gw_AR2 = 2;
				}
			}
			else if (tDelay == 0)
			{
				if (isTimerActive(Timer_MPC_YMAS_Rq_MPC_Gw_AR2) == 0)
				{
					res = EnableTimingCyclic("YMAS_Rq_MPC_Gw_AR2", 0);
					res = EnableTimingEvtTrg("YMAS_Rq_MPC_Gw_AR2", 0);
				}
			}
			break;
		case (2):
			break;
		default:
			Write("error: wrong parameter (%d)", @this);
			stop();
			break;
	}
}
/*@@end*/


/*@@sysvarChange:CH_Nodes::CH_MPCCRC_Cam_Stat_Pr2Cam_S_AUTO:*/
on sysvar sysvar::CH_Nodes::CH_MPCCRC_Cam_Stat_Pr2Cam_S_AUTO
{
//	EnableCRC("Cam_Stat_AR2",  "Cam_Stat_Pr2", !@this); // 1 = on, 0 = off 
	enableControl("Cam_Stat_AR2", "CH_MPCCRC_Cam_Stat_Pr2Cam_Stat__", @this); //1: enable; 0: disable
	CRC_Cam_Stat_Pr2 = @sysvar::CH_Nodes::CH_MPCCRC_Cam_Stat_Pr2Cam_S_AUTO;
}
/*@@end*/

/*@@sysvarChange:CH_Nodes::CH_MPCSQC_Cam_Stat_Pr2Cam_S_AUTO:*/
on sysvar sysvar::CH_Nodes::CH_MPCSQC_Cam_Stat_Pr2Cam_S_AUTO
{
//	EnableSQC("Cam_Stat_AR2",  "Cam_Stat_Pr2", !@this); // 1 = on, 0 = off 
	enableControl("Cam_Stat_AR2", "CH_MPCSQC_Cam_Stat_Pr2Cam_Stat__", @this); //1: enable; 0: disable
	SQC_Cam_Stat_Pr2 = @sysvar::CH_Nodes::CH_MPCSQC_Cam_Stat_Pr2Cam_S_AUTO;
}
/*@@end*/

/*@@sysvarChange:CH_Nodes::CH_MPCCamLane_Disp_Warn__UB_A_01:*/
on sysvar sysvar::CH_Nodes::CH_MPCCamLane_Disp_Warn__UB_A_01
{
	switch (@sysvar::CH_Nodes::CH_MPCCamLane_Disp_Warn__UB_A_01)
	{
		case (0):
			enableControl("CamLane_Disp_Warn_Rq_Gw_AR2", "CH_MPCCamLane_Disp_Warn_Rq_G__01", 0); //1: enable; 0: disable
			@sysvar::CH_Nodes::CH_MPCCamLane_Disp_Warn_Rq_G__01 = 1;
			break;
		case (1):
			enableControl("CamLane_Disp_Warn_Rq_Gw_AR2", "CH_MPCCamLane_Disp_Warn_Rq_G__01", 1); //1: enable; 0: disable
			break;
		case (2):
			enableControl("CamLane_Disp_Warn_Rq_Gw_AR2", "CH_MPCCamLane_Disp_Warn_Rq_G__01", 0); //1: enable; 0: disable
			@sysvar::CH_Nodes::CH_MPCCamLane_Disp_Warn_Rq_G__01 = 1;
			break;
		case (3):
			enableControl("CamLane_Disp_Warn_Rq_Gw_AR2", "CH_MPCCamLane_Disp_Warn_Rq_G__01", 0); //1: enable; 0: disable
			@sysvar::CH_Nodes::CH_MPCCamLane_Disp_Warn_Rq_G__01 = 0;
			break;
	}
}
/*@@end*/

/*@@sysvarChange:CH_Nodes::CH_MPCCRC_CamLane_Disp_Warn_AUTO:*/
on sysvar sysvar::CH_Nodes::CH_MPCCRC_CamLane_Disp_Warn_AUTO
{
//	EnableCRC("CamLane_Disp_Warn_Rq_Gw_AR2",  "CamLane_Disp_Warn_Rq_Pr2", !@this); // 1 = on, 0 = off 
	enableControl("CamLane_Disp_Warn_Rq_Gw_AR2", "CH_MPCCRC_CamLane_Disp_Warn_Rq__", @this); //1: enable; 0: disable
	CRC_CamLane_Disp_Warn_Rq_Pr2 = @sysvar::CH_Nodes::CH_MPCCRC_CamLane_Disp_Warn_AUTO;
}
/*@@end*/

/*@@sysvarChange:CH_Nodes::CH_MPCSQC_CamLane_Disp_Warn_AUTO:*/
on sysvar sysvar::CH_Nodes::CH_MPCSQC_CamLane_Disp_Warn_AUTO
{
//	EnableSQC("CamLane_Disp_Warn_Rq_Gw_AR2",  "CamLane_Disp_Warn_Rq_Pr2", !@this); // 1 = on, 0 = off 
	enableControl("CamLane_Disp_Warn_Rq_Gw_AR2", "CH_MPCSQC_CamLane_Disp_Warn_Rq__", @this); //1: enable; 0: disable
	SQC_CamLane_Disp_Warn_Rq_Pr2 = @sysvar::CH_Nodes::CH_MPCSQC_CamLane_Disp_Warn_AUTO;
}
/*@@end*/

/*@@sysvarChange:CH_Nodes::CH_MPCCRC_CamLane_FastAttr1_AUTO:*/
on sysvar sysvar::CH_Nodes::CH_MPCCRC_CamLane_FastAttr1_AUTO
{
//	EnableCRC("CamLane_FastAttr1_FR2",  "CamLane_FastAttr1_Pr2", !@this); // 1 = on, 0 = off 
	enableControl("CamLane_FastAttr1_FR2", "CH_MPCCRC_CamLane_FastAttr1_Pr2_", @this); //1: enable; 0: disable
	CRC_CamLane_FastAttr1_Pr2 = @sysvar::CH_Nodes::CH_MPCCRC_CamLane_FastAttr1_AUTO;
}
/*@@end*/

/*@@sysvarChange:CH_Nodes::CH_MPCSQC_CamLane_FastAttr1_AUTO:*/
on sysvar sysvar::CH_Nodes::CH_MPCSQC_CamLane_FastAttr1_AUTO
{
//	EnableSQC("CamLane_FastAttr1_FR2",  "CamLane_FastAttr1_Pr2", !@this); // 1 = on, 0 = off 
	enableControl("CamLane_FastAttr1_FR2", "CH_MPCSQC_CamLane_FastAttr1_Pr2_", @this); //1: enable; 0: disable
	SQC_CamLane_FastAttr1_Pr2 = @sysvar::CH_Nodes::CH_MPCSQC_CamLane_FastAttr1_AUTO;
}
/*@@end*/

/*@@sysvarChange:CH_Nodes::CH_MPCCRC_CamLane_FastAttr2_AUTO:*/
on sysvar sysvar::CH_Nodes::CH_MPCCRC_CamLane_FastAttr2_AUTO
{
//	EnableCRC("CamLane_FastAttr2_FR2",  "CamLane_FastAttr2_Pr2", !@this); // 1 = on, 0 = off 
	enableControl("CamLane_FastAttr2_FR2", "CH_MPCCRC_CamLane_FastAttr2_Pr2_", @this); //1: enable; 0: disable
	CRC_CamLane_FastAttr2_Pr2 = @sysvar::CH_Nodes::CH_MPCCRC_CamLane_FastAttr2_AUTO;
}
/*@@end*/

/*@@sysvarChange:CH_Nodes::CH_MPCSQC_CamLane_FastAttr2_AUTO:*/
on sysvar sysvar::CH_Nodes::CH_MPCSQC_CamLane_FastAttr2_AUTO
{
//	EnableSQC("CamLane_FastAttr2_FR2",  "CamLane_FastAttr2_Pr2", !@this); // 1 = on, 0 = off 
	enableControl("CamLane_FastAttr2_FR2", "CH_MPCSQC_CamLane_FastAttr2_Pr2_", @this); //1: enable; 0: disable
	SQC_CamLane_FastAttr2_Pr2 = @sysvar::CH_Nodes::CH_MPCSQC_CamLane_FastAttr2_AUTO;
}
/*@@end*/

/*@@sysvarChange:CH_Nodes::CH_MPCCamLane_LaneAttr1__UB_A_01:*/
on sysvar sysvar::CH_Nodes::CH_MPCCamLane_LaneAttr1__UB_A_01
{
	switch (@sysvar::CH_Nodes::CH_MPCCamLane_LaneAttr1__UB_A_01)
	{
		case (0):
			enableControl("CamLane_LaneAttr1_Gw_AR2", "CH_MPCCamLane_LaneAttr1_Gw_A__01", 0); //1: enable; 0: disable
			@sysvar::CH_Nodes::CH_MPCCamLane_LaneAttr1_Gw_A__01 = 1;
			break;
		case (1):
			enableControl("CamLane_LaneAttr1_Gw_AR2", "CH_MPCCamLane_LaneAttr1_Gw_A__01", 1); //1: enable; 0: disable
			break;
		case (2):
			enableControl("CamLane_LaneAttr1_Gw_AR2", "CH_MPCCamLane_LaneAttr1_Gw_A__01", 0); //1: enable; 0: disable
			@sysvar::CH_Nodes::CH_MPCCamLane_LaneAttr1_Gw_A__01 = 1;
			break;
		case (3):
			enableControl("CamLane_LaneAttr1_Gw_AR2", "CH_MPCCamLane_LaneAttr1_Gw_A__01", 0); //1: enable; 0: disable
			@sysvar::CH_Nodes::CH_MPCCamLane_LaneAttr1_Gw_A__01 = 0;
			break;
	}
}
/*@@end*/

/*@@sysvarChange:CH_Nodes::CH_MPCCRC_CamLane_LaneAttr1_AUTO:*/
on sysvar sysvar::CH_Nodes::CH_MPCCRC_CamLane_LaneAttr1_AUTO
{
//	EnableCRC("CamLane_LaneAttr1_Gw_AR2",  "CamLane_LaneAttr1_Pr2", !@this); // 1 = on, 0 = off 
	enableControl("CamLane_LaneAttr1_Gw_AR2", "CH_MPCCRC_CamLane_LaneAttr1_Pr2_", @this); //1: enable; 0: disable
	CRC_CamLane_LaneAttr1_Pr2 = @sysvar::CH_Nodes::CH_MPCCRC_CamLane_LaneAttr1_AUTO;
}
/*@@end*/

/*@@sysvarChange:CH_Nodes::CH_MPCSQC_CamLane_LaneAttr1_AUTO:*/
on sysvar sysvar::CH_Nodes::CH_MPCSQC_CamLane_LaneAttr1_AUTO
{
//	EnableSQC("CamLane_LaneAttr1_Gw_AR2",  "CamLane_LaneAttr1_Pr2", !@this); // 1 = on, 0 = off 
	enableControl("CamLane_LaneAttr1_Gw_AR2", "CH_MPCSQC_CamLane_LaneAttr1_Pr2_", @this); //1: enable; 0: disable
	SQC_CamLane_LaneAttr1_Pr2 = @sysvar::CH_Nodes::CH_MPCSQC_CamLane_LaneAttr1_AUTO;
}
/*@@end*/

/*@@sysvarChange:CH_Nodes::CH_MPCCamLane_LaneAttr2__UB_A_01:*/
on sysvar sysvar::CH_Nodes::CH_MPCCamLane_LaneAttr2__UB_A_01
{
	switch (@sysvar::CH_Nodes::CH_MPCCamLane_LaneAttr2__UB_A_01)
	{
		case (0):
			enableControl("CamLane_LaneAttr2_Gw_AR2", "CH_MPCCamLane_LaneAttr2_Gw_A__01", 0); //1: enable; 0: disable
			@sysvar::CH_Nodes::CH_MPCCamLane_LaneAttr2_Gw_A__01 = 1;
			break;
		case (1):
			enableControl("CamLane_LaneAttr2_Gw_AR2", "CH_MPCCamLane_LaneAttr2_Gw_A__01", 1); //1: enable; 0: disable
			break;
		case (2):
			enableControl("CamLane_LaneAttr2_Gw_AR2", "CH_MPCCamLane_LaneAttr2_Gw_A__01", 0); //1: enable; 0: disable
			@sysvar::CH_Nodes::CH_MPCCamLane_LaneAttr2_Gw_A__01 = 1;
			break;
		case (3):
			enableControl("CamLane_LaneAttr2_Gw_AR2", "CH_MPCCamLane_LaneAttr2_Gw_A__01", 0); //1: enable; 0: disable
			@sysvar::CH_Nodes::CH_MPCCamLane_LaneAttr2_Gw_A__01 = 0;
			break;
	}
}
/*@@end*/

/*@@sysvarChange:CH_Nodes::CH_MPCCRC_CamLane_LaneAttr2_AUTO:*/
on sysvar sysvar::CH_Nodes::CH_MPCCRC_CamLane_LaneAttr2_AUTO
{
//	EnableCRC("CamLane_LaneAttr2_Gw_AR2",  "CamLane_LaneAttr2_Pr2", !@this); // 1 = on, 0 = off 
	enableControl("CamLane_LaneAttr2_Gw_AR2", "CH_MPCCRC_CamLane_LaneAttr2_Pr2_", @this); //1: enable; 0: disable
	CRC_CamLane_LaneAttr2_Pr2 = @sysvar::CH_Nodes::CH_MPCCRC_CamLane_LaneAttr2_AUTO;
}
/*@@end*/

/*@@sysvarChange:CH_Nodes::CH_MPCSQC_CamLane_LaneAttr2_AUTO:*/
on sysvar sysvar::CH_Nodes::CH_MPCSQC_CamLane_LaneAttr2_AUTO
{
//	EnableSQC("CamLane_LaneAttr2_Gw_AR2",  "CamLane_LaneAttr2_Pr2", !@this); // 1 = on, 0 = off 
	enableControl("CamLane_LaneAttr2_Gw_AR2", "CH_MPCSQC_CamLane_LaneAttr2_Pr2_", @this); //1: enable; 0: disable
	SQC_CamLane_LaneAttr2_Pr2 = @sysvar::CH_Nodes::CH_MPCSQC_CamLane_LaneAttr2_AUTO;
}
/*@@end*/

/*@@sysvarChange:CH_Nodes::CH_MPCCamLane_LaneAttr3__UB_A_01:*/
on sysvar sysvar::CH_Nodes::CH_MPCCamLane_LaneAttr3__UB_A_01
{
	switch (@sysvar::CH_Nodes::CH_MPCCamLane_LaneAttr3__UB_A_01)
	{
		case (0):
			enableControl("CamLane_LaneAttr3_Gw_AR2", "CH_MPCCamLane_LaneAttr3_Gw_A__01", 0); //1: enable; 0: disable
			@sysvar::CH_Nodes::CH_MPCCamLane_LaneAttr3_Gw_A__01 = 1;
			break;
		case (1):
			enableControl("CamLane_LaneAttr3_Gw_AR2", "CH_MPCCamLane_LaneAttr3_Gw_A__01", 1); //1: enable; 0: disable
			break;
		case (2):
			enableControl("CamLane_LaneAttr3_Gw_AR2", "CH_MPCCamLane_LaneAttr3_Gw_A__01", 0); //1: enable; 0: disable
			@sysvar::CH_Nodes::CH_MPCCamLane_LaneAttr3_Gw_A__01 = 1;
			break;
		case (3):
			enableControl("CamLane_LaneAttr3_Gw_AR2", "CH_MPCCamLane_LaneAttr3_Gw_A__01", 0); //1: enable; 0: disable
			@sysvar::CH_Nodes::CH_MPCCamLane_LaneAttr3_Gw_A__01 = 0;
			break;
	}
}
/*@@end*/

/*@@sysvarChange:CH_Nodes::CH_MPCCRC_CamLane_LaneAttr3_AUTO:*/
on sysvar sysvar::CH_Nodes::CH_MPCCRC_CamLane_LaneAttr3_AUTO
{
//	EnableCRC("CamLane_LaneAttr3_Gw_AR2",  "CamLane_LaneAttr3_Pr2", !@this); // 1 = on, 0 = off 
	enableControl("CamLane_LaneAttr3_Gw_AR2", "CH_MPCCRC_CamLane_LaneAttr3_Pr2_", @this); //1: enable; 0: disable
	CRC_CamLane_LaneAttr3_Pr2 = @sysvar::CH_Nodes::CH_MPCCRC_CamLane_LaneAttr3_AUTO;
}
/*@@end*/

/*@@sysvarChange:CH_Nodes::CH_MPCSQC_CamLane_LaneAttr3_AUTO:*/
on sysvar sysvar::CH_Nodes::CH_MPCSQC_CamLane_LaneAttr3_AUTO
{
//	EnableSQC("CamLane_LaneAttr3_Gw_AR2",  "CamLane_LaneAttr3_Pr2", !@this); // 1 = on, 0 = off 
	enableControl("CamLane_LaneAttr3_Gw_AR2", "CH_MPCSQC_CamLane_LaneAttr3_Pr2_", @this); //1: enable; 0: disable
	SQC_CamLane_LaneAttr3_Pr2 = @sysvar::CH_Nodes::CH_MPCSQC_CamLane_LaneAttr3_AUTO;
}
/*@@end*/

/*@@sysvarChange:CH_Nodes::CH_MPCCRC_CamLane_LaneAttr4_AUTO:*/
on sysvar sysvar::CH_Nodes::CH_MPCCRC_CamLane_LaneAttr4_AUTO
{
//	EnableCRC("CamLane_LaneAttr4_FR2",  "CamLane_LaneAttr4_Pr2", !@this); // 1 = on, 0 = off 
	enableControl("CamLane_LaneAttr4_FR2", "CH_MPCCRC_CamLane_LaneAttr4_Pr2_", @this); //1: enable; 0: disable
	CRC_CamLane_LaneAttr4_Pr2 = @sysvar::CH_Nodes::CH_MPCCRC_CamLane_LaneAttr4_AUTO;
}
/*@@end*/

/*@@sysvarChange:CH_Nodes::CH_MPCSQC_CamLane_LaneAttr4_AUTO:*/
on sysvar sysvar::CH_Nodes::CH_MPCSQC_CamLane_LaneAttr4_AUTO
{
//	EnableSQC("CamLane_LaneAttr4_FR2",  "CamLane_LaneAttr4_Pr2", !@this); // 1 = on, 0 = off 
	enableControl("CamLane_LaneAttr4_FR2", "CH_MPCSQC_CamLane_LaneAttr4_Pr2_", @this); //1: enable; 0: disable
	SQC_CamLane_LaneAttr4_Pr2 = @sysvar::CH_Nodes::CH_MPCSQC_CamLane_LaneAttr4_AUTO;
}
/*@@end*/

/*@@sysvarChange:CH_Nodes::CH_MPCCRC_CamLane_LaneAttr5_AUTO:*/
on sysvar sysvar::CH_Nodes::CH_MPCCRC_CamLane_LaneAttr5_AUTO
{
//	EnableCRC("CamLane_LaneAttr5_FR2",  "CamLane_LaneAttr5_Pr2", !@this); // 1 = on, 0 = off 
	enableControl("CamLane_LaneAttr5_FR2", "CH_MPCCRC_CamLane_LaneAttr5_Pr2_", @this); //1: enable; 0: disable
	CRC_CamLane_LaneAttr5_Pr2 = @sysvar::CH_Nodes::CH_MPCCRC_CamLane_LaneAttr5_AUTO;
}
/*@@end*/

/*@@sysvarChange:CH_Nodes::CH_MPCSQC_CamLane_LaneAttr5_AUTO:*/
on sysvar sysvar::CH_Nodes::CH_MPCSQC_CamLane_LaneAttr5_AUTO
{
//	EnableSQC("CamLane_LaneAttr5_FR2",  "CamLane_LaneAttr5_Pr2", !@this); // 1 = on, 0 = off 
	enableControl("CamLane_LaneAttr5_FR2", "CH_MPCSQC_CamLane_LaneAttr5_Pr2_", @this); //1: enable; 0: disable
	SQC_CamLane_LaneAttr5_Pr2 = @sysvar::CH_Nodes::CH_MPCSQC_CamLane_LaneAttr5_AUTO;
}
/*@@end*/

/*@@sysvarChange:CH_Nodes::CH_MPCCamLane_LaneAttr6__UB_A_01:*/
on sysvar sysvar::CH_Nodes::CH_MPCCamLane_LaneAttr6__UB_A_01
{
	switch (@sysvar::CH_Nodes::CH_MPCCamLane_LaneAttr6__UB_A_01)
	{
		case (0):
			enableControl("CamLane_LaneAttr6_Gw_AR2", "CH_MPCCamLane_LaneAttr6_Gw_A__01", 0); //1: enable; 0: disable
			@sysvar::CH_Nodes::CH_MPCCamLane_LaneAttr6_Gw_A__01 = 1;
			break;
		case (1):
			enableControl("CamLane_LaneAttr6_Gw_AR2", "CH_MPCCamLane_LaneAttr6_Gw_A__01", 1); //1: enable; 0: disable
			break;
		case (2):
			enableControl("CamLane_LaneAttr6_Gw_AR2", "CH_MPCCamLane_LaneAttr6_Gw_A__01", 0); //1: enable; 0: disable
			@sysvar::CH_Nodes::CH_MPCCamLane_LaneAttr6_Gw_A__01 = 1;
			break;
		case (3):
			enableControl("CamLane_LaneAttr6_Gw_AR2", "CH_MPCCamLane_LaneAttr6_Gw_A__01", 0); //1: enable; 0: disable
			@sysvar::CH_Nodes::CH_MPCCamLane_LaneAttr6_Gw_A__01 = 0;
			break;
	}
}
/*@@end*/

/*@@sysvarChange:CH_Nodes::CH_MPCCRC_CamLane_LaneAttr6_AUTO:*/
on sysvar sysvar::CH_Nodes::CH_MPCCRC_CamLane_LaneAttr6_AUTO
{
//	EnableCRC("CamLane_LaneAttr6_Gw_AR2",  "CamLane_LaneAttr6_Pr2", !@this); // 1 = on, 0 = off 
	enableControl("CamLane_LaneAttr6_Gw_AR2", "CH_MPCCRC_CamLane_LaneAttr6_Pr2_", @this); //1: enable; 0: disable
	CRC_CamLane_LaneAttr6_Pr2 = @sysvar::CH_Nodes::CH_MPCCRC_CamLane_LaneAttr6_AUTO;
}
/*@@end*/

/*@@sysvarChange:CH_Nodes::CH_MPCSQC_CamLane_LaneAttr6_AUTO:*/
on sysvar sysvar::CH_Nodes::CH_MPCSQC_CamLane_LaneAttr6_AUTO
{
//	EnableSQC("CamLane_LaneAttr6_Gw_AR2",  "CamLane_LaneAttr6_Pr2", !@this); // 1 = on, 0 = off 
	enableControl("CamLane_LaneAttr6_Gw_AR2", "CH_MPCSQC_CamLane_LaneAttr6_Pr2_", @this); //1: enable; 0: disable
	SQC_CamLane_LaneAttr6_Pr2 = @sysvar::CH_Nodes::CH_MPCSQC_CamLane_LaneAttr6_AUTO;
}
/*@@end*/

/*@@sysvarChange:CH_Nodes::CH_MPCCamLane_LaneAttr7__UB_A_01:*/
on sysvar sysvar::CH_Nodes::CH_MPCCamLane_LaneAttr7__UB_A_01
{
	switch (@sysvar::CH_Nodes::CH_MPCCamLane_LaneAttr7__UB_A_01)
	{
		case (0):
			enableControl("CamLane_LaneAttr7_Gw_AR2", "CH_MPCCamLane_LaneAttr7_Gw_A__01", 0); //1: enable; 0: disable
			@sysvar::CH_Nodes::CH_MPCCamLane_LaneAttr7_Gw_A__01 = 1;
			break;
		case (1):
			enableControl("CamLane_LaneAttr7_Gw_AR2", "CH_MPCCamLane_LaneAttr7_Gw_A__01", 1); //1: enable; 0: disable
			break;
		case (2):
			enableControl("CamLane_LaneAttr7_Gw_AR2", "CH_MPCCamLane_LaneAttr7_Gw_A__01", 0); //1: enable; 0: disable
			@sysvar::CH_Nodes::CH_MPCCamLane_LaneAttr7_Gw_A__01 = 1;
			break;
		case (3):
			enableControl("CamLane_LaneAttr7_Gw_AR2", "CH_MPCCamLane_LaneAttr7_Gw_A__01", 0); //1: enable; 0: disable
			@sysvar::CH_Nodes::CH_MPCCamLane_LaneAttr7_Gw_A__01 = 0;
			break;
	}
}
/*@@end*/

/*@@sysvarChange:CH_Nodes::CH_MPCCRC_CamLane_LaneAttr7_AUTO:*/
on sysvar sysvar::CH_Nodes::CH_MPCCRC_CamLane_LaneAttr7_AUTO
{
//	EnableCRC("CamLane_LaneAttr7_Gw_AR2",  "CamLane_LaneAttr7_Pr2", !@this); // 1 = on, 0 = off 
	enableControl("CamLane_LaneAttr7_Gw_AR2", "CH_MPCCRC_CamLane_LaneAttr7_Pr2_", @this); //1: enable; 0: disable
	CRC_CamLane_LaneAttr7_Pr2 = @sysvar::CH_Nodes::CH_MPCCRC_CamLane_LaneAttr7_AUTO;
}
/*@@end*/

/*@@sysvarChange:CH_Nodes::CH_MPCSQC_CamLane_LaneAttr7_AUTO:*/
on sysvar sysvar::CH_Nodes::CH_MPCSQC_CamLane_LaneAttr7_AUTO
{
//	EnableSQC("CamLane_LaneAttr7_Gw_AR2",  "CamLane_LaneAttr7_Pr2", !@this); // 1 = on, 0 = off 
	enableControl("CamLane_LaneAttr7_Gw_AR2", "CH_MPCSQC_CamLane_LaneAttr7_Pr2_", @this); //1: enable; 0: disable
	SQC_CamLane_LaneAttr7_Pr2 = @sysvar::CH_Nodes::CH_MPCSQC_CamLane_LaneAttr7_AUTO;
}
/*@@end*/

/*@@sysvarChange:CH_Nodes::CH_MPCCRC_CamObj_A_Mtn_Pr2C_AUTO:*/
on sysvar sysvar::CH_Nodes::CH_MPCCRC_CamObj_A_Mtn_Pr2C_AUTO
{
//	EnableCRC("CamObj_A_Mtn_FR2",  "CamObj_A_Mtn_Pr2", !@this); // 1 = on, 0 = off 
	enableControl("CamObj_A_Mtn_FR2", "CH_MPCCRC_CamObj_A_Mtn_Pr2CamOb_", @this); //1: enable; 0: disable
	CRC_CamObj_A_Mtn_Pr2 = @sysvar::CH_Nodes::CH_MPCCRC_CamObj_A_Mtn_Pr2C_AUTO;
}
/*@@end*/

/*@@sysvarChange:CH_Nodes::CH_MPCSQC_CamObj_A_Mtn_Pr2C_AUTO:*/
on sysvar sysvar::CH_Nodes::CH_MPCSQC_CamObj_A_Mtn_Pr2C_AUTO
{
//	EnableSQC("CamObj_A_Mtn_FR2",  "CamObj_A_Mtn_Pr2", !@this); // 1 = on, 0 = off 
	enableControl("CamObj_A_Mtn_FR2", "CH_MPCSQC_CamObj_A_Mtn_Pr2CamOb_", @this); //1: enable; 0: disable
	SQC_CamObj_A_Mtn_Pr2 = @sysvar::CH_Nodes::CH_MPCSQC_CamObj_A_Mtn_Pr2C_AUTO;
}
/*@@end*/

/*@@sysvarChange:CH_Nodes::CH_MPCCRC_CamObj_A_Posn_Pr2_AUTO:*/
on sysvar sysvar::CH_Nodes::CH_MPCCRC_CamObj_A_Posn_Pr2_AUTO
{
//	EnableCRC("CamObj_A_Posn_FR2",  "CamObj_A_Posn_Pr2", !@this); // 1 = on, 0 = off 
	enableControl("CamObj_A_Posn_FR2", "CH_MPCCRC_CamObj_A_Posn_Pr2CamO_", @this); //1: enable; 0: disable
	CRC_CamObj_A_Posn_Pr2 = @sysvar::CH_Nodes::CH_MPCCRC_CamObj_A_Posn_Pr2_AUTO;
}
/*@@end*/

/*@@sysvarChange:CH_Nodes::CH_MPCSQC_CamObj_A_Posn_Pr2_AUTO:*/
on sysvar sysvar::CH_Nodes::CH_MPCSQC_CamObj_A_Posn_Pr2_AUTO
{
//	EnableSQC("CamObj_A_Posn_FR2",  "CamObj_A_Posn_Pr2", !@this); // 1 = on, 0 = off 
	enableControl("CamObj_A_Posn_FR2", "CH_MPCSQC_CamObj_A_Posn_Pr2CamO_", @this); //1: enable; 0: disable
	SQC_CamObj_A_Posn_Pr2 = @sysvar::CH_Nodes::CH_MPCSQC_CamObj_A_Posn_Pr2_AUTO;
}
/*@@end*/

/*@@sysvarChange:CH_Nodes::CH_MPCCRC_CamObj_B_Mtn_Pr2C_AUTO:*/
on sysvar sysvar::CH_Nodes::CH_MPCCRC_CamObj_B_Mtn_Pr2C_AUTO
{
//	EnableCRC("CamObj_B_Mtn_FR2",  "CamObj_B_Mtn_Pr2", !@this); // 1 = on, 0 = off 
	enableControl("CamObj_B_Mtn_FR2", "CH_MPCCRC_CamObj_B_Mtn_Pr2CamOb_", @this); //1: enable; 0: disable
	CRC_CamObj_B_Mtn_Pr2 = @sysvar::CH_Nodes::CH_MPCCRC_CamObj_B_Mtn_Pr2C_AUTO;
}
/*@@end*/

/*@@sysvarChange:CH_Nodes::CH_MPCSQC_CamObj_B_Mtn_Pr2C_AUTO:*/
on sysvar sysvar::CH_Nodes::CH_MPCSQC_CamObj_B_Mtn_Pr2C_AUTO
{
//	EnableSQC("CamObj_B_Mtn_FR2",  "CamObj_B_Mtn_Pr2", !@this); // 1 = on, 0 = off 
	enableControl("CamObj_B_Mtn_FR2", "CH_MPCSQC_CamObj_B_Mtn_Pr2CamOb_", @this); //1: enable; 0: disable
	SQC_CamObj_B_Mtn_Pr2 = @sysvar::CH_Nodes::CH_MPCSQC_CamObj_B_Mtn_Pr2C_AUTO;
}
/*@@end*/

/*@@sysvarChange:CH_Nodes::CH_MPCCRC_CamObj_B_Posn_Pr2_AUTO:*/
on sysvar sysvar::CH_Nodes::CH_MPCCRC_CamObj_B_Posn_Pr2_AUTO
{
//	EnableCRC("CamObj_B_Posn_FR2",  "CamObj_B_Posn_Pr2", !@this); // 1 = on, 0 = off 
	enableControl("CamObj_B_Posn_FR2", "CH_MPCCRC_CamObj_B_Posn_Pr2CamO_", @this); //1: enable; 0: disable
	CRC_CamObj_B_Posn_Pr2 = @sysvar::CH_Nodes::CH_MPCCRC_CamObj_B_Posn_Pr2_AUTO;
}
/*@@end*/

/*@@sysvarChange:CH_Nodes::CH_MPCSQC_CamObj_B_Posn_Pr2_AUTO:*/
on sysvar sysvar::CH_Nodes::CH_MPCSQC_CamObj_B_Posn_Pr2_AUTO
{
//	EnableSQC("CamObj_B_Posn_FR2",  "CamObj_B_Posn_Pr2", !@this); // 1 = on, 0 = off 
	enableControl("CamObj_B_Posn_FR2", "CH_MPCSQC_CamObj_B_Posn_Pr2CamO_", @this); //1: enable; 0: disable
	SQC_CamObj_B_Posn_Pr2 = @sysvar::CH_Nodes::CH_MPCSQC_CamObj_B_Posn_Pr2_AUTO;
}
/*@@end*/

/*@@sysvarChange:CH_Nodes::CH_MPCCRC_CamObj_C_Mtn_Pr2C_AUTO:*/
on sysvar sysvar::CH_Nodes::CH_MPCCRC_CamObj_C_Mtn_Pr2C_AUTO
{
//	EnableCRC("CamObj_C_Mtn_FR2",  "CamObj_C_Mtn_Pr2", !@this); // 1 = on, 0 = off 
	enableControl("CamObj_C_Mtn_FR2", "CH_MPCCRC_CamObj_C_Mtn_Pr2CamOb_", @this); //1: enable; 0: disable
	CRC_CamObj_C_Mtn_Pr2 = @sysvar::CH_Nodes::CH_MPCCRC_CamObj_C_Mtn_Pr2C_AUTO;
}
/*@@end*/

/*@@sysvarChange:CH_Nodes::CH_MPCSQC_CamObj_C_Mtn_Pr2C_AUTO:*/
on sysvar sysvar::CH_Nodes::CH_MPCSQC_CamObj_C_Mtn_Pr2C_AUTO
{
//	EnableSQC("CamObj_C_Mtn_FR2",  "CamObj_C_Mtn_Pr2", !@this); // 1 = on, 0 = off 
	enableControl("CamObj_C_Mtn_FR2", "CH_MPCSQC_CamObj_C_Mtn_Pr2CamOb_", @this); //1: enable; 0: disable
	SQC_CamObj_C_Mtn_Pr2 = @sysvar::CH_Nodes::CH_MPCSQC_CamObj_C_Mtn_Pr2C_AUTO;
}
/*@@end*/

/*@@sysvarChange:CH_Nodes::CH_MPCCRC_CamObj_C_Posn_Pr2_AUTO:*/
on sysvar sysvar::CH_Nodes::CH_MPCCRC_CamObj_C_Posn_Pr2_AUTO
{
//	EnableCRC("CamObj_C_Posn_FR2",  "CamObj_C_Posn_Pr2", !@this); // 1 = on, 0 = off 
	enableControl("CamObj_C_Posn_FR2", "CH_MPCCRC_CamObj_C_Posn_Pr2CamO_", @this); //1: enable; 0: disable
	CRC_CamObj_C_Posn_Pr2 = @sysvar::CH_Nodes::CH_MPCCRC_CamObj_C_Posn_Pr2_AUTO;
}
/*@@end*/

/*@@sysvarChange:CH_Nodes::CH_MPCSQC_CamObj_C_Posn_Pr2_AUTO:*/
on sysvar sysvar::CH_Nodes::CH_MPCSQC_CamObj_C_Posn_Pr2_AUTO
{
//	EnableSQC("CamObj_C_Posn_FR2",  "CamObj_C_Posn_Pr2", !@this); // 1 = on, 0 = off 
	enableControl("CamObj_C_Posn_FR2", "CH_MPCSQC_CamObj_C_Posn_Pr2CamO_", @this); //1: enable; 0: disable
	SQC_CamObj_C_Posn_Pr2 = @sysvar::CH_Nodes::CH_MPCSQC_CamObj_C_Posn_Pr2_AUTO;
}
/*@@end*/

/*@@sysvarChange:CH_Nodes::CH_MPCIHC_Lgt_Stat_MPC_G_UB_A_01:*/
on sysvar sysvar::CH_Nodes::CH_MPCIHC_Lgt_Stat_MPC_G_UB_A_01
{
	switch (@sysvar::CH_Nodes::CH_MPCIHC_Lgt_Stat_MPC_G_UB_A_01)
	{
		case (0):
			enableControl("IHC_Lgt_Stat_MPC_Gw_AR2", "CH_MPCIHC_Lgt_Stat_MPC_Gw_AR__01", 0); //1: enable; 0: disable
			@sysvar::CH_Nodes::CH_MPCIHC_Lgt_Stat_MPC_Gw_AR__01 = 1;
			break;
		case (1):
			enableControl("IHC_Lgt_Stat_MPC_Gw_AR2", "CH_MPCIHC_Lgt_Stat_MPC_Gw_AR__01", 1); //1: enable; 0: disable
			break;
		case (2):
			enableControl("IHC_Lgt_Stat_MPC_Gw_AR2", "CH_MPCIHC_Lgt_Stat_MPC_Gw_AR__01", 0); //1: enable; 0: disable
			@sysvar::CH_Nodes::CH_MPCIHC_Lgt_Stat_MPC_Gw_AR__01 = 1;
			break;
		case (3):
			enableControl("IHC_Lgt_Stat_MPC_Gw_AR2", "CH_MPCIHC_Lgt_Stat_MPC_Gw_AR__01", 0); //1: enable; 0: disable
			@sysvar::CH_Nodes::CH_MPCIHC_Lgt_Stat_MPC_Gw_AR__01 = 0;
			break;
	}
}
/*@@end*/

/*@@sysvarChange:CH_Nodes::CH_MPCCRC_IHC_Lgt_Stat_MPC__AUTO:*/
on sysvar sysvar::CH_Nodes::CH_MPCCRC_IHC_Lgt_Stat_MPC__AUTO
{
//	EnableCRC("IHC_Lgt_Stat_MPC_Gw_AR2",  "IHC_Lgt_Stat_MPC_Pr2", !@this); // 1 = on, 0 = off 
	enableControl("IHC_Lgt_Stat_MPC_Gw_AR2", "CH_MPCCRC_IHC_Lgt_Stat_MPC_Pr2I_", @this); //1: enable; 0: disable
	CRC_IHC_Lgt_Stat_MPC_Pr2 = @sysvar::CH_Nodes::CH_MPCCRC_IHC_Lgt_Stat_MPC__AUTO;
}
/*@@end*/

/*@@sysvarChange:CH_Nodes::CH_MPCSQC_IHC_Lgt_Stat_MPC__AUTO:*/
on sysvar sysvar::CH_Nodes::CH_MPCSQC_IHC_Lgt_Stat_MPC__AUTO
{
//	EnableSQC("IHC_Lgt_Stat_MPC_Gw_AR2",  "IHC_Lgt_Stat_MPC_Pr2", !@this); // 1 = on, 0 = off 
	enableControl("IHC_Lgt_Stat_MPC_Gw_AR2", "CH_MPCSQC_IHC_Lgt_Stat_MPC_Pr2I_", @this); //1: enable; 0: disable
	SQC_IHC_Lgt_Stat_MPC_Pr2 = @sysvar::CH_Nodes::CH_MPCSQC_IHC_Lgt_Stat_MPC__AUTO;
}
/*@@end*/

/*@@sysvarChange:CH_Nodes::CH_MPCIHC_Plus_HL_Stat_A_UB_A_01:*/
on sysvar sysvar::CH_Nodes::CH_MPCIHC_Plus_HL_Stat_A_UB_A_01
{
	switch (@sysvar::CH_Nodes::CH_MPCIHC_Plus_HL_Stat_A_UB_A_01)
	{
		case (0):
			enableControl("IHC_Plus_HL_Stat_AR2", "CH_MPCIHC_Plus_HL_Stat_AR2_UB_01", 0); //1: enable; 0: disable
			@sysvar::CH_Nodes::CH_MPCIHC_Plus_HL_Stat_AR2_UB_01 = 1;
			break;
		case (1):
			enableControl("IHC_Plus_HL_Stat_AR2", "CH_MPCIHC_Plus_HL_Stat_AR2_UB_01", 1); //1: enable; 0: disable
			break;
		case (2):
			enableControl("IHC_Plus_HL_Stat_AR2", "CH_MPCIHC_Plus_HL_Stat_AR2_UB_01", 0); //1: enable; 0: disable
			@sysvar::CH_Nodes::CH_MPCIHC_Plus_HL_Stat_AR2_UB_01 = 1;
			break;
		case (3):
			enableControl("IHC_Plus_HL_Stat_AR2", "CH_MPCIHC_Plus_HL_Stat_AR2_UB_01", 0); //1: enable; 0: disable
			@sysvar::CH_Nodes::CH_MPCIHC_Plus_HL_Stat_AR2_UB_01 = 0;
			break;
	}
}
/*@@end*/

/*@@sysvarChange:CH_Nodes::CH_MPCCRC_IHC_Plus_HL_Stat__AUTO:*/
on sysvar sysvar::CH_Nodes::CH_MPCCRC_IHC_Plus_HL_Stat__AUTO
{
//	EnableCRC("IHC_Plus_HL_Stat_AR2",  "IHC_Plus_HL_Stat_Pr2", !@this); // 1 = on, 0 = off 
	enableControl("IHC_Plus_HL_Stat_AR2", "CH_MPCCRC_IHC_Plus_HL_Stat_Pr2I_", @this); //1: enable; 0: disable
	CRC_IHC_Plus_HL_Stat_Pr2 = @sysvar::CH_Nodes::CH_MPCCRC_IHC_Plus_HL_Stat__AUTO;
}
/*@@end*/

/*@@sysvarChange:CH_Nodes::CH_MPCSQC_IHC_Plus_HL_Stat__AUTO:*/
on sysvar sysvar::CH_Nodes::CH_MPCSQC_IHC_Plus_HL_Stat__AUTO
{
//	EnableSQC("IHC_Plus_HL_Stat_AR2",  "IHC_Plus_HL_Stat_Pr2", !@this); // 1 = on, 0 = off 
	enableControl("IHC_Plus_HL_Stat_AR2", "CH_MPCSQC_IHC_Plus_HL_Stat_Pr2I_", @this); //1: enable; 0: disable
	SQC_IHC_Plus_HL_Stat_Pr2 = @sysvar::CH_Nodes::CH_MPCSQC_IHC_Plus_HL_Stat__AUTO;
}
/*@@end*/

/*@@sysvarChange:CH_Nodes::CH_MPCIHC_Plus_Tunnel_3__UB_AUTO:*/
on sysvar sysvar::CH_Nodes::CH_MPCIHC_Plus_Tunnel_3__UB_AUTO
{
	switch (@sysvar::CH_Nodes::CH_MPCIHC_Plus_Tunnel_3__UB_AUTO)
	{
		case (0):
			enableControl("IHC_Plus_Tunnel_3_4_AR2", "CH_MPCIHC_Plus_Tunnel_3_4_AR_UB_", 0); //1: enable; 0: disable
			@sysvar::CH_Nodes::CH_MPCIHC_Plus_Tunnel_3_4_AR_UB_ = 1;
			break;
		case (1):
			enableControl("IHC_Plus_Tunnel_3_4_AR2", "CH_MPCIHC_Plus_Tunnel_3_4_AR_UB_", 1); //1: enable; 0: disable
			break;
		case (2):
			enableControl("IHC_Plus_Tunnel_3_4_AR2", "CH_MPCIHC_Plus_Tunnel_3_4_AR_UB_", 0); //1: enable; 0: disable
			@sysvar::CH_Nodes::CH_MPCIHC_Plus_Tunnel_3_4_AR_UB_ = 1;
			break;
		case (3):
			enableControl("IHC_Plus_Tunnel_3_4_AR2", "CH_MPCIHC_Plus_Tunnel_3_4_AR_UB_", 0); //1: enable; 0: disable
			@sysvar::CH_Nodes::CH_MPCIHC_Plus_Tunnel_3_4_AR_UB_ = 0;
			break;
	}
}
/*@@end*/

/*@@sysvarChange:CH_Nodes::CH_MPCCRC_IHC_Plus_Tunnel_3_AUTO:*/
on sysvar sysvar::CH_Nodes::CH_MPCCRC_IHC_Plus_Tunnel_3_AUTO
{
//	EnableCRC("IHC_Plus_Tunnel_3_4_AR2",  "IHC_Plus_Tunnel_3_4_Pr2", !@this); // 1 = on, 0 = off 
	enableControl("IHC_Plus_Tunnel_3_4_AR2", "CH_MPCCRC_IHC_Plus_Tunnel_3_4_P_", @this); //1: enable; 0: disable
	CRC_IHC_Plus_Tunnel_3_4_Pr2 = @sysvar::CH_Nodes::CH_MPCCRC_IHC_Plus_Tunnel_3_AUTO;
}
/*@@end*/

/*@@sysvarChange:CH_Nodes::CH_MPCSQC_IHC_Plus_Tunnel_3_AUTO:*/
on sysvar sysvar::CH_Nodes::CH_MPCSQC_IHC_Plus_Tunnel_3_AUTO
{
//	EnableSQC("IHC_Plus_Tunnel_3_4_AR2",  "IHC_Plus_Tunnel_3_4_Pr2", !@this); // 1 = on, 0 = off 
	enableControl("IHC_Plus_Tunnel_3_4_AR2", "CH_MPCSQC_IHC_Plus_Tunnel_3_4_P_", @this); //1: enable; 0: disable
	SQC_IHC_Plus_Tunnel_3_4_Pr2 = @sysvar::CH_Nodes::CH_MPCSQC_IHC_Plus_Tunnel_3_AUTO;
}
/*@@end*/

/*@@sysvarChange:CH_Nodes::CH_MPCIHC_Plus_Tunnel_AR_UB_A_01:*/
on sysvar sysvar::CH_Nodes::CH_MPCIHC_Plus_Tunnel_AR_UB_A_01
{
	switch (@sysvar::CH_Nodes::CH_MPCIHC_Plus_Tunnel_AR_UB_A_01)
	{
		case (0):
			enableControl("IHC_Plus_Tunnel_AR2", "CH_MPCIHC_Plus_Tunnel_AR2_UB__01", 0); //1: enable; 0: disable
			@sysvar::CH_Nodes::CH_MPCIHC_Plus_Tunnel_AR2_UB__01 = 1;
			break;
		case (1):
			enableControl("IHC_Plus_Tunnel_AR2", "CH_MPCIHC_Plus_Tunnel_AR2_UB__01", 1); //1: enable; 0: disable
			break;
		case (2):
			enableControl("IHC_Plus_Tunnel_AR2", "CH_MPCIHC_Plus_Tunnel_AR2_UB__01", 0); //1: enable; 0: disable
			@sysvar::CH_Nodes::CH_MPCIHC_Plus_Tunnel_AR2_UB__01 = 1;
			break;
		case (3):
			enableControl("IHC_Plus_Tunnel_AR2", "CH_MPCIHC_Plus_Tunnel_AR2_UB__01", 0); //1: enable; 0: disable
			@sysvar::CH_Nodes::CH_MPCIHC_Plus_Tunnel_AR2_UB__01 = 0;
			break;
	}
}
/*@@end*/

/*@@sysvarChange:CH_Nodes::CH_MPCCRC_IHC_Plus_Tunnel_P_AUTO:*/
on sysvar sysvar::CH_Nodes::CH_MPCCRC_IHC_Plus_Tunnel_P_AUTO
{
//	EnableCRC("IHC_Plus_Tunnel_AR2",  "IHC_Plus_Tunnel_Pr2", !@this); // 1 = on, 0 = off 
	enableControl("IHC_Plus_Tunnel_AR2", "CH_MPCCRC_IHC_Plus_Tunnel_Pr2IH_", @this); //1: enable; 0: disable
	CRC_IHC_Plus_Tunnel_Pr2 = @sysvar::CH_Nodes::CH_MPCCRC_IHC_Plus_Tunnel_P_AUTO;
}
/*@@end*/

/*@@sysvarChange:CH_Nodes::CH_MPCSQC_IHC_Plus_Tunnel_P_AUTO:*/
on sysvar sysvar::CH_Nodes::CH_MPCSQC_IHC_Plus_Tunnel_P_AUTO
{
//	EnableSQC("IHC_Plus_Tunnel_AR2",  "IHC_Plus_Tunnel_Pr2", !@this); // 1 = on, 0 = off 
	enableControl("IHC_Plus_Tunnel_AR2", "CH_MPCSQC_IHC_Plus_Tunnel_Pr2IH_", @this); //1: enable; 0: disable
	SQC_IHC_Plus_Tunnel_Pr2 = @sysvar::CH_Nodes::CH_MPCSQC_IHC_Plus_Tunnel_P_AUTO;
}
/*@@end*/

/*@@sysvarChange:CH_Nodes::CH_MPCCRC_Preview_Header1_P_AUTO:*/
on sysvar sysvar::CH_Nodes::CH_MPCCRC_Preview_Header1_P_AUTO
{
//	EnableCRC("Preview_Header1_FR2",  "Preview_Header1_Pr2", !@this); // 1 = on, 0 = off 
	enableControl("Preview_Header1_FR2", "CH_MPCCRC_Preview_Header1_Pr2Pr_", @this); //1: enable; 0: disable
	CRC_Preview_Header1_Pr2 = @sysvar::CH_Nodes::CH_MPCCRC_Preview_Header1_P_AUTO;
}
/*@@end*/

/*@@sysvarChange:CH_Nodes::CH_MPCSQC_Preview_Header1_P_AUTO:*/
on sysvar sysvar::CH_Nodes::CH_MPCSQC_Preview_Header1_P_AUTO
{
//	EnableSQC("Preview_Header1_FR2",  "Preview_Header1_Pr2", !@this); // 1 = on, 0 = off 
	enableControl("Preview_Header1_FR2", "CH_MPCSQC_Preview_Header1_Pr2Pr_", @this); //1: enable; 0: disable
	SQC_Preview_Header1_Pr2 = @sysvar::CH_Nodes::CH_MPCSQC_Preview_Header1_P_AUTO;
}
/*@@end*/

/*@@sysvarChange:CH_Nodes::CH_MPCCRC_Preview_Header2_P_AUTO:*/
on sysvar sysvar::CH_Nodes::CH_MPCCRC_Preview_Header2_P_AUTO
{
//	EnableCRC("Preview_Header2_FR2",  "Preview_Header2_Pr2", !@this); // 1 = on, 0 = off 
	enableControl("Preview_Header2_FR2", "CH_MPCCRC_Preview_Header2_Pr2Pr_", @this); //1: enable; 0: disable
	CRC_Preview_Header2_Pr2 = @sysvar::CH_Nodes::CH_MPCCRC_Preview_Header2_P_AUTO;
}
/*@@end*/

/*@@sysvarChange:CH_Nodes::CH_MPCSQC_Preview_Header2_P_AUTO:*/
on sysvar sysvar::CH_Nodes::CH_MPCSQC_Preview_Header2_P_AUTO
{
//	EnableSQC("Preview_Header2_FR2",  "Preview_Header2_Pr2", !@this); // 1 = on, 0 = off 
	enableControl("Preview_Header2_FR2", "CH_MPCSQC_Preview_Header2_Pr2Pr_", @this); //1: enable; 0: disable
	SQC_Preview_Header2_Pr2 = @sysvar::CH_Nodes::CH_MPCSQC_Preview_Header2_P_AUTO;
}
/*@@end*/

/*@@sysvarChange:CH_Nodes::CH_MPCCRC_Preview_ProfData1_AUTO:*/
on sysvar sysvar::CH_Nodes::CH_MPCCRC_Preview_ProfData1_AUTO
{
//	EnableCRC("Preview_ProfData1_FR2",  "Preview_ProfData1_Pr2", !@this); // 1 = on, 0 = off 
	enableControl("Preview_ProfData1_FR2", "CH_MPCCRC_Preview_ProfData1_Pr2_", @this); //1: enable; 0: disable
	CRC_Preview_ProfData1_Pr2 = @sysvar::CH_Nodes::CH_MPCCRC_Preview_ProfData1_AUTO;
}
/*@@end*/

/*@@sysvarChange:CH_Nodes::CH_MPCSQC_Preview_ProfData1_AUTO:*/
on sysvar sysvar::CH_Nodes::CH_MPCSQC_Preview_ProfData1_AUTO
{
//	EnableSQC("Preview_ProfData1_FR2",  "Preview_ProfData1_Pr2", !@this); // 1 = on, 0 = off 
	enableControl("Preview_ProfData1_FR2", "CH_MPCSQC_Preview_ProfData1_Pr2_", @this); //1: enable; 0: disable
	SQC_Preview_ProfData1_Pr2 = @sysvar::CH_Nodes::CH_MPCSQC_Preview_ProfData1_AUTO;
}
/*@@end*/

/*@@sysvarChange:CH_Nodes::CH_MPCCRC_Preview_ProfData2_AUTO:*/
on sysvar sysvar::CH_Nodes::CH_MPCCRC_Preview_ProfData2_AUTO
{
//	EnableCRC("Preview_ProfData2_FR2",  "Preview_ProfData2_Pr2", !@this); // 1 = on, 0 = off 
	enableControl("Preview_ProfData2_FR2", "CH_MPCCRC_Preview_ProfData2_Pr2_", @this); //1: enable; 0: disable
	CRC_Preview_ProfData2_Pr2 = @sysvar::CH_Nodes::CH_MPCCRC_Preview_ProfData2_AUTO;
}
/*@@end*/

/*@@sysvarChange:CH_Nodes::CH_MPCSQC_Preview_ProfData2_AUTO:*/
on sysvar sysvar::CH_Nodes::CH_MPCSQC_Preview_ProfData2_AUTO
{
//	EnableSQC("Preview_ProfData2_FR2",  "Preview_ProfData2_Pr2", !@this); // 1 = on, 0 = off 
	enableControl("Preview_ProfData2_FR2", "CH_MPCSQC_Preview_ProfData2_Pr2_", @this); //1: enable; 0: disable
	SQC_Preview_ProfData2_Pr2 = @sysvar::CH_Nodes::CH_MPCSQC_Preview_ProfData2_AUTO;
}
/*@@end*/

/*@@sysvarChange:CH_Nodes::CH_MPCSPL_Obj1_Obj2_MPC__UB_A_01:*/
on sysvar sysvar::CH_Nodes::CH_MPCSPL_Obj1_Obj2_MPC__UB_A_01
{
	switch (@sysvar::CH_Nodes::CH_MPCSPL_Obj1_Obj2_MPC__UB_A_01)
	{
		case (0):
			enableControl("SPL_Obj1_Obj2_MPC_AR2", "CH_MPCSPL_Obj1_Obj2_MPC_AR2_U_01", 0); //1: enable; 0: disable
			@sysvar::CH_Nodes::CH_MPCSPL_Obj1_Obj2_MPC_AR2_U_01 = 1;
			break;
		case (1):
			enableControl("SPL_Obj1_Obj2_MPC_AR2", "CH_MPCSPL_Obj1_Obj2_MPC_AR2_U_01", 1); //1: enable; 0: disable
			break;
		case (2):
			enableControl("SPL_Obj1_Obj2_MPC_AR2", "CH_MPCSPL_Obj1_Obj2_MPC_AR2_U_01", 0); //1: enable; 0: disable
			@sysvar::CH_Nodes::CH_MPCSPL_Obj1_Obj2_MPC_AR2_U_01 = 1;
			break;
		case (3):
			enableControl("SPL_Obj1_Obj2_MPC_AR2", "CH_MPCSPL_Obj1_Obj2_MPC_AR2_U_01", 0); //1: enable; 0: disable
			@sysvar::CH_Nodes::CH_MPCSPL_Obj1_Obj2_MPC_AR2_U_01 = 0;
			break;
	}
}
/*@@end*/

/*@@sysvarChange:CH_Nodes::CH_MPCCRC_SPL_Obj1_Obj2_MPC_AUTO:*/
on sysvar sysvar::CH_Nodes::CH_MPCCRC_SPL_Obj1_Obj2_MPC_AUTO
{
//	EnableCRC("SPL_Obj1_Obj2_MPC_AR2",  "SPL_Obj1_Obj2_MPC_Pr2", !@this); // 1 = on, 0 = off 
	enableControl("SPL_Obj1_Obj2_MPC_AR2", "CH_MPCCRC_SPL_Obj1_Obj2_MPC_Pr2_", @this); //1: enable; 0: disable
	CRC_SPL_Obj1_Obj2_MPC_Pr2 = @sysvar::CH_Nodes::CH_MPCCRC_SPL_Obj1_Obj2_MPC_AUTO;
}
/*@@end*/

/*@@sysvarChange:CH_Nodes::CH_MPCSQC_SPL_Obj1_Obj2_MPC_AUTO:*/
on sysvar sysvar::CH_Nodes::CH_MPCSQC_SPL_Obj1_Obj2_MPC_AUTO
{
//	EnableSQC("SPL_Obj1_Obj2_MPC_AR2",  "SPL_Obj1_Obj2_MPC_Pr2", !@this); // 1 = on, 0 = off 
	enableControl("SPL_Obj1_Obj2_MPC_AR2", "CH_MPCSQC_SPL_Obj1_Obj2_MPC_Pr2_", @this); //1: enable; 0: disable
	SQC_SPL_Obj1_Obj2_MPC_Pr2 = @sysvar::CH_Nodes::CH_MPCSQC_SPL_Obj1_Obj2_MPC_AUTO;
}
/*@@end*/

/*@@sysvarChange:CH_Nodes::CH_MPCTSA_Disp_Rq2_Gw_AR_UB_A_01:*/
on sysvar sysvar::CH_Nodes::CH_MPCTSA_Disp_Rq2_Gw_AR_UB_A_01
{
	switch (@sysvar::CH_Nodes::CH_MPCTSA_Disp_Rq2_Gw_AR_UB_A_01)
	{
		case (0):
			enableControl("TSA_Disp_Rq2_Gw_AR", "CH_MPCTSA_Disp_Rq2_Gw_AR_UB__01", 0); //1: enable; 0: disable
			@sysvar::CH_Nodes::CH_MPCTSA_Disp_Rq2_Gw_AR_UB__01 = 1;
			break;
		case (1):
			enableControl("TSA_Disp_Rq2_Gw_AR", "CH_MPCTSA_Disp_Rq2_Gw_AR_UB__01", 1); //1: enable; 0: disable
			break;
		case (2):
			enableControl("TSA_Disp_Rq2_Gw_AR", "CH_MPCTSA_Disp_Rq2_Gw_AR_UB__01", 0); //1: enable; 0: disable
			@sysvar::CH_Nodes::CH_MPCTSA_Disp_Rq2_Gw_AR_UB__01 = 1;
			break;
		case (3):
			enableControl("TSA_Disp_Rq2_Gw_AR", "CH_MPCTSA_Disp_Rq2_Gw_AR_UB__01", 0); //1: enable; 0: disable
			@sysvar::CH_Nodes::CH_MPCTSA_Disp_Rq2_Gw_AR_UB__01 = 0;
			break;
	}
}
/*@@end*/

/*@@sysvarChange:CH_Nodes::CH_MPCTSA_Disp_Rq3_Gw_AR_UB_A_01:*/
on sysvar sysvar::CH_Nodes::CH_MPCTSA_Disp_Rq3_Gw_AR_UB_A_01
{
	switch (@sysvar::CH_Nodes::CH_MPCTSA_Disp_Rq3_Gw_AR_UB_A_01)
	{
		case (0):
			enableControl("TSA_Disp_Rq3_Gw_AR", "CH_MPCTSA_Disp_Rq3_Gw_AR_UB__01", 0); //1: enable; 0: disable
			@sysvar::CH_Nodes::CH_MPCTSA_Disp_Rq3_Gw_AR_UB__01 = 1;
			break;
		case (1):
			enableControl("TSA_Disp_Rq3_Gw_AR", "CH_MPCTSA_Disp_Rq3_Gw_AR_UB__01", 1); //1: enable; 0: disable
			break;
		case (2):
			enableControl("TSA_Disp_Rq3_Gw_AR", "CH_MPCTSA_Disp_Rq3_Gw_AR_UB__01", 0); //1: enable; 0: disable
			@sysvar::CH_Nodes::CH_MPCTSA_Disp_Rq3_Gw_AR_UB__01 = 1;
			break;
		case (3):
			enableControl("TSA_Disp_Rq3_Gw_AR", "CH_MPCTSA_Disp_Rq3_Gw_AR_UB__01", 0); //1: enable; 0: disable
			@sysvar::CH_Nodes::CH_MPCTSA_Disp_Rq3_Gw_AR_UB__01 = 0;
			break;
	}
}
/*@@end*/

/*@@sysvarChange:CH_Nodes::CH_MPCYMAS_Rq_MPC_Gw_AR2_UB_A_01:*/
on sysvar sysvar::CH_Nodes::CH_MPCYMAS_Rq_MPC_Gw_AR2_UB_A_01
{
	switch (@sysvar::CH_Nodes::CH_MPCYMAS_Rq_MPC_Gw_AR2_UB_A_01)
	{
		case (0):
			enableControl("YMAS_Rq_MPC_Gw_AR2", "CH_MPCYMAS_Rq_MPC_Gw_AR2_UB__01", 0); //1: enable; 0: disable
			@sysvar::CH_Nodes::CH_MPCYMAS_Rq_MPC_Gw_AR2_UB__01 = 1;
			break;
		case (1):
			enableControl("YMAS_Rq_MPC_Gw_AR2", "CH_MPCYMAS_Rq_MPC_Gw_AR2_UB__01", 1); //1: enable; 0: disable
			break;
		case (2):
			enableControl("YMAS_Rq_MPC_Gw_AR2", "CH_MPCYMAS_Rq_MPC_Gw_AR2_UB__01", 0); //1: enable; 0: disable
			@sysvar::CH_Nodes::CH_MPCYMAS_Rq_MPC_Gw_AR2_UB__01 = 1;
			break;
		case (3):
			enableControl("YMAS_Rq_MPC_Gw_AR2", "CH_MPCYMAS_Rq_MPC_Gw_AR2_UB__01", 0); //1: enable; 0: disable
			@sysvar::CH_Nodes::CH_MPCYMAS_Rq_MPC_Gw_AR2_UB__01 = 0;
			break;
	}
}
/*@@end*/

/*@@sysvarChange:CH_Nodes::CH_MPCCRC_YMAS_Rq_MPC_Pr2YM_AUTO:*/
on sysvar sysvar::CH_Nodes::CH_MPCCRC_YMAS_Rq_MPC_Pr2YM_AUTO
{
//	EnableCRC("YMAS_Rq_MPC_Gw_AR2",  "YMAS_Rq_MPC_Pr2", !@this); // 1 = on, 0 = off 
	enableControl("YMAS_Rq_MPC_Gw_AR2", "CH_MPCCRC_YMAS_Rq_MPC_Pr2YMAS_R_", @this); //1: enable; 0: disable
	CRC_YMAS_Rq_MPC_Pr2 = @sysvar::CH_Nodes::CH_MPCCRC_YMAS_Rq_MPC_Pr2YM_AUTO;
}
/*@@end*/

/*@@sysvarChange:CH_Nodes::CH_MPCSQC_YMAS_Rq_MPC_Pr2YM_AUTO:*/
on sysvar sysvar::CH_Nodes::CH_MPCSQC_YMAS_Rq_MPC_Pr2YM_AUTO
{
//	EnableSQC("YMAS_Rq_MPC_Gw_AR2",  "YMAS_Rq_MPC_Pr2", !@this); // 1 = on, 0 = off 
	enableControl("YMAS_Rq_MPC_Gw_AR2", "CH_MPCSQC_YMAS_Rq_MPC_Pr2YMAS_R_", @this); //1: enable; 0: disable
	SQC_YMAS_Rq_MPC_Pr2 = @sysvar::CH_Nodes::CH_MPCSQC_YMAS_Rq_MPC_Pr2YM_AUTO;
}
/*@@end*/

/*@@caplFunc:CH_MPCCamLane_Disp_Warn_Rq_Gw_AR2():*///function
CH_MPCCamLane_Disp_Warn_Rq_Gw_AR2()
{
	switch (@sysvar::CH_Nodes::CH_MPCCamLane_Disp_Warn__UB_A_01)
	{
		case (0):
			//Updatebit wird mit 1 gesendet; entspricht Standard
			break;
		case (1):
			//nur wenn manueller Wert gleich 0 ist, muss was gemacht werden
			if (@sysvar::CH_Nodes::CH_MPCCamLane_Disp_Warn__UB_A_01 == 0)
				DisturbPDUUB("CamLane_Disp_Warn_Rq_Gw_AR2", 1, 0); //Updatebit wird einmal auf Null gesetzt
			break;
		case (2):
			//Updatebit wird mit 1 gesendet; entspricht Standard
			break;
		case (3):
			DisturbPDUUB("CamLane_Disp_Warn_Rq_Gw_AR2", 1, 0); //Updatebit wird einmal auf Null gesetzt
			break;
	}
}
/*@@end*/

/*@@caplFunc:CH_MPCCamLane_LaneAttr1_Gw_AR2():*///function
CH_MPCCamLane_LaneAttr1_Gw_AR2()
{
	switch (@sysvar::CH_Nodes::CH_MPCCamLane_LaneAttr1__UB_A_01)
	{
		case (0):
			//Updatebit wird mit 1 gesendet; entspricht Standard
			break;
		case (1):
			//nur wenn manueller Wert gleich 0 ist, muss was gemacht werden
			if (@sysvar::CH_Nodes::CH_MPCCamLane_LaneAttr1__UB_A_01 == 0)
				DisturbPDUUB("CamLane_LaneAttr1_Gw_AR2", 1, 0); //Updatebit wird einmal auf Null gesetzt
			break;
		case (2):
			//Updatebit wird mit 1 gesendet; entspricht Standard
			break;
		case (3):
			DisturbPDUUB("CamLane_LaneAttr1_Gw_AR2", 1, 0); //Updatebit wird einmal auf Null gesetzt
			break;
	}
}
/*@@end*/

/*@@caplFunc:CH_MPCCamLane_LaneAttr2_Gw_AR2():*///function
CH_MPCCamLane_LaneAttr2_Gw_AR2()
{
	switch (@sysvar::CH_Nodes::CH_MPCCamLane_LaneAttr2__UB_A_01)
	{
		case (0):
			//Updatebit wird mit 1 gesendet; entspricht Standard
			break;
		case (1):
			//nur wenn manueller Wert gleich 0 ist, muss was gemacht werden
			if (@sysvar::CH_Nodes::CH_MPCCamLane_LaneAttr2__UB_A_01 == 0)
				DisturbPDUUB("CamLane_LaneAttr2_Gw_AR2", 1, 0); //Updatebit wird einmal auf Null gesetzt
			break;
		case (2):
			//Updatebit wird mit 1 gesendet; entspricht Standard
			break;
		case (3):
			DisturbPDUUB("CamLane_LaneAttr2_Gw_AR2", 1, 0); //Updatebit wird einmal auf Null gesetzt
			break;
	}
}
/*@@end*/

/*@@caplFunc:CH_MPCCamLane_LaneAttr3_Gw_AR2():*///function
CH_MPCCamLane_LaneAttr3_Gw_AR2()
{
	switch (@sysvar::CH_Nodes::CH_MPCCamLane_LaneAttr3__UB_A_01)
	{
		case (0):
			//Updatebit wird mit 1 gesendet; entspricht Standard
			break;
		case (1):
			//nur wenn manueller Wert gleich 0 ist, muss was gemacht werden
			if (@sysvar::CH_Nodes::CH_MPCCamLane_LaneAttr3__UB_A_01 == 0)
				DisturbPDUUB("CamLane_LaneAttr3_Gw_AR2", 1, 0); //Updatebit wird einmal auf Null gesetzt
			break;
		case (2):
			//Updatebit wird mit 1 gesendet; entspricht Standard
			break;
		case (3):
			DisturbPDUUB("CamLane_LaneAttr3_Gw_AR2", 1, 0); //Updatebit wird einmal auf Null gesetzt
			break;
	}
}
/*@@end*/

/*@@caplFunc:CH_MPCCamLane_LaneAttr6_Gw_AR2():*///function
CH_MPCCamLane_LaneAttr6_Gw_AR2()
{
	switch (@sysvar::CH_Nodes::CH_MPCCamLane_LaneAttr6__UB_A_01)
	{
		case (0):
			//Updatebit wird mit 1 gesendet; entspricht Standard
			break;
		case (1):
			//nur wenn manueller Wert gleich 0 ist, muss was gemacht werden
			if (@sysvar::CH_Nodes::CH_MPCCamLane_LaneAttr6__UB_A_01 == 0)
				DisturbPDUUB("CamLane_LaneAttr6_Gw_AR2", 1, 0); //Updatebit wird einmal auf Null gesetzt
			break;
		case (2):
			//Updatebit wird mit 1 gesendet; entspricht Standard
			break;
		case (3):
			DisturbPDUUB("CamLane_LaneAttr6_Gw_AR2", 1, 0); //Updatebit wird einmal auf Null gesetzt
			break;
	}
}
/*@@end*/

/*@@caplFunc:CH_MPCCamLane_LaneAttr7_Gw_AR2():*///function
CH_MPCCamLane_LaneAttr7_Gw_AR2()
{
	switch (@sysvar::CH_Nodes::CH_MPCCamLane_LaneAttr7__UB_A_01)
	{
		case (0):
			//Updatebit wird mit 1 gesendet; entspricht Standard
			break;
		case (1):
			//nur wenn manueller Wert gleich 0 ist, muss was gemacht werden
			if (@sysvar::CH_Nodes::CH_MPCCamLane_LaneAttr7__UB_A_01 == 0)
				DisturbPDUUB("CamLane_LaneAttr7_Gw_AR2", 1, 0); //Updatebit wird einmal auf Null gesetzt
			break;
		case (2):
			//Updatebit wird mit 1 gesendet; entspricht Standard
			break;
		case (3):
			DisturbPDUUB("CamLane_LaneAttr7_Gw_AR2", 1, 0); //Updatebit wird einmal auf Null gesetzt
			break;
	}
}
/*@@end*/

/*@@caplFunc:CH_MPCIHC_Lgt_Stat_MPC_Gw_AR2():*///function
CH_MPCIHC_Lgt_Stat_MPC_Gw_AR2()
{
	switch (@sysvar::CH_Nodes::CH_MPCIHC_Lgt_Stat_MPC_G_UB_A_01)
	{
		case (0):
			//Updatebit wird mit 1 gesendet; entspricht Standard
			break;
		case (1):
			//nur wenn manueller Wert gleich 0 ist, muss was gemacht werden
			if (@sysvar::CH_Nodes::CH_MPCIHC_Lgt_Stat_MPC_G_UB_A_01 == 0)
				DisturbPDUUB("IHC_Lgt_Stat_MPC_Gw_AR2", 1, 0); //Updatebit wird einmal auf Null gesetzt
			break;
		case (2):
			//Updatebit wird mit 1 gesendet; entspricht Standard
			break;
		case (3):
			DisturbPDUUB("IHC_Lgt_Stat_MPC_Gw_AR2", 1, 0); //Updatebit wird einmal auf Null gesetzt
			break;
	}
}
/*@@end*/

/*@@caplFunc:CH_MPCIHC_Plus_HL_Stat_AR2():*///function
CH_MPCIHC_Plus_HL_Stat_AR2()
{
	switch (@sysvar::CH_Nodes::CH_MPCIHC_Plus_HL_Stat_A_UB_A_01)
	{
		case (0):
			//Updatebit wird mit 1 gesendet; entspricht Standard
			break;
		case (1):
			//nur wenn manueller Wert gleich 0 ist, muss was gemacht werden
			if (@sysvar::CH_Nodes::CH_MPCIHC_Plus_HL_Stat_A_UB_A_01 == 0)
				DisturbPDUUB("IHC_Plus_HL_Stat_AR2", 1, 0); //Updatebit wird einmal auf Null gesetzt
			break;
		case (2):
			//Updatebit wird mit 1 gesendet; entspricht Standard
			break;
		case (3):
			DisturbPDUUB("IHC_Plus_HL_Stat_AR2", 1, 0); //Updatebit wird einmal auf Null gesetzt
			break;
	}
}
/*@@end*/

/*@@caplFunc:CH_MPCIHC_Plus_Tunnel_3_4_AR2():*///function
CH_MPCIHC_Plus_Tunnel_3_4_AR2()
{
	switch (@sysvar::CH_Nodes::CH_MPCIHC_Plus_Tunnel_3__UB_AUTO)
	{
		case (0):
			//Updatebit wird mit 1 gesendet; entspricht Standard
			break;
		case (1):
			//nur wenn manueller Wert gleich 0 ist, muss was gemacht werden
			if (@sysvar::CH_Nodes::CH_MPCIHC_Plus_Tunnel_3__UB_AUTO == 0)
				DisturbPDUUB("IHC_Plus_Tunnel_3_4_AR2", 1, 0); //Updatebit wird einmal auf Null gesetzt
			break;
		case (2):
			//Updatebit wird mit 1 gesendet; entspricht Standard
			break;
		case (3):
			DisturbPDUUB("IHC_Plus_Tunnel_3_4_AR2", 1, 0); //Updatebit wird einmal auf Null gesetzt
			break;
	}
}
/*@@end*/

/*@@caplFunc:CH_MPCIHC_Plus_Tunnel_AR2():*///function
CH_MPCIHC_Plus_Tunnel_AR2()
{
	switch (@sysvar::CH_Nodes::CH_MPCIHC_Plus_Tunnel_AR_UB_A_01)
	{
		case (0):
			//Updatebit wird mit 1 gesendet; entspricht Standard
			break;
		case (1):
			//nur wenn manueller Wert gleich 0 ist, muss was gemacht werden
			if (@sysvar::CH_Nodes::CH_MPCIHC_Plus_Tunnel_AR_UB_A_01 == 0)
				DisturbPDUUB("IHC_Plus_Tunnel_AR2", 1, 0); //Updatebit wird einmal auf Null gesetzt
			break;
		case (2):
			//Updatebit wird mit 1 gesendet; entspricht Standard
			break;
		case (3):
			DisturbPDUUB("IHC_Plus_Tunnel_AR2", 1, 0); //Updatebit wird einmal auf Null gesetzt
			break;
	}
}
/*@@end*/

/*@@caplFunc:CH_MPCSPL_Obj1_Obj2_MPC_AR2():*///function
CH_MPCSPL_Obj1_Obj2_MPC_AR2()
{
	switch (@sysvar::CH_Nodes::CH_MPCSPL_Obj1_Obj2_MPC__UB_A_01)
	{
		case (0):
			//Updatebit wird mit 1 gesendet; entspricht Standard
			break;
		case (1):
			//nur wenn manueller Wert gleich 0 ist, muss was gemacht werden
			if (@sysvar::CH_Nodes::CH_MPCSPL_Obj1_Obj2_MPC__UB_A_01 == 0)
				DisturbPDUUB("SPL_Obj1_Obj2_MPC_AR2", 1, 0); //Updatebit wird einmal auf Null gesetzt
			break;
		case (2):
			//Updatebit wird mit 1 gesendet; entspricht Standard
			break;
		case (3):
			DisturbPDUUB("SPL_Obj1_Obj2_MPC_AR2", 1, 0); //Updatebit wird einmal auf Null gesetzt
			break;
	}
}
/*@@end*/

/*@@caplFunc:CH_MPCTSA_Disp_Rq2_Gw_AR():*///function
CH_MPCTSA_Disp_Rq2_Gw_AR()
{
	switch (@sysvar::CH_Nodes::CH_MPCTSA_Disp_Rq2_Gw_AR_UB_A_01)
	{
		case (0):
			//Updatebit wird mit 1 gesendet; entspricht Standard
			break;
		case (1):
			//nur wenn manueller Wert gleich 0 ist, muss was gemacht werden
			if (@sysvar::CH_Nodes::CH_MPCTSA_Disp_Rq2_Gw_AR_UB_A_01 == 0)
				DisturbPDUUB("TSA_Disp_Rq2_Gw_AR", 1, 0); //Updatebit wird einmal auf Null gesetzt
			break;
		case (2):
			//Updatebit wird mit 1 gesendet; entspricht Standard
			break;
		case (3):
			DisturbPDUUB("TSA_Disp_Rq2_Gw_AR", 1, 0); //Updatebit wird einmal auf Null gesetzt
			break;
	}
}
/*@@end*/

/*@@caplFunc:CH_MPCTSA_Disp_Rq3_Gw_AR():*///function
CH_MPCTSA_Disp_Rq3_Gw_AR()
{
	switch (@sysvar::CH_Nodes::CH_MPCTSA_Disp_Rq3_Gw_AR_UB_A_01)
	{
		case (0):
			//Updatebit wird mit 1 gesendet; entspricht Standard
			break;
		case (1):
			//nur wenn manueller Wert gleich 0 ist, muss was gemacht werden
			if (@sysvar::CH_Nodes::CH_MPCTSA_Disp_Rq3_Gw_AR_UB_A_01 == 0)
				DisturbPDUUB("TSA_Disp_Rq3_Gw_AR", 1, 0); //Updatebit wird einmal auf Null gesetzt
			break;
		case (2):
			//Updatebit wird mit 1 gesendet; entspricht Standard
			break;
		case (3):
			DisturbPDUUB("TSA_Disp_Rq3_Gw_AR", 1, 0); //Updatebit wird einmal auf Null gesetzt
			break;
	}
}
/*@@end*/

/*@@caplFunc:CH_MPCYMAS_Rq_MPC_Gw_AR2():*///function
CH_MPCYMAS_Rq_MPC_Gw_AR2()
{
	switch (@sysvar::CH_Nodes::CH_MPCYMAS_Rq_MPC_Gw_AR2_UB_A_01)
	{
		case (0):
			//Updatebit wird mit 1 gesendet; entspricht Standard
			break;
		case (1):
			//nur wenn manueller Wert gleich 0 ist, muss was gemacht werden
			if (@sysvar::CH_Nodes::CH_MPCYMAS_Rq_MPC_Gw_AR2_UB_A_01 == 0)
				DisturbPDUUB("YMAS_Rq_MPC_Gw_AR2", 1, 0); //Updatebit wird einmal auf Null gesetzt
			break;
		case (2):
			//Updatebit wird mit 1 gesendet; entspricht Standard
			break;
		case (3):
			DisturbPDUUB("YMAS_Rq_MPC_Gw_AR2", 1, 0); //Updatebit wird einmal auf Null gesetzt
			break;
	}
}
/*@@end*/

/*@@caplFunc:FrILTxPending(char[],long,byte[],long):*///callback
void FrILTxPending(char pduName[], long len, byte payload[], long TxAck)
{
	byte crc;
	dword SQC;
	dword MC;
	dword Tgl;
	dword i;

	if (strncmp (pduName, "Cam_Stat_AR2", strLen(pduName)+strLen("Cam_Stat_AR2")) == 0)
	{
		if (TxAck == 1)
		{
			if (@sysvar::CH_Nodes::CH_MPCSQC_Cam_Stat_Pr2Cam_S_AUTO == 0)
			{
				//SQC automatisch ändern
				SQC_VAL_Cam_Stat_Pr2 = (SQC_VAL_Cam_Stat_Pr2 + 1) % 16;
			}
			else
			{
				//SQC manuel veränderbar
			}

		}
		else
		{
			if (@sysvar::CH_Nodes::CH_MPCSQC_Cam_Stat_Pr2Cam_S_AUTO == 0)
			{
				//SQC automatisch ändern
				//SQC für CRC speichern
				CounterValForCRC_Cam_Stat_Pr2 = SQC_VAL_Cam_Stat_Pr2;
				//SQC in Byte schreiben
				payload[1] = (payload[1] & ~0x0F) |  SQC_VAL_Cam_Stat_Pr2;
			}
			else
			{
				//SQC manuel veränderbar
			}

			if (@sysvar::CH_Nodes::CH_MPCCRC_Cam_Stat_Pr2Cam_S_AUTO == 0)
			{
				//CRC automatisch berechnen
				crc = 0xFF;
				crc = crctableProfTwo[crc ^ payload[1]];
				crc = crctableProfTwo[crc ^ payload[2]];
				crc = crctableProfTwo[crc ^ payload[3]];
				crc = crctableProfTwo[crc ^ payload[4]];
				crc = crctableProfTwo[crc ^ payload[5]];
				crc = crctableProfTwo[crc ^ payload[6]];
				crc = crctableProfTwo[crc ^ payload[7]];
				crc = crctableProfTwo[crc ^ payload[8]];
				crc = crctableProfTwo[crc ^ payload[9]];
				crc = crctableProfTwo[crc ^ payload[10]];
				crc = crctableProfTwo[crc ^ payload[11]];
				crc = crctableProfTwo[crc ^ payload[12]];
				crc = crctableProfTwo[crc ^ payload[13]];
				crc = crctableProfTwo[crc ^ payload[14]];
				crc = crctableProfTwo[crc ^ payload[15]];
				crc = crctableProfTwo[crc ^ payload[16]];
				crc = crctableProfTwo[crc ^ payload[17]];
				switch (CounterValForCRC_Cam_Stat_Pr2)
				{
					case(0) :
						crc = crctableProfTwo[crc ^ 158];
						break;
					case(1) :
						crc = crctableProfTwo[crc ^ 125];
						break;
					case(2) :
						crc = crctableProfTwo[crc ^ 92];
						break;
					case(3) :
						crc = crctableProfTwo[crc ^ 59];
						break;
					case(4) :
						crc = crctableProfTwo[crc ^ 26];
						break;
					case(5) :
						crc = crctableProfTwo[crc ^ 244];
						break;
					case(6) :
						crc = crctableProfTwo[crc ^ 211];
						break;
					case(7) :
						crc = crctableProfTwo[crc ^ 178];
						break;
					case(8) :
						crc = crctableProfTwo[crc ^ 145];
						break;
					case(9) :
						crc = crctableProfTwo[crc ^ 112];
						break;
					case(10) :
						crc = crctableProfTwo[crc ^ 79];
						break;
					case(11) :
						crc = crctableProfTwo[crc ^ 46];
						break;
					case(12) :
						crc = crctableProfTwo[crc ^ 13];
						break;
					case(13) :
						crc = crctableProfTwo[crc ^ 231];
						break;
					case(14) :
						crc = crctableProfTwo[crc ^ 198];
						break;
					case(15) :
						crc = crctableProfTwo[crc ^ 165];
						break;
					default :
//						write("error: wrong parameter (%d)",CounterValForCRC_Cam_Stat_Pr2); stop();
						break;
				}
				crc = (crc ^ 0xFF);
				payload[0] = crc;
			}
			else
			{
				//CRC manuel veränderbar
			}

		}
	}
	if (strncmp (pduName, "CamLane_Disp_Warn_Rq_Gw_AR2", strLen(pduName)+strLen("CamLane_Disp_Warn_Rq_Gw_AR2")) == 0)
	{
		if (TxAck == 1)
		{
			if (@sysvar::CH_Nodes::CH_MPCSQC_CamLane_Disp_Warn_AUTO == 0)
			{
				//SQC automatisch ändern
				SQC_VAL_CamLane_Disp_Warn_Rq_Pr2 = (SQC_VAL_CamLane_Disp_Warn_Rq_Pr2 + 1) % 16;
			}
			else
			{
				//SQC manuel veränderbar
			}

		}
		else
		{
			if (@sysvar::CH_Nodes::CH_MPCSQC_CamLane_Disp_Warn_AUTO == 0)
			{
				//SQC automatisch ändern
				//SQC für CRC speichern
				CounterValForCRC_CamLane_Disp_Warn_Rq_Pr2 = SQC_VAL_CamLane_Disp_Warn_Rq_Pr2;
				//SQC in Byte schreiben
				payload[1] = (payload[1] & ~0x0F) |  SQC_VAL_CamLane_Disp_Warn_Rq_Pr2;
			}
			else
			{
				//SQC manuel veränderbar
			}

			if (@sysvar::CH_Nodes::CH_MPCCRC_CamLane_Disp_Warn_AUTO == 0)
			{
				//CRC automatisch berechnen
				crc = 0xFF;
				crc = crctableProfTwo[crc ^ payload[1]];
				crc = crctableProfTwo[crc ^ payload[2]];
				crc = crctableProfTwo[crc ^ payload[3]];
				crc = crctableProfTwo[crc ^ payload[4]];
				crc = crctableProfTwo[crc ^ payload[5]];
				crc = crctableProfTwo[crc ^ payload[6]];
				crc = crctableProfTwo[crc ^ payload[7]];
				switch (CounterValForCRC_CamLane_Disp_Warn_Rq_Pr2)
				{
					case(0) :
						crc = crctableProfTwo[crc ^ 227];
						break;
					case(1) :
						crc = crctableProfTwo[crc ^ 71];
						break;
					case(2) :
						crc = crctableProfTwo[crc ^ 166];
						break;
					case(3) :
						crc = crctableProfTwo[crc ^ 10];
						break;
					case(4) :
						crc = crctableProfTwo[crc ^ 105];
						break;
					case(5) :
						crc = crctableProfTwo[crc ^ 200];
						break;
					case(6) :
						crc = crctableProfTwo[crc ^ 44];
						break;
					case(7) :
						crc = crctableProfTwo[crc ^ 139];
						break;
					case(8) :
						crc = crctableProfTwo[crc ^ 234];
						break;
					case(9) :
						crc = crctableProfTwo[crc ^ 78];
						break;
					case(10) :
						crc = crctableProfTwo[crc ^ 173];
						break;
					case(11) :
						crc = crctableProfTwo[crc ^ 17];
						break;
					case(12) :
						crc = crctableProfTwo[crc ^ 112];
						break;
					case(13) :
						crc = crctableProfTwo[crc ^ 207];
						break;
					case(14) :
						crc = crctableProfTwo[crc ^ 51];
						break;
					case(15) :
						crc = crctableProfTwo[crc ^ 146];
						break;
					default :
//						write("error: wrong parameter (%d)",CounterValForCRC_CamLane_Disp_Warn_Rq_Pr2); stop();
						break;
				}
				crc = (crc ^ 0xFF);
				payload[0] = crc;
			}
			else
			{
				//CRC manuel veränderbar
			}

			CH_MPCCamLane_LaneAttr1_Gw_AR2();
			CH_MPCCamLane_Disp_Warn_Rq_Gw_AR2();
		}
	}
	if (strncmp (pduName, "CamLane_FastAttr1_FR2", strLen(pduName)+strLen("CamLane_FastAttr1_FR2")) == 0)
	{
		if (TxAck == 1)
		{
			if (@sysvar::CH_Nodes::CH_MPCSQC_CamLane_FastAttr1_AUTO == 0)
			{
				//SQC automatisch ändern
				SQC_VAL_CamLane_FastAttr1_Pr2 = (SQC_VAL_CamLane_FastAttr1_Pr2 + 1) % 16;
			}
			else
			{
				//SQC manuel veränderbar
			}

		}
		else
		{
			if (@sysvar::CH_Nodes::CH_MPCSQC_CamLane_FastAttr1_AUTO == 0)
			{
				//SQC automatisch ändern
				//SQC für CRC speichern
				CounterValForCRC_CamLane_FastAttr1_Pr2 = SQC_VAL_CamLane_FastAttr1_Pr2;
				//SQC in Byte schreiben
				payload[1] = (payload[1] & ~0x0F) |  SQC_VAL_CamLane_FastAttr1_Pr2;
			}
			else
			{
				//SQC manuel veränderbar
			}

			if (@sysvar::CH_Nodes::CH_MPCCRC_CamLane_FastAttr1_AUTO == 0)
			{
				//CRC automatisch berechnen
				crc = 0xFF;
				crc = crctableProfTwo[crc ^ payload[1]];
				crc = crctableProfTwo[crc ^ payload[2]];
				crc = crctableProfTwo[crc ^ payload[3]];
				crc = crctableProfTwo[crc ^ payload[4]];
				crc = crctableProfTwo[crc ^ payload[5]];
				crc = crctableProfTwo[crc ^ payload[6]];
				crc = crctableProfTwo[crc ^ payload[7]];
				crc = crctableProfTwo[crc ^ payload[8]];
				crc = crctableProfTwo[crc ^ payload[9]];
				crc = crctableProfTwo[crc ^ payload[10]];
				crc = crctableProfTwo[crc ^ payload[11]];
				crc = crctableProfTwo[crc ^ payload[12]];
				crc = crctableProfTwo[crc ^ payload[13]];
				crc = crctableProfTwo[crc ^ payload[14]];
				crc = crctableProfTwo[crc ^ payload[15]];
				crc = crctableProfTwo[crc ^ payload[16]];
				crc = crctableProfTwo[crc ^ payload[17]];
				switch (CounterValForCRC_CamLane_FastAttr1_Pr2)
				{
					case(0) :
						crc = crctableProfTwo[crc ^ 246];
						break;
					case(1) :
						crc = crctableProfTwo[crc ^ 151];
						break;
					case(2) :
						crc = crctableProfTwo[crc ^ 56];
						break;
					case(3) :
						crc = crctableProfTwo[crc ^ 212];
						break;
					case(4) :
						crc = crctableProfTwo[crc ^ 117];
						break;
					case(5) :
						crc = crctableProfTwo[crc ^ 22];
						break;
					case(6) :
						crc = crctableProfTwo[crc ^ 178];
						break;
					case(7) :
						crc = crctableProfTwo[crc ^ 83];
						break;
					case(8) :
						crc = crctableProfTwo[crc ^ 239];
						break;
					case(9) :
						crc = crctableProfTwo[crc ^ 144];
						break;
					case(10) :
						crc = crctableProfTwo[crc ^ 49];
						break;
					case(11) :
						crc = crctableProfTwo[crc ^ 205];
						break;
					case(12) :
						crc = crctableProfTwo[crc ^ 110];
						break;
					case(13) :
						crc = crctableProfTwo[crc ^ 15];
						break;
					case(14) :
						crc = crctableProfTwo[crc ^ 171];
						break;
					case(15) :
						crc = crctableProfTwo[crc ^ 76];
						break;
					default :
//						write("error: wrong parameter (%d)",CounterValForCRC_CamLane_FastAttr1_Pr2); stop();
						break;
				}
				crc = (crc ^ 0xFF);
				payload[0] = crc;
			}
			else
			{
				//CRC manuel veränderbar
			}

		}
	}
	if (strncmp (pduName, "CamLane_FastAttr2_FR2", strLen(pduName)+strLen("CamLane_FastAttr2_FR2")) == 0)
	{
		if (TxAck == 1)
		{
			if (@sysvar::CH_Nodes::CH_MPCSQC_CamLane_FastAttr2_AUTO == 0)
			{
				//SQC automatisch ändern
				SQC_VAL_CamLane_FastAttr2_Pr2 = (SQC_VAL_CamLane_FastAttr2_Pr2 + 1) % 16;
			}
			else
			{
				//SQC manuel veränderbar
			}

		}
		else
		{
			if (@sysvar::CH_Nodes::CH_MPCSQC_CamLane_FastAttr2_AUTO == 0)
			{
				//SQC automatisch ändern
				//SQC für CRC speichern
				CounterValForCRC_CamLane_FastAttr2_Pr2 = SQC_VAL_CamLane_FastAttr2_Pr2;
				//SQC in Byte schreiben
				payload[1] = (payload[1] & ~0x0F) |  SQC_VAL_CamLane_FastAttr2_Pr2;
			}
			else
			{
				//SQC manuel veränderbar
			}

			if (@sysvar::CH_Nodes::CH_MPCCRC_CamLane_FastAttr2_AUTO == 0)
			{
				//CRC automatisch berechnen
				crc = 0xFF;
				crc = crctableProfTwo[crc ^ payload[1]];
				crc = crctableProfTwo[crc ^ payload[2]];
				crc = crctableProfTwo[crc ^ payload[3]];
				crc = crctableProfTwo[crc ^ payload[4]];
				crc = crctableProfTwo[crc ^ payload[5]];
				crc = crctableProfTwo[crc ^ payload[6]];
				crc = crctableProfTwo[crc ^ payload[7]];
				crc = crctableProfTwo[crc ^ payload[8]];
				crc = crctableProfTwo[crc ^ payload[9]];
				crc = crctableProfTwo[crc ^ payload[10]];
				crc = crctableProfTwo[crc ^ payload[11]];
				crc = crctableProfTwo[crc ^ payload[12]];
				crc = crctableProfTwo[crc ^ payload[13]];
				crc = crctableProfTwo[crc ^ payload[14]];
				crc = crctableProfTwo[crc ^ payload[15]];
				crc = crctableProfTwo[crc ^ payload[16]];
				crc = crctableProfTwo[crc ^ payload[17]];
				switch (CounterValForCRC_CamLane_FastAttr2_Pr2)
				{
					case(0) :
						crc = crctableProfTwo[crc ^ 174];
						break;
					case(1) :
						crc = crctableProfTwo[crc ^ 135];
						break;
					case(2) :
						crc = crctableProfTwo[crc ^ 96];
						break;
					case(3) :
						crc = crctableProfTwo[crc ^ 57];
						break;
					case(4) :
						crc = crctableProfTwo[crc ^ 18];
						break;
					case(5) :
						crc = crctableProfTwo[crc ^ 230];
						break;
					case(6) :
						crc = crctableProfTwo[crc ^ 191];
						break;
					case(7) :
						crc = crctableProfTwo[crc ^ 152];
						break;
					case(8) :
						crc = crctableProfTwo[crc ^ 113];
						break;
					case(9) :
						crc = crctableProfTwo[crc ^ 74];
						break;
					case(10) :
						crc = crctableProfTwo[crc ^ 35];
						break;
					case(11) :
						crc = crctableProfTwo[crc ^ 247];
						break;
					case(12) :
						crc = crctableProfTwo[crc ^ 208];
						break;
					case(13) :
						crc = crctableProfTwo[crc ^ 169];
						break;
					case(14) :
						crc = crctableProfTwo[crc ^ 130];
						break;
					case(15) :
						crc = crctableProfTwo[crc ^ 91];
						break;
					default :
//						write("error: wrong parameter (%d)",CounterValForCRC_CamLane_FastAttr2_Pr2); stop();
						break;
				}
				crc = (crc ^ 0xFF);
				payload[0] = crc;
			}
			else
			{
				//CRC manuel veränderbar
			}

		}
	}
	if (strncmp (pduName, "CamLane_LaneAttr1_Gw_AR2", strLen(pduName)+strLen("CamLane_LaneAttr1_Gw_AR2")) == 0)
	{
		if (TxAck == 1)
		{
			if (@sysvar::CH_Nodes::CH_MPCSQC_CamLane_LaneAttr1_AUTO == 0)
			{
				//SQC automatisch ändern
				SQC_VAL_CamLane_LaneAttr1_Pr2 = (SQC_VAL_CamLane_LaneAttr1_Pr2 + 1) % 16;
			}
			else
			{
				//SQC manuel veränderbar
			}

		}
		else
		{
			if (@sysvar::CH_Nodes::CH_MPCSQC_CamLane_LaneAttr1_AUTO == 0)
			{
				//SQC automatisch ändern
				//SQC für CRC speichern
				CounterValForCRC_CamLane_LaneAttr1_Pr2 = SQC_VAL_CamLane_LaneAttr1_Pr2;
				//SQC in Byte schreiben
				payload[1] = (payload[1] & ~0x0F) |  SQC_VAL_CamLane_LaneAttr1_Pr2;
			}
			else
			{
				//SQC manuel veränderbar
			}

			if (@sysvar::CH_Nodes::CH_MPCCRC_CamLane_LaneAttr1_AUTO == 0)
			{
				//CRC automatisch berechnen
				crc = 0xFF;
				crc = crctableProfTwo[crc ^ payload[1]];
				crc = crctableProfTwo[crc ^ payload[2]];
				crc = crctableProfTwo[crc ^ payload[3]];
				crc = crctableProfTwo[crc ^ payload[4]];
				crc = crctableProfTwo[crc ^ payload[5]];
				crc = crctableProfTwo[crc ^ payload[6]];
				crc = crctableProfTwo[crc ^ payload[7]];
				switch (CounterValForCRC_CamLane_LaneAttr1_Pr2)
				{
					case(0) :
						crc = crctableProfTwo[crc ^ 95];
						break;
					case(1) :
						crc = crctableProfTwo[crc ^ 30];
						break;
					case(2) :
						crc = crctableProfTwo[crc ^ 216];
						break;
					case(3) :
						crc = crctableProfTwo[crc ^ 151];
						break;
					case(4) :
						crc = crctableProfTwo[crc ^ 86];
						break;
					case(5) :
						crc = crctableProfTwo[crc ^ 21];
						break;
					case(6) :
						crc = crctableProfTwo[crc ^ 207];
						break;
					case(7) :
						crc = crctableProfTwo[crc ^ 142];
						break;
					case(8) :
						crc = crctableProfTwo[crc ^ 77];
						break;
					case(9) :
						crc = crctableProfTwo[crc ^ 12];
						break;
					case(10) :
						crc = crctableProfTwo[crc ^ 198];
						break;
					case(11) :
						crc = crctableProfTwo[crc ^ 133];
						break;
					case(12) :
						crc = crctableProfTwo[crc ^ 68];
						break;
					case(13) :
						crc = crctableProfTwo[crc ^ 3];
						break;
					case(14) :
						crc = crctableProfTwo[crc ^ 189];
						break;
					case(15) :
						crc = crctableProfTwo[crc ^ 124];
						break;
					default :
//						write("error: wrong parameter (%d)",CounterValForCRC_CamLane_LaneAttr1_Pr2); stop();
						break;
				}
				crc = (crc ^ 0xFF);
				payload[0] = crc;
			}
			else
			{
				//CRC manuel veränderbar
			}

			CH_MPCCamLane_LaneAttr1_Gw_AR2();
			CH_MPCCamLane_Disp_Warn_Rq_Gw_AR2();
		}
	}
	if (strncmp (pduName, "CamLane_LaneAttr2_Gw_AR2", strLen(pduName)+strLen("CamLane_LaneAttr2_Gw_AR2")) == 0)
	{
		if (TxAck == 1)
		{
			if (@sysvar::CH_Nodes::CH_MPCSQC_CamLane_LaneAttr2_AUTO == 0)
			{
				//SQC automatisch ändern
				SQC_VAL_CamLane_LaneAttr2_Pr2 = (SQC_VAL_CamLane_LaneAttr2_Pr2 + 1) % 16;
			}
			else
			{
				//SQC manuel veränderbar
			}

		}
		else
		{
			if (@sysvar::CH_Nodes::CH_MPCSQC_CamLane_LaneAttr2_AUTO == 0)
			{
				//SQC automatisch ändern
				//SQC für CRC speichern
				CounterValForCRC_CamLane_LaneAttr2_Pr2 = SQC_VAL_CamLane_LaneAttr2_Pr2;
				//SQC in Byte schreiben
				payload[1] = (payload[1] & ~0x0F) |  SQC_VAL_CamLane_LaneAttr2_Pr2;
			}
			else
			{
				//SQC manuel veränderbar
			}

			if (@sysvar::CH_Nodes::CH_MPCCRC_CamLane_LaneAttr2_AUTO == 0)
			{
				//CRC automatisch berechnen
				crc = 0xFF;
				crc = crctableProfTwo[crc ^ payload[1]];
				crc = crctableProfTwo[crc ^ payload[2]];
				crc = crctableProfTwo[crc ^ payload[3]];
				crc = crctableProfTwo[crc ^ payload[4]];
				crc = crctableProfTwo[crc ^ payload[5]];
				crc = crctableProfTwo[crc ^ payload[6]];
				crc = crctableProfTwo[crc ^ payload[7]];
				switch (CounterValForCRC_CamLane_LaneAttr2_Pr2)
				{
					case(0) :
						crc = crctableProfTwo[crc ^ 248];
						break;
					case(1) :
						crc = crctableProfTwo[crc ^ 53];
						break;
					case(2) :
						crc = crctableProfTwo[crc ^ 109];
						break;
					case(3) :
						crc = crctableProfTwo[crc ^ 165];
						break;
					case(4) :
						crc = crctableProfTwo[crc ^ 221];
						break;
					case(5) :
						crc = crctableProfTwo[crc ^ 26];
						break;
					case(6) :
						crc = crctableProfTwo[crc ^ 82];
						break;
					case(7) :
						crc = crctableProfTwo[crc ^ 138];
						break;
					case(8) :
						crc = crctableProfTwo[crc ^ 194];
						break;
					case(9) :
						crc = crctableProfTwo[crc ^ 250];
						break;
					case(10) :
						crc = crctableProfTwo[crc ^ 55];
						break;
					case(11) :
						crc = crctableProfTwo[crc ^ 111];
						break;
					case(12) :
						crc = crctableProfTwo[crc ^ 167];
						break;
					case(13) :
						crc = crctableProfTwo[crc ^ 223];
						break;
					case(14) :
						crc = crctableProfTwo[crc ^ 28];
						break;
					case(15) :
						crc = crctableProfTwo[crc ^ 84];
						break;
					default :
//						write("error: wrong parameter (%d)",CounterValForCRC_CamLane_LaneAttr2_Pr2); stop();
						break;
				}
				crc = (crc ^ 0xFF);
				payload[0] = crc;
			}
			else
			{
				//CRC manuel veränderbar
			}

			CH_MPCCamLane_LaneAttr2_Gw_AR2();
			CH_MPCCamLane_LaneAttr3_Gw_AR2();
		}
	}
	if (strncmp (pduName, "CamLane_LaneAttr3_Gw_AR2", strLen(pduName)+strLen("CamLane_LaneAttr3_Gw_AR2")) == 0)
	{
		if (TxAck == 1)
		{
			if (@sysvar::CH_Nodes::CH_MPCSQC_CamLane_LaneAttr3_AUTO == 0)
			{
				//SQC automatisch ändern
				SQC_VAL_CamLane_LaneAttr3_Pr2 = (SQC_VAL_CamLane_LaneAttr3_Pr2 + 1) % 16;
			}
			else
			{
				//SQC manuel veränderbar
			}

		}
		else
		{
			if (@sysvar::CH_Nodes::CH_MPCSQC_CamLane_LaneAttr3_AUTO == 0)
			{
				//SQC automatisch ändern
				//SQC für CRC speichern
				CounterValForCRC_CamLane_LaneAttr3_Pr2 = SQC_VAL_CamLane_LaneAttr3_Pr2;
				//SQC in Byte schreiben
				payload[1] = (payload[1] & ~0x0F) |  SQC_VAL_CamLane_LaneAttr3_Pr2;
			}
			else
			{
				//SQC manuel veränderbar
			}

			if (@sysvar::CH_Nodes::CH_MPCCRC_CamLane_LaneAttr3_AUTO == 0)
			{
				//CRC automatisch berechnen
				crc = 0xFF;
				crc = crctableProfTwo[crc ^ payload[1]];
				crc = crctableProfTwo[crc ^ payload[2]];
				crc = crctableProfTwo[crc ^ payload[3]];
				crc = crctableProfTwo[crc ^ payload[4]];
				crc = crctableProfTwo[crc ^ payload[5]];
				crc = crctableProfTwo[crc ^ payload[6]];
				crc = crctableProfTwo[crc ^ payload[7]];
				switch (CounterValForCRC_CamLane_LaneAttr3_Pr2)
				{
					case(0) :
						crc = crctableProfTwo[crc ^ 248];
						break;
					case(1) :
						crc = crctableProfTwo[crc ^ 142];
						break;
					case(2) :
						crc = crctableProfTwo[crc ^ 36];
						break;
					case(3) :
						crc = crctableProfTwo[crc ^ 181];
						break;
					case(4) :
						crc = crctableProfTwo[crc ^ 75];
						break;
					case(5) :
						crc = crctableProfTwo[crc ^ 220];
						break;
					case(6) :
						crc = crctableProfTwo[crc ^ 114];
						break;
					case(7) :
						crc = crctableProfTwo[crc ^ 8];
						break;
					case(8) :
						crc = crctableProfTwo[crc ^ 153];
						break;
					case(9) :
						crc = crctableProfTwo[crc ^ 47];
						break;
					case(10) :
						crc = crctableProfTwo[crc ^ 192];
						break;
					case(11) :
						crc = crctableProfTwo[crc ^ 86];
						break;
					case(12) :
						crc = crctableProfTwo[crc ^ 231];
						break;
					case(13) :
						crc = crctableProfTwo[crc ^ 125];
						break;
					case(14) :
						crc = crctableProfTwo[crc ^ 19];
						break;
					case(15) :
						crc = crctableProfTwo[crc ^ 164];
						break;
					default :
//						write("error: wrong parameter (%d)",CounterValForCRC_CamLane_LaneAttr3_Pr2); stop();
						break;
				}
				crc = (crc ^ 0xFF);
				payload[0] = crc;
			}
			else
			{
				//CRC manuel veränderbar
			}

			CH_MPCCamLane_LaneAttr2_Gw_AR2();
			CH_MPCCamLane_LaneAttr3_Gw_AR2();
		}
	}
	if (strncmp (pduName, "CamLane_LaneAttr4_FR2", strLen(pduName)+strLen("CamLane_LaneAttr4_FR2")) == 0)
	{
		if (TxAck == 1)
		{
			if (@sysvar::CH_Nodes::CH_MPCSQC_CamLane_LaneAttr4_AUTO == 0)
			{
				//SQC automatisch ändern
				SQC_VAL_CamLane_LaneAttr4_Pr2 = (SQC_VAL_CamLane_LaneAttr4_Pr2 + 1) % 16;
			}
			else
			{
				//SQC manuel veränderbar
			}

		}
		else
		{
			if (@sysvar::CH_Nodes::CH_MPCSQC_CamLane_LaneAttr4_AUTO == 0)
			{
				//SQC automatisch ändern
				//SQC für CRC speichern
				CounterValForCRC_CamLane_LaneAttr4_Pr2 = SQC_VAL_CamLane_LaneAttr4_Pr2;
				//SQC in Byte schreiben
				payload[1] = (payload[1] & ~0x0F) |  SQC_VAL_CamLane_LaneAttr4_Pr2;
			}
			else
			{
				//SQC manuel veränderbar
			}

			if (@sysvar::CH_Nodes::CH_MPCCRC_CamLane_LaneAttr4_AUTO == 0)
			{
				//CRC automatisch berechnen
				crc = 0xFF;
				crc = crctableProfTwo[crc ^ payload[1]];
				crc = crctableProfTwo[crc ^ payload[2]];
				crc = crctableProfTwo[crc ^ payload[3]];
				crc = crctableProfTwo[crc ^ payload[4]];
				crc = crctableProfTwo[crc ^ payload[5]];
				crc = crctableProfTwo[crc ^ payload[6]];
				crc = crctableProfTwo[crc ^ payload[7]];
				crc = crctableProfTwo[crc ^ payload[8]];
				crc = crctableProfTwo[crc ^ payload[9]];
				crc = crctableProfTwo[crc ^ payload[10]];
				crc = crctableProfTwo[crc ^ payload[11]];
				crc = crctableProfTwo[crc ^ payload[12]];
				crc = crctableProfTwo[crc ^ payload[13]];
				crc = crctableProfTwo[crc ^ payload[14]];
				crc = crctableProfTwo[crc ^ payload[15]];
				crc = crctableProfTwo[crc ^ payload[16]];
				crc = crctableProfTwo[crc ^ payload[17]];
				switch (CounterValForCRC_CamLane_LaneAttr4_Pr2)
				{
					case(0) :
						crc = crctableProfTwo[crc ^ 32];
						break;
					case(1) :
						crc = crctableProfTwo[crc ^ 92];
						break;
					case(2) :
						crc = crctableProfTwo[crc ^ 152];
						break;
					case(3) :
						crc = crctableProfTwo[crc ^ 212];
						break;
					case(4) :
						crc = crctableProfTwo[crc ^ 21];
						break;
					case(5) :
						crc = crctableProfTwo[crc ^ 81];
						break;
					case(6) :
						crc = crctableProfTwo[crc ^ 141];
						break;
					case(7) :
						crc = crctableProfTwo[crc ^ 201];
						break;
					case(8) :
						crc = crctableProfTwo[crc ^ 10];
						break;
					case(9) :
						crc = crctableProfTwo[crc ^ 70];
						break;
					case(10) :
						crc = crctableProfTwo[crc ^ 130];
						break;
					case(11) :
						crc = crctableProfTwo[crc ^ 190];
						break;
					case(12) :
						crc = crctableProfTwo[crc ^ 250];
						break;
					case(13) :
						crc = crctableProfTwo[crc ^ 59];
						break;
					case(14) :
						crc = crctableProfTwo[crc ^ 119];
						break;
					case(15) :
						crc = crctableProfTwo[crc ^ 179];
						break;
					default :
//						write("error: wrong parameter (%d)",CounterValForCRC_CamLane_LaneAttr4_Pr2); stop();
						break;
				}
				crc = (crc ^ 0xFF);
				payload[0] = crc;
			}
			else
			{
				//CRC manuel veränderbar
			}

		}
	}
	if (strncmp (pduName, "CamLane_LaneAttr5_FR2", strLen(pduName)+strLen("CamLane_LaneAttr5_FR2")) == 0)
	{
		if (TxAck == 1)
		{
			if (@sysvar::CH_Nodes::CH_MPCSQC_CamLane_LaneAttr5_AUTO == 0)
			{
				//SQC automatisch ändern
				SQC_VAL_CamLane_LaneAttr5_Pr2 = (SQC_VAL_CamLane_LaneAttr5_Pr2 + 1) % 16;
			}
			else
			{
				//SQC manuel veränderbar
			}

		}
		else
		{
			if (@sysvar::CH_Nodes::CH_MPCSQC_CamLane_LaneAttr5_AUTO == 0)
			{
				//SQC automatisch ändern
				//SQC für CRC speichern
				CounterValForCRC_CamLane_LaneAttr5_Pr2 = SQC_VAL_CamLane_LaneAttr5_Pr2;
				//SQC in Byte schreiben
				payload[1] = (payload[1] & ~0x0F) |  SQC_VAL_CamLane_LaneAttr5_Pr2;
			}
			else
			{
				//SQC manuel veränderbar
			}

			if (@sysvar::CH_Nodes::CH_MPCCRC_CamLane_LaneAttr5_AUTO == 0)
			{
				//CRC automatisch berechnen
				crc = 0xFF;
				crc = crctableProfTwo[crc ^ payload[1]];
				crc = crctableProfTwo[crc ^ payload[2]];
				crc = crctableProfTwo[crc ^ payload[3]];
				crc = crctableProfTwo[crc ^ payload[4]];
				crc = crctableProfTwo[crc ^ payload[5]];
				crc = crctableProfTwo[crc ^ payload[6]];
				crc = crctableProfTwo[crc ^ payload[7]];
				crc = crctableProfTwo[crc ^ payload[8]];
				crc = crctableProfTwo[crc ^ payload[9]];
				crc = crctableProfTwo[crc ^ payload[10]];
				crc = crctableProfTwo[crc ^ payload[11]];
				crc = crctableProfTwo[crc ^ payload[12]];
				crc = crctableProfTwo[crc ^ payload[13]];
				crc = crctableProfTwo[crc ^ payload[14]];
				crc = crctableProfTwo[crc ^ payload[15]];
				crc = crctableProfTwo[crc ^ payload[16]];
				crc = crctableProfTwo[crc ^ payload[17]];
				switch (CounterValForCRC_CamLane_LaneAttr5_Pr2)
				{
					case(0) :
						crc = crctableProfTwo[crc ^ 110];
						break;
					case(1) :
						crc = crctableProfTwo[crc ^ 178];
						break;
					case(2) :
						crc = crctableProfTwo[crc ^ 246];
						break;
					case(3) :
						crc = crctableProfTwo[crc ^ 63];
						break;
					case(4) :
						crc = crctableProfTwo[crc ^ 131];
						break;
					case(5) :
						crc = crctableProfTwo[crc ^ 199];
						break;
					case(6) :
						crc = crctableProfTwo[crc ^ 16];
						break;
					case(7) :
						crc = crctableProfTwo[crc ^ 84];
						break;
					case(8) :
						crc = crctableProfTwo[crc ^ 152];
						break;
					case(9) :
						crc = crctableProfTwo[crc ^ 220];
						break;
					case(10) :
						crc = crctableProfTwo[crc ^ 37];
						break;
					case(11) :
						crc = crctableProfTwo[crc ^ 105];
						break;
					case(12) :
						crc = crctableProfTwo[crc ^ 173];
						break;
					case(13) :
						crc = crctableProfTwo[crc ^ 241];
						break;
					case(14) :
						crc = crctableProfTwo[crc ^ 58];
						break;
					case(15) :
						crc = crctableProfTwo[crc ^ 126];
						break;
					default :
//						write("error: wrong parameter (%d)",CounterValForCRC_CamLane_LaneAttr5_Pr2); stop();
						break;
				}
				crc = (crc ^ 0xFF);
				payload[0] = crc;
			}
			else
			{
				//CRC manuel veränderbar
			}

		}
	}
	if (strncmp (pduName, "CamLane_LaneAttr6_Gw_AR2", strLen(pduName)+strLen("CamLane_LaneAttr6_Gw_AR2")) == 0)
	{
		if (TxAck == 1)
		{
			if (@sysvar::CH_Nodes::CH_MPCSQC_CamLane_LaneAttr6_AUTO == 0)
			{
				//SQC automatisch ändern
				SQC_VAL_CamLane_LaneAttr6_Pr2 = (SQC_VAL_CamLane_LaneAttr6_Pr2 + 1) % 16;
			}
			else
			{
				//SQC manuel veränderbar
			}

		}
		else
		{
			if (@sysvar::CH_Nodes::CH_MPCSQC_CamLane_LaneAttr6_AUTO == 0)
			{
				//SQC automatisch ändern
				//SQC für CRC speichern
				CounterValForCRC_CamLane_LaneAttr6_Pr2 = SQC_VAL_CamLane_LaneAttr6_Pr2;
				//SQC in Byte schreiben
				payload[1] = (payload[1] & ~0x0F) |  SQC_VAL_CamLane_LaneAttr6_Pr2;
			}
			else
			{
				//SQC manuel veränderbar
			}

			if (@sysvar::CH_Nodes::CH_MPCCRC_CamLane_LaneAttr6_AUTO == 0)
			{
				//CRC automatisch berechnen
				crc = 0xFF;
				crc = crctableProfTwo[crc ^ payload[1]];
				crc = crctableProfTwo[crc ^ payload[2]];
				crc = crctableProfTwo[crc ^ payload[3]];
				crc = crctableProfTwo[crc ^ payload[4]];
				crc = crctableProfTwo[crc ^ payload[5]];
				crc = crctableProfTwo[crc ^ payload[6]];
				crc = crctableProfTwo[crc ^ payload[7]];
				switch (CounterValForCRC_CamLane_LaneAttr6_Pr2)
				{
					case(0) :
						crc = crctableProfTwo[crc ^ 202];
						break;
					case(1) :
						crc = crctableProfTwo[crc ^ 193];
						break;
					case(2) :
						crc = crctableProfTwo[crc ^ 184];
						break;
					case(3) :
						crc = crctableProfTwo[crc ^ 175];
						break;
					case(4) :
						crc = crctableProfTwo[crc ^ 166];
						break;
					case(5) :
						crc = crctableProfTwo[crc ^ 157];
						break;
					case(6) :
						crc = crctableProfTwo[crc ^ 148];
						break;
					case(7) :
						crc = crctableProfTwo[crc ^ 139];
						break;
					case(8) :
						crc = crctableProfTwo[crc ^ 130];
						break;
					case(9) :
						crc = crctableProfTwo[crc ^ 121];
						break;
					case(10) :
						crc = crctableProfTwo[crc ^ 112];
						break;
					case(11) :
						crc = crctableProfTwo[crc ^ 103];
						break;
					case(12) :
						crc = crctableProfTwo[crc ^ 94];
						break;
					case(13) :
						crc = crctableProfTwo[crc ^ 85];
						break;
					case(14) :
						crc = crctableProfTwo[crc ^ 76];
						break;
					case(15) :
						crc = crctableProfTwo[crc ^ 67];
						break;
					default :
//						write("error: wrong parameter (%d)",CounterValForCRC_CamLane_LaneAttr6_Pr2); stop();
						break;
				}
				crc = (crc ^ 0xFF);
				payload[0] = crc;
			}
			else
			{
				//CRC manuel veränderbar
			}

			CH_MPCCamLane_LaneAttr7_Gw_AR2();
			CH_MPCCamLane_LaneAttr6_Gw_AR2();
		}
	}
	if (strncmp (pduName, "CamLane_LaneAttr7_Gw_AR2", strLen(pduName)+strLen("CamLane_LaneAttr7_Gw_AR2")) == 0)
	{
		if (TxAck == 1)
		{
			if (@sysvar::CH_Nodes::CH_MPCSQC_CamLane_LaneAttr7_AUTO == 0)
			{
				//SQC automatisch ändern
				SQC_VAL_CamLane_LaneAttr7_Pr2 = (SQC_VAL_CamLane_LaneAttr7_Pr2 + 1) % 16;
			}
			else
			{
				//SQC manuel veränderbar
			}

		}
		else
		{
			if (@sysvar::CH_Nodes::CH_MPCSQC_CamLane_LaneAttr7_AUTO == 0)
			{
				//SQC automatisch ändern
				//SQC für CRC speichern
				CounterValForCRC_CamLane_LaneAttr7_Pr2 = SQC_VAL_CamLane_LaneAttr7_Pr2;
				//SQC in Byte schreiben
				payload[1] = (payload[1] & ~0x0F) |  SQC_VAL_CamLane_LaneAttr7_Pr2;
			}
			else
			{
				//SQC manuel veränderbar
			}

			if (@sysvar::CH_Nodes::CH_MPCCRC_CamLane_LaneAttr7_AUTO == 0)
			{
				//CRC automatisch berechnen
				crc = 0xFF;
				crc = crctableProfTwo[crc ^ payload[1]];
				crc = crctableProfTwo[crc ^ payload[2]];
				crc = crctableProfTwo[crc ^ payload[3]];
				crc = crctableProfTwo[crc ^ payload[4]];
				crc = crctableProfTwo[crc ^ payload[5]];
				crc = crctableProfTwo[crc ^ payload[6]];
				crc = crctableProfTwo[crc ^ payload[7]];
				switch (CounterValForCRC_CamLane_LaneAttr7_Pr2)
				{
					case(0) :
						crc = crctableProfTwo[crc ^ 102];
						break;
					case(1) :
						crc = crctableProfTwo[crc ^ 163];
						break;
					case(2) :
						crc = crctableProfTwo[crc ^ 224];
						break;
					case(3) :
						crc = crctableProfTwo[crc ^ 34];
						break;
					case(4) :
						crc = crctableProfTwo[crc ^ 95];
						break;
					case(5) :
						crc = crctableProfTwo[crc ^ 156];
						break;
					case(6) :
						crc = crctableProfTwo[crc ^ 217];
						break;
					case(7) :
						crc = crctableProfTwo[crc ^ 27];
						break;
					case(8) :
						crc = crctableProfTwo[crc ^ 88];
						break;
					case(9) :
						crc = crctableProfTwo[crc ^ 149];
						break;
					case(10) :
						crc = crctableProfTwo[crc ^ 210];
						break;
					case(11) :
						crc = crctableProfTwo[crc ^ 20];
						break;
					case(12) :
						crc = crctableProfTwo[crc ^ 81];
						break;
					case(13) :
						crc = crctableProfTwo[crc ^ 142];
						break;
					case(14) :
						crc = crctableProfTwo[crc ^ 203];
						break;
					case(15) :
						crc = crctableProfTwo[crc ^ 13];
						break;
					default :
//						write("error: wrong parameter (%d)",CounterValForCRC_CamLane_LaneAttr7_Pr2); stop();
						break;
				}
				crc = (crc ^ 0xFF);
				payload[0] = crc;
			}
			else
			{
				//CRC manuel veränderbar
			}

			CH_MPCCamLane_LaneAttr7_Gw_AR2();
			CH_MPCCamLane_LaneAttr6_Gw_AR2();
		}
	}
	if (strncmp (pduName, "CamObj_A_Mtn_FR2", strLen(pduName)+strLen("CamObj_A_Mtn_FR2")) == 0)
	{
		if (TxAck == 1)
		{
			if (@sysvar::CH_Nodes::CH_MPCSQC_CamObj_A_Mtn_Pr2C_AUTO == 0)
			{
				//SQC automatisch ändern
				SQC_VAL_CamObj_A_Mtn_Pr2 = (SQC_VAL_CamObj_A_Mtn_Pr2 + 1) % 16;
			}
			else
			{
				//SQC manuel veränderbar
			}

		}
		else
		{
			if (@sysvar::CH_Nodes::CH_MPCSQC_CamObj_A_Mtn_Pr2C_AUTO == 0)
			{
				//SQC automatisch ändern
				//SQC für CRC speichern
				CounterValForCRC_CamObj_A_Mtn_Pr2 = SQC_VAL_CamObj_A_Mtn_Pr2;
				//SQC in Byte schreiben
				payload[1] = (payload[1] & ~0x0F) |  SQC_VAL_CamObj_A_Mtn_Pr2;
			}
			else
			{
				//SQC manuel veränderbar
			}

			if (@sysvar::CH_Nodes::CH_MPCCRC_CamObj_A_Mtn_Pr2C_AUTO == 0)
			{
				//CRC automatisch berechnen
				crc = 0xFF;
				crc = crctableProfTwo[crc ^ payload[1]];
				crc = crctableProfTwo[crc ^ payload[2]];
				crc = crctableProfTwo[crc ^ payload[3]];
				crc = crctableProfTwo[crc ^ payload[4]];
				crc = crctableProfTwo[crc ^ payload[5]];
				crc = crctableProfTwo[crc ^ payload[6]];
				crc = crctableProfTwo[crc ^ payload[7]];
				crc = crctableProfTwo[crc ^ payload[8]];
				crc = crctableProfTwo[crc ^ payload[9]];
				crc = crctableProfTwo[crc ^ payload[10]];
				crc = crctableProfTwo[crc ^ payload[11]];
				crc = crctableProfTwo[crc ^ payload[12]];
				crc = crctableProfTwo[crc ^ payload[13]];
				crc = crctableProfTwo[crc ^ payload[14]];
				crc = crctableProfTwo[crc ^ payload[15]];
				crc = crctableProfTwo[crc ^ payload[16]];
				crc = crctableProfTwo[crc ^ payload[17]];
				switch (CounterValForCRC_CamObj_A_Mtn_Pr2)
				{
					case(0) :
						crc = crctableProfTwo[crc ^ 208];
						break;
					case(1) :
						crc = crctableProfTwo[crc ^ 161];
						break;
					case(2) :
						crc = crctableProfTwo[crc ^ 114];
						break;
					case(3) :
						crc = crctableProfTwo[crc ^ 67];
						break;
					case(4) :
						crc = crctableProfTwo[crc ^ 20];
						break;
					case(5) :
						crc = crctableProfTwo[crc ^ 224];
						break;
					case(6) :
						crc = crctableProfTwo[crc ^ 177];
						break;
					case(7) :
						crc = crctableProfTwo[crc ^ 130];
						break;
					case(8) :
						crc = crctableProfTwo[crc ^ 83];
						break;
					case(9) :
						crc = crctableProfTwo[crc ^ 36];
						break;
					case(10) :
						crc = crctableProfTwo[crc ^ 240];
						break;
					case(11) :
						crc = crctableProfTwo[crc ^ 193];
						break;
					case(12) :
						crc = crctableProfTwo[crc ^ 146];
						break;
					case(13) :
						crc = crctableProfTwo[crc ^ 99];
						break;
					case(14) :
						crc = crctableProfTwo[crc ^ 52];
						break;
					case(15) :
						crc = crctableProfTwo[crc ^ 5];
						break;
					default :
//						write("error: wrong parameter (%d)",CounterValForCRC_CamObj_A_Mtn_Pr2); stop();
						break;
				}
				crc = (crc ^ 0xFF);
				payload[0] = crc;
			}
			else
			{
				//CRC manuel veränderbar
			}

		}
	}
	if (strncmp (pduName, "CamObj_A_Posn_FR2", strLen(pduName)+strLen("CamObj_A_Posn_FR2")) == 0)
	{
		if (TxAck == 1)
		{
			if (@sysvar::CH_Nodes::CH_MPCSQC_CamObj_A_Posn_Pr2_AUTO == 0)
			{
				//SQC automatisch ändern
				SQC_VAL_CamObj_A_Posn_Pr2 = (SQC_VAL_CamObj_A_Posn_Pr2 + 1) % 16;
			}
			else
			{
				//SQC manuel veränderbar
			}

		}
		else
		{
			if (@sysvar::CH_Nodes::CH_MPCSQC_CamObj_A_Posn_Pr2_AUTO == 0)
			{
				//SQC automatisch ändern
				//SQC für CRC speichern
				CounterValForCRC_CamObj_A_Posn_Pr2 = SQC_VAL_CamObj_A_Posn_Pr2;
				//SQC in Byte schreiben
				payload[1] = (payload[1] & ~0x0F) |  SQC_VAL_CamObj_A_Posn_Pr2;
			}
			else
			{
				//SQC manuel veränderbar
			}

			if (@sysvar::CH_Nodes::CH_MPCCRC_CamObj_A_Posn_Pr2_AUTO == 0)
			{
				//CRC automatisch berechnen
				crc = 0xFF;
				crc = crctableProfTwo[crc ^ payload[1]];
				crc = crctableProfTwo[crc ^ payload[2]];
				crc = crctableProfTwo[crc ^ payload[3]];
				crc = crctableProfTwo[crc ^ payload[4]];
				crc = crctableProfTwo[crc ^ payload[5]];
				crc = crctableProfTwo[crc ^ payload[6]];
				crc = crctableProfTwo[crc ^ payload[7]];
				crc = crctableProfTwo[crc ^ payload[8]];
				crc = crctableProfTwo[crc ^ payload[9]];
				crc = crctableProfTwo[crc ^ payload[10]];
				crc = crctableProfTwo[crc ^ payload[11]];
				crc = crctableProfTwo[crc ^ payload[12]];
				crc = crctableProfTwo[crc ^ payload[13]];
				crc = crctableProfTwo[crc ^ payload[14]];
				crc = crctableProfTwo[crc ^ payload[15]];
				crc = crctableProfTwo[crc ^ payload[16]];
				crc = crctableProfTwo[crc ^ payload[17]];
				switch (CounterValForCRC_CamObj_A_Posn_Pr2)
				{
					case(0) :
						crc = crctableProfTwo[crc ^ 24];
						break;
					case(1) :
						crc = crctableProfTwo[crc ^ 204];
						break;
					case(2) :
						crc = crctableProfTwo[crc ^ 133];
						break;
					case(3) :
						crc = crctableProfTwo[crc ^ 62];
						break;
					case(4) :
						crc = crctableProfTwo[crc ^ 242];
						break;
					case(5) :
						crc = crctableProfTwo[crc ^ 171];
						break;
					case(6) :
						crc = crctableProfTwo[crc ^ 100];
						break;
					case(7) :
						crc = crctableProfTwo[crc ^ 29];
						break;
					case(8) :
						crc = crctableProfTwo[crc ^ 209];
						break;
					case(9) :
						crc = crctableProfTwo[crc ^ 138];
						break;
					case(10) :
						crc = crctableProfTwo[crc ^ 67];
						break;
					case(11) :
						crc = crctableProfTwo[crc ^ 247];
						break;
					case(12) :
						crc = crctableProfTwo[crc ^ 176];
						break;
					case(13) :
						crc = crctableProfTwo[crc ^ 105];
						break;
					case(14) :
						crc = crctableProfTwo[crc ^ 34];
						break;
					case(15) :
						crc = crctableProfTwo[crc ^ 214];
						break;
					default :
//						write("error: wrong parameter (%d)",CounterValForCRC_CamObj_A_Posn_Pr2); stop();
						break;
				}
				crc = (crc ^ 0xFF);
				payload[0] = crc;
			}
			else
			{
				//CRC manuel veränderbar
			}

		}
	}
	if (strncmp (pduName, "CamObj_B_Mtn_FR2", strLen(pduName)+strLen("CamObj_B_Mtn_FR2")) == 0)
	{
		if (TxAck == 1)
		{
			if (@sysvar::CH_Nodes::CH_MPCSQC_CamObj_B_Mtn_Pr2C_AUTO == 0)
			{
				//SQC automatisch ändern
				SQC_VAL_CamObj_B_Mtn_Pr2 = (SQC_VAL_CamObj_B_Mtn_Pr2 + 1) % 16;
			}
			else
			{
				//SQC manuel veränderbar
			}

		}
		else
		{
			if (@sysvar::CH_Nodes::CH_MPCSQC_CamObj_B_Mtn_Pr2C_AUTO == 0)
			{
				//SQC automatisch ändern
				//SQC für CRC speichern
				CounterValForCRC_CamObj_B_Mtn_Pr2 = SQC_VAL_CamObj_B_Mtn_Pr2;
				//SQC in Byte schreiben
				payload[1] = (payload[1] & ~0x0F) |  SQC_VAL_CamObj_B_Mtn_Pr2;
			}
			else
			{
				//SQC manuel veränderbar
			}

			if (@sysvar::CH_Nodes::CH_MPCCRC_CamObj_B_Mtn_Pr2C_AUTO == 0)
			{
				//CRC automatisch berechnen
				crc = 0xFF;
				crc = crctableProfTwo[crc ^ payload[1]];
				crc = crctableProfTwo[crc ^ payload[2]];
				crc = crctableProfTwo[crc ^ payload[3]];
				crc = crctableProfTwo[crc ^ payload[4]];
				crc = crctableProfTwo[crc ^ payload[5]];
				crc = crctableProfTwo[crc ^ payload[6]];
				crc = crctableProfTwo[crc ^ payload[7]];
				crc = crctableProfTwo[crc ^ payload[8]];
				crc = crctableProfTwo[crc ^ payload[9]];
				crc = crctableProfTwo[crc ^ payload[10]];
				crc = crctableProfTwo[crc ^ payload[11]];
				crc = crctableProfTwo[crc ^ payload[12]];
				crc = crctableProfTwo[crc ^ payload[13]];
				crc = crctableProfTwo[crc ^ payload[14]];
				crc = crctableProfTwo[crc ^ payload[15]];
				crc = crctableProfTwo[crc ^ payload[16]];
				crc = crctableProfTwo[crc ^ payload[17]];
				switch (CounterValForCRC_CamObj_B_Mtn_Pr2)
				{
					case(0) :
						crc = crctableProfTwo[crc ^ 239];
						break;
					case(1) :
						crc = crctableProfTwo[crc ^ 166];
						break;
					case(2) :
						crc = crctableProfTwo[crc ^ 93];
						break;
					case(3) :
						crc = crctableProfTwo[crc ^ 20];
						break;
					case(4) :
						crc = crctableProfTwo[crc ^ 198];
						break;
					case(5) :
						crc = crctableProfTwo[crc ^ 125];
						break;
					case(6) :
						crc = crctableProfTwo[crc ^ 52];
						break;
					case(7) :
						crc = crctableProfTwo[crc ^ 230];
						break;
					case(8) :
						crc = crctableProfTwo[crc ^ 157];
						break;
					case(9) :
						crc = crctableProfTwo[crc ^ 84];
						break;
					case(10) :
						crc = crctableProfTwo[crc ^ 11];
						break;
					case(11) :
						crc = crctableProfTwo[crc ^ 189];
						break;
					case(12) :
						crc = crctableProfTwo[crc ^ 116];
						break;
					case(13) :
						crc = crctableProfTwo[crc ^ 43];
						break;
					case(14) :
						crc = crctableProfTwo[crc ^ 221];
						break;
					case(15) :
						crc = crctableProfTwo[crc ^ 148];
						break;
					default :
//						write("error: wrong parameter (%d)",CounterValForCRC_CamObj_B_Mtn_Pr2); stop();
						break;
				}
				crc = (crc ^ 0xFF);
				payload[0] = crc;
			}
			else
			{
				//CRC manuel veränderbar
			}

		}
	}
	if (strncmp (pduName, "CamObj_B_Posn_FR2", strLen(pduName)+strLen("CamObj_B_Posn_FR2")) == 0)
	{
		if (TxAck == 1)
		{
			if (@sysvar::CH_Nodes::CH_MPCSQC_CamObj_B_Posn_Pr2_AUTO == 0)
			{
				//SQC automatisch ändern
				SQC_VAL_CamObj_B_Posn_Pr2 = (SQC_VAL_CamObj_B_Posn_Pr2 + 1) % 16;
			}
			else
			{
				//SQC manuel veränderbar
			}

		}
		else
		{
			if (@sysvar::CH_Nodes::CH_MPCSQC_CamObj_B_Posn_Pr2_AUTO == 0)
			{
				//SQC automatisch ändern
				//SQC für CRC speichern
				CounterValForCRC_CamObj_B_Posn_Pr2 = SQC_VAL_CamObj_B_Posn_Pr2;
				//SQC in Byte schreiben
				payload[1] = (payload[1] & ~0x0F) |  SQC_VAL_CamObj_B_Posn_Pr2;
			}
			else
			{
				//SQC manuel veränderbar
			}

			if (@sysvar::CH_Nodes::CH_MPCCRC_CamObj_B_Posn_Pr2_AUTO == 0)
			{
				//CRC automatisch berechnen
				crc = 0xFF;
				crc = crctableProfTwo[crc ^ payload[1]];
				crc = crctableProfTwo[crc ^ payload[2]];
				crc = crctableProfTwo[crc ^ payload[3]];
				crc = crctableProfTwo[crc ^ payload[4]];
				crc = crctableProfTwo[crc ^ payload[5]];
				crc = crctableProfTwo[crc ^ payload[6]];
				crc = crctableProfTwo[crc ^ payload[7]];
				crc = crctableProfTwo[crc ^ payload[8]];
				crc = crctableProfTwo[crc ^ payload[9]];
				crc = crctableProfTwo[crc ^ payload[10]];
				crc = crctableProfTwo[crc ^ payload[11]];
				crc = crctableProfTwo[crc ^ payload[12]];
				crc = crctableProfTwo[crc ^ payload[13]];
				crc = crctableProfTwo[crc ^ payload[14]];
				crc = crctableProfTwo[crc ^ payload[15]];
				crc = crctableProfTwo[crc ^ payload[16]];
				crc = crctableProfTwo[crc ^ payload[17]];
				switch (CounterValForCRC_CamObj_B_Posn_Pr2)
				{
					case(0) :
						crc = crctableProfTwo[crc ^ 253];
						break;
					case(1) :
						crc = crctableProfTwo[crc ^ 20];
						break;
					case(2) :
						crc = crctableProfTwo[crc ^ 38];
						break;
					case(3) :
						crc = crctableProfTwo[crc ^ 56];
						break;
					case(4) :
						crc = crctableProfTwo[crc ^ 74];
						break;
					case(5) :
						crc = crctableProfTwo[crc ^ 92];
						break;
					case(6) :
						crc = crctableProfTwo[crc ^ 110];
						break;
					case(7) :
						crc = crctableProfTwo[crc ^ 128];
						break;
					case(8) :
						crc = crctableProfTwo[crc ^ 146];
						break;
					case(9) :
						crc = crctableProfTwo[crc ^ 164];
						break;
					case(10) :
						crc = crctableProfTwo[crc ^ 182];
						break;
					case(11) :
						crc = crctableProfTwo[crc ^ 200];
						break;
					case(12) :
						crc = crctableProfTwo[crc ^ 218];
						break;
					case(13) :
						crc = crctableProfTwo[crc ^ 236];
						break;
					case(14) :
						crc = crctableProfTwo[crc ^ 3];
						break;
					case(15) :
						crc = crctableProfTwo[crc ^ 21];
						break;
					default :
//						write("error: wrong parameter (%d)",CounterValForCRC_CamObj_B_Posn_Pr2); stop();
						break;
				}
				crc = (crc ^ 0xFF);
				payload[0] = crc;
			}
			else
			{
				//CRC manuel veränderbar
			}

		}
	}
	if (strncmp (pduName, "CamObj_C_Mtn_FR2", strLen(pduName)+strLen("CamObj_C_Mtn_FR2")) == 0)
	{
		if (TxAck == 1)
		{
			if (@sysvar::CH_Nodes::CH_MPCSQC_CamObj_C_Mtn_Pr2C_AUTO == 0)
			{
				//SQC automatisch ändern
				SQC_VAL_CamObj_C_Mtn_Pr2 = (SQC_VAL_CamObj_C_Mtn_Pr2 + 1) % 16;
			}
			else
			{
				//SQC manuel veränderbar
			}

		}
		else
		{
			if (@sysvar::CH_Nodes::CH_MPCSQC_CamObj_C_Mtn_Pr2C_AUTO == 0)
			{
				//SQC automatisch ändern
				//SQC für CRC speichern
				CounterValForCRC_CamObj_C_Mtn_Pr2 = SQC_VAL_CamObj_C_Mtn_Pr2;
				//SQC in Byte schreiben
				payload[1] = (payload[1] & ~0x0F) |  SQC_VAL_CamObj_C_Mtn_Pr2;
			}
			else
			{
				//SQC manuel veränderbar
			}

			if (@sysvar::CH_Nodes::CH_MPCCRC_CamObj_C_Mtn_Pr2C_AUTO == 0)
			{
				//CRC automatisch berechnen
				crc = 0xFF;
				crc = crctableProfTwo[crc ^ payload[1]];
				crc = crctableProfTwo[crc ^ payload[2]];
				crc = crctableProfTwo[crc ^ payload[3]];
				crc = crctableProfTwo[crc ^ payload[4]];
				crc = crctableProfTwo[crc ^ payload[5]];
				crc = crctableProfTwo[crc ^ payload[6]];
				crc = crctableProfTwo[crc ^ payload[7]];
				crc = crctableProfTwo[crc ^ payload[8]];
				crc = crctableProfTwo[crc ^ payload[9]];
				crc = crctableProfTwo[crc ^ payload[10]];
				crc = crctableProfTwo[crc ^ payload[11]];
				crc = crctableProfTwo[crc ^ payload[12]];
				crc = crctableProfTwo[crc ^ payload[13]];
				crc = crctableProfTwo[crc ^ payload[14]];
				crc = crctableProfTwo[crc ^ payload[15]];
				crc = crctableProfTwo[crc ^ payload[16]];
				crc = crctableProfTwo[crc ^ payload[17]];
				switch (CounterValForCRC_CamObj_C_Mtn_Pr2)
				{
					case(0) :
						crc = crctableProfTwo[crc ^ 239];
						break;
					case(1) :
						crc = crctableProfTwo[crc ^ 3];
						break;
					case(2) :
						crc = crctableProfTwo[crc ^ 18];
						break;
					case(3) :
						crc = crctableProfTwo[crc ^ 33];
						break;
					case(4) :
						crc = crctableProfTwo[crc ^ 48];
						break;
					case(5) :
						crc = crctableProfTwo[crc ^ 63];
						break;
					case(6) :
						crc = crctableProfTwo[crc ^ 78];
						break;
					case(7) :
						crc = crctableProfTwo[crc ^ 93];
						break;
					case(8) :
						crc = crctableProfTwo[crc ^ 108];
						break;
					case(9) :
						crc = crctableProfTwo[crc ^ 123];
						break;
					case(10) :
						crc = crctableProfTwo[crc ^ 138];
						break;
					case(11) :
						crc = crctableProfTwo[crc ^ 153];
						break;
					case(12) :
						crc = crctableProfTwo[crc ^ 168];
						break;
					case(13) :
						crc = crctableProfTwo[crc ^ 183];
						break;
					case(14) :
						crc = crctableProfTwo[crc ^ 198];
						break;
					case(15) :
						crc = crctableProfTwo[crc ^ 213];
						break;
					default :
//						write("error: wrong parameter (%d)",CounterValForCRC_CamObj_C_Mtn_Pr2); stop();
						break;
				}
				crc = (crc ^ 0xFF);
				payload[0] = crc;
			}
			else
			{
				//CRC manuel veränderbar
			}

		}
	}
	if (strncmp (pduName, "CamObj_C_Posn_FR2", strLen(pduName)+strLen("CamObj_C_Posn_FR2")) == 0)
	{
		if (TxAck == 1)
		{
			if (@sysvar::CH_Nodes::CH_MPCSQC_CamObj_C_Posn_Pr2_AUTO == 0)
			{
				//SQC automatisch ändern
				SQC_VAL_CamObj_C_Posn_Pr2 = (SQC_VAL_CamObj_C_Posn_Pr2 + 1) % 16;
			}
			else
			{
				//SQC manuel veränderbar
			}

		}
		else
		{
			if (@sysvar::CH_Nodes::CH_MPCSQC_CamObj_C_Posn_Pr2_AUTO == 0)
			{
				//SQC automatisch ändern
				//SQC für CRC speichern
				CounterValForCRC_CamObj_C_Posn_Pr2 = SQC_VAL_CamObj_C_Posn_Pr2;
				//SQC in Byte schreiben
				payload[1] = (payload[1] & ~0x0F) |  SQC_VAL_CamObj_C_Posn_Pr2;
			}
			else
			{
				//SQC manuel veränderbar
			}

			if (@sysvar::CH_Nodes::CH_MPCCRC_CamObj_C_Posn_Pr2_AUTO == 0)
			{
				//CRC automatisch berechnen
				crc = 0xFF;
				crc = crctableProfTwo[crc ^ payload[1]];
				crc = crctableProfTwo[crc ^ payload[2]];
				crc = crctableProfTwo[crc ^ payload[3]];
				crc = crctableProfTwo[crc ^ payload[4]];
				crc = crctableProfTwo[crc ^ payload[5]];
				crc = crctableProfTwo[crc ^ payload[6]];
				crc = crctableProfTwo[crc ^ payload[7]];
				crc = crctableProfTwo[crc ^ payload[8]];
				crc = crctableProfTwo[crc ^ payload[9]];
				crc = crctableProfTwo[crc ^ payload[10]];
				crc = crctableProfTwo[crc ^ payload[11]];
				crc = crctableProfTwo[crc ^ payload[12]];
				crc = crctableProfTwo[crc ^ payload[13]];
				crc = crctableProfTwo[crc ^ payload[14]];
				crc = crctableProfTwo[crc ^ payload[15]];
				crc = crctableProfTwo[crc ^ payload[16]];
				crc = crctableProfTwo[crc ^ payload[17]];
				switch (CounterValForCRC_CamObj_C_Posn_Pr2)
				{
					case(0) :
						crc = crctableProfTwo[crc ^ 43];
						break;
					case(1) :
						crc = crctableProfTwo[crc ^ 63];
						break;
					case(2) :
						crc = crctableProfTwo[crc ^ 83];
						break;
					case(3) :
						crc = crctableProfTwo[crc ^ 103];
						break;
					case(4) :
						crc = crctableProfTwo[crc ^ 123];
						break;
					case(5) :
						crc = crctableProfTwo[crc ^ 143];
						break;
					case(6) :
						crc = crctableProfTwo[crc ^ 163];
						break;
					case(7) :
						crc = crctableProfTwo[crc ^ 183];
						break;
					case(8) :
						crc = crctableProfTwo[crc ^ 203];
						break;
					case(9) :
						crc = crctableProfTwo[crc ^ 223];
						break;
					case(10) :
						crc = crctableProfTwo[crc ^ 243];
						break;
					case(11) :
						crc = crctableProfTwo[crc ^ 12];
						break;
					case(12) :
						crc = crctableProfTwo[crc ^ 32];
						break;
					case(13) :
						crc = crctableProfTwo[crc ^ 52];
						break;
					case(14) :
						crc = crctableProfTwo[crc ^ 72];
						break;
					case(15) :
						crc = crctableProfTwo[crc ^ 92];
						break;
					default :
//						write("error: wrong parameter (%d)",CounterValForCRC_CamObj_C_Posn_Pr2); stop();
						break;
				}
				crc = (crc ^ 0xFF);
				payload[0] = crc;
			}
			else
			{
				//CRC manuel veränderbar
			}

		}
	}
	if (strncmp (pduName, "IHC_Lgt_Stat_MPC_Gw_AR2", strLen(pduName)+strLen("IHC_Lgt_Stat_MPC_Gw_AR2")) == 0)
	{
		if (TxAck == 1)
		{
			if (@sysvar::CH_Nodes::CH_MPCSQC_IHC_Lgt_Stat_MPC__AUTO == 0)
			{
				//SQC automatisch ändern
				SQC_VAL_IHC_Lgt_Stat_MPC_Pr2 = (SQC_VAL_IHC_Lgt_Stat_MPC_Pr2 + 1) % 16;
			}
			else
			{
				//SQC manuel veränderbar
			}

		}
		else
		{
			if (@sysvar::CH_Nodes::CH_MPCSQC_IHC_Lgt_Stat_MPC__AUTO == 0)
			{
				//SQC automatisch ändern
				//SQC für CRC speichern
				CounterValForCRC_IHC_Lgt_Stat_MPC_Pr2 = SQC_VAL_IHC_Lgt_Stat_MPC_Pr2;
				//SQC in Byte schreiben
				payload[1] = (payload[1] & ~0x0F) |  SQC_VAL_IHC_Lgt_Stat_MPC_Pr2;
			}
			else
			{
				//SQC manuel veränderbar
			}

			if (@sysvar::CH_Nodes::CH_MPCCRC_IHC_Lgt_Stat_MPC__AUTO == 0)
			{
				//CRC automatisch berechnen
				crc = 0xFF;
				crc = crctableProfTwo[crc ^ payload[1]];
				crc = crctableProfTwo[crc ^ payload[2]];
				crc = crctableProfTwo[crc ^ payload[3]];
				crc = crctableProfTwo[crc ^ payload[4]];
				crc = crctableProfTwo[crc ^ payload[5]];
				crc = crctableProfTwo[crc ^ payload[6]];
				crc = crctableProfTwo[crc ^ payload[7]];
				switch (CounterValForCRC_IHC_Lgt_Stat_MPC_Pr2)
				{
					case(0) :
						crc = crctableProfTwo[crc ^ 79];
						break;
					case(1) :
						crc = crctableProfTwo[crc ^ 195];
						break;
					case(2) :
						crc = crctableProfTwo[crc ^ 60];
						break;
					case(3) :
						crc = crctableProfTwo[crc ^ 176];
						break;
					case(4) :
						crc = crctableProfTwo[crc ^ 41];
						break;
					case(5) :
						crc = crctableProfTwo[crc ^ 157];
						break;
					case(6) :
						crc = crctableProfTwo[crc ^ 22];
						break;
					case(7) :
						crc = crctableProfTwo[crc ^ 138];
						break;
					case(8) :
						crc = crctableProfTwo[crc ^ 3];
						break;
					case(9) :
						crc = crctableProfTwo[crc ^ 119];
						break;
					case(10) :
						crc = crctableProfTwo[crc ^ 235];
						break;
					case(11) :
						crc = crctableProfTwo[crc ^ 100];
						break;
					case(12) :
						crc = crctableProfTwo[crc ^ 216];
						break;
					case(13) :
						crc = crctableProfTwo[crc ^ 81];
						break;
					case(14) :
						crc = crctableProfTwo[crc ^ 197];
						break;
					case(15) :
						crc = crctableProfTwo[crc ^ 62];
						break;
					default :
//						write("error: wrong parameter (%d)",CounterValForCRC_IHC_Lgt_Stat_MPC_Pr2); stop();
						break;
				}
				crc = (crc ^ 0xFF);
				payload[0] = crc;
			}
			else
			{
				//CRC manuel veränderbar
			}

			CH_MPCIHC_Lgt_Stat_MPC_Gw_AR2();
			CH_MPCIHC_Plus_HL_Stat_AR2();
		}
	}
	if (strncmp (pduName, "IHC_Plus_HL_Stat_AR2", strLen(pduName)+strLen("IHC_Plus_HL_Stat_AR2")) == 0)
	{
		if (TxAck == 1)
		{
			if (@sysvar::CH_Nodes::CH_MPCSQC_IHC_Plus_HL_Stat__AUTO == 0)
			{
				//SQC automatisch ändern
				SQC_VAL_IHC_Plus_HL_Stat_Pr2 = (SQC_VAL_IHC_Plus_HL_Stat_Pr2 + 1) % 16;
			}
			else
			{
				//SQC manuel veränderbar
			}

		}
		else
		{
			if (@sysvar::CH_Nodes::CH_MPCSQC_IHC_Plus_HL_Stat__AUTO == 0)
			{
				//SQC automatisch ändern
				//SQC für CRC speichern
				CounterValForCRC_IHC_Plus_HL_Stat_Pr2 = SQC_VAL_IHC_Plus_HL_Stat_Pr2;
				//SQC in Byte schreiben
				payload[1] = (payload[1] & ~0x0F) |  SQC_VAL_IHC_Plus_HL_Stat_Pr2;
			}
			else
			{
				//SQC manuel veränderbar
			}

			if (@sysvar::CH_Nodes::CH_MPCCRC_IHC_Plus_HL_Stat__AUTO == 0)
			{
				//CRC automatisch berechnen
				crc = 0xFF;
				crc = crctableProfTwo[crc ^ payload[1]];
				crc = crctableProfTwo[crc ^ payload[2]];
				crc = crctableProfTwo[crc ^ payload[3]];
				crc = crctableProfTwo[crc ^ payload[4]];
				crc = crctableProfTwo[crc ^ payload[5]];
				crc = crctableProfTwo[crc ^ payload[6]];
				crc = crctableProfTwo[crc ^ payload[7]];
				switch (CounterValForCRC_IHC_Plus_HL_Stat_Pr2)
				{
					case(0) :
						crc = crctableProfTwo[crc ^ 48];
						break;
					case(1) :
						crc = crctableProfTwo[crc ^ 125];
						break;
					case(2) :
						crc = crctableProfTwo[crc ^ 202];
						break;
					case(3) :
						crc = crctableProfTwo[crc ^ 28];
						break;
					case(4) :
						crc = crctableProfTwo[crc ^ 105];
						break;
					case(5) :
						crc = crctableProfTwo[crc ^ 182];
						break;
					case(6) :
						crc = crctableProfTwo[crc ^ 8];
						break;
					case(7) :
						crc = crctableProfTwo[crc ^ 85];
						break;
					case(8) :
						crc = crctableProfTwo[crc ^ 162];
						break;
					case(9) :
						crc = crctableProfTwo[crc ^ 239];
						break;
					case(10) :
						crc = crctableProfTwo[crc ^ 65];
						break;
					case(11) :
						crc = crctableProfTwo[crc ^ 142];
						break;
					case(12) :
						crc = crctableProfTwo[crc ^ 219];
						break;
					case(13) :
						crc = crctableProfTwo[crc ^ 45];
						break;
					case(14) :
						crc = crctableProfTwo[crc ^ 122];
						break;
					case(15) :
						crc = crctableProfTwo[crc ^ 199];
						break;
					default :
//						write("error: wrong parameter (%d)",CounterValForCRC_IHC_Plus_HL_Stat_Pr2); stop();
						break;
				}
				crc = (crc ^ 0xFF);
				payload[0] = crc;
			}
			else
			{
				//CRC manuel veränderbar
			}

			CH_MPCIHC_Lgt_Stat_MPC_Gw_AR2();
			CH_MPCIHC_Plus_HL_Stat_AR2();
		}
	}
	if (strncmp (pduName, "IHC_Plus_Tunnel_3_4_AR2", strLen(pduName)+strLen("IHC_Plus_Tunnel_3_4_AR2")) == 0)
	{
		if (TxAck == 1)
		{
			if (@sysvar::CH_Nodes::CH_MPCSQC_IHC_Plus_Tunnel_3_AUTO == 0)
			{
				//SQC automatisch ändern
				SQC_VAL_IHC_Plus_Tunnel_3_4_Pr2 = (SQC_VAL_IHC_Plus_Tunnel_3_4_Pr2 + 1) % 16;
			}
			else
			{
				//SQC manuel veränderbar
			}

		}
		else
		{
			if (@sysvar::CH_Nodes::CH_MPCSQC_IHC_Plus_Tunnel_3_AUTO == 0)
			{
				//SQC automatisch ändern
				//SQC für CRC speichern
				CounterValForCRC_IHC_Plus_Tunnel_3_4_Pr2 = SQC_VAL_IHC_Plus_Tunnel_3_4_Pr2;
				//SQC in Byte schreiben
				payload[1] = (payload[1] & ~0x0F) |  SQC_VAL_IHC_Plus_Tunnel_3_4_Pr2;
			}
			else
			{
				//SQC manuel veränderbar
			}

			if (@sysvar::CH_Nodes::CH_MPCCRC_IHC_Plus_Tunnel_3_AUTO == 0)
			{
				//CRC automatisch berechnen
				crc = 0xFF;
				crc = crctableProfTwo[crc ^ payload[1]];
				crc = crctableProfTwo[crc ^ payload[2]];
				crc = crctableProfTwo[crc ^ payload[3]];
				crc = crctableProfTwo[crc ^ payload[4]];
				crc = crctableProfTwo[crc ^ payload[5]];
				crc = crctableProfTwo[crc ^ payload[6]];
				crc = crctableProfTwo[crc ^ payload[7]];
				switch (CounterValForCRC_IHC_Plus_Tunnel_3_4_Pr2)
				{
					case(0) :
						crc = crctableProfTwo[crc ^ 76];
						break;
					case(1) :
						crc = crctableProfTwo[crc ^ 221];
						break;
					case(2) :
						crc = crctableProfTwo[crc ^ 115];
						break;
					case(3) :
						crc = crctableProfTwo[crc ^ 9];
						break;
					case(4) :
						crc = crctableProfTwo[crc ^ 154];
						break;
					case(5) :
						crc = crctableProfTwo[crc ^ 48];
						break;
					case(6) :
						crc = crctableProfTwo[crc ^ 193];
						break;
					case(7) :
						crc = crctableProfTwo[crc ^ 87];
						break;
					case(8) :
						crc = crctableProfTwo[crc ^ 232];
						break;
					case(9) :
						crc = crctableProfTwo[crc ^ 126];
						break;
					case(10) :
						crc = crctableProfTwo[crc ^ 20];
						break;
					case(11) :
						crc = crctableProfTwo[crc ^ 165];
						break;
					case(12) :
						crc = crctableProfTwo[crc ^ 59];
						break;
					case(13) :
						crc = crctableProfTwo[crc ^ 204];
						break;
					case(14) :
						crc = crctableProfTwo[crc ^ 98];
						break;
					case(15) :
						crc = crctableProfTwo[crc ^ 243];
						break;
					default :
//						write("error: wrong parameter (%d)",CounterValForCRC_IHC_Plus_Tunnel_3_4_Pr2); stop();
						break;
				}
				crc = (crc ^ 0xFF);
				payload[0] = crc;
			}
			else
			{
				//CRC manuel veränderbar
			}

			CH_MPCIHC_Plus_Tunnel_3_4_AR2();
			CH_MPCIHC_Plus_Tunnel_AR2();
		}
	}
	if (strncmp (pduName, "IHC_Plus_Tunnel_AR2", strLen(pduName)+strLen("IHC_Plus_Tunnel_AR2")) == 0)
	{
		if (TxAck == 1)
		{
			if (@sysvar::CH_Nodes::CH_MPCSQC_IHC_Plus_Tunnel_P_AUTO == 0)
			{
				//SQC automatisch ändern
				SQC_VAL_IHC_Plus_Tunnel_Pr2 = (SQC_VAL_IHC_Plus_Tunnel_Pr2 + 1) % 16;
			}
			else
			{
				//SQC manuel veränderbar
			}

		}
		else
		{
			if (@sysvar::CH_Nodes::CH_MPCSQC_IHC_Plus_Tunnel_P_AUTO == 0)
			{
				//SQC automatisch ändern
				//SQC für CRC speichern
				CounterValForCRC_IHC_Plus_Tunnel_Pr2 = SQC_VAL_IHC_Plus_Tunnel_Pr2;
				//SQC in Byte schreiben
				payload[1] = (payload[1] & ~0x0F) |  SQC_VAL_IHC_Plus_Tunnel_Pr2;
			}
			else
			{
				//SQC manuel veränderbar
			}

			if (@sysvar::CH_Nodes::CH_MPCCRC_IHC_Plus_Tunnel_P_AUTO == 0)
			{
				//CRC automatisch berechnen
				crc = 0xFF;
				crc = crctableProfTwo[crc ^ payload[1]];
				crc = crctableProfTwo[crc ^ payload[2]];
				crc = crctableProfTwo[crc ^ payload[3]];
				crc = crctableProfTwo[crc ^ payload[4]];
				crc = crctableProfTwo[crc ^ payload[5]];
				crc = crctableProfTwo[crc ^ payload[6]];
				crc = crctableProfTwo[crc ^ payload[7]];
				switch (CounterValForCRC_IHC_Plus_Tunnel_Pr2)
				{
					case(0) :
						crc = crctableProfTwo[crc ^ 107];
						break;
					case(1) :
						crc = crctableProfTwo[crc ^ 123];
						break;
					case(2) :
						crc = crctableProfTwo[crc ^ 139];
						break;
					case(3) :
						crc = crctableProfTwo[crc ^ 155];
						break;
					case(4) :
						crc = crctableProfTwo[crc ^ 171];
						break;
					case(5) :
						crc = crctableProfTwo[crc ^ 187];
						break;
					case(6) :
						crc = crctableProfTwo[crc ^ 203];
						break;
					case(7) :
						crc = crctableProfTwo[crc ^ 219];
						break;
					case(8) :
						crc = crctableProfTwo[crc ^ 235];
						break;
					case(9) :
						crc = crctableProfTwo[crc ^ 251];
						break;
					case(10) :
						crc = crctableProfTwo[crc ^ 16];
						break;
					case(11) :
						crc = crctableProfTwo[crc ^ 32];
						break;
					case(12) :
						crc = crctableProfTwo[crc ^ 48];
						break;
					case(13) :
						crc = crctableProfTwo[crc ^ 64];
						break;
					case(14) :
						crc = crctableProfTwo[crc ^ 80];
						break;
					case(15) :
						crc = crctableProfTwo[crc ^ 96];
						break;
					default :
//						write("error: wrong parameter (%d)",CounterValForCRC_IHC_Plus_Tunnel_Pr2); stop();
						break;
				}
				crc = (crc ^ 0xFF);
				payload[0] = crc;
			}
			else
			{
				//CRC manuel veränderbar
			}

			CH_MPCIHC_Plus_Tunnel_3_4_AR2();
			CH_MPCIHC_Plus_Tunnel_AR2();
		}
	}
	if (strncmp (pduName, "Preview_Header1_FR2", strLen(pduName)+strLen("Preview_Header1_FR2")) == 0)
	{
		if (TxAck == 1)
		{
			if (@sysvar::CH_Nodes::CH_MPCSQC_Preview_Header1_P_AUTO == 0)
			{
				//SQC automatisch ändern
				SQC_VAL_Preview_Header1_Pr2 = (SQC_VAL_Preview_Header1_Pr2 + 1) % 16;
			}
			else
			{
				//SQC manuel veränderbar
			}

		}
		else
		{
			if (@sysvar::CH_Nodes::CH_MPCSQC_Preview_Header1_P_AUTO == 0)
			{
				//SQC automatisch ändern
				//SQC für CRC speichern
				CounterValForCRC_Preview_Header1_Pr2 = SQC_VAL_Preview_Header1_Pr2;
				//SQC in Byte schreiben
				payload[1] = (payload[1] & ~0x0F) |  SQC_VAL_Preview_Header1_Pr2;
			}
			else
			{
				//SQC manuel veränderbar
			}

			if (@sysvar::CH_Nodes::CH_MPCCRC_Preview_Header1_P_AUTO == 0)
			{
				//CRC automatisch berechnen
				crc = 0xFF;
				crc = crctableProfTwo[crc ^ payload[1]];
				crc = crctableProfTwo[crc ^ payload[2]];
				crc = crctableProfTwo[crc ^ payload[3]];
				crc = crctableProfTwo[crc ^ payload[4]];
				crc = crctableProfTwo[crc ^ payload[5]];
				crc = crctableProfTwo[crc ^ payload[6]];
				crc = crctableProfTwo[crc ^ payload[7]];
				crc = crctableProfTwo[crc ^ payload[8]];
				crc = crctableProfTwo[crc ^ payload[9]];
				crc = crctableProfTwo[crc ^ payload[10]];
				crc = crctableProfTwo[crc ^ payload[11]];
				crc = crctableProfTwo[crc ^ payload[12]];
				crc = crctableProfTwo[crc ^ payload[13]];
				crc = crctableProfTwo[crc ^ payload[14]];
				crc = crctableProfTwo[crc ^ payload[15]];
				crc = crctableProfTwo[crc ^ payload[16]];
				crc = crctableProfTwo[crc ^ payload[17]];
				switch (CounterValForCRC_Preview_Header1_Pr2)
				{
					case(0) :
						crc = crctableProfTwo[crc ^ 10];
						break;
					case(1) :
						crc = crctableProfTwo[crc ^ 27];
						break;
					case(2) :
						crc = crctableProfTwo[crc ^ 44];
						break;
					case(3) :
						crc = crctableProfTwo[crc ^ 61];
						break;
					case(4) :
						crc = crctableProfTwo[crc ^ 78];
						break;
					case(5) :
						crc = crctableProfTwo[crc ^ 95];
						break;
					case(6) :
						crc = crctableProfTwo[crc ^ 112];
						break;
					case(7) :
						crc = crctableProfTwo[crc ^ 129];
						break;
					case(8) :
						crc = crctableProfTwo[crc ^ 146];
						break;
					case(9) :
						crc = crctableProfTwo[crc ^ 163];
						break;
					case(10) :
						crc = crctableProfTwo[crc ^ 180];
						break;
					case(11) :
						crc = crctableProfTwo[crc ^ 197];
						break;
					case(12) :
						crc = crctableProfTwo[crc ^ 214];
						break;
					case(13) :
						crc = crctableProfTwo[crc ^ 231];
						break;
					case(14) :
						crc = crctableProfTwo[crc ^ 248];
						break;
					case(15) :
						crc = crctableProfTwo[crc ^ 14];
						break;
					default :
//						write("error: wrong parameter (%d)",CounterValForCRC_Preview_Header1_Pr2); stop();
						break;
				}
				crc = (crc ^ 0xFF);
				payload[0] = crc;
			}
			else
			{
				//CRC manuel veränderbar
			}

		}
	}
	if (strncmp (pduName, "Preview_Header2_FR2", strLen(pduName)+strLen("Preview_Header2_FR2")) == 0)
	{
		if (TxAck == 1)
		{
			if (@sysvar::CH_Nodes::CH_MPCSQC_Preview_Header2_P_AUTO == 0)
			{
				//SQC automatisch ändern
				SQC_VAL_Preview_Header2_Pr2 = (SQC_VAL_Preview_Header2_Pr2 + 1) % 16;
			}
			else
			{
				//SQC manuel veränderbar
			}

		}
		else
		{
			if (@sysvar::CH_Nodes::CH_MPCSQC_Preview_Header2_P_AUTO == 0)
			{
				//SQC automatisch ändern
				//SQC für CRC speichern
				CounterValForCRC_Preview_Header2_Pr2 = SQC_VAL_Preview_Header2_Pr2;
				//SQC in Byte schreiben
				payload[1] = (payload[1] & ~0x0F) |  SQC_VAL_Preview_Header2_Pr2;
			}
			else
			{
				//SQC manuel veränderbar
			}

			if (@sysvar::CH_Nodes::CH_MPCCRC_Preview_Header2_P_AUTO == 0)
			{
				//CRC automatisch berechnen
				crc = 0xFF;
				crc = crctableProfTwo[crc ^ payload[1]];
				crc = crctableProfTwo[crc ^ payload[2]];
				crc = crctableProfTwo[crc ^ payload[3]];
				crc = crctableProfTwo[crc ^ payload[4]];
				crc = crctableProfTwo[crc ^ payload[5]];
				crc = crctableProfTwo[crc ^ payload[6]];
				crc = crctableProfTwo[crc ^ payload[7]];
				crc = crctableProfTwo[crc ^ payload[8]];
				crc = crctableProfTwo[crc ^ payload[9]];
				crc = crctableProfTwo[crc ^ payload[10]];
				crc = crctableProfTwo[crc ^ payload[11]];
				crc = crctableProfTwo[crc ^ payload[12]];
				crc = crctableProfTwo[crc ^ payload[13]];
				crc = crctableProfTwo[crc ^ payload[14]];
				crc = crctableProfTwo[crc ^ payload[15]];
				crc = crctableProfTwo[crc ^ payload[16]];
				crc = crctableProfTwo[crc ^ payload[17]];
				switch (CounterValForCRC_Preview_Header2_Pr2)
				{
					case(0) :
						crc = crctableProfTwo[crc ^ 107];
						break;
					case(1) :
						crc = crctableProfTwo[crc ^ 34];
						break;
					case(2) :
						crc = crctableProfTwo[crc ^ 212];
						break;
					case(3) :
						crc = crctableProfTwo[crc ^ 139];
						break;
					case(4) :
						crc = crctableProfTwo[crc ^ 66];
						break;
					case(5) :
						crc = crctableProfTwo[crc ^ 244];
						break;
					case(6) :
						crc = crctableProfTwo[crc ^ 171];
						break;
					case(7) :
						crc = crctableProfTwo[crc ^ 98];
						break;
					case(8) :
						crc = crctableProfTwo[crc ^ 25];
						break;
					case(9) :
						crc = crctableProfTwo[crc ^ 203];
						break;
					case(10) :
						crc = crctableProfTwo[crc ^ 130];
						break;
					case(11) :
						crc = crctableProfTwo[crc ^ 57];
						break;
					case(12) :
						crc = crctableProfTwo[crc ^ 235];
						break;
					case(13) :
						crc = crctableProfTwo[crc ^ 162];
						break;
					case(14) :
						crc = crctableProfTwo[crc ^ 89];
						break;
					case(15) :
						crc = crctableProfTwo[crc ^ 16];
						break;
					default :
//						write("error: wrong parameter (%d)",CounterValForCRC_Preview_Header2_Pr2); stop();
						break;
				}
				crc = (crc ^ 0xFF);
				payload[0] = crc;
			}
			else
			{
				//CRC manuel veränderbar
			}

		}
	}
	if (strncmp (pduName, "Preview_ProfData1_FR2", strLen(pduName)+strLen("Preview_ProfData1_FR2")) == 0)
	{
		if (TxAck == 1)
		{
			if (@sysvar::CH_Nodes::CH_MPCSQC_Preview_ProfData1_AUTO == 0)
			{
				//SQC automatisch ändern
				SQC_VAL_Preview_ProfData1_Pr2 = (SQC_VAL_Preview_ProfData1_Pr2 + 1) % 16;
			}
			else
			{
				//SQC manuel veränderbar
			}

		}
		else
		{
			if (@sysvar::CH_Nodes::CH_MPCSQC_Preview_ProfData1_AUTO == 0)
			{
				//SQC automatisch ändern
				//SQC für CRC speichern
				CounterValForCRC_Preview_ProfData1_Pr2 = SQC_VAL_Preview_ProfData1_Pr2;
				//SQC in Byte schreiben
				payload[1] = (payload[1] & ~0x0F) |  SQC_VAL_Preview_ProfData1_Pr2;
			}
			else
			{
				//SQC manuel veränderbar
			}

			if (@sysvar::CH_Nodes::CH_MPCCRC_Preview_ProfData1_AUTO == 0)
			{
				//CRC automatisch berechnen
				crc = 0xFF;
				crc = crctableProfTwo[crc ^ payload[1]];
				crc = crctableProfTwo[crc ^ payload[2]];
				crc = crctableProfTwo[crc ^ payload[3]];
				crc = crctableProfTwo[crc ^ payload[4]];
				crc = crctableProfTwo[crc ^ payload[5]];
				crc = crctableProfTwo[crc ^ payload[6]];
				crc = crctableProfTwo[crc ^ payload[7]];
				crc = crctableProfTwo[crc ^ payload[8]];
				crc = crctableProfTwo[crc ^ payload[9]];
				crc = crctableProfTwo[crc ^ payload[10]];
				crc = crctableProfTwo[crc ^ payload[11]];
				crc = crctableProfTwo[crc ^ payload[12]];
				crc = crctableProfTwo[crc ^ payload[13]];
				crc = crctableProfTwo[crc ^ payload[14]];
				crc = crctableProfTwo[crc ^ payload[15]];
				crc = crctableProfTwo[crc ^ payload[16]];
				crc = crctableProfTwo[crc ^ payload[17]];
				switch (CounterValForCRC_Preview_ProfData1_Pr2)
				{
					case(0) :
						crc = crctableProfTwo[crc ^ 121];
						break;
					case(1) :
						crc = crctableProfTwo[crc ^ 238];
						break;
					case(2) :
						crc = crctableProfTwo[crc ^ 104];
						break;
					case(3) :
						crc = crctableProfTwo[crc ^ 221];
						break;
					case(4) :
						crc = crctableProfTwo[crc ^ 87];
						break;
					case(5) :
						crc = crctableProfTwo[crc ^ 204];
						break;
					case(6) :
						crc = crctableProfTwo[crc ^ 70];
						break;
					case(7) :
						crc = crctableProfTwo[crc ^ 187];
						break;
					case(8) :
						crc = crctableProfTwo[crc ^ 53];
						break;
					case(9) :
						crc = crctableProfTwo[crc ^ 170];
						break;
					case(10) :
						crc = crctableProfTwo[crc ^ 36];
						break;
					case(11) :
						crc = crctableProfTwo[crc ^ 153];
						break;
					case(12) :
						crc = crctableProfTwo[crc ^ 19];
						break;
					case(13) :
						crc = crctableProfTwo[crc ^ 136];
						break;
					case(14) :
						crc = crctableProfTwo[crc ^ 253];
						break;
					case(15) :
						crc = crctableProfTwo[crc ^ 119];
						break;
					default :
//						write("error: wrong parameter (%d)",CounterValForCRC_Preview_ProfData1_Pr2); stop();
						break;
				}
				crc = (crc ^ 0xFF);
				payload[0] = crc;
			}
			else
			{
				//CRC manuel veränderbar
			}

		}
	}
	if (strncmp (pduName, "Preview_ProfData2_FR2", strLen(pduName)+strLen("Preview_ProfData2_FR2")) == 0)
	{
		if (TxAck == 1)
		{
			if (@sysvar::CH_Nodes::CH_MPCSQC_Preview_ProfData2_AUTO == 0)
			{
				//SQC automatisch ändern
				SQC_VAL_Preview_ProfData2_Pr2 = (SQC_VAL_Preview_ProfData2_Pr2 + 1) % 16;
			}
			else
			{
				//SQC manuel veränderbar
			}

		}
		else
		{
			if (@sysvar::CH_Nodes::CH_MPCSQC_Preview_ProfData2_AUTO == 0)
			{
				//SQC automatisch ändern
				//SQC für CRC speichern
				CounterValForCRC_Preview_ProfData2_Pr2 = SQC_VAL_Preview_ProfData2_Pr2;
				//SQC in Byte schreiben
				payload[1] = (payload[1] & ~0x0F) |  SQC_VAL_Preview_ProfData2_Pr2;
			}
			else
			{
				//SQC manuel veränderbar
			}

			if (@sysvar::CH_Nodes::CH_MPCCRC_Preview_ProfData2_AUTO == 0)
			{
				//CRC automatisch berechnen
				crc = 0xFF;
				crc = crctableProfTwo[crc ^ payload[1]];
				crc = crctableProfTwo[crc ^ payload[2]];
				crc = crctableProfTwo[crc ^ payload[3]];
				crc = crctableProfTwo[crc ^ payload[4]];
				crc = crctableProfTwo[crc ^ payload[5]];
				crc = crctableProfTwo[crc ^ payload[6]];
				crc = crctableProfTwo[crc ^ payload[7]];
				crc = crctableProfTwo[crc ^ payload[8]];
				crc = crctableProfTwo[crc ^ payload[9]];
				crc = crctableProfTwo[crc ^ payload[10]];
				crc = crctableProfTwo[crc ^ payload[11]];
				crc = crctableProfTwo[crc ^ payload[12]];
				crc = crctableProfTwo[crc ^ payload[13]];
				crc = crctableProfTwo[crc ^ payload[14]];
				crc = crctableProfTwo[crc ^ payload[15]];
				crc = crctableProfTwo[crc ^ payload[16]];
				crc = crctableProfTwo[crc ^ payload[17]];
				switch (CounterValForCRC_Preview_ProfData2_Pr2)
				{
					case(0) :
						crc = crctableProfTwo[crc ^ 74];
						break;
					case(1) :
						crc = crctableProfTwo[crc ^ 94];
						break;
					case(2) :
						crc = crctableProfTwo[crc ^ 114];
						break;
					case(3) :
						crc = crctableProfTwo[crc ^ 134];
						break;
					case(4) :
						crc = crctableProfTwo[crc ^ 154];
						break;
					case(5) :
						crc = crctableProfTwo[crc ^ 174];
						break;
					case(6) :
						crc = crctableProfTwo[crc ^ 194];
						break;
					case(7) :
						crc = crctableProfTwo[crc ^ 214];
						break;
					case(8) :
						crc = crctableProfTwo[crc ^ 234];
						break;
					case(9) :
						crc = crctableProfTwo[crc ^ 3];
						break;
					case(10) :
						crc = crctableProfTwo[crc ^ 23];
						break;
					case(11) :
						crc = crctableProfTwo[crc ^ 43];
						break;
					case(12) :
						crc = crctableProfTwo[crc ^ 63];
						break;
					case(13) :
						crc = crctableProfTwo[crc ^ 83];
						break;
					case(14) :
						crc = crctableProfTwo[crc ^ 103];
						break;
					case(15) :
						crc = crctableProfTwo[crc ^ 123];
						break;
					default :
//						write("error: wrong parameter (%d)",CounterValForCRC_Preview_ProfData2_Pr2); stop();
						break;
				}
				crc = (crc ^ 0xFF);
				payload[0] = crc;
			}
			else
			{
				//CRC manuel veränderbar
			}

		}
	}
	if (strncmp (pduName, "ROE_SMPC", strLen(pduName)+strLen("ROE_SMPC")) == 0)
	{
		if (TxAck == 1)
		{
		}
		else
		{
		}
	}
	if (strncmp (pduName, "SPL_Obj1_Obj2_MPC_AR2", strLen(pduName)+strLen("SPL_Obj1_Obj2_MPC_AR2")) == 0)
	{
		if (TxAck == 1)
		{
			if (@sysvar::CH_Nodes::CH_MPCSQC_SPL_Obj1_Obj2_MPC_AUTO == 0)
			{
				//SQC automatisch ändern
				SQC_VAL_SPL_Obj1_Obj2_MPC_Pr2 = (SQC_VAL_SPL_Obj1_Obj2_MPC_Pr2 + 1) % 16;
			}
			else
			{
				//SQC manuel veränderbar
			}

		}
		else
		{
			if (@sysvar::CH_Nodes::CH_MPCSQC_SPL_Obj1_Obj2_MPC_AUTO == 0)
			{
				//SQC automatisch ändern
				//SQC für CRC speichern
				CounterValForCRC_SPL_Obj1_Obj2_MPC_Pr2 = SQC_VAL_SPL_Obj1_Obj2_MPC_Pr2;
				//SQC in Byte schreiben
				payload[1] = (payload[1] & ~0x0F) |  SQC_VAL_SPL_Obj1_Obj2_MPC_Pr2;
			}
			else
			{
				//SQC manuel veränderbar
			}

			if (@sysvar::CH_Nodes::CH_MPCCRC_SPL_Obj1_Obj2_MPC_AUTO == 0)
			{
				//CRC automatisch berechnen
				crc = 0xFF;
				crc = crctableProfTwo[crc ^ payload[1]];
				crc = crctableProfTwo[crc ^ payload[2]];
				crc = crctableProfTwo[crc ^ payload[3]];
				crc = crctableProfTwo[crc ^ payload[4]];
				crc = crctableProfTwo[crc ^ payload[5]];
				crc = crctableProfTwo[crc ^ payload[6]];
				crc = crctableProfTwo[crc ^ payload[7]];
				switch (CounterValForCRC_SPL_Obj1_Obj2_MPC_Pr2)
				{
					case(0) :
						crc = crctableProfTwo[crc ^ 88];
						break;
					case(1) :
						crc = crctableProfTwo[crc ^ 153];
						break;
					case(2) :
						crc = crctableProfTwo[crc ^ 218];
						break;
					case(3) :
						crc = crctableProfTwo[crc ^ 32];
						break;
					case(4) :
						crc = crctableProfTwo[crc ^ 97];
						break;
					case(5) :
						crc = crctableProfTwo[crc ^ 162];
						break;
					case(6) :
						crc = crctableProfTwo[crc ^ 227];
						break;
					case(7) :
						crc = crctableProfTwo[crc ^ 41];
						break;
					case(8) :
						crc = crctableProfTwo[crc ^ 106];
						break;
					case(9) :
						crc = crctableProfTwo[crc ^ 171];
						break;
					case(10) :
						crc = crctableProfTwo[crc ^ 236];
						break;
					case(11) :
						crc = crctableProfTwo[crc ^ 50];
						break;
					case(12) :
						crc = crctableProfTwo[crc ^ 115];
						break;
					case(13) :
						crc = crctableProfTwo[crc ^ 180];
						break;
					case(14) :
						crc = crctableProfTwo[crc ^ 245];
						break;
					case(15) :
						crc = crctableProfTwo[crc ^ 59];
						break;
					default :
//						write("error: wrong parameter (%d)",CounterValForCRC_SPL_Obj1_Obj2_MPC_Pr2); stop();
						break;
				}
				crc = (crc ^ 0xFF);
				payload[0] = crc;
			}
			else
			{
				//CRC manuel veränderbar
			}

			CH_MPCSPL_Obj1_Obj2_MPC_AR2();
		}
	}
	if (strncmp (pduName, "TSA_Disp_Rq1_Gw_AR2", strLen(pduName)+strLen("TSA_Disp_Rq1_Gw_AR2")) == 0)
	{
		if (TxAck == 1)
		{
		}
		else
		{
		}
	}
	if (strncmp (pduName, "TSA_Disp_Rq2_Gw_AR", strLen(pduName)+strLen("TSA_Disp_Rq2_Gw_AR")) == 0)
	{
		if (TxAck == 1)
		{
		}
		else
		{
			CH_MPCTSA_Disp_Rq2_Gw_AR();
			CH_MPCTSA_Disp_Rq3_Gw_AR();
		}
	}
	if (strncmp (pduName, "TSA_Disp_Rq3_Gw_AR", strLen(pduName)+strLen("TSA_Disp_Rq3_Gw_AR")) == 0)
	{
		if (TxAck == 1)
		{
		}
		else
		{
			CH_MPCTSA_Disp_Rq2_Gw_AR();
			CH_MPCTSA_Disp_Rq3_Gw_AR();
		}
	}
	if (strncmp (pduName, "YMAS_Rq_MPC_Gw_AR2", strLen(pduName)+strLen("YMAS_Rq_MPC_Gw_AR2")) == 0)
	{
		if (TxAck == 1)
		{
			if (@sysvar::CH_Nodes::CH_MPCSQC_YMAS_Rq_MPC_Pr2YM_AUTO == 0)
			{
				//SQC automatisch ändern
				SQC_VAL_YMAS_Rq_MPC_Pr2 = (SQC_VAL_YMAS_Rq_MPC_Pr2 + 1) % 16;
			}
			else
			{
				//SQC manuel veränderbar
			}

		}
		else
		{
			if (@sysvar::CH_Nodes::CH_MPCSQC_YMAS_Rq_MPC_Pr2YM_AUTO == 0)
			{
				//SQC automatisch ändern
				//SQC für CRC speichern
				CounterValForCRC_YMAS_Rq_MPC_Pr2 = SQC_VAL_YMAS_Rq_MPC_Pr2;
				//SQC in Byte schreiben
				payload[1] = (payload[1] & ~0x0F) |  SQC_VAL_YMAS_Rq_MPC_Pr2;
			}
			else
			{
				//SQC manuel veränderbar
			}

			if (@sysvar::CH_Nodes::CH_MPCCRC_YMAS_Rq_MPC_Pr2YM_AUTO == 0)
			{
				//CRC automatisch berechnen
				crc = 0xFF;
				crc = crctableProfTwo[crc ^ payload[1]];
				crc = crctableProfTwo[crc ^ payload[2]];
				crc = crctableProfTwo[crc ^ payload[3]];
				crc = crctableProfTwo[crc ^ payload[4]];
				crc = crctableProfTwo[crc ^ payload[5]];
				crc = crctableProfTwo[crc ^ payload[6]];
				crc = crctableProfTwo[crc ^ payload[7]];
				switch (CounterValForCRC_YMAS_Rq_MPC_Pr2)
				{
					case(0) :
						crc = crctableProfTwo[crc ^ 10];
						break;
					case(1) :
						crc = crctableProfTwo[crc ^ 215];
						break;
					case(2) :
						crc = crctableProfTwo[crc ^ 169];
						break;
					case(3) :
						crc = crctableProfTwo[crc ^ 123];
						break;
					case(4) :
						crc = crctableProfTwo[crc ^ 77];
						break;
					case(5) :
						crc = crctableProfTwo[crc ^ 31];
						break;
					case(6) :
						crc = crctableProfTwo[crc ^ 236];
						break;
					case(7) :
						crc = crctableProfTwo[crc ^ 190];
						break;
					case(8) :
						crc = crctableProfTwo[crc ^ 144];
						break;
					case(9) :
						crc = crctableProfTwo[crc ^ 98];
						break;
					case(10) :
						crc = crctableProfTwo[crc ^ 52];
						break;
					case(11) :
						crc = crctableProfTwo[crc ^ 6];
						break;
					case(12) :
						crc = crctableProfTwo[crc ^ 211];
						break;
					case(13) :
						crc = crctableProfTwo[crc ^ 165];
						break;
					case(14) :
						crc = crctableProfTwo[crc ^ 119];
						break;
					case(15) :
						crc = crctableProfTwo[crc ^ 73];
						break;
					default :
//						write("error: wrong parameter (%d)",CounterValForCRC_YMAS_Rq_MPC_Pr2); stop();
						break;
				}
				crc = (crc ^ 0xFF);
				payload[0] = crc;
			}
			else
			{
				//CRC manuel veränderbar
			}

			CH_MPCYMAS_Rq_MPC_Gw_AR2();
		}
	}
}
/*@@end*/

/*@@caplFunc:StartSim(int):*/
StartSim(int BusAktiv)
{
	result = EnableCRC("", 0); // 1 = on, 0 = off
	result = EnableTGL("", 0); // 1 = on, 0 = off 
	result = EnableSQC("", 0); // 1 = on, 0 = off 
	result = EnableMC("", 0); // 1 = on, 0 = off 
	CRC_Cam_Stat_Pr2 = 0;
	SQC_VAL_Cam_Stat_Pr2 = 0;
	SQC_Cam_Stat_Pr2 = 0;
	switch (@sysvar::CH_Nodes::CH_MPCCamLane_Disp_Warn__UB_A_01)
	{
		case (0):
			enableControl("CamLane_Disp_Warn_Rq_Gw_AR2", "CH_MPCCamLane_Disp_Warn_Rq_G__01", 0); //1: enable; 0: disable
			@sysvar::CH_Nodes::CH_MPCCamLane_Disp_Warn_Rq_G__01 = 1;
			break;
		case (1):
			enableControl("CamLane_Disp_Warn_Rq_Gw_AR2", "CH_MPCCamLane_Disp_Warn_Rq_G__01", 1); //1: enable; 0: disable
			break;
		case (2):
			enableControl("CamLane_Disp_Warn_Rq_Gw_AR2", "CH_MPCCamLane_Disp_Warn_Rq_G__01", 0); //1: enable; 0: disable
			@sysvar::CH_Nodes::CH_MPCCamLane_Disp_Warn_Rq_G__01 = 1;
			break;
		case (3):
			enableControl("CamLane_Disp_Warn_Rq_Gw_AR2", "CH_MPCCamLane_Disp_Warn_Rq_G__01", 0); //1: enable; 0: disable
			@sysvar::CH_Nodes::CH_MPCCamLane_Disp_Warn_Rq_G__01 = 0;
			break;
	}

	CRC_CamLane_Disp_Warn_Rq_Pr2 = 0;
	SQC_VAL_CamLane_Disp_Warn_Rq_Pr2 = 0;
	SQC_CamLane_Disp_Warn_Rq_Pr2 = 0;
	CRC_CamLane_FastAttr1_Pr2 = 0;
	SQC_VAL_CamLane_FastAttr1_Pr2 = 0;
	SQC_CamLane_FastAttr1_Pr2 = 0;
	CRC_CamLane_FastAttr2_Pr2 = 0;
	SQC_VAL_CamLane_FastAttr2_Pr2 = 0;
	SQC_CamLane_FastAttr2_Pr2 = 0;
	switch (@sysvar::CH_Nodes::CH_MPCCamLane_LaneAttr1__UB_A_01)
	{
		case (0):
			enableControl("CamLane_LaneAttr1_Gw_AR2", "CH_MPCCamLane_LaneAttr1_Gw_A__01", 0); //1: enable; 0: disable
			@sysvar::CH_Nodes::CH_MPCCamLane_LaneAttr1_Gw_A__01 = 1;
			break;
		case (1):
			enableControl("CamLane_LaneAttr1_Gw_AR2", "CH_MPCCamLane_LaneAttr1_Gw_A__01", 1); //1: enable; 0: disable
			break;
		case (2):
			enableControl("CamLane_LaneAttr1_Gw_AR2", "CH_MPCCamLane_LaneAttr1_Gw_A__01", 0); //1: enable; 0: disable
			@sysvar::CH_Nodes::CH_MPCCamLane_LaneAttr1_Gw_A__01 = 1;
			break;
		case (3):
			enableControl("CamLane_LaneAttr1_Gw_AR2", "CH_MPCCamLane_LaneAttr1_Gw_A__01", 0); //1: enable; 0: disable
			@sysvar::CH_Nodes::CH_MPCCamLane_LaneAttr1_Gw_A__01 = 0;
			break;
	}

	CRC_CamLane_LaneAttr1_Pr2 = 0;
	SQC_VAL_CamLane_LaneAttr1_Pr2 = 0;
	SQC_CamLane_LaneAttr1_Pr2 = 0;
	switch (@sysvar::CH_Nodes::CH_MPCCamLane_LaneAttr2__UB_A_01)
	{
		case (0):
			enableControl("CamLane_LaneAttr2_Gw_AR2", "CH_MPCCamLane_LaneAttr2_Gw_A__01", 0); //1: enable; 0: disable
			@sysvar::CH_Nodes::CH_MPCCamLane_LaneAttr2_Gw_A__01 = 1;
			break;
		case (1):
			enableControl("CamLane_LaneAttr2_Gw_AR2", "CH_MPCCamLane_LaneAttr2_Gw_A__01", 1); //1: enable; 0: disable
			break;
		case (2):
			enableControl("CamLane_LaneAttr2_Gw_AR2", "CH_MPCCamLane_LaneAttr2_Gw_A__01", 0); //1: enable; 0: disable
			@sysvar::CH_Nodes::CH_MPCCamLane_LaneAttr2_Gw_A__01 = 1;
			break;
		case (3):
			enableControl("CamLane_LaneAttr2_Gw_AR2", "CH_MPCCamLane_LaneAttr2_Gw_A__01", 0); //1: enable; 0: disable
			@sysvar::CH_Nodes::CH_MPCCamLane_LaneAttr2_Gw_A__01 = 0;
			break;
	}

	CRC_CamLane_LaneAttr2_Pr2 = 0;
	SQC_VAL_CamLane_LaneAttr2_Pr2 = 0;
	SQC_CamLane_LaneAttr2_Pr2 = 0;
	switch (@sysvar::CH_Nodes::CH_MPCCamLane_LaneAttr3__UB_A_01)
	{
		case (0):
			enableControl("CamLane_LaneAttr3_Gw_AR2", "CH_MPCCamLane_LaneAttr3_Gw_A__01", 0); //1: enable; 0: disable
			@sysvar::CH_Nodes::CH_MPCCamLane_LaneAttr3_Gw_A__01 = 1;
			break;
		case (1):
			enableControl("CamLane_LaneAttr3_Gw_AR2", "CH_MPCCamLane_LaneAttr3_Gw_A__01", 1); //1: enable; 0: disable
			break;
		case (2):
			enableControl("CamLane_LaneAttr3_Gw_AR2", "CH_MPCCamLane_LaneAttr3_Gw_A__01", 0); //1: enable; 0: disable
			@sysvar::CH_Nodes::CH_MPCCamLane_LaneAttr3_Gw_A__01 = 1;
			break;
		case (3):
			enableControl("CamLane_LaneAttr3_Gw_AR2", "CH_MPCCamLane_LaneAttr3_Gw_A__01", 0); //1: enable; 0: disable
			@sysvar::CH_Nodes::CH_MPCCamLane_LaneAttr3_Gw_A__01 = 0;
			break;
	}

	CRC_CamLane_LaneAttr3_Pr2 = 0;
	SQC_VAL_CamLane_LaneAttr3_Pr2 = 0;
	SQC_CamLane_LaneAttr3_Pr2 = 0;
	CRC_CamLane_LaneAttr4_Pr2 = 0;
	SQC_VAL_CamLane_LaneAttr4_Pr2 = 0;
	SQC_CamLane_LaneAttr4_Pr2 = 0;
	CRC_CamLane_LaneAttr5_Pr2 = 0;
	SQC_VAL_CamLane_LaneAttr5_Pr2 = 0;
	SQC_CamLane_LaneAttr5_Pr2 = 0;
	switch (@sysvar::CH_Nodes::CH_MPCCamLane_LaneAttr6__UB_A_01)
	{
		case (0):
			enableControl("CamLane_LaneAttr6_Gw_AR2", "CH_MPCCamLane_LaneAttr6_Gw_A__01", 0); //1: enable; 0: disable
			@sysvar::CH_Nodes::CH_MPCCamLane_LaneAttr6_Gw_A__01 = 1;
			break;
		case (1):
			enableControl("CamLane_LaneAttr6_Gw_AR2", "CH_MPCCamLane_LaneAttr6_Gw_A__01", 1); //1: enable; 0: disable
			break;
		case (2):
			enableControl("CamLane_LaneAttr6_Gw_AR2", "CH_MPCCamLane_LaneAttr6_Gw_A__01", 0); //1: enable; 0: disable
			@sysvar::CH_Nodes::CH_MPCCamLane_LaneAttr6_Gw_A__01 = 1;
			break;
		case (3):
			enableControl("CamLane_LaneAttr6_Gw_AR2", "CH_MPCCamLane_LaneAttr6_Gw_A__01", 0); //1: enable; 0: disable
			@sysvar::CH_Nodes::CH_MPCCamLane_LaneAttr6_Gw_A__01 = 0;
			break;
	}

	CRC_CamLane_LaneAttr6_Pr2 = 0;
	SQC_VAL_CamLane_LaneAttr6_Pr2 = 0;
	SQC_CamLane_LaneAttr6_Pr2 = 0;
	switch (@sysvar::CH_Nodes::CH_MPCCamLane_LaneAttr7__UB_A_01)
	{
		case (0):
			enableControl("CamLane_LaneAttr7_Gw_AR2", "CH_MPCCamLane_LaneAttr7_Gw_A__01", 0); //1: enable; 0: disable
			@sysvar::CH_Nodes::CH_MPCCamLane_LaneAttr7_Gw_A__01 = 1;
			break;
		case (1):
			enableControl("CamLane_LaneAttr7_Gw_AR2", "CH_MPCCamLane_LaneAttr7_Gw_A__01", 1); //1: enable; 0: disable
			break;
		case (2):
			enableControl("CamLane_LaneAttr7_Gw_AR2", "CH_MPCCamLane_LaneAttr7_Gw_A__01", 0); //1: enable; 0: disable
			@sysvar::CH_Nodes::CH_MPCCamLane_LaneAttr7_Gw_A__01 = 1;
			break;
		case (3):
			enableControl("CamLane_LaneAttr7_Gw_AR2", "CH_MPCCamLane_LaneAttr7_Gw_A__01", 0); //1: enable; 0: disable
			@sysvar::CH_Nodes::CH_MPCCamLane_LaneAttr7_Gw_A__01 = 0;
			break;
	}

	CRC_CamLane_LaneAttr7_Pr2 = 0;
	SQC_VAL_CamLane_LaneAttr7_Pr2 = 0;
	SQC_CamLane_LaneAttr7_Pr2 = 0;
	CRC_CamObj_A_Mtn_Pr2 = 0;
	SQC_VAL_CamObj_A_Mtn_Pr2 = 0;
	SQC_CamObj_A_Mtn_Pr2 = 0;
	CRC_CamObj_A_Posn_Pr2 = 0;
	SQC_VAL_CamObj_A_Posn_Pr2 = 0;
	SQC_CamObj_A_Posn_Pr2 = 0;
	CRC_CamObj_B_Mtn_Pr2 = 0;
	SQC_VAL_CamObj_B_Mtn_Pr2 = 0;
	SQC_CamObj_B_Mtn_Pr2 = 0;
	CRC_CamObj_B_Posn_Pr2 = 0;
	SQC_VAL_CamObj_B_Posn_Pr2 = 0;
	SQC_CamObj_B_Posn_Pr2 = 0;
	CRC_CamObj_C_Mtn_Pr2 = 0;
	SQC_VAL_CamObj_C_Mtn_Pr2 = 0;
	SQC_CamObj_C_Mtn_Pr2 = 0;
	CRC_CamObj_C_Posn_Pr2 = 0;
	SQC_VAL_CamObj_C_Posn_Pr2 = 0;
	SQC_CamObj_C_Posn_Pr2 = 0;
	switch (@sysvar::CH_Nodes::CH_MPCIHC_Lgt_Stat_MPC_G_UB_A_01)
	{
		case (0):
			enableControl("IHC_Lgt_Stat_MPC_Gw_AR2", "CH_MPCIHC_Lgt_Stat_MPC_Gw_AR__01", 0); //1: enable; 0: disable
			@sysvar::CH_Nodes::CH_MPCIHC_Lgt_Stat_MPC_Gw_AR__01 = 1;
			break;
		case (1):
			enableControl("IHC_Lgt_Stat_MPC_Gw_AR2", "CH_MPCIHC_Lgt_Stat_MPC_Gw_AR__01", 1); //1: enable; 0: disable
			break;
		case (2):
			enableControl("IHC_Lgt_Stat_MPC_Gw_AR2", "CH_MPCIHC_Lgt_Stat_MPC_Gw_AR__01", 0); //1: enable; 0: disable
			@sysvar::CH_Nodes::CH_MPCIHC_Lgt_Stat_MPC_Gw_AR__01 = 1;
			break;
		case (3):
			enableControl("IHC_Lgt_Stat_MPC_Gw_AR2", "CH_MPCIHC_Lgt_Stat_MPC_Gw_AR__01", 0); //1: enable; 0: disable
			@sysvar::CH_Nodes::CH_MPCIHC_Lgt_Stat_MPC_Gw_AR__01 = 0;
			break;
	}

	CRC_IHC_Lgt_Stat_MPC_Pr2 = 0;
	SQC_VAL_IHC_Lgt_Stat_MPC_Pr2 = 0;
	SQC_IHC_Lgt_Stat_MPC_Pr2 = 0;
	switch (@sysvar::CH_Nodes::CH_MPCIHC_Plus_HL_Stat_A_UB_A_01)
	{
		case (0):
			enableControl("IHC_Plus_HL_Stat_AR2", "CH_MPCIHC_Plus_HL_Stat_AR2_UB_01", 0); //1: enable; 0: disable
			@sysvar::CH_Nodes::CH_MPCIHC_Plus_HL_Stat_AR2_UB_01 = 1;
			break;
		case (1):
			enableControl("IHC_Plus_HL_Stat_AR2", "CH_MPCIHC_Plus_HL_Stat_AR2_UB_01", 1); //1: enable; 0: disable
			break;
		case (2):
			enableControl("IHC_Plus_HL_Stat_AR2", "CH_MPCIHC_Plus_HL_Stat_AR2_UB_01", 0); //1: enable; 0: disable
			@sysvar::CH_Nodes::CH_MPCIHC_Plus_HL_Stat_AR2_UB_01 = 1;
			break;
		case (3):
			enableControl("IHC_Plus_HL_Stat_AR2", "CH_MPCIHC_Plus_HL_Stat_AR2_UB_01", 0); //1: enable; 0: disable
			@sysvar::CH_Nodes::CH_MPCIHC_Plus_HL_Stat_AR2_UB_01 = 0;
			break;
	}

	CRC_IHC_Plus_HL_Stat_Pr2 = 0;
	SQC_VAL_IHC_Plus_HL_Stat_Pr2 = 0;
	SQC_IHC_Plus_HL_Stat_Pr2 = 0;
	switch (@sysvar::CH_Nodes::CH_MPCIHC_Plus_Tunnel_3__UB_AUTO)
	{
		case (0):
			enableControl("IHC_Plus_Tunnel_3_4_AR2", "CH_MPCIHC_Plus_Tunnel_3_4_AR_UB_", 0); //1: enable; 0: disable
			@sysvar::CH_Nodes::CH_MPCIHC_Plus_Tunnel_3_4_AR_UB_ = 1;
			break;
		case (1):
			enableControl("IHC_Plus_Tunnel_3_4_AR2", "CH_MPCIHC_Plus_Tunnel_3_4_AR_UB_", 1); //1: enable; 0: disable
			break;
		case (2):
			enableControl("IHC_Plus_Tunnel_3_4_AR2", "CH_MPCIHC_Plus_Tunnel_3_4_AR_UB_", 0); //1: enable; 0: disable
			@sysvar::CH_Nodes::CH_MPCIHC_Plus_Tunnel_3_4_AR_UB_ = 1;
			break;
		case (3):
			enableControl("IHC_Plus_Tunnel_3_4_AR2", "CH_MPCIHC_Plus_Tunnel_3_4_AR_UB_", 0); //1: enable; 0: disable
			@sysvar::CH_Nodes::CH_MPCIHC_Plus_Tunnel_3_4_AR_UB_ = 0;
			break;
	}

	CRC_IHC_Plus_Tunnel_3_4_Pr2 = 0;
	SQC_VAL_IHC_Plus_Tunnel_3_4_Pr2 = 0;
	SQC_IHC_Plus_Tunnel_3_4_Pr2 = 0;
	switch (@sysvar::CH_Nodes::CH_MPCIHC_Plus_Tunnel_AR_UB_A_01)
	{
		case (0):
			enableControl("IHC_Plus_Tunnel_AR2", "CH_MPCIHC_Plus_Tunnel_AR2_UB__01", 0); //1: enable; 0: disable
			@sysvar::CH_Nodes::CH_MPCIHC_Plus_Tunnel_AR2_UB__01 = 1;
			break;
		case (1):
			enableControl("IHC_Plus_Tunnel_AR2", "CH_MPCIHC_Plus_Tunnel_AR2_UB__01", 1); //1: enable; 0: disable
			break;
		case (2):
			enableControl("IHC_Plus_Tunnel_AR2", "CH_MPCIHC_Plus_Tunnel_AR2_UB__01", 0); //1: enable; 0: disable
			@sysvar::CH_Nodes::CH_MPCIHC_Plus_Tunnel_AR2_UB__01 = 1;
			break;
		case (3):
			enableControl("IHC_Plus_Tunnel_AR2", "CH_MPCIHC_Plus_Tunnel_AR2_UB__01", 0); //1: enable; 0: disable
			@sysvar::CH_Nodes::CH_MPCIHC_Plus_Tunnel_AR2_UB__01 = 0;
			break;
	}

	CRC_IHC_Plus_Tunnel_Pr2 = 0;
	SQC_VAL_IHC_Plus_Tunnel_Pr2 = 0;
	SQC_IHC_Plus_Tunnel_Pr2 = 0;
	CRC_Preview_Header1_Pr2 = 0;
	SQC_VAL_Preview_Header1_Pr2 = 0;
	SQC_Preview_Header1_Pr2 = 0;
	CRC_Preview_Header2_Pr2 = 0;
	SQC_VAL_Preview_Header2_Pr2 = 0;
	SQC_Preview_Header2_Pr2 = 0;
	CRC_Preview_ProfData1_Pr2 = 0;
	SQC_VAL_Preview_ProfData1_Pr2 = 0;
	SQC_Preview_ProfData1_Pr2 = 0;
	CRC_Preview_ProfData2_Pr2 = 0;
	SQC_VAL_Preview_ProfData2_Pr2 = 0;
	SQC_Preview_ProfData2_Pr2 = 0;
	switch (@sysvar::CH_Nodes::CH_MPCSPL_Obj1_Obj2_MPC__UB_A_01)
	{
		case (0):
			enableControl("SPL_Obj1_Obj2_MPC_AR2", "CH_MPCSPL_Obj1_Obj2_MPC_AR2_U_01", 0); //1: enable; 0: disable
			@sysvar::CH_Nodes::CH_MPCSPL_Obj1_Obj2_MPC_AR2_U_01 = 1;
			break;
		case (1):
			enableControl("SPL_Obj1_Obj2_MPC_AR2", "CH_MPCSPL_Obj1_Obj2_MPC_AR2_U_01", 1); //1: enable; 0: disable
			break;
		case (2):
			enableControl("SPL_Obj1_Obj2_MPC_AR2", "CH_MPCSPL_Obj1_Obj2_MPC_AR2_U_01", 0); //1: enable; 0: disable
			@sysvar::CH_Nodes::CH_MPCSPL_Obj1_Obj2_MPC_AR2_U_01 = 1;
			break;
		case (3):
			enableControl("SPL_Obj1_Obj2_MPC_AR2", "CH_MPCSPL_Obj1_Obj2_MPC_AR2_U_01", 0); //1: enable; 0: disable
			@sysvar::CH_Nodes::CH_MPCSPL_Obj1_Obj2_MPC_AR2_U_01 = 0;
			break;
	}

	CRC_SPL_Obj1_Obj2_MPC_Pr2 = 0;
	SQC_VAL_SPL_Obj1_Obj2_MPC_Pr2 = 0;
	SQC_SPL_Obj1_Obj2_MPC_Pr2 = 0;
	switch (@sysvar::CH_Nodes::CH_MPCTSA_Disp_Rq2_Gw_AR_UB_A_01)
	{
		case (0):
			enableControl("TSA_Disp_Rq2_Gw_AR", "CH_MPCTSA_Disp_Rq2_Gw_AR_UB__01", 0); //1: enable; 0: disable
			@sysvar::CH_Nodes::CH_MPCTSA_Disp_Rq2_Gw_AR_UB__01 = 1;
			break;
		case (1):
			enableControl("TSA_Disp_Rq2_Gw_AR", "CH_MPCTSA_Disp_Rq2_Gw_AR_UB__01", 1); //1: enable; 0: disable
			break;
		case (2):
			enableControl("TSA_Disp_Rq2_Gw_AR", "CH_MPCTSA_Disp_Rq2_Gw_AR_UB__01", 0); //1: enable; 0: disable
			@sysvar::CH_Nodes::CH_MPCTSA_Disp_Rq2_Gw_AR_UB__01 = 1;
			break;
		case (3):
			enableControl("TSA_Disp_Rq2_Gw_AR", "CH_MPCTSA_Disp_Rq2_Gw_AR_UB__01", 0); //1: enable; 0: disable
			@sysvar::CH_Nodes::CH_MPCTSA_Disp_Rq2_Gw_AR_UB__01 = 0;
			break;
	}

	switch (@sysvar::CH_Nodes::CH_MPCTSA_Disp_Rq3_Gw_AR_UB_A_01)
	{
		case (0):
			enableControl("TSA_Disp_Rq3_Gw_AR", "CH_MPCTSA_Disp_Rq3_Gw_AR_UB__01", 0); //1: enable; 0: disable
			@sysvar::CH_Nodes::CH_MPCTSA_Disp_Rq3_Gw_AR_UB__01 = 1;
			break;
		case (1):
			enableControl("TSA_Disp_Rq3_Gw_AR", "CH_MPCTSA_Disp_Rq3_Gw_AR_UB__01", 1); //1: enable; 0: disable
			break;
		case (2):
			enableControl("TSA_Disp_Rq3_Gw_AR", "CH_MPCTSA_Disp_Rq3_Gw_AR_UB__01", 0); //1: enable; 0: disable
			@sysvar::CH_Nodes::CH_MPCTSA_Disp_Rq3_Gw_AR_UB__01 = 1;
			break;
		case (3):
			enableControl("TSA_Disp_Rq3_Gw_AR", "CH_MPCTSA_Disp_Rq3_Gw_AR_UB__01", 0); //1: enable; 0: disable
			@sysvar::CH_Nodes::CH_MPCTSA_Disp_Rq3_Gw_AR_UB__01 = 0;
			break;
	}

	switch (@sysvar::CH_Nodes::CH_MPCYMAS_Rq_MPC_Gw_AR2_UB_A_01)
	{
		case (0):
			enableControl("YMAS_Rq_MPC_Gw_AR2", "CH_MPCYMAS_Rq_MPC_Gw_AR2_UB__01", 0); //1: enable; 0: disable
			@sysvar::CH_Nodes::CH_MPCYMAS_Rq_MPC_Gw_AR2_UB__01 = 1;
			break;
		case (1):
			enableControl("YMAS_Rq_MPC_Gw_AR2", "CH_MPCYMAS_Rq_MPC_Gw_AR2_UB__01", 1); //1: enable; 0: disable
			break;
		case (2):
			enableControl("YMAS_Rq_MPC_Gw_AR2", "CH_MPCYMAS_Rq_MPC_Gw_AR2_UB__01", 0); //1: enable; 0: disable
			@sysvar::CH_Nodes::CH_MPCYMAS_Rq_MPC_Gw_AR2_UB__01 = 1;
			break;
		case (3):
			enableControl("YMAS_Rq_MPC_Gw_AR2", "CH_MPCYMAS_Rq_MPC_Gw_AR2_UB__01", 0); //1: enable; 0: disable
			@sysvar::CH_Nodes::CH_MPCYMAS_Rq_MPC_Gw_AR2_UB__01 = 0;
			break;
	}

	CRC_YMAS_Rq_MPC_Pr2 = 0;
	SQC_VAL_YMAS_Rq_MPC_Pr2 = 0;
	SQC_YMAS_Rq_MPC_Pr2 = 0;
}
/*@@end*/

/*@@caplFunc:StopSim():*/
StopSim()
{
}
/*@@end*/

/*@@frPDU:MsgChannel1.CHASSIS::Cam_Stat_AR2:*/
on frPDU MsgChannel1.CHASSIS::Cam_Stat_AR2
{
}
/*@@end*/

/*@@frPDU:MsgChannel1.CHASSIS::CamLane_Disp_Warn_Rq_Gw_AR2:*/
on frPDU MsgChannel1.CHASSIS::CamLane_Disp_Warn_Rq_Gw_AR2
{
}
/*@@end*/

/*@@frPDU:MsgChannel1.CHASSIS::CamLane_FastAttr1_FR2:*/
on frPDU MsgChannel1.CHASSIS::CamLane_FastAttr1_FR2
{
}
/*@@end*/

/*@@frPDU:MsgChannel1.CHASSIS::CamLane_FastAttr2_FR2:*/
on frPDU MsgChannel1.CHASSIS::CamLane_FastAttr2_FR2
{
}
/*@@end*/

/*@@frPDU:MsgChannel1.CHASSIS::CamLane_LaneAttr1_Gw_AR2:*/
on frPDU MsgChannel1.CHASSIS::CamLane_LaneAttr1_Gw_AR2
{
}
/*@@end*/

/*@@frPDU:MsgChannel1.CHASSIS::CamLane_LaneAttr2_Gw_AR2:*/
on frPDU MsgChannel1.CHASSIS::CamLane_LaneAttr2_Gw_AR2
{
}
/*@@end*/

/*@@frPDU:MsgChannel1.CHASSIS::CamLane_LaneAttr3_Gw_AR2:*/
on frPDU MsgChannel1.CHASSIS::CamLane_LaneAttr3_Gw_AR2
{
}
/*@@end*/

/*@@frPDU:MsgChannel1.CHASSIS::CamLane_LaneAttr4_FR2:*/
on frPDU MsgChannel1.CHASSIS::CamLane_LaneAttr4_FR2
{
}
/*@@end*/

/*@@frPDU:MsgChannel1.CHASSIS::CamLane_LaneAttr5_FR2:*/
on frPDU MsgChannel1.CHASSIS::CamLane_LaneAttr5_FR2
{
}
/*@@end*/

/*@@frPDU:MsgChannel1.CHASSIS::CamLane_LaneAttr6_Gw_AR2:*/
on frPDU MsgChannel1.CHASSIS::CamLane_LaneAttr6_Gw_AR2
{
}
/*@@end*/

/*@@frPDU:MsgChannel1.CHASSIS::CamLane_LaneAttr7_Gw_AR2:*/
on frPDU MsgChannel1.CHASSIS::CamLane_LaneAttr7_Gw_AR2
{
}
/*@@end*/

/*@@frPDU:MsgChannel1.CHASSIS::CamObj_A_Mtn_FR2:*/
on frPDU MsgChannel1.CHASSIS::CamObj_A_Mtn_FR2
{
}
/*@@end*/

/*@@frPDU:MsgChannel1.CHASSIS::CamObj_A_Posn_FR2:*/
on frPDU MsgChannel1.CHASSIS::CamObj_A_Posn_FR2
{
}
/*@@end*/

/*@@frPDU:MsgChannel1.CHASSIS::CamObj_B_Mtn_FR2:*/
on frPDU MsgChannel1.CHASSIS::CamObj_B_Mtn_FR2
{
}
/*@@end*/

/*@@frPDU:MsgChannel1.CHASSIS::CamObj_B_Posn_FR2:*/
on frPDU MsgChannel1.CHASSIS::CamObj_B_Posn_FR2
{
}
/*@@end*/

/*@@frPDU:MsgChannel1.CHASSIS::CamObj_C_Mtn_FR2:*/
on frPDU MsgChannel1.CHASSIS::CamObj_C_Mtn_FR2
{
}
/*@@end*/

/*@@frPDU:MsgChannel1.CHASSIS::CamObj_C_Posn_FR2:*/
on frPDU MsgChannel1.CHASSIS::CamObj_C_Posn_FR2
{
}
/*@@end*/

/*@@frPDU:MsgChannel1.CHASSIS::IHC_Lgt_Stat_MPC_Gw_AR2:*/
on frPDU MsgChannel1.CHASSIS::IHC_Lgt_Stat_MPC_Gw_AR2
{
}
/*@@end*/

/*@@frPDU:MsgChannel1.CHASSIS::IHC_Plus_HL_Stat_AR2:*/
on frPDU MsgChannel1.CHASSIS::IHC_Plus_HL_Stat_AR2
{
}
/*@@end*/

/*@@frPDU:MsgChannel1.CHASSIS::IHC_Plus_Tunnel_3_4_AR2:*/
on frPDU MsgChannel1.CHASSIS::IHC_Plus_Tunnel_3_4_AR2
{
}
/*@@end*/

/*@@frPDU:MsgChannel1.CHASSIS::IHC_Plus_Tunnel_AR2:*/
on frPDU MsgChannel1.CHASSIS::IHC_Plus_Tunnel_AR2
{
}
/*@@end*/

/*@@frPDU:MsgChannel1.CHASSIS::Preview_Header1_FR2:*/
on frPDU MsgChannel1.CHASSIS::Preview_Header1_FR2
{
}
/*@@end*/

/*@@frPDU:MsgChannel1.CHASSIS::Preview_Header2_FR2:*/
on frPDU MsgChannel1.CHASSIS::Preview_Header2_FR2
{
}
/*@@end*/

/*@@frPDU:MsgChannel1.CHASSIS::Preview_ProfData1_FR2:*/
on frPDU MsgChannel1.CHASSIS::Preview_ProfData1_FR2
{
}
/*@@end*/

/*@@frPDU:MsgChannel1.CHASSIS::Preview_ProfData2_FR2:*/
on frPDU MsgChannel1.CHASSIS::Preview_ProfData2_FR2
{
}
/*@@end*/

/*@@frPDU:MsgChannel1.CHASSIS::ROE_SMPC:*/
on frPDU MsgChannel1.CHASSIS::ROE_SMPC
{
}
/*@@end*/

/*@@frPDU:MsgChannel1.CHASSIS::SPL_Obj1_Obj2_MPC_AR2:*/
on frPDU MsgChannel1.CHASSIS::SPL_Obj1_Obj2_MPC_AR2
{
}
/*@@end*/

/*@@frPDU:MsgChannel1.CHASSIS::TSA_Disp_Rq1_Gw_AR2:*/
on frPDU MsgChannel1.CHASSIS::TSA_Disp_Rq1_Gw_AR2
{
}
/*@@end*/

/*@@frPDU:MsgChannel1.CHASSIS::TSA_Disp_Rq2_Gw_AR:*/
on frPDU MsgChannel1.CHASSIS::TSA_Disp_Rq2_Gw_AR
{
}
/*@@end*/

/*@@frPDU:MsgChannel1.CHASSIS::TSA_Disp_Rq3_Gw_AR:*/
on frPDU MsgChannel1.CHASSIS::TSA_Disp_Rq3_Gw_AR
{
}
/*@@end*/

/*@@frPDU:MsgChannel1.CHASSIS::YMAS_Rq_MPC_Gw_AR2:*/
on frPDU MsgChannel1.CHASSIS::YMAS_Rq_MPC_Gw_AR2
{
}
/*@@end*/

