/*@@var:*/
/*
|==========================================================================================|
|                                                                                          |
|                                                                                          |
|                                         COPYRIGHT                                        |
|                                                                                          |
|                   Copyright (c) by Daimler AG Abt. RD/EEV 2015                           |
|                                                                                          |
|                                                                                          |
|==========================================================================================|
|                                                                                          |
|                                   CAPL AUTHOR IDENTITY                                   |
|                                   --------------------                                   |
|                                                                                          |
| Initials   | Name                 | Company                                              |
| -----------+----------------------+----------------------------------------------------- |
| BH         | Björn Haßelkus       | Firma TZM (EXTERN im Auftrag der Daimler AG)         |
| RS         | Rainer Schulte       | Firma TZM (EXTERN im Auftrag der Daimler AG)         |
|            |                      |                                                      |
|                                                                                          |
|==========================================================================================|
|                                                                                          |
|                                     REVISION HISTORY                                     |
|                                     ----------------                                     |
|                                                                                          |
| Date       | Ver   | Author       | Description                                          |
| -----------+-------+--------------+----------------------------------------------------- |
| 27.04.15   | 1.0   | RS           | creation                                             |
|            |       |              |                                                      |
|                                                                                          |
|------------------------------------------------------------------------------------------|
*/


variables
{
	char buffer[1024];
	int intval;
	float floatval;
	char strval[512];
}
/*@@end*/

/*@@caplFunc:saveVars_1(dword):*/
void saveVars_1(dword hFile)
{
	snprintf(buffer, elcount(buffer), "   0.000000    SV: 2 0 0 ::CH_Nodes::CH__NMActive_AWD_TCASE = %X\n", @sysvar::CH_Nodes::CH__NMActive_AWD_TCASE);
	filePutString (buffer, elcount(buffer), hFile);
	snprintf(buffer, elcount(buffer), "   0.000000    SV: 2 0 0 ::CH_Nodes::CH__NMAwake_AWD_TCASE = %X\n", @sysvar::CH_Nodes::CH__NMAwake_AWD_TCASE);
	filePutString (buffer, elcount(buffer), hFile);
	intval = getSignal(CHASSIS::AWD_TCASE_Disp_Rq_AR2::AWD_Msg1_Disp_Rq);
	snprintf(buffer, elcount(buffer), "   0.000000 F1 AWD_TCASE::AWD_TCASE_Disp_Rq_AR2::AWD_Msg1_Disp_Rq = %d\n", intval);
	filePutString (buffer, elcount(buffer), hFile);
	intval = getSignal(CHASSIS::AWD_TCASE_Disp_Rq_AR2::AWD_Msg2_Disp_Rq);
	snprintf(buffer, elcount(buffer), "   0.000000 F1 AWD_TCASE::AWD_TCASE_Disp_Rq_AR2::AWD_Msg2_Disp_Rq = %d\n", intval);
	filePutString (buffer, elcount(buffer), hFile);
	intval = getSignal(CHASSIS::AWD_TCASE_Disp_Rq_AR2::TCASE_GrLo_IndLmp_On_Rq);
	snprintf(buffer, elcount(buffer), "   0.000000 F1 AWD_TCASE::AWD_TCASE_Disp_Rq_AR2::TCASE_GrLo_IndLmp_On_Rq = %d\n", intval);
	filePutString (buffer, elcount(buffer), hFile);
	intval = getSignal(CHASSIS::AWD_TCASE_Disp_Rq_AR2::DPC_Disp_TrgRq_TCASE);
	snprintf(buffer, elcount(buffer), "   0.000000 F1 AWD_TCASE::AWD_TCASE_Disp_Rq_AR2::DPC_Disp_TrgRq_TCASE = %d\n", intval);
	filePutString (buffer, elcount(buffer), hFile);
	intval = getSignal(CHASSIS::AWD_TCASE_Disp_Rq_AR2::TCASE_Msg1_Disp_Rq);
	snprintf(buffer, elcount(buffer), "   0.000000 F1 AWD_TCASE::AWD_TCASE_Disp_Rq_AR2::TCASE_Msg1_Disp_Rq = %d\n", intval);
	filePutString (buffer, elcount(buffer), hFile);
	intval = getSignal(CHASSIS::AWD_TCASE_Disp_Rq_AR2::TCASE_Msg2_Disp_Rq);
	snprintf(buffer, elcount(buffer), "   0.000000 F1 AWD_TCASE::AWD_TCASE_Disp_Rq_AR2::TCASE_Msg2_Disp_Rq = %d\n", intval);
	filePutString (buffer, elcount(buffer), hFile);
	intval = getSignal(CHASSIS::AWD_TCASE_Disp_Rq_AR2::TCASE_Msg3_Disp_Rq);
	snprintf(buffer, elcount(buffer), "   0.000000 F1 AWD_TCASE::AWD_TCASE_Disp_Rq_AR2::TCASE_Msg3_Disp_Rq = %d\n", intval);
	filePutString (buffer, elcount(buffer), hFile);
	intval = getSignal(CHASSIS::AWD_TCASE_Disp_Rq_AR2::TCASE_Msg4_Disp_Rq);
	snprintf(buffer, elcount(buffer), "   0.000000 F1 AWD_TCASE::AWD_TCASE_Disp_Rq_AR2::TCASE_Msg4_Disp_Rq = %d\n", intval);
	filePutString (buffer, elcount(buffer), hFile);
	intval = getSignal(CHASSIS::AWD_TCASE_Disp_Rq_AR2::TCASE_Msg5_Disp_Rq);
	snprintf(buffer, elcount(buffer), "   0.000000 F1 AWD_TCASE::AWD_TCASE_Disp_Rq_AR2::TCASE_Msg5_Disp_Rq = %d\n", intval);
	filePutString (buffer, elcount(buffer), hFile);
	intval = getSignal(CHASSIS::AWD_TCASE_Disp_Rq_AR2::TCASE_Msg6_Disp_Rq);
	snprintf(buffer, elcount(buffer), "   0.000000 F1 AWD_TCASE::AWD_TCASE_Disp_Rq_AR2::TCASE_Msg6_Disp_Rq = %d\n", intval);
	filePutString (buffer, elcount(buffer), hFile);
	intval = getSignal(CHASSIS::AWD_TCASE_Disp_Rq_AR2::TCASE_Msg7_Disp_Rq);
	snprintf(buffer, elcount(buffer), "   0.000000 F1 AWD_TCASE::AWD_TCASE_Disp_Rq_AR2::TCASE_Msg7_Disp_Rq = %d\n", intval);
	filePutString (buffer, elcount(buffer), hFile);
	intval = getSignal(CHASSIS::AWD_TCASE_Disp_Rq_AR2::TCASE_Msg8_Disp_Rq);
	snprintf(buffer, elcount(buffer), "   0.000000 F1 AWD_TCASE::AWD_TCASE_Disp_Rq_AR2::TCASE_Msg8_Disp_Rq = %d\n", intval);
	filePutString (buffer, elcount(buffer), hFile);
	intval = getSignal(CHASSIS::AWD_TCASE_Disp_Rq_AR2::TCASE_Msg9_Disp_Rq);
	snprintf(buffer, elcount(buffer), "   0.000000 F1 AWD_TCASE::AWD_TCASE_Disp_Rq_AR2::TCASE_Msg9_Disp_Rq = %d\n", intval);
	filePutString (buffer, elcount(buffer), hFile);
	intval = getSignal(CHASSIS::AWD_TCASE_Disp_Rq_AR2::TCASE_Msg10_Disp_Rq);
	snprintf(buffer, elcount(buffer), "   0.000000 F1 AWD_TCASE::AWD_TCASE_Disp_Rq_AR2::TCASE_Msg10_Disp_Rq = %d\n", intval);
	filePutString (buffer, elcount(buffer), hFile);
	intval = getSignal(CHASSIS::AWD_TCASE_Disp_Rq_AR2::TCASE_Msg11_Disp_Rq);
	snprintf(buffer, elcount(buffer), "   0.000000 F1 AWD_TCASE::AWD_TCASE_Disp_Rq_AR2::TCASE_Msg11_Disp_Rq = %d\n", intval);
	filePutString (buffer, elcount(buffer), hFile);
	intval = getSignal(CHASSIS::AWD_TCASE_Disp_Rq_AR2::TCASE_Msg12_Disp_Rq);
	snprintf(buffer, elcount(buffer), "   0.000000 F1 AWD_TCASE::AWD_TCASE_Disp_Rq_AR2::TCASE_Msg12_Disp_Rq = %d\n", intval);
	filePutString (buffer, elcount(buffer), hFile);
	intval = getSignal(CHASSIS::AWD_TCASE_Disp_Rq_AR2::TCASE_Msg13_Disp_Rq);
	snprintf(buffer, elcount(buffer), "   0.000000 F1 AWD_TCASE::AWD_TCASE_Disp_Rq_AR2::TCASE_Msg13_Disp_Rq = %d\n", intval);
	filePutString (buffer, elcount(buffer), hFile);
	intval = getSignal(CHASSIS::AWD_TCASE_Disp_Rq_AR2::DiffLk_Msg1_Disp_Rq);
	snprintf(buffer, elcount(buffer), "   0.000000 F1 AWD_TCASE::AWD_TCASE_Disp_Rq_AR2::DiffLk_Msg1_Disp_Rq = %d\n", intval);
	filePutString (buffer, elcount(buffer), hFile);
	intval = getSignal(CHASSIS::AWD_TCASE_Disp_Rq_AR2::DiffLk_Msg2_Disp_Rq);
	snprintf(buffer, elcount(buffer), "   0.000000 F1 AWD_TCASE::AWD_TCASE_Disp_Rq_AR2::DiffLk_Msg2_Disp_Rq = %d\n", intval);
	filePutString (buffer, elcount(buffer), hFile);
	intval = getSignal(CHASSIS::AWD_TCASE_Disp_Rq_AR2::DiffLk_Msg3_Disp_Rq);
	snprintf(buffer, elcount(buffer), "   0.000000 F1 AWD_TCASE::AWD_TCASE_Disp_Rq_AR2::DiffLk_Msg3_Disp_Rq = %d\n", intval);
	filePutString (buffer, elcount(buffer), hFile);
	intval = getSignal(CHASSIS::AWD_TCASE_Disp_Rq_AR2::DiffLk_Msg4_Disp_Rq);
	snprintf(buffer, elcount(buffer), "   0.000000 F1 AWD_TCASE::AWD_TCASE_Disp_Rq_AR2::DiffLk_Msg4_Disp_Rq = %d\n", intval);
	filePutString (buffer, elcount(buffer), hFile);
	intval = getSignal(CHASSIS::AWD_TCASE_Disp_Rq_AR2::DiffLk_Msg5_Disp_Rq);
	snprintf(buffer, elcount(buffer), "   0.000000 F1 AWD_TCASE::AWD_TCASE_Disp_Rq_AR2::DiffLk_Msg5_Disp_Rq = %d\n", intval);
	filePutString (buffer, elcount(buffer), hFile);
	intval = getSignal(CHASSIS::AWD_TCASE_Disp_Rq_AR2::DiffLk_Msg6_Disp_Rq);
	snprintf(buffer, elcount(buffer), "   0.000000 F1 AWD_TCASE::AWD_TCASE_Disp_Rq_AR2::DiffLk_Msg6_Disp_Rq = %d\n", intval);
	filePutString (buffer, elcount(buffer), hFile);
	intval = getSignal(CHASSIS::AWD_TCASE_Disp_Rq_AR2::DiffLk_Msg7_Disp_Rq);
	snprintf(buffer, elcount(buffer), "   0.000000 F1 AWD_TCASE::AWD_TCASE_Disp_Rq_AR2::DiffLk_Msg7_Disp_Rq = %d\n", intval);
	filePutString (buffer, elcount(buffer), hFile);
	intval = getSignal(CHASSIS::AWD_TCASE_Disp_Rq_AR2::DiffLk_Msg8_Disp_Rq);
	snprintf(buffer, elcount(buffer), "   0.000000 F1 AWD_TCASE::AWD_TCASE_Disp_Rq_AR2::DiffLk_Msg8_Disp_Rq = %d\n", intval);
	filePutString (buffer, elcount(buffer), hFile);
	intval = getSignal(CHASSIS::AWD_TCASE_Disp_Rq_AR2::DiffLk_Msg9_Disp_Rq);
	snprintf(buffer, elcount(buffer), "   0.000000 F1 AWD_TCASE::AWD_TCASE_Disp_Rq_AR2::DiffLk_Msg9_Disp_Rq = %d\n", intval);
	filePutString (buffer, elcount(buffer), hFile);
	intval = @sysvar::CH_Nodes::CH_AWD_TCASECRC_AWD_TCASE_S_AUTO;
	snprintf(buffer, elcount(buffer), "   0.000000    SV: 2 0 0 ::CH_Nodes::CH_AWD_TCASECRC_AWD_TCASE_S_AUTO = %d\n", intval);
	filePutString (buffer, elcount(buffer), hFile);
	intval = getSignal(CHASSIS::AWD_TCASE_Stat1_AR2::CRC_AWD_TCASE_Stat1_Pr2);
	snprintf(buffer, elcount(buffer), "   0.000000 F1 AWD_TCASE::AWD_TCASE_Stat1_AR2::CRC_AWD_TCASE_Stat1_Pr2 = %d\n", intval);
	filePutString (buffer, elcount(buffer), hFile);
	intval = @sysvar::CH_Nodes::CH_AWD_TCASESQC_AWD_TCASE_S_AUTO;
	snprintf(buffer, elcount(buffer), "   0.000000    SV: 2 0 0 ::CH_Nodes::CH_AWD_TCASESQC_AWD_TCASE_S_AUTO = %d\n", intval);
	filePutString (buffer, elcount(buffer), hFile);
	intval = getSignal(CHASSIS::AWD_TCASE_Stat1_AR2::SQC_AWD_TCASE_Stat1_Pr2);
	snprintf(buffer, elcount(buffer), "   0.000000 F1 AWD_TCASE::AWD_TCASE_Stat1_AR2::SQC_AWD_TCASE_Stat1_Pr2 = %d\n", intval);
	filePutString (buffer, elcount(buffer), hFile);
	intval = getSignal(CHASSIS::AWD_TCASE_Stat1_AR2::AWD_Err_Stat_V2);
	snprintf(buffer, elcount(buffer), "   0.000000 F1 AWD_TCASE::AWD_TCASE_Stat1_AR2::AWD_Err_Stat_V2 = %d\n", intval);
	filePutString (buffer, elcount(buffer), hFile);
	intval = getSignal(CHASSIS::AWD_TCASE_Stat1_AR2::RearGrTemp_Estim_AWD);
	snprintf(buffer, elcount(buffer), "   0.000000 F1 AWD_TCASE::AWD_TCASE_Stat1_AR2::RearGrTemp_Estim_AWD = %d\n", intval);
	filePutString (buffer, elcount(buffer), hFile);
	intval = getSignal(CHASSIS::AWD_TCASE_Stat1_AR2::AWD_OprtnMd);
	snprintf(buffer, elcount(buffer), "   0.000000 F1 AWD_TCASE::AWD_TCASE_Stat1_AR2::AWD_OprtnMd = %d\n", intval);
	filePutString (buffer, elcount(buffer), hFile);
	intval = getSignal(CHASSIS::AWD_TCASE_Stat1_AR2::Gr_TCASE_V2);
	snprintf(buffer, elcount(buffer), "   0.000000 F1 AWD_TCASE::AWD_TCASE_Stat1_AR2::Gr_TCASE_V2 = %d\n", intval);
	filePutString (buffer, elcount(buffer), hFile);
	intval = getSignal(CHASSIS::AWD_TCASE_Stat1_AR2::AWD_Clutch_Stat);
	snprintf(buffer, elcount(buffer), "   0.000000 F1 AWD_TCASE::AWD_TCASE_Stat1_AR2::AWD_Clutch_Stat = %d\n", intval);
	filePutString (buffer, elcount(buffer), hFile);
	intval = getSignal(CHASSIS::AWD_TCASE_Stat1_AR2::ESP_Md_Rq_AWD);
	snprintf(buffer, elcount(buffer), "   0.000000 F1 AWD_TCASE::AWD_TCASE_Stat1_AR2::ESP_Md_Rq_AWD = %d\n", intval);
	filePutString (buffer, elcount(buffer), hFile);
	intval = getSignal(CHASSIS::AWD_TCASE_Stat1_AR2::Rsrv1_AWD_TCASE_Stat1_Pr2);
	snprintf(buffer, elcount(buffer), "   0.000000 F1 AWD_TCASE::AWD_TCASE_Stat1_AR2::Rsrv1_AWD_TCASE_Stat1_Pr2 = %d\n", intval);
	filePutString (buffer, elcount(buffer), hFile);
	intval = getSignal(CHASSIS::AWD_TCASE_Stat1_AR2::Rsrv2_AWD_TCASE_Stat1_Pr2);
	snprintf(buffer, elcount(buffer), "   0.000000 F1 AWD_TCASE::AWD_TCASE_Stat1_AR2::Rsrv2_AWD_TCASE_Stat1_Pr2 = %d\n", intval);
	filePutString (buffer, elcount(buffer), hFile);
	intval = @sysvar::CH_Nodes::CH_AWD_TCASECRC_AWD_TCASE_S_A_01;
	snprintf(buffer, elcount(buffer), "   0.000000    SV: 2 0 0 ::CH_Nodes::CH_AWD_TCASECRC_AWD_TCASE_S_A_01 = %d\n", intval);
	filePutString (buffer, elcount(buffer), hFile);
	intval = getSignal(CHASSIS::AWD_TCASE_Stat2_AR2::CRC_AWD_TCASE_Stat2_Pr2);
	snprintf(buffer, elcount(buffer), "   0.000000 F1 AWD_TCASE::AWD_TCASE_Stat2_AR2::CRC_AWD_TCASE_Stat2_Pr2 = %d\n", intval);
	filePutString (buffer, elcount(buffer), hFile);
	intval = @sysvar::CH_Nodes::CH_AWD_TCASESQC_AWD_TCASE_S_A_01;
	snprintf(buffer, elcount(buffer), "   0.000000    SV: 2 0 0 ::CH_Nodes::CH_AWD_TCASESQC_AWD_TCASE_S_A_01 = %d\n", intval);
	filePutString (buffer, elcount(buffer), hFile);
	intval = getSignal(CHASSIS::AWD_TCASE_Stat2_AR2::SQC_AWD_TCASE_Stat2_Pr2);
	snprintf(buffer, elcount(buffer), "   0.000000 F1 AWD_TCASE::AWD_TCASE_Stat2_AR2::SQC_AWD_TCASE_Stat2_Pr2 = %d\n", intval);
	filePutString (buffer, elcount(buffer), hFile);
	intval = getSignal(CHASSIS::AWD_TCASE_Stat2_AR2::Rsrv1_AWD_TCASE_Stat2_Pr2);
	snprintf(buffer, elcount(buffer), "   0.000000 F1 AWD_TCASE::AWD_TCASE_Stat2_AR2::Rsrv1_AWD_TCASE_Stat2_Pr2 = %d\n", intval);
	filePutString (buffer, elcount(buffer), hFile);
	intval = getSignal(CHASSIS::AWD_TCASE_Stat2_AR2::LkTrq_Target_AWD_V2);
	snprintf(buffer, elcount(buffer), "   0.000000 F1 AWD_TCASE::AWD_TCASE_Stat2_AR2::LkTrq_Target_AWD_V2 = %d\n", intval);
	filePutString (buffer, elcount(buffer), hFile);
	intval = getSignal(CHASSIS::AWD_TCASE_Stat2_AR2::LkTrq_Estim_AWD_V2);
	snprintf(buffer, elcount(buffer), "   0.000000 F1 AWD_TCASE::AWD_TCASE_Stat2_AR2::LkTrq_Estim_AWD_V2 = %d\n", intval);
	filePutString (buffer, elcount(buffer), hFile);
	intval = getSignal(CHASSIS::AWD_TCASE_Stat2_AR2::DiffLk_M_LkTrq);
	snprintf(buffer, elcount(buffer), "   0.000000 F1 AWD_TCASE::AWD_TCASE_Stat2_AR2::DiffLk_M_LkTrq = %d\n", intval);
	filePutString (buffer, elcount(buffer), hFile);
	intval = getSignal(CHASSIS::AWD_TCASE_Stat2_AR2::Rsrv3_AWD_TCASE_Stat2_Pr2);
	snprintf(buffer, elcount(buffer), "   0.000000 F1 AWD_TCASE::AWD_TCASE_Stat2_AR2::Rsrv3_AWD_TCASE_Stat2_Pr2 = %d\n", intval);
	filePutString (buffer, elcount(buffer), hFile);
	intval = getSignal(CHASSIS::AWD_TCASE_Stat2_AR2::TCASE_OilTemp_AWD);
	snprintf(buffer, elcount(buffer), "   0.000000 F1 AWD_TCASE::AWD_TCASE_Stat2_AR2::TCASE_OilTemp_AWD = %d\n", intval);
	filePutString (buffer, elcount(buffer), hFile);
	intval = getSignal(CHASSIS::AWD_TCASE_Stat2_AR2::Rsrv2_AWD_TCASE_Stat2_Pr2);
	snprintf(buffer, elcount(buffer), "   0.000000 F1 AWD_TCASE::AWD_TCASE_Stat2_AR2::Rsrv2_AWD_TCASE_Stat2_Pr2 = %d\n", intval);
	filePutString (buffer, elcount(buffer), hFile);
	intval = getSignal(CHASSIS::ROE_AWD_TCASE::ROE_Header_AWD_TCASE);
	snprintf(buffer, elcount(buffer), "   0.000000 F1 AWD_TCASE::ROE_AWD_TCASE::ROE_Header_AWD_TCASE = %d\n", intval);
	filePutString (buffer, elcount(buffer), hFile);
	intval = getSignal(CHASSIS::ROE_AWD_TCASE::ROE_DTC_AWD_TCASE);
	snprintf(buffer, elcount(buffer), "   0.000000 F1 AWD_TCASE::ROE_AWD_TCASE::ROE_DTC_AWD_TCASE = %d\n", intval);
	filePutString (buffer, elcount(buffer), hFile);
	intval = getSignal(CHASSIS::ROE_AWD_TCASE::ROE_DTC_Stat_AWD_TCASE);
	snprintf(buffer, elcount(buffer), "   0.000000 F1 AWD_TCASE::ROE_AWD_TCASE::ROE_DTC_Stat_AWD_TCASE = %d\n", intval);
	filePutString (buffer, elcount(buffer), hFile);
	snprintf(buffer, elcount(buffer), "   0.000000    SV: 2 0 0 ::CH_Nodes::CH__NMActive_CPC = %X\n", @sysvar::CH_Nodes::CH__NMActive_CPC);
	filePutString (buffer, elcount(buffer), hFile);

}
/*@@end*/
/*@@caplFunc:saveVars_2(dword):*/
void saveVars_2(dword hFile)
{
	snprintf(buffer, elcount(buffer), "   0.000000    SV: 2 0 0 ::CH_Nodes::CH__NMAwake_CPC = %X\n", @sysvar::CH_Nodes::CH__NMAwake_CPC);
	filePutString (buffer, elcount(buffer), hFile);
	intval = getSignal(CHASSIS::Adblue_Disp_Rq_AR::Adblue_RemDistServ_Disp_Rq);
	snprintf(buffer, elcount(buffer), "   0.000000 F1 CPC::Adblue_Disp_Rq_AR::Adblue_RemDistServ_Disp_Rq = %d\n", intval);
	filePutString (buffer, elcount(buffer), hFile);
	intval = getSignal(CHASSIS::Adblue_Disp_Rq_AR::AdBlue_TankRes_Disp_Rq);
	snprintf(buffer, elcount(buffer), "   0.000000 F1 CPC::Adblue_Disp_Rq_AR::AdBlue_TankRes_Disp_Rq = %d\n", intval);
	filePutString (buffer, elcount(buffer), hFile);
	intval = getSignal(CHASSIS::Adblue_Disp_Rq_AR::AdBlue_TankLvl_Disp_Rq);
	snprintf(buffer, elcount(buffer), "   0.000000 F1 CPC::Adblue_Disp_Rq_AR::AdBlue_TankLvl_Disp_Rq = %d\n", intval);
	filePutString (buffer, elcount(buffer), hFile);
	intval = getSignal(CHASSIS::Adblue_Disp_Rq_AR::AdBlue_SCRCM_Flt_Disp_Rq);
	snprintf(buffer, elcount(buffer), "   0.000000 F1 CPC::Adblue_Disp_Rq_AR::AdBlue_SCRCM_Flt_Disp_Rq = %d\n", intval);
	filePutString (buffer, elcount(buffer), hFile);
	intval = getSignal(CHASSIS::Adblue_Disp_Rq_AR::AdBlue_Md_Disp_Rq);
	snprintf(buffer, elcount(buffer), "   0.000000 F1 CPC::Adblue_Disp_Rq_AR::AdBlue_Md_Disp_Rq = %d\n", intval);
	filePutString (buffer, elcount(buffer), hFile);
	intval = getSignal(CHASSIS::Adblue_Disp_Warn_Rq_AR::Adblue_RemainDist);
	snprintf(buffer, elcount(buffer), "   0.000000 F1 CPC::Adblue_Disp_Warn_Rq_AR::Adblue_RemainDist = %d\n", intval);
	filePutString (buffer, elcount(buffer), hFile);
	intval = getSignal(CHASSIS::Adblue_Disp_Warn_Rq_AR::Adblue_WarnLvl1);
	snprintf(buffer, elcount(buffer), "   0.000000 F1 CPC::Adblue_Disp_Warn_Rq_AR::Adblue_WarnLvl1 = %d\n", intval);
	filePutString (buffer, elcount(buffer), hFile);
	intval = getSignal(CHASSIS::Adblue_Disp_Warn_Rq_AR::Adblue_WarnLvl2);
	snprintf(buffer, elcount(buffer), "   0.000000 F1 CPC::Adblue_Disp_Warn_Rq_AR::Adblue_WarnLvl2 = %d\n", intval);
	filePutString (buffer, elcount(buffer), hFile);
	intval = getSignal(CHASSIS::Adblue_Disp_Warn_Rq_AR::Adblue_WarnLvl3);
	snprintf(buffer, elcount(buffer), "   0.000000 F1 CPC::Adblue_Disp_Warn_Rq_AR::Adblue_WarnLvl3 = %d\n", intval);
	filePutString (buffer, elcount(buffer), hFile);
	intval = getSignal(CHASSIS::Adblue_Disp_Warn_Rq_AR::AdblueEU6_ChkMsg_Disp_Rq);
	snprintf(buffer, elcount(buffer), "   0.000000 F1 CPC::Adblue_Disp_Warn_Rq_AR::AdblueEU6_ChkMsg_Disp_Rq = %d\n", intval);
	filePutString (buffer, elcount(buffer), hFile);
	intval = getSignal(CHASSIS::Adblue_Disp_Warn_Rq_AR::AdblueEU6_Msg_Disp_TrgrRq);
	snprintf(buffer, elcount(buffer), "   0.000000 F1 CPC::Adblue_Disp_Warn_Rq_AR::AdblueEU6_Msg_Disp_TrgrRq = %d\n", intval);
	filePutString (buffer, elcount(buffer), hFile);
	intval = getSignal(CHASSIS::Adblue_Disp_Warn_Rq_AR::AdblueEU6_RefillMsg_Disp_Rq);
	snprintf(buffer, elcount(buffer), "   0.000000 F1 CPC::Adblue_Disp_Warn_Rq_AR::AdblueEU6_RefillMsg_Disp_Rq = %d\n", intval);
	filePutString (buffer, elcount(buffer), hFile);
	intval = getSignal(CHASSIS::Adblue_Disp_Warn_Rq_AR::AdblueEU6_RemainDist);
	snprintf(buffer, elcount(buffer), "   0.000000 F1 CPC::Adblue_Disp_Warn_Rq_AR::AdblueEU6_RemainDist = %d\n", intval);
	filePutString (buffer, elcount(buffer), hFile);
	intval = getSignal(CHASSIS::Adblue_Disp_Warn_Rq_AR::EngSt_Remain);
	snprintf(buffer, elcount(buffer), "   0.000000 F1 CPC::Adblue_Disp_Warn_Rq_AR::EngSt_Remain = %d\n", intval);
	filePutString (buffer, elcount(buffer), hFile);
	intval = getSignal(CHASSIS::Assyst_Stat2_AR::Assyst_OilWarn_Disp_Rq);
	snprintf(buffer, elcount(buffer), "   0.000000 F1 CPC::Assyst_Stat2_AR::Assyst_OilWarn_Disp_Rq = %d\n", intval);
	filePutString (buffer, elcount(buffer), hFile);
	intval = getSignal(CHASSIS::Assyst_Stat2_AR::Assyst_OilQuant_Disp_Rq);
	snprintf(buffer, elcount(buffer), "   0.000000 F1 CPC::Assyst_Stat2_AR::Assyst_OilQuant_Disp_Rq = %d\n", intval);
	filePutString (buffer, elcount(buffer), hFile);
	intval = getSignal(CHASSIS::Assyst_Stat2_AR::Assyst_HndOvr_Stat);
	snprintf(buffer, elcount(buffer), "   0.000000 F1 CPC::Assyst_Stat2_AR::Assyst_HndOvr_Stat = %d\n", intval);
	filePutString (buffer, elcount(buffer), hFile);
	intval = getSignal(CHASSIS::Assyst_Stat2_AR::Assyst_ServConf_Stat);
	snprintf(buffer, elcount(buffer), "   0.000000 F1 CPC::Assyst_Stat2_AR::Assyst_ServConf_Stat = %d\n", intval);
	filePutString (buffer, elcount(buffer), hFile);
	intval = getSignal(CHASSIS::Assyst_Stat2_AR::Assyst_ServRst_Stat);
	snprintf(buffer, elcount(buffer), "   0.000000 F1 CPC::Assyst_Stat2_AR::Assyst_ServRst_Stat = %d\n", intval);
	filePutString (buffer, elcount(buffer), hFile);
	floatval = getSignal(CHASSIS::Assyst_Stat2_AR::Assyst_OilQuant_Miss);
	snprintf(buffer, elcount(buffer), "   0.000000 F1 CPC::Assyst_Stat2_AR::Assyst_OilQuant_Miss = %f\n", floatval);
	filePutString (buffer, elcount(buffer), hFile);
	intval = getSignal(CHASSIS::Assyst_Stat2_AR::Assyst_OilQuant_Rel);
	snprintf(buffer, elcount(buffer), "   0.000000 F1 CPC::Assyst_Stat2_AR::Assyst_OilQuant_Rel = %d\n", intval);
	filePutString (buffer, elcount(buffer), hFile);
	intval = getSignal(CHASSIS::Assyst_Stat2_AR::Assyst_RelOilQual_Para2);
	snprintf(buffer, elcount(buffer), "   0.000000 F1 CPC::Assyst_Stat2_AR::Assyst_RelOilQual_Para2 = %d\n", intval);
	filePutString (buffer, elcount(buffer), hFile);
	intval = getSignal(CHASSIS::Assyst_Stat3_AR2::Assyst_OprtnTm);
	snprintf(buffer, elcount(buffer), "   0.000000 F1 CPC::Assyst_Stat3_AR2::Assyst_OprtnTm = %d\n", intval);
	filePutString (buffer, elcount(buffer), hFile);
	intval = getSignal(CHASSIS::Assyst_Stat3_AR2::Assyst_RemainOprtnTm);
	snprintf(buffer, elcount(buffer), "   0.000000 F1 CPC::Assyst_Stat3_AR2::Assyst_RemainOprtnTm = %d\n", intval);
	filePutString (buffer, elcount(buffer), hFile);
	intval = getSignal(CHASSIS::Assyst_Stat_AR::Assyst_RelOilQual_Para);
	snprintf(buffer, elcount(buffer), "   0.000000 F1 CPC::Assyst_Stat_AR::Assyst_RelOilQual_Para = %d\n", intval);
	filePutString (buffer, elcount(buffer), hFile);
	floatval = getSignal(CHASSIS::Assyst_Stat_AR::Assyst_OilQuant);
	snprintf(buffer, elcount(buffer), "   0.000000 F1 CPC::Assyst_Stat_AR::Assyst_OilQuant = %f\n", floatval);
	filePutString (buffer, elcount(buffer), hFile);
	floatval = getSignal(CHASSIS::Assyst_Stat_AR::Assyst_RemDist);
	snprintf(buffer, elcount(buffer), "   0.000000 F1 CPC::Assyst_Stat_AR::Assyst_RemDist = %f\n", floatval);
	filePutString (buffer, elcount(buffer), hFile);
	intval = getSignal(CHASSIS::Assyst_Stat_AR::Assyst_RemTm);
	snprintf(buffer, elcount(buffer), "   0.000000 F1 CPC::Assyst_Stat_AR::Assyst_RemTm = %d\n", intval);
	filePutString (buffer, elcount(buffer), hFile);
	intval = getSignal(CHASSIS::Assyst_Stat_AR::Assyst_RemDist_Rdc);
	snprintf(buffer, elcount(buffer), "   0.000000 F1 CPC::Assyst_Stat_AR::Assyst_RemDist_Rdc = %d\n", intval);
	filePutString (buffer, elcount(buffer), hFile);
	intval = getSignal(CHASSIS::CNG_Disp_Rq_AR2::Rsrv1_CNG_Disp_Rq);
	snprintf(buffer, elcount(buffer), "   0.000000 F1 CPC::CNG_Disp_Rq_AR2::Rsrv1_CNG_Disp_Rq = %d\n", intval);
	filePutString (buffer, elcount(buffer), hFile);
	intval = getSignal(CHASSIS::CNG_Disp_Rq_AR2::CNG_TankLvl_Min);
	snprintf(buffer, elcount(buffer), "   0.000000 F1 CPC::CNG_Disp_Rq_AR2::CNG_TankLvl_Min = %d\n", intval);
	filePutString (buffer, elcount(buffer), hFile);
	intval = getSignal(CHASSIS::CNG_Disp_Rq_AR2::CNG_TankCapIndLmp_On_Rq);
	snprintf(buffer, elcount(buffer), "   0.000000 F1 CPC::CNG_Disp_Rq_AR2::CNG_TankCapIndLmp_On_Rq = %d\n", intval);
	filePutString (buffer, elcount(buffer), hFile);
	intval = getSignal(CHASSIS::CNG_Disp_Rq_AR2::CNG_FuelMd_Stat);
	snprintf(buffer, elcount(buffer), "   0.000000 F1 CPC::CNG_Disp_Rq_AR2::CNG_FuelMd_Stat = %d\n", intval);
	filePutString (buffer, elcount(buffer), hFile);
	intval = getSignal(CHASSIS::CNG_Disp_Rq_AR2::CNG_FuelMdChg_Actv);
	snprintf(buffer, elcount(buffer), "   0.000000 F1 CPC::CNG_Disp_Rq_AR2::CNG_FuelMdChg_Actv = %d\n", intval);
	filePutString (buffer, elcount(buffer), hFile);
	intval = getSignal(CHASSIS::CNG_Disp_Rq_AR2::CNG_TankLvl);
	snprintf(buffer, elcount(buffer), "   0.000000 F1 CPC::CNG_Disp_Rq_AR2::CNG_TankLvl = %d\n", intval);
	filePutString (buffer, elcount(buffer), hFile);
	intval = getSignal(CHASSIS::CNG_Disp_Rq_AR2::CNG_FuelPress);
	snprintf(buffer, elcount(buffer), "   0.000000 F1 CPC::CNG_Disp_Rq_AR2::CNG_FuelPress = %d\n", intval);
	filePutString (buffer, elcount(buffer), hFile);
	intval = getSignal(CHASSIS::CNG_Disp_Rq_AR2::CNG_Msg1_Disp_Rq);
	snprintf(buffer, elcount(buffer), "   0.000000 F1 CPC::CNG_Disp_Rq_AR2::CNG_Msg1_Disp_Rq = %d\n", intval);
	filePutString (buffer, elcount(buffer), hFile);
	intval = getSignal(CHASSIS::CNG_Disp_Rq_AR2::CNG_Msg2_Disp_Rq);
	snprintf(buffer, elcount(buffer), "   0.000000 F1 CPC::CNG_Disp_Rq_AR2::CNG_Msg2_Disp_Rq = %d\n", intval);
	filePutString (buffer, elcount(buffer), hFile);
	intval = getSignal(CHASSIS::CNG_Disp_Rq_AR2::CNG_Msg3_Disp_Rq);
	snprintf(buffer, elcount(buffer), "   0.000000 F1 CPC::CNG_Disp_Rq_AR2::CNG_Msg3_Disp_Rq = %d\n", intval);
	filePutString (buffer, elcount(buffer), hFile);
	intval = getSignal(CHASSIS::CNG_Disp_Rq_AR2::CNG_Msg4_Disp_Rq);
	snprintf(buffer, elcount(buffer), "   0.000000 F1 CPC::CNG_Disp_Rq_AR2::CNG_Msg4_Disp_Rq = %d\n", intval);
	filePutString (buffer, elcount(buffer), hFile);
	intval = getSignal(CHASSIS::CNG_Disp_Rq_AR2::CNG_Msg5_Disp_Rq);
	snprintf(buffer, elcount(buffer), "   0.000000 F1 CPC::CNG_Disp_Rq_AR2::CNG_Msg5_Disp_Rq = %d\n", intval);
	filePutString (buffer, elcount(buffer), hFile);
	intval = getSignal(CHASSIS::CNG_Disp_Rq_AR2::CNG_Msg6_Disp_Rq);
	snprintf(buffer, elcount(buffer), "   0.000000 F1 CPC::CNG_Disp_Rq_AR2::CNG_Msg6_Disp_Rq = %d\n", intval);
	filePutString (buffer, elcount(buffer), hFile);
	intval = getSignal(CHASSIS::CNG_Disp_Rq_AR2::CNG_Msg7_Disp_Rq);
	snprintf(buffer, elcount(buffer), "   0.000000 F1 CPC::CNG_Disp_Rq_AR2::CNG_Msg7_Disp_Rq = %d\n", intval);
	filePutString (buffer, elcount(buffer), hFile);
	intval = getSignal(CHASSIS::CNG_Disp_Rq_AR2::CNG_Msg8_Disp_Rq);
	snprintf(buffer, elcount(buffer), "   0.000000 F1 CPC::CNG_Disp_Rq_AR2::CNG_Msg8_Disp_Rq = %d\n", intval);
	filePutString (buffer, elcount(buffer), hFile);
	intval = getSignal(CHASSIS::CNG_Disp_Rq_AR2::CNG_FuelMd_Disp_Rq);
	snprintf(buffer, elcount(buffer), "   0.000000 F1 CPC::CNG_Disp_Rq_AR2::CNG_FuelMd_Disp_Rq = %d\n", intval);
	filePutString (buffer, elcount(buffer), hFile);
	intval = getSignal(CHASSIS::CNG_Disp_Rq_AR2::Rsrv2_CNG_Disp_Rq);
	snprintf(buffer, elcount(buffer), "   0.000000 F1 CPC::CNG_Disp_Rq_AR2::Rsrv2_CNG_Disp_Rq = %d\n", intval);
	filePutString (buffer, elcount(buffer), hFile);
	intval = getSignal(CHASSIS::CNG_Disp_Rq_AR2::CNG_FuelMdChg_Stat);
	snprintf(buffer, elcount(buffer), "   0.000000 F1 CPC::CNG_Disp_Rq_AR2::CNG_FuelMdChg_Stat = %d\n", intval);
	filePutString (buffer, elcount(buffer), hFile);
	intval = getSignal(CHASSIS::CNG_Disp_Rq_AR2::CNG_Qual);
	snprintf(buffer, elcount(buffer), "   0.000000 F1 CPC::CNG_Disp_Rq_AR2::CNG_Qual = %d\n", intval);
	filePutString (buffer, elcount(buffer), hFile);
	intval = getSignal(CHASSIS::CPC_CHASSIS_R1_AR2::EHC_Curr);
	snprintf(buffer, elcount(buffer), "   0.000000 F1 CPC::CPC_CHASSIS_R1_AR2::EHC_Curr = %d\n", intval);
	filePutString (buffer, elcount(buffer), hFile);
	intval = @sysvar::CH_Nodes::CH_CPCEHC_CurrCPC_CHASSI_UB_AUTO;
	snprintf(buffer, elcount(buffer), "   0.000000    SV: 2 0 0 ::CH_Nodes::CH_CPCEHC_CurrCPC_CHASSI_UB_AUTO = %d\n", intval);
	filePutString (buffer, elcount(buffer), hFile);
	intval = @sysvar::CH_Nodes::CH_CPCEHC_CurrCPC_CHASSIS_R1_UB_;
	snprintf(buffer, elcount(buffer), "   0.000000    SV: 2 0 0 ::CH_Nodes::CH_CPCEHC_CurrCPC_CHASSIS_R1_UB_ = %d\n", intval);
	filePutString (buffer, elcount(buffer), hFile);
}
/*@@end*/

/*@@caplFunc:saveVars_3(dword):*/
void saveVars_3(dword hFile)
{
	intval = getSignal(CHASSIS::CPC_CHASSIS_R1_AR2::AddWtrPmp_On_Rq_ECM);
	snprintf(buffer, elcount(buffer), "   0.000000 F1 CPC::CPC_CHASSIS_R1_AR2::AddWtrPmp_On_Rq_ECM = %d\n", intval);
	filePutString (buffer, elcount(buffer), hFile);
	intval = @sysvar::CH_Nodes::CH_CPCAddWtrPmp_On_Rq_EC_UB_AUTO;
	snprintf(buffer, elcount(buffer), "   0.000000    SV: 2 0 0 ::CH_Nodes::CH_CPCAddWtrPmp_On_Rq_EC_UB_AUTO = %d\n", intval);
	filePutString (buffer, elcount(buffer), hFile);
	intval = @sysvar::CH_Nodes::CH_CPCAddWtrPmp_On_Rq_ECMCPC_UB_;
	snprintf(buffer, elcount(buffer), "   0.000000    SV: 2 0 0 ::CH_Nodes::CH_CPCAddWtrPmp_On_Rq_ECMCPC_UB_ = %d\n", intval);
	filePutString (buffer, elcount(buffer), hFile);
	floatval = getSignal(CHASSIS::CPC_CHASSIS_R1_AR2::PNHV_Bat_Volt);
	snprintf(buffer, elcount(buffer), "   0.000000 F1 CPC::CPC_CHASSIS_R1_AR2::PNHV_Bat_Volt = %f\n", floatval);
	filePutString (buffer, elcount(buffer), hFile);
	intval = @sysvar::CH_Nodes::CH_CPCPNHV_Bat_VoltCPC_C_UB_AUTO;
	snprintf(buffer, elcount(buffer), "   0.000000    SV: 2 0 0 ::CH_Nodes::CH_CPCPNHV_Bat_VoltCPC_C_UB_AUTO = %d\n", intval);
	filePutString (buffer, elcount(buffer), hFile);
	intval = @sysvar::CH_Nodes::CH_CPCPNHV_Bat_VoltCPC_CHASS_UB_;
	snprintf(buffer, elcount(buffer), "   0.000000    SV: 2 0 0 ::CH_Nodes::CH_CPCPNHV_Bat_VoltCPC_CHASS_UB_ = %d\n", intval);
	filePutString (buffer, elcount(buffer), hFile);
	intval = getSignal(CHASSIS::CPC_CHASSIS_R1_AR2::DCDC1_Md);
	snprintf(buffer, elcount(buffer), "   0.000000 F1 CPC::CPC_CHASSIS_R1_AR2::DCDC1_Md = %d\n", intval);
	filePutString (buffer, elcount(buffer), hFile);
	intval = @sysvar::CH_Nodes::CH_CPCDCDC1_MdCPC_CHASSI_UB_AUTO;
	snprintf(buffer, elcount(buffer), "   0.000000    SV: 2 0 0 ::CH_Nodes::CH_CPCDCDC1_MdCPC_CHASSI_UB_AUTO = %d\n", intval);
	filePutString (buffer, elcount(buffer), hFile);
	intval = @sysvar::CH_Nodes::CH_CPCDCDC1_MdCPC_CHASSIS_R1_UB_;
	snprintf(buffer, elcount(buffer), "   0.000000    SV: 2 0 0 ::CH_Nodes::CH_CPCDCDC1_MdCPC_CHASSIS_R1_UB_ = %d\n", intval);
	filePutString (buffer, elcount(buffer), hFile);
	floatval = getSignal(CHASSIS::CPC_CHASSIS_R1_AR2::Therm_HiTempSTOut1);
	snprintf(buffer, elcount(buffer), "   0.000000 F1 CPC::CPC_CHASSIS_R1_AR2::Therm_HiTempSTOut1 = %f\n", floatval);
	filePutString (buffer, elcount(buffer), hFile);
	intval = @sysvar::CH_Nodes::CH_CPCTherm_HiTempSTOut1_UB_AUTO;
	snprintf(buffer, elcount(buffer), "   0.000000    SV: 2 0 0 ::CH_Nodes::CH_CPCTherm_HiTempSTOut1_UB_AUTO = %d\n", intval);
	filePutString (buffer, elcount(buffer), hFile);
	intval = @sysvar::CH_Nodes::CH_CPCTherm_HiTempSTOut1CPC__UB_;
	snprintf(buffer, elcount(buffer), "   0.000000    SV: 2 0 0 ::CH_Nodes::CH_CPCTherm_HiTempSTOut1CPC__UB_ = %d\n", intval);
	filePutString (buffer, elcount(buffer), hFile);
	intval = getSignal(CHASSIS::CPC_CHASSIS_R2_AR2::WDC_Stat);
	snprintf(buffer, elcount(buffer), "   0.000000 F1 CPC::CPC_CHASSIS_R2_AR2::WDC_Stat = %d\n", intval);
	filePutString (buffer, elcount(buffer), hFile);
	intval = getSignal(CHASSIS::CPC_CHASSIS_R2_AR2::DrvAccelMax_Stat);
	snprintf(buffer, elcount(buffer), "   0.000000 F1 CPC::CPC_CHASSIS_R2_AR2::DrvAccelMax_Stat = %d\n", intval);
	filePutString (buffer, elcount(buffer), hFile);
	floatval = getSignal(CHASSIS::CPC_CHASSIS_R2_AR2::EM01_DC_Curr);
	snprintf(buffer, elcount(buffer), "   0.000000 F1 CPC::CPC_CHASSIS_R2_AR2::EM01_DC_Curr = %f\n", floatval);
	filePutString (buffer, elcount(buffer), hFile);
	intval = getSignal(CHASSIS::CPC_CHASSIS_R2_AR2::ECM_LHOM_Stat);
	snprintf(buffer, elcount(buffer), "   0.000000 F1 CPC::CPC_CHASSIS_R2_AR2::ECM_LHOM_Stat = %d\n", intval);
	filePutString (buffer, elcount(buffer), hFile);
	intval = @sysvar::CH_Nodes::CH_CPCCRC_DCDC1_Rs1_Pr2DCDC_AUTO;
	snprintf(buffer, elcount(buffer), "   0.000000    SV: 2 0 0 ::CH_Nodes::CH_CPCCRC_DCDC1_Rs1_Pr2DCDC_AUTO = %d\n", intval);
	filePutString (buffer, elcount(buffer), hFile);
	intval = getSignal(CHASSIS::DCDC1_Rs1_AR2::CRC_DCDC1_Rs1_Pr2);
	snprintf(buffer, elcount(buffer), "   0.000000 F1 CPC::DCDC1_Rs1_AR2::CRC_DCDC1_Rs1_Pr2 = %d\n", intval);
	filePutString (buffer, elcount(buffer), hFile);
	intval = @sysvar::CH_Nodes::CH_CPCSQC_DCDC1_Rs1_Pr2DCDC_AUTO;
	snprintf(buffer, elcount(buffer), "   0.000000    SV: 2 0 0 ::CH_Nodes::CH_CPCSQC_DCDC1_Rs1_Pr2DCDC_AUTO = %d\n", intval);
	filePutString (buffer, elcount(buffer), hFile);
	intval = getSignal(CHASSIS::DCDC1_Rs1_AR2::SQC_DCDC1_Rs1_Pr2);
	snprintf(buffer, elcount(buffer), "   0.000000 F1 CPC::DCDC1_Rs1_AR2::SQC_DCDC1_Rs1_Pr2 = %d\n", intval);
	filePutString (buffer, elcount(buffer), hFile);
	intval = getSignal(CHASSIS::DCDC1_Rs1_AR2::DCDC1_PNLV_OutCurr_V2);
	snprintf(buffer, elcount(buffer), "   0.000000 F1 CPC::DCDC1_Rs1_AR2::DCDC1_PNLV_OutCurr_V2 = %d\n", intval);
	filePutString (buffer, elcount(buffer), hFile);
	intval = getSignal(CHASSIS::DCDC1_Rs1_AR2::DCDC1_Intrlk_Flt_V2);
	snprintf(buffer, elcount(buffer), "   0.000000 F1 CPC::DCDC1_Rs1_AR2::DCDC1_Intrlk_Flt_V2 = %d\n", intval);
	filePutString (buffer, elcount(buffer), hFile);
	floatval = getSignal(CHASSIS::DCDC1_Rs1_AR2::DCDC1_PNHV_OutCurr);
	snprintf(buffer, elcount(buffer), "   0.000000 F1 CPC::DCDC1_Rs1_AR2::DCDC1_PNHV_OutCurr = %f\n", floatval);
	filePutString (buffer, elcount(buffer), hFile);
	floatval = getSignal(CHASSIS::DCDC1_Rs1_AR2::DCDC1_PNLV_OutVolt_V2);
	snprintf(buffer, elcount(buffer), "   0.000000 F1 CPC::DCDC1_Rs1_AR2::DCDC1_PNLV_OutVolt_V2 = %f\n", floatval);
	filePutString (buffer, elcount(buffer), hFile);
	floatval = getSignal(CHASSIS::DCDC1_Rs1_AR2::DCDC1_GrndStrapVolt);
	snprintf(buffer, elcount(buffer), "   0.000000 F1 CPC::DCDC1_Rs1_AR2::DCDC1_GrndStrapVolt = %f\n", floatval);
	filePutString (buffer, elcount(buffer), hFile);
	intval = getSignal(CHASSIS::DCDC1_Rs1_AR2::DCDC1_PNLV_GenLoad);
	snprintf(buffer, elcount(buffer), "   0.000000 F1 CPC::DCDC1_Rs1_AR2::DCDC1_PNLV_GenLoad = %d\n", intval);
	filePutString (buffer, elcount(buffer), hFile);
	intval = getSignal(CHASSIS::DPC_PT_Rs_AR::DPC_Md_PT_Rs);
	snprintf(buffer, elcount(buffer), "   0.000000 F1 CPC::DPC_PT_Rs_AR::DPC_Md_PT_Rs = %d\n", intval);
	filePutString (buffer, elcount(buffer), hFile);
	intval = getSignal(CHASSIS::DPC_PT_Rs_AR::DPC_Md_AddFunc1_Rs);
	snprintf(buffer, elcount(buffer), "   0.000000 F1 CPC::DPC_PT_Rs_AR::DPC_Md_AddFunc1_Rs = %d\n", intval);
	filePutString (buffer, elcount(buffer), hFile);
	intval = getSignal(CHASSIS::DPC_PT_Rs_AR::DPC_Md_ECO_Assist_Rs);
	snprintf(buffer, elcount(buffer), "   0.000000 F1 CPC::DPC_PT_Rs_AR::DPC_Md_ECO_Assist_Rs = %d\n", intval);
	filePutString (buffer, elcount(buffer), hFile);
	intval = getSignal(CHASSIS::ECM_DAC4_AR::ECM_DAC_Data1);
	snprintf(buffer, elcount(buffer), "   0.000000 F1 CPC::ECM_DAC4_AR::ECM_DAC_Data1 = %d\n", intval);
	filePutString (buffer, elcount(buffer), hFile);
	intval = getSignal(CHASSIS::ECM_DAC4_AR::ECM_DAC_Data2);
	snprintf(buffer, elcount(buffer), "   0.000000 F1 CPC::ECM_DAC4_AR::ECM_DAC_Data2 = %d\n", intval);
	filePutString (buffer, elcount(buffer), hFile);
	intval = getSignal(CHASSIS::ECM_DAC4_AR::ECM_DAC_Data3);
	snprintf(buffer, elcount(buffer), "   0.000000 F1 CPC::ECM_DAC4_AR::ECM_DAC_Data3 = %d\n", intval);
	filePutString (buffer, elcount(buffer), hFile);
	intval = getSignal(CHASSIS::ECM_DAC4_AR::ECM_DAC_Data4);
	snprintf(buffer, elcount(buffer), "   0.000000 F1 CPC::ECM_DAC4_AR::ECM_DAC_Data4 = %d\n", intval);
	filePutString (buffer, elcount(buffer), hFile);
	intval = getSignal(CHASSIS::ECM_DAC4_AR::ECM_DAC_Data5);
	snprintf(buffer, elcount(buffer), "   0.000000 F1 CPC::ECM_DAC4_AR::ECM_DAC_Data5 = %d\n", intval);
	filePutString (buffer, elcount(buffer), hFile);
	intval = getSignal(CHASSIS::ECM_DAC4_AR::ECM_DAC_Data6);
	snprintf(buffer, elcount(buffer), "   0.000000 F1 CPC::ECM_DAC4_AR::ECM_DAC_Data6 = %d\n", intval);
	filePutString (buffer, elcount(buffer), hFile);
	intval = getSignal(CHASSIS::ECM_DAC4_AR::ECM_DAC_Data7);
	snprintf(buffer, elcount(buffer), "   0.000000 F1 CPC::ECM_DAC4_AR::ECM_DAC_Data7 = %d\n", intval);
	filePutString (buffer, elcount(buffer), hFile);
	intval = getSignal(CHASSIS::ECM_DAC4_AR::ECM_DAC_Data8);
	snprintf(buffer, elcount(buffer), "   0.000000 F1 CPC::ECM_DAC4_AR::ECM_DAC_Data8 = %d\n", intval);
	filePutString (buffer, elcount(buffer), hFile);
	intval = getSignal(CHASSIS::ECO_Homepage_Data::ECO_Stat_Veh);
	snprintf(buffer, elcount(buffer), "   0.000000 F1 CPC::ECO_Homepage_Data::ECO_Stat_Veh = %d\n", intval);
	filePutString (buffer, elcount(buffer), hFile);
	intval = getSignal(CHASSIS::ECO_Homepage_Data::ECO_Stat_Pt);
	snprintf(buffer, elcount(buffer), "   0.000000 F1 CPC::ECO_Homepage_Data::ECO_Stat_Pt = %d\n", intval);
	filePutString (buffer, elcount(buffer), hFile);
	floatval = getSignal(CHASSIS::ECO_Score_Disp_Rq_AR::ECO_Score_Accel_Disp_Rq);
	snprintf(buffer, elcount(buffer), "   0.000000 F1 CPC::ECO_Score_Disp_Rq_AR::ECO_Score_Accel_Disp_Rq = %f\n", floatval);
	filePutString (buffer, elcount(buffer), hFile);
	floatval = getSignal(CHASSIS::ECO_Score_Disp_Rq_AR::ECO_Score_Const_Disp_Rq);
	snprintf(buffer, elcount(buffer), "   0.000000 F1 CPC::ECO_Score_Disp_Rq_AR::ECO_Score_Const_Disp_Rq = %f\n", floatval);
	filePutString (buffer, elcount(buffer), hFile);
	floatval = getSignal(CHASSIS::ECO_Score_Disp_Rq_AR::ECO_Score_FreeWhl_Disp_Rq);
	snprintf(buffer, elcount(buffer), "   0.000000 F1 CPC::ECO_Score_Disp_Rq_AR::ECO_Score_FreeWhl_Disp_Rq = %f\n", floatval);
	filePutString (buffer, elcount(buffer), hFile);
	floatval = getSignal(CHASSIS::ECO_Score_Disp_Rq_AR::ECO_Score_Total_Disp_Rq);
	snprintf(buffer, elcount(buffer), "   0.000000 F1 CPC::ECO_Score_Disp_Rq_AR::ECO_Score_Total_Disp_Rq = %f\n", floatval);
	filePutString (buffer, elcount(buffer), hFile);
	floatval = getSignal(CHASSIS::ECO_Score_Disp_Rq_AR::ECO_Score_BonusRng_Disp_Rq);
	snprintf(buffer, elcount(buffer), "   0.000000 F1 CPC::ECO_Score_Disp_Rq_AR::ECO_Score_BonusRng_Disp_Rq = %f\n", floatval);
	filePutString (buffer, elcount(buffer), hFile);
	intval = getSignal(CHASSIS::ECO_Score_Disp_Rq_AR::ECO_Score_FreeWhl_Trnd_Disp_Rq);
	snprintf(buffer, elcount(buffer), "   0.000000 F1 CPC::ECO_Score_Disp_Rq_AR::ECO_Score_FreeWhl_Trnd_Disp_Rq = %d\n", intval);
	filePutString (buffer, elcount(buffer), hFile);
	intval = getSignal(CHASSIS::ECO_Score_Disp_Rq_AR::ECO_Score_Accel_Trnd_Disp_Rq);
	snprintf(buffer, elcount(buffer), "   0.000000 F1 CPC::ECO_Score_Disp_Rq_AR::ECO_Score_Accel_Trnd_Disp_Rq = %d\n", intval);
	filePutString (buffer, elcount(buffer), hFile);
	intval = getSignal(CHASSIS::ECO_Score_Disp_Rq_AR::ECO_Score_Const_Trnd_Disp_Rq);
	snprintf(buffer, elcount(buffer), "   0.000000 F1 CPC::ECO_Score_Disp_Rq_AR::ECO_Score_Const_Trnd_Disp_Rq = %d\n", intval);
	filePutString (buffer, elcount(buffer), hFile);
	intval = @sysvar::CH_Nodes::CH_CPCCRC_EM01_Stat1_Pr2EM0_AUTO;
	snprintf(buffer, elcount(buffer), "   0.000000    SV: 2 0 0 ::CH_Nodes::CH_CPCCRC_EM01_Stat1_Pr2EM0_AUTO = %d\n", intval);
	filePutString (buffer, elcount(buffer), hFile);
	intval = getSignal(CHASSIS::EM01_Stat1_AR2::CRC_EM01_Stat1_Pr2);
	snprintf(buffer, elcount(buffer), "   0.000000 F1 CPC::EM01_Stat1_AR2::CRC_EM01_Stat1_Pr2 = %d\n", intval);
	filePutString (buffer, elcount(buffer), hFile);
	intval = @sysvar::CH_Nodes::CH_CPCSQC_EM01_Stat1_Pr2EM0_AUTO;
	snprintf(buffer, elcount(buffer), "   0.000000    SV: 2 0 0 ::CH_Nodes::CH_CPCSQC_EM01_Stat1_Pr2EM0_AUTO = %d\n", intval);
	filePutString (buffer, elcount(buffer), hFile);
	intval = getSignal(CHASSIS::EM01_Stat1_AR2::SQC_EM01_Stat1_Pr2);
	snprintf(buffer, elcount(buffer), "   0.000000 F1 CPC::EM01_Stat1_AR2::SQC_EM01_Stat1_Pr2 = %d\n", intval);
	filePutString (buffer, elcount(buffer), hFile);
	intval = getSignal(CHASSIS::EM01_Stat1_AR2::EM01_Emg_Rq);
	snprintf(buffer, elcount(buffer), "   0.000000 F1 CPC::EM01_Stat1_AR2::EM01_Emg_Rq = %d\n", intval);
	filePutString (buffer, elcount(buffer), hFile);
	intval = getSignal(CHASSIS::EM01_Stat1_AR2::Rsrv1_EM01_Stat1_Pr2);
	snprintf(buffer, elcount(buffer), "   0.000000 F1 CPC::EM01_Stat1_AR2::Rsrv1_EM01_Stat1_Pr2 = %d\n", intval);
	filePutString (buffer, elcount(buffer), hFile);
	intval = getSignal(CHASSIS::EM01_Stat1_AR2::EM01_RPM);
	snprintf(buffer, elcount(buffer), "   0.000000 F1 CPC::EM01_Stat1_AR2::EM01_RPM = %d\n", intval);
	filePutString (buffer, elcount(buffer), hFile);
	intval = getSignal(CHASSIS::EM01_Stat1_AR2::EM01_RotDir);
	snprintf(buffer, elcount(buffer), "   0.000000 F1 CPC::EM01_Stat1_AR2::EM01_RotDir = %d\n", intval);
	filePutString (buffer, elcount(buffer), hFile);
	intval = getSignal(CHASSIS::EM01_Stat1_AR2::EM01_NegTrq_Rs);
	snprintf(buffer, elcount(buffer), "   0.000000 F1 CPC::EM01_Stat1_AR2::EM01_NegTrq_Rs = %d\n", intval);
	filePutString (buffer, elcount(buffer), hFile);
	floatval = getSignal(CHASSIS::EM01_Stat1_AR2::EM01_DC_Volt);
	snprintf(buffer, elcount(buffer), "   0.000000 F1 CPC::EM01_Stat1_AR2::EM01_DC_Volt = %f\n", floatval);
	filePutString (buffer, elcount(buffer), hFile);
	intval = getSignal(CHASSIS::EM01_Stat1_AR2::EM01_VehImmobSyst_Actv_Md);
	snprintf(buffer, elcount(buffer), "   0.000000 F1 CPC::EM01_Stat1_AR2::EM01_VehImmobSyst_Actv_Md = %d\n", intval);
	filePutString (buffer, elcount(buffer), hFile);
	floatval = getSignal(CHASSIS::EM01_Stat1_AR2::EM01_Trq);
	snprintf(buffer, elcount(buffer), "   0.000000 F1 CPC::EM01_Stat1_AR2::EM01_Trq = %f\n", floatval);
	filePutString (buffer, elcount(buffer), hFile);
}
/*@@end*/

/*@@caplFunc:saveVars_4(dword):*/
void saveVars_4(dword hFile)
{
	intval = getSignal(CHASSIS::EM01_Stat1_AR2::EM01_PerfLim_Rq);
	snprintf(buffer, elcount(buffer), "   0.000000 F1 CPC::EM01_Stat1_AR2::EM01_PerfLim_Rq = %d\n", intval);
	filePutString (buffer, elcount(buffer), hFile);
	intval = @sysvar::CH_Nodes::CH_CPCCRC_EM01_Stat2_Pr2EM0_AUTO;
	snprintf(buffer, elcount(buffer), "   0.000000    SV: 2 0 0 ::CH_Nodes::CH_CPCCRC_EM01_Stat2_Pr2EM0_AUTO = %d\n", intval);
	filePutString (buffer, elcount(buffer), hFile);
	intval = getSignal(CHASSIS::EM01_Stat2_AR2::CRC_EM01_Stat2_Pr2);
	snprintf(buffer, elcount(buffer), "   0.000000 F1 CPC::EM01_Stat2_AR2::CRC_EM01_Stat2_Pr2 = %d\n", intval);
	filePutString (buffer, elcount(buffer), hFile);
	intval = @sysvar::CH_Nodes::CH_CPCSQC_EM01_Stat2_Pr2EM0_AUTO;
	snprintf(buffer, elcount(buffer), "   0.000000    SV: 2 0 0 ::CH_Nodes::CH_CPCSQC_EM01_Stat2_Pr2EM0_AUTO = %d\n", intval);
	filePutString (buffer, elcount(buffer), hFile);
	intval = getSignal(CHASSIS::EM01_Stat2_AR2::SQC_EM01_Stat2_Pr2);
	snprintf(buffer, elcount(buffer), "   0.000000 F1 CPC::EM01_Stat2_AR2::SQC_EM01_Stat2_Pr2 = %d\n", intval);
	filePutString (buffer, elcount(buffer), hFile);
	intval = getSignal(CHASSIS::EM01_Stat2_AR2::Rsrv1_EM01_Stat2_Pr2);
	snprintf(buffer, elcount(buffer), "   0.000000 F1 CPC::EM01_Stat2_AR2::Rsrv1_EM01_Stat2_Pr2 = %d\n", intval);
	filePutString (buffer, elcount(buffer), hFile);
	floatval = getSignal(CHASSIS::EM01_Stat2_AR2::EM01_TrqAvl_Max);
	snprintf(buffer, elcount(buffer), "   0.000000 F1 CPC::EM01_Stat2_AR2::EM01_TrqAvl_Max = %f\n", floatval);
	filePutString (buffer, elcount(buffer), hFile);
	intval = getSignal(CHASSIS::EM01_Stat2_AR2::EM01_MachStat);
	snprintf(buffer, elcount(buffer), "   0.000000 F1 CPC::EM01_Stat2_AR2::EM01_MachStat = %d\n", intval);
	filePutString (buffer, elcount(buffer), hFile);
	floatval = getSignal(CHASSIS::EM01_Stat2_AR2::EM01_RecupTrq);
	snprintf(buffer, elcount(buffer), "   0.000000 F1 CPC::EM01_Stat2_AR2::EM01_RecupTrq = %f\n", floatval);
	filePutString (buffer, elcount(buffer), hFile);
	intval = getSignal(CHASSIS::EM01_Stat2_AR2::EM01_Intrlk_Err);
	snprintf(buffer, elcount(buffer), "   0.000000 F1 CPC::EM01_Stat2_AR2::EM01_Intrlk_Err = %d\n", intval);
	filePutString (buffer, elcount(buffer), hFile);
	intval = getSignal(CHASSIS::EM01_Stat2_AR2::EM01_RBS_IntrvnDsabl_Rq);
	snprintf(buffer, elcount(buffer), "   0.000000 F1 CPC::EM01_Stat2_AR2::EM01_RBS_IntrvnDsabl_Rq = %d\n", intval);
	filePutString (buffer, elcount(buffer), hFile);
	floatval = getSignal(CHASSIS::EM01_Stat2_AR2::EM01_TrqAvl_Min);
	snprintf(buffer, elcount(buffer), "   0.000000 F1 CPC::EM01_Stat2_AR2::EM01_TrqAvl_Min = %f\n", floatval);
	filePutString (buffer, elcount(buffer), hFile);
	intval = getSignal(CHASSIS::EM01_Stat2_AR2::Rsrv2_EM01_Stat2_Pr2);
	snprintf(buffer, elcount(buffer), "   0.000000 F1 CPC::EM01_Stat2_AR2::Rsrv2_EM01_Stat2_Pr2 = %d\n", intval);
	filePutString (buffer, elcount(buffer), hFile);
	intval = getSignal(CHASSIS::EM01_Stat2_AR2::EM01_Crash_Err);
	snprintf(buffer, elcount(buffer), "   0.000000 F1 CPC::EM01_Stat2_AR2::EM01_Crash_Err = %d\n", intval);
	filePutString (buffer, elcount(buffer), hFile);
	intval = @sysvar::CH_Nodes::CH_CPCCRC_EM01_Trq_Rs_Pr2EM_AUTO;
	snprintf(buffer, elcount(buffer), "   0.000000    SV: 2 0 0 ::CH_Nodes::CH_CPCCRC_EM01_Trq_Rs_Pr2EM_AUTO = %d\n", intval);
	filePutString (buffer, elcount(buffer), hFile);
	intval = getSignal(CHASSIS::EM01_Trq_Rs_AR2::CRC_EM01_Trq_Rs_Pr2);
	snprintf(buffer, elcount(buffer), "   0.000000 F1 CPC::EM01_Trq_Rs_AR2::CRC_EM01_Trq_Rs_Pr2 = %d\n", intval);
	filePutString (buffer, elcount(buffer), hFile);
	intval = @sysvar::CH_Nodes::CH_CPCSQC_EM01_Trq_Rs_Pr2EM_AUTO;
	snprintf(buffer, elcount(buffer), "   0.000000    SV: 2 0 0 ::CH_Nodes::CH_CPCSQC_EM01_Trq_Rs_Pr2EM_AUTO = %d\n", intval);
	filePutString (buffer, elcount(buffer), hFile);
	intval = getSignal(CHASSIS::EM01_Trq_Rs_AR2::SQC_EM01_Trq_Rs_Pr2);
	snprintf(buffer, elcount(buffer), "   0.000000 F1 CPC::EM01_Trq_Rs_AR2::SQC_EM01_Trq_Rs_Pr2 = %d\n", intval);
	filePutString (buffer, elcount(buffer), hFile);
	floatval = getSignal(CHASSIS::EM01_Trq_Rs_AR2::EM01_TrqDynMin);
	snprintf(buffer, elcount(buffer), "   0.000000 F1 CPC::EM01_Trq_Rs_AR2::EM01_TrqDynMin = %f\n", floatval);
	filePutString (buffer, elcount(buffer), hFile);
	floatval = getSignal(CHASSIS::EM01_Trq_Rs_AR2::EM01_TrqStaticMax);
	snprintf(buffer, elcount(buffer), "   0.000000 F1 CPC::EM01_Trq_Rs_AR2::EM01_TrqStaticMax = %f\n", floatval);
	filePutString (buffer, elcount(buffer), hFile);
	floatval = getSignal(CHASSIS::EM01_Trq_Rs_AR2::EM01_TrqStaticMin);
	snprintf(buffer, elcount(buffer), "   0.000000 F1 CPC::EM01_Trq_Rs_AR2::EM01_TrqStaticMin = %f\n", floatval);
	filePutString (buffer, elcount(buffer), hFile);
	floatval = getSignal(CHASSIS::EM01_Trq_Rs_AR2::EM01_TrqDynMax);
	snprintf(buffer, elcount(buffer), "   0.000000 F1 CPC::EM01_Trq_Rs_AR2::EM01_TrqDynMax = %f\n", floatval);
	filePutString (buffer, elcount(buffer), hFile);
	intval = getSignal(CHASSIS::EM_DAC4_AR::EM2_DAC_Data1);
	snprintf(buffer, elcount(buffer), "   0.000000 F1 CPC::EM_DAC4_AR::EM2_DAC_Data1 = %d\n", intval);
	filePutString (buffer, elcount(buffer), hFile);
	intval = getSignal(CHASSIS::EM_DAC4_AR::EM2_DAC_Data2);
	snprintf(buffer, elcount(buffer), "   0.000000 F1 CPC::EM_DAC4_AR::EM2_DAC_Data2 = %d\n", intval);
	filePutString (buffer, elcount(buffer), hFile);
	intval = getSignal(CHASSIS::EM_DAC4_AR::EM2_DAC_Data3);
	snprintf(buffer, elcount(buffer), "   0.000000 F1 CPC::EM_DAC4_AR::EM2_DAC_Data3 = %d\n", intval);
	filePutString (buffer, elcount(buffer), hFile);
	intval = getSignal(CHASSIS::EM_DAC4_AR::EM2_DAC_Data4);
	snprintf(buffer, elcount(buffer), "   0.000000 F1 CPC::EM_DAC4_AR::EM2_DAC_Data4 = %d\n", intval);
	filePutString (buffer, elcount(buffer), hFile);
	intval = getSignal(CHASSIS::EM_DAC4_AR::EM2_DAC_Data5);
	snprintf(buffer, elcount(buffer), "   0.000000 F1 CPC::EM_DAC4_AR::EM2_DAC_Data5 = %d\n", intval);
	filePutString (buffer, elcount(buffer), hFile);
	intval = getSignal(CHASSIS::EM_DAC4_AR::EM2_DAC_Data6);
	snprintf(buffer, elcount(buffer), "   0.000000 F1 CPC::EM_DAC4_AR::EM2_DAC_Data6 = %d\n", intval);
	filePutString (buffer, elcount(buffer), hFile);
	intval = getSignal(CHASSIS::EM_DAC4_AR::EM2_DAC_Data7);
	snprintf(buffer, elcount(buffer), "   0.000000 F1 CPC::EM_DAC4_AR::EM2_DAC_Data7 = %d\n", intval);
	filePutString (buffer, elcount(buffer), hFile);
	intval = getSignal(CHASSIS::EM_DAC4_AR::EM2_DAC_Data8);
	snprintf(buffer, elcount(buffer), "   0.000000 F1 CPC::EM_DAC4_AR::EM2_DAC_Data8 = %d\n", intval);
	filePutString (buffer, elcount(buffer), hFile);
	floatval = getSignal(CHASSIS::EMM_Data1_AR2::PNHV_Chiller_EXV_Posn);
	snprintf(buffer, elcount(buffer), "   0.000000 F1 CPC::EMM_Data1_AR2::PNHV_Chiller_EXV_Posn = %f\n", floatval);
	filePutString (buffer, elcount(buffer), hFile);
	floatval = getSignal(CHASSIS::EMM_Data1_AR2::PNHV_Chiller_RfrgPress);
	snprintf(buffer, elcount(buffer), "   0.000000 F1 CPC::EMM_Data1_AR2::PNHV_Chiller_RfrgPress = %f\n", floatval);
	filePutString (buffer, elcount(buffer), hFile);
	intval = getSignal(CHASSIS::EMM_Data1_AR2::PNHV_RefrgPressSens_Err);
	snprintf(buffer, elcount(buffer), "   0.000000 F1 CPC::EMM_Data1_AR2::PNHV_RefrgPressSens_Err = %d\n", intval);
	filePutString (buffer, elcount(buffer), hFile);
	intval = getSignal(CHASSIS::EMM_Data1_AR2::PNHV_Chiller_EXV_Err);
	snprintf(buffer, elcount(buffer), "   0.000000 F1 CPC::EMM_Data1_AR2::PNHV_Chiller_EXV_Err = %d\n", intval);
	filePutString (buffer, elcount(buffer), hFile);
	intval = getSignal(CHASSIS::EMM_Data1_AR2::EMM_PN48_LoadRdc_Rq);
	snprintf(buffer, elcount(buffer), "   0.000000 F1 CPC::EMM_Data1_AR2::EMM_PN48_LoadRdc_Rq = %d\n", intval);
	filePutString (buffer, elcount(buffer), hFile);
	intval = getSignal(CHASSIS::EMM_Data1_AR2::EMM_WPT_ManSet_Stat);
	snprintf(buffer, elcount(buffer), "   0.000000 F1 CPC::EMM_Data1_AR2::EMM_WPT_ManSet_Stat = %d\n", intval);
	filePutString (buffer, elcount(buffer), hFile);
	intval = getSignal(CHASSIS::EMM_Data1_AR2::PNHV_SupBat_Chrg_Actv);
	snprintf(buffer, elcount(buffer), "   0.000000 F1 CPC::EMM_Data1_AR2::PNHV_SupBat_Chrg_Actv = %d\n", intval);
	filePutString (buffer, elcount(buffer), hFile);
	floatval = getSignal(CHASSIS::EMM_Data1_AR2::EMM_PNHV_Bat_SOC);
	snprintf(buffer, elcount(buffer), "   0.000000 F1 CPC::EMM_Data1_AR2::EMM_PNHV_Bat_SOC = %f\n", floatval);
	filePutString (buffer, elcount(buffer), hFile);
	intval = getSignal(CHASSIS::EMM_Data1_AR2::Bus_Actv_Stat);
	snprintf(buffer, elcount(buffer), "   0.000000 F1 CPC::EMM_Data1_AR2::Bus_Actv_Stat = %d\n", intval);
	filePutString (buffer, elcount(buffer), hFile);
	intval = getSignal(CHASSIS::EnergyMngmnt_PreCond_Stat_AR2::PNHV_PreCond2_Pwr);
	snprintf(buffer, elcount(buffer), "   0.000000 F1 CPC::EnergyMngmnt_PreCond_Stat_AR2::PNHV_PreCond2_Pwr = %d\n", intval);
	filePutString (buffer, elcount(buffer), hFile);
	intval = getSignal(CHASSIS::EnergyMngmnt_PreCond_Stat_AR2::PNHV_PreCond2_Rq);
	snprintf(buffer, elcount(buffer), "   0.000000 F1 CPC::EnergyMngmnt_PreCond_Stat_AR2::PNHV_PreCond2_Rq = %d\n", intval);
	filePutString (buffer, elcount(buffer), hFile);
	intval = getSignal(CHASSIS::EnergyMngmnt_PreCond_Stat_AR2::PNHV_PreCond2_Time_Rq);
	snprintf(buffer, elcount(buffer), "   0.000000 F1 CPC::EnergyMngmnt_PreCond_Stat_AR2::PNHV_PreCond2_Time_Rq = %d\n", intval);
	filePutString (buffer, elcount(buffer), hFile);
	intval = getSignal(CHASSIS::EnergyMngmnt_PreCond_Stat_AR2::PNHV_DCDC_BoostMd_Rq);
	snprintf(buffer, elcount(buffer), "   0.000000 F1 CPC::EnergyMngmnt_PreCond_Stat_AR2::PNHV_DCDC_BoostMd_Rq = %d\n", intval);
	filePutString (buffer, elcount(buffer), hFile);
	intval = getSignal(CHASSIS::EnergyMngmnt_PreCond_Stat_AR2::PNHV_DCDC_BuckMd_Dsabl_Rq);
	snprintf(buffer, elcount(buffer), "   0.000000 F1 CPC::EnergyMngmnt_PreCond_Stat_AR2::PNHV_DCDC_BuckMd_Dsabl_Rq = %d\n", intval);
	filePutString (buffer, elcount(buffer), hFile);
	intval = getSignal(CHASSIS::EnergyMngmnt_PreCond_Stat_AR2::PNHV_Wait4_PreCond2_LED_Rq);
	snprintf(buffer, elcount(buffer), "   0.000000 F1 CPC::EnergyMngmnt_PreCond_Stat_AR2::PNHV_Wait4_PreCond2_LED_Rq = %d\n", intval);
	filePutString (buffer, elcount(buffer), hFile);
	intval = getSignal(CHASSIS::EnergyMngmnt_PreCond_Stat_AR2::PNHV_PreCond1_Err);
	snprintf(buffer, elcount(buffer), "   0.000000 F1 CPC::EnergyMngmnt_PreCond_Stat_AR2::PNHV_PreCond1_Err = %d\n", intval);
	filePutString (buffer, elcount(buffer), hFile);
	intval = getSignal(CHASSIS::EnergyMngmnt_PreCond_Stat_AR2::PNHV_PreCond2_Err);
	snprintf(buffer, elcount(buffer), "   0.000000 F1 CPC::EnergyMngmnt_PreCond_Stat_AR2::PNHV_PreCond2_Err = %d\n", intval);
	filePutString (buffer, elcount(buffer), hFile);
	intval = getSignal(CHASSIS::EnergyMngmnt_PreCond_Stat_AR2::PNHV_PreCond1_Avl_V2);
	snprintf(buffer, elcount(buffer), "   0.000000 F1 CPC::EnergyMngmnt_PreCond_Stat_AR2::PNHV_PreCond1_Avl_V2 = %d\n", intval);
	filePutString (buffer, elcount(buffer), hFile);
	intval = getSignal(CHASSIS::EnergyMngmnt_PreCond_Stat_AR2::PNHV_PreCond2_Dsabl);
	snprintf(buffer, elcount(buffer), "   0.000000 F1 CPC::EnergyMngmnt_PreCond_Stat_AR2::PNHV_PreCond2_Dsabl = %d\n", intval);
	filePutString (buffer, elcount(buffer), hFile);
	intval = getSignal(CHASSIS::EnergyMngmnt_PreCond_Stat_AR2::PNHV_PreCond2_PredTm);
	snprintf(buffer, elcount(buffer), "   0.000000 F1 CPC::EnergyMngmnt_PreCond_Stat_AR2::PNHV_PreCond2_PredTm = %d\n", intval);
	filePutString (buffer, elcount(buffer), hFile);
	intval = getSignal(CHASSIS::EnergyMngmnt_PreCond_Stat_AR2::PNHV_PreCond3_Err);
	snprintf(buffer, elcount(buffer), "   0.000000 F1 CPC::EnergyMngmnt_PreCond_Stat_AR2::PNHV_PreCond3_Err = %d\n", intval);
	filePutString (buffer, elcount(buffer), hFile);
	intval = getSignal(CHASSIS::EnergyMngmnt_PreCond_Stat_AR2::PNHV_PreCond4_Err);
	snprintf(buffer, elcount(buffer), "   0.000000 F1 CPC::EnergyMngmnt_PreCond_Stat_AR2::PNHV_PreCond4_Err = %d\n", intval);
	filePutString (buffer, elcount(buffer), hFile);
	intval = getSignal(CHASSIS::EnergyMngmnt_PreCond_Stat_AR2::PNHV_RemainTm_Wakeup);
	snprintf(buffer, elcount(buffer), "   0.000000 F1 CPC::EnergyMngmnt_PreCond_Stat_AR2::PNHV_RemainTm_Wakeup = %d\n", intval);
	filePutString (buffer, elcount(buffer), hFile);
	intval = @sysvar::CH_Nodes::CH_CPCCRC_Eng_Rs1_Pr2Eng_Rs_AUTO;
	snprintf(buffer, elcount(buffer), "   0.000000    SV: 2 0 0 ::CH_Nodes::CH_CPCCRC_Eng_Rs1_Pr2Eng_Rs_AUTO = %d\n", intval);
	filePutString (buffer, elcount(buffer), hFile);
	intval = getSignal(CHASSIS::Eng_Rs_1_AR2::CRC_Eng_Rs1_Pr2);
	snprintf(buffer, elcount(buffer), "   0.000000 F1 CPC::Eng_Rs_1_AR2::CRC_Eng_Rs1_Pr2 = %d\n", intval);
	filePutString (buffer, elcount(buffer), hFile);
	intval = @sysvar::CH_Nodes::CH_CPCSQC_Eng_Rs1_Pr2Eng_Rs_AUTO;
	snprintf(buffer, elcount(buffer), "   0.000000    SV: 2 0 0 ::CH_Nodes::CH_CPCSQC_Eng_Rs1_Pr2Eng_Rs_AUTO = %d\n", intval);
	filePutString (buffer, elcount(buffer), hFile);
	intval = getSignal(CHASSIS::Eng_Rs_1_AR2::SQC_Eng_Rs1_Pr2);
	snprintf(buffer, elcount(buffer), "   0.000000 F1 CPC::Eng_Rs_1_AR2::SQC_Eng_Rs1_Pr2 = %d\n", intval);
	filePutString (buffer, elcount(buffer), hFile);
}
/*@@end*/

/*@@caplFunc:saveVars_5(dword):*/
void saveVars_5(dword hFile)
{
	intval = getSignal(CHASSIS::Eng_Rs_1_AR2::Rsrv1_Eng_Rs1_Pr2);
	snprintf(buffer, elcount(buffer), "   0.000000 F1 CPC::Eng_Rs_1_AR2::Rsrv1_Eng_Rs1_Pr2 = %d\n", intval);
	filePutString (buffer, elcount(buffer), hFile);
	floatval = getSignal(CHASSIS::Eng_Rs_1_AR2::EngTrqSel_D);
	snprintf(buffer, elcount(buffer), "   0.000000 F1 CPC::Eng_Rs_1_AR2::EngTrqSel_D = %f\n", floatval);
	filePutString (buffer, elcount(buffer), hFile);
	intval = getSignal(CHASSIS::Eng_Rs_1_AR2::BrkRq_ECM);
	snprintf(buffer, elcount(buffer), "   0.000000 F1 CPC::Eng_Rs_1_AR2::BrkRq_ECM = %d\n", intval);
	filePutString (buffer, elcount(buffer), hFile);
	intval = getSignal(CHASSIS::Eng_Rs_1_AR2::EngTrqAdjFast_Enbl);
	snprintf(buffer, elcount(buffer), "   0.000000 F1 CPC::Eng_Rs_1_AR2::EngTrqAdjFast_Enbl = %d\n", intval);
	filePutString (buffer, elcount(buffer), hFile);
	floatval = getSignal(CHASSIS::Eng_Rs_1_AR2::EngTrqSel_ESP);
	snprintf(buffer, elcount(buffer), "   0.000000 F1 CPC::Eng_Rs_1_AR2::EngTrqSel_ESP = %f\n", floatval);
	filePutString (buffer, elcount(buffer), hFile);
	intval = getSignal(CHASSIS::Eng_Rs_1_AR2::EngTrq_ESP_Ack);
	snprintf(buffer, elcount(buffer), "   0.000000 F1 CPC::Eng_Rs_1_AR2::EngTrq_ESP_Ack = %d\n", intval);
	filePutString (buffer, elcount(buffer), hFile);
	intval = getSignal(CHASSIS::Eng_Rs_1_AR2::Rsrv2_Eng_Rs1_Pr2);
	snprintf(buffer, elcount(buffer), "   0.000000 F1 CPC::Eng_Rs_1_AR2::Rsrv2_Eng_Rs1_Pr2 = %d\n", intval);
	filePutString (buffer, elcount(buffer), hFile);
	floatval = getSignal(CHASSIS::Eng_Rs_1_AR2::EngTrqSel_AS);
	snprintf(buffer, elcount(buffer), "   0.000000 F1 CPC::Eng_Rs_1_AR2::EngTrqSel_AS = %f\n", floatval);
	filePutString (buffer, elcount(buffer), hFile);
	intval = getSignal(CHASSIS::Eng_Rs_1_AR2::EngTrq_Enbl_Rq_ESP);
	snprintf(buffer, elcount(buffer), "   0.000000 F1 CPC::Eng_Rs_1_AR2::EngTrq_Enbl_Rq_ESP = %d\n", intval);
	filePutString (buffer, elcount(buffer), hFile);
	intval = getSignal(CHASSIS::Eng_Rs_1_AR2::EngTrq_Enbl_Rq_AS);
	snprintf(buffer, elcount(buffer), "   0.000000 F1 CPC::Eng_Rs_1_AR2::EngTrq_Enbl_Rq_AS = %d\n", intval);
	filePutString (buffer, elcount(buffer), hFile);
	intval = getSignal(CHASSIS::Eng_Rs_1_AR2::Rsrv4_Eng_Rs1_Pr2);
	snprintf(buffer, elcount(buffer), "   0.000000 F1 CPC::Eng_Rs_1_AR2::Rsrv4_Eng_Rs1_Pr2 = %d\n", intval);
	filePutString (buffer, elcount(buffer), hFile);
	intval = @sysvar::CH_Nodes::CH_CPCCRC_Eng_Rs2_Pr2Eng_Rs_AUTO;
	snprintf(buffer, elcount(buffer), "   0.000000    SV: 2 0 0 ::CH_Nodes::CH_CPCCRC_Eng_Rs2_Pr2Eng_Rs_AUTO = %d\n", intval);
	filePutString (buffer, elcount(buffer), hFile);
	intval = getSignal(CHASSIS::Eng_Rs_2_AR2::CRC_Eng_Rs2_Pr2);
	snprintf(buffer, elcount(buffer), "   0.000000 F1 CPC::Eng_Rs_2_AR2::CRC_Eng_Rs2_Pr2 = %d\n", intval);
	filePutString (buffer, elcount(buffer), hFile);
	intval = @sysvar::CH_Nodes::CH_CPCSQC_Eng_Rs2_Pr2Eng_Rs_AUTO;
	snprintf(buffer, elcount(buffer), "   0.000000    SV: 2 0 0 ::CH_Nodes::CH_CPCSQC_Eng_Rs2_Pr2Eng_Rs_AUTO = %d\n", intval);
	filePutString (buffer, elcount(buffer), hFile);
	intval = getSignal(CHASSIS::Eng_Rs_2_AR2::SQC_Eng_Rs2_Pr2);
	snprintf(buffer, elcount(buffer), "   0.000000 F1 CPC::Eng_Rs_2_AR2::SQC_Eng_Rs2_Pr2 = %d\n", intval);
	filePutString (buffer, elcount(buffer), hFile);
	intval = getSignal(CHASSIS::Eng_Rs_2_AR2::Rsrv1_Eng_Rs2_Pr2);
	snprintf(buffer, elcount(buffer), "   0.000000 F1 CPC::Eng_Rs_2_AR2::Rsrv1_Eng_Rs2_Pr2 = %d\n", intval);
	filePutString (buffer, elcount(buffer), hFile);
	floatval = getSignal(CHASSIS::Eng_Rs_2_AR2::EngTrqMax);
	snprintf(buffer, elcount(buffer), "   0.000000 F1 CPC::Eng_Rs_2_AR2::EngTrqMax = %f\n", floatval);
	filePutString (buffer, elcount(buffer), hFile);
	intval = getSignal(CHASSIS::Eng_Rs_2_AR2::Rsrv2_Eng_Rs2_Pr2);
	snprintf(buffer, elcount(buffer), "   0.000000 F1 CPC::Eng_Rs_2_AR2::Rsrv2_Eng_Rs2_Pr2 = %d\n", intval);
	filePutString (buffer, elcount(buffer), hFile);
	floatval = getSignal(CHASSIS::Eng_Rs_2_AR2::EngTrqMin);
	snprintf(buffer, elcount(buffer), "   0.000000 F1 CPC::Eng_Rs_2_AR2::EngTrqMin = %f\n", floatval);
	filePutString (buffer, elcount(buffer), hFile);
	intval = getSignal(CHASSIS::Eng_Rs_2_AR2::Rsrv3_Eng_Rs2_Pr2);
	snprintf(buffer, elcount(buffer), "   0.000000 F1 CPC::Eng_Rs_2_AR2::Rsrv3_Eng_Rs2_Pr2 = %d\n", intval);
	filePutString (buffer, elcount(buffer), hFile);
	floatval = getSignal(CHASSIS::Eng_Rs_2_AR2::EngTrqStatic);
	snprintf(buffer, elcount(buffer), "   0.000000 F1 CPC::Eng_Rs_2_AR2::EngTrqStatic = %f\n", floatval);
	filePutString (buffer, elcount(buffer), hFile);
	intval = getSignal(CHASSIS::Eng_Rs_2_AR2::Rsrv4_Eng_Rs2_Pr2);
	snprintf(buffer, elcount(buffer), "   0.000000 F1 CPC::Eng_Rs_2_AR2::Rsrv4_Eng_Rs2_Pr2 = %d\n", intval);
	filePutString (buffer, elcount(buffer), hFile);
	intval = @sysvar::CH_Nodes::CH_CPCCRC_Eng_Rs3_Pr2Eng_Rs_AUTO;
	snprintf(buffer, elcount(buffer), "   0.000000    SV: 2 0 0 ::CH_Nodes::CH_CPCCRC_Eng_Rs3_Pr2Eng_Rs_AUTO = %d\n", intval);
	filePutString (buffer, elcount(buffer), hFile);
	intval = getSignal(CHASSIS::Eng_Rs_3_AR2::CRC_Eng_Rs3_Pr2);
	snprintf(buffer, elcount(buffer), "   0.000000 F1 CPC::Eng_Rs_3_AR2::CRC_Eng_Rs3_Pr2 = %d\n", intval);
	filePutString (buffer, elcount(buffer), hFile);
	intval = @sysvar::CH_Nodes::CH_CPCSQC_Eng_Rs3_Pr2Eng_Rs_AUTO;
	snprintf(buffer, elcount(buffer), "   0.000000    SV: 2 0 0 ::CH_Nodes::CH_CPCSQC_Eng_Rs3_Pr2Eng_Rs_AUTO = %d\n", intval);
	filePutString (buffer, elcount(buffer), hFile);
	intval = getSignal(CHASSIS::Eng_Rs_3_AR2::SQC_Eng_Rs3_Pr2);
	snprintf(buffer, elcount(buffer), "   0.000000 F1 CPC::Eng_Rs_3_AR2::SQC_Eng_Rs3_Pr2 = %d\n", intval);
	filePutString (buffer, elcount(buffer), hFile);
	intval = getSignal(CHASSIS::Eng_Rs_3_AR2::KickDnSw_Psd);
	snprintf(buffer, elcount(buffer), "   0.000000 F1 CPC::Eng_Rs_3_AR2::KickDnSw_Psd = %d\n", intval);
	filePutString (buffer, elcount(buffer), hFile);
	intval = getSignal(CHASSIS::Eng_Rs_3_AR2::AccelPdlPosnSens_Flt);
	snprintf(buffer, elcount(buffer), "   0.000000 F1 CPC::Eng_Rs_3_AR2::AccelPdlPosnSens_Flt = %d\n", intval);
	filePutString (buffer, elcount(buffer), hFile);
	intval = getSignal(CHASSIS::Eng_Rs_3_AR2::Rsrv2_Eng_Rs3_Pr2);
	snprintf(buffer, elcount(buffer), "   0.000000 F1 CPC::Eng_Rs_3_AR2::Rsrv2_Eng_Rs3_Pr2 = %d\n", intval);
	filePutString (buffer, elcount(buffer), hFile);
	intval = getSignal(CHASSIS::Eng_Rs_3_AR2::StartBrk_Rq_ECM);
	snprintf(buffer, elcount(buffer), "   0.000000 F1 CPC::Eng_Rs_3_AR2::StartBrk_Rq_ECM = %d\n", intval);
	filePutString (buffer, elcount(buffer), hFile);
	floatval = getSignal(CHASSIS::Eng_Rs_3_AR2::AccelPdlPosn);
	snprintf(buffer, elcount(buffer), "   0.000000 F1 CPC::Eng_Rs_3_AR2::AccelPdlPosn = %f\n", floatval);
	filePutString (buffer, elcount(buffer), hFile);
	floatval = getSignal(CHASSIS::Eng_Rs_3_AR2::AccelPdlPosn_Raw);
	snprintf(buffer, elcount(buffer), "   0.000000 F1 CPC::Eng_Rs_3_AR2::AccelPdlPosn_Raw = %f\n", floatval);
	filePutString (buffer, elcount(buffer), hFile);
	floatval = getSignal(CHASSIS::Eng_Rs_3_AR2::AccelPdlPosn_D_Raw);
	snprintf(buffer, elcount(buffer), "   0.000000 F1 CPC::Eng_Rs_3_AR2::AccelPdlPosn_D_Raw = %f\n", floatval);
	filePutString (buffer, elcount(buffer), hFile);
	intval = getSignal(CHASSIS::Eng_Rs_3_AR2::Tcc_Trq_Adpn_Rq);
	snprintf(buffer, elcount(buffer), "   0.000000 F1 CPC::Eng_Rs_3_AR2::Tcc_Trq_Adpn_Rq = %d\n", intval);
	filePutString (buffer, elcount(buffer), hFile);
	intval = getSignal(CHASSIS::Eng_Rs_3_AR2::DrvAwaySpd_Rq_TCM);
	snprintf(buffer, elcount(buffer), "   0.000000 F1 CPC::Eng_Rs_3_AR2::DrvAwaySpd_Rq_TCM = %d\n", intval);
	filePutString (buffer, elcount(buffer), hFile);
	intval = @sysvar::CH_Nodes::CH_CPCCRC_Eng_Rs_EM_Pr2Eng__AUTO;
	snprintf(buffer, elcount(buffer), "   0.000000    SV: 2 0 0 ::CH_Nodes::CH_CPCCRC_Eng_Rs_EM_Pr2Eng__AUTO = %d\n", intval);
	filePutString (buffer, elcount(buffer), hFile);
	intval = getSignal(CHASSIS::Eng_Rs_EM_AR2::CRC_Eng_Rs_EM_Pr2);
	snprintf(buffer, elcount(buffer), "   0.000000 F1 CPC::Eng_Rs_EM_AR2::CRC_Eng_Rs_EM_Pr2 = %d\n", intval);
	filePutString (buffer, elcount(buffer), hFile);
	intval = @sysvar::CH_Nodes::CH_CPCSQC_Eng_Rs_EM_Pr2Eng__AUTO;
	snprintf(buffer, elcount(buffer), "   0.000000    SV: 2 0 0 ::CH_Nodes::CH_CPCSQC_Eng_Rs_EM_Pr2Eng__AUTO = %d\n", intval);
	filePutString (buffer, elcount(buffer), hFile);
	intval = getSignal(CHASSIS::Eng_Rs_EM_AR2::SQC_Eng_Rs_EM_Pr2);
	snprintf(buffer, elcount(buffer), "   0.000000 F1 CPC::Eng_Rs_EM_AR2::SQC_Eng_Rs_EM_Pr2 = %d\n", intval);
	filePutString (buffer, elcount(buffer), hFile);
	intval = getSignal(CHASSIS::Eng_Rs_EM_AR2::Rsrv1_Eng_Rs_EM_Pr2);
	snprintf(buffer, elcount(buffer), "   0.000000 F1 CPC::Eng_Rs_EM_AR2::Rsrv1_Eng_Rs_EM_Pr2 = %d\n", intval);
	filePutString (buffer, elcount(buffer), hFile);
	floatval = getSignal(CHASSIS::Eng_Rs_EM_AR2::EngTrqMin_EM);
	snprintf(buffer, elcount(buffer), "   0.000000 F1 CPC::Eng_Rs_EM_AR2::EngTrqMin_EM = %f\n", floatval);
	filePutString (buffer, elcount(buffer), hFile);
	intval = getSignal(CHASSIS::Eng_Rs_EM_AR2::PT_Md_Chg);
	snprintf(buffer, elcount(buffer), "   0.000000 F1 CPC::Eng_Rs_EM_AR2::PT_Md_Chg = %d\n", intval);
	filePutString (buffer, elcount(buffer), hFile);
	intval = getSignal(CHASSIS::Eng_Rs_EM_AR2::Rsrv3_Eng_Rs_EM_Pr2);
	snprintf(buffer, elcount(buffer), "   0.000000 F1 CPC::Eng_Rs_EM_AR2::Rsrv3_Eng_Rs_EM_Pr2 = %d\n", intval);
	filePutString (buffer, elcount(buffer), hFile);
	intval = getSignal(CHASSIS::Eng_Rs_EM_AR2::Rsrv5_Eng_Rs_EM_Pr2);
	snprintf(buffer, elcount(buffer), "   0.000000 F1 CPC::Eng_Rs_EM_AR2::Rsrv5_Eng_Rs_EM_Pr2 = %d\n", intval);
	filePutString (buffer, elcount(buffer), hFile);
	intval = getSignal(CHASSIS::Eng_Rs_EM_AR2::EM_MaxTrqIntrvntn_Posbl);
	snprintf(buffer, elcount(buffer), "   0.000000 F1 CPC::Eng_Rs_EM_AR2::EM_MaxTrqIntrvntn_Posbl = %d\n", intval);
	filePutString (buffer, elcount(buffer), hFile);
	intval = getSignal(CHASSIS::Eng_Rs_EM_AR2::Rsrv2_Eng_Rs_EM_Pr2);
	snprintf(buffer, elcount(buffer), "   0.000000 F1 CPC::Eng_Rs_EM_AR2::Rsrv2_Eng_Rs_EM_Pr2 = %d\n", intval);
	filePutString (buffer, elcount(buffer), hFile);
	floatval = getSignal(CHASSIS::Eng_Rs_EM_AR2::EngTrqMinTTC_Corr);
	snprintf(buffer, elcount(buffer), "   0.000000 F1 CPC::Eng_Rs_EM_AR2::EngTrqMinTTC_Corr = %f\n", floatval);
	filePutString (buffer, elcount(buffer), hFile);
	intval = getSignal(CHASSIS::Eng_Rs_EM_AR2::Rsrv4_Eng_Rs_EM_Pr2);
	snprintf(buffer, elcount(buffer), "   0.000000 F1 CPC::Eng_Rs_EM_AR2::Rsrv4_Eng_Rs_EM_Pr2 = %d\n", intval);
	filePutString (buffer, elcount(buffer), hFile);
	intval = @sysvar::CH_Nodes::CH_CPCCRC_Eng_Rs_EngCtrl_Pr_AUTO;
	snprintf(buffer, elcount(buffer), "   0.000000    SV: 2 0 0 ::CH_Nodes::CH_CPCCRC_Eng_Rs_EngCtrl_Pr_AUTO = %d\n", intval);
	filePutString (buffer, elcount(buffer), hFile);
	intval = getSignal(CHASSIS::Eng_Rs_EngCtrl_AR2::CRC_Eng_Rs_EngCtrl_Pr2);
	snprintf(buffer, elcount(buffer), "   0.000000 F1 CPC::Eng_Rs_EngCtrl_AR2::CRC_Eng_Rs_EngCtrl_Pr2 = %d\n", intval);
	filePutString (buffer, elcount(buffer), hFile);
	intval = @sysvar::CH_Nodes::CH_CPCSQC_Eng_Rs_EngCtrl_Pr_AUTO;
	snprintf(buffer, elcount(buffer), "   0.000000    SV: 2 0 0 ::CH_Nodes::CH_CPCSQC_Eng_Rs_EngCtrl_Pr_AUTO = %d\n", intval);
	filePutString (buffer, elcount(buffer), hFile);
	intval = getSignal(CHASSIS::Eng_Rs_EngCtrl_AR2::SQC_Eng_Rs_EngCtrl_Pr2);
	snprintf(buffer, elcount(buffer), "   0.000000 F1 CPC::Eng_Rs_EngCtrl_AR2::SQC_Eng_Rs_EngCtrl_Pr2 = %d\n", intval);
	filePutString (buffer, elcount(buffer), hFile);
	intval = getSignal(CHASSIS::Eng_Rs_EngCtrl_AR2::EngRun_Stat);
	snprintf(buffer, elcount(buffer), "   0.000000 F1 CPC::Eng_Rs_EngCtrl_AR2::EngRun_Stat = %d\n", intval);
	filePutString (buffer, elcount(buffer), hFile);
	intval = getSignal(CHASSIS::Eng_Rs_EngCtrl_AR2::AddPwrCnsmr_On_Rq);
	snprintf(buffer, elcount(buffer), "   0.000000 F1 CPC::Eng_Rs_EngCtrl_AR2::AddPwrCnsmr_On_Rq = %d\n", intval);
	filePutString (buffer, elcount(buffer), hFile);
	floatval = getSignal(CHASSIS::Eng_Rs_EngCtrl_AR2::EngTrqMaxCorrFctr);
	snprintf(buffer, elcount(buffer), "   0.000000 F1 CPC::Eng_Rs_EngCtrl_AR2::EngTrqMaxCorrFctr = %f\n", floatval);
	filePutString (buffer, elcount(buffer), hFile);
	intval = getSignal(CHASSIS::Eng_Rs_EngCtrl_AR2::EngRPM);
	snprintf(buffer, elcount(buffer), "   0.000000 F1 CPC::Eng_Rs_EngCtrl_AR2::EngRPM = %d\n", intval);
	filePutString (buffer, elcount(buffer), hFile);
	intval = getSignal(CHASSIS::Eng_Rs_EngCtrl_AR2::EngRPM_Sens_LHOM);
	snprintf(buffer, elcount(buffer), "   0.000000 F1 CPC::Eng_Rs_EngCtrl_AR2::EngRPM_Sens_LHOM = %d\n", intval);
	filePutString (buffer, elcount(buffer), hFile);
	intval = getSignal(CHASSIS::Eng_Rs_EngCtrl_AR2::EngTrqLmtd_Misfire);
	snprintf(buffer, elcount(buffer), "   0.000000 F1 CPC::Eng_Rs_EngCtrl_AR2::EngTrqLmtd_Misfire = %d\n", intval);
	filePutString (buffer, elcount(buffer), hFile);
	floatval = getSignal(CHASSIS::Eng_Rs_EngCtrl_AR2::EngTrq);
	snprintf(buffer, elcount(buffer), "   0.000000 F1 CPC::Eng_Rs_EngCtrl_AR2::EngTrq = %f\n", floatval);
	filePutString (buffer, elcount(buffer), hFile);
}
/*@@end*/

/*@@caplFunc:saveVars_6(dword):*/
void saveVars_6(dword hFile)
{
	intval = getSignal(CHASSIS::Eng_Rs_EngCtrl_AR2::Rsrv2_Eng_Rs_EngCtrl_Pr2);
	snprintf(buffer, elcount(buffer), "   0.000000 F1 CPC::Eng_Rs_EngCtrl_AR2::Rsrv2_Eng_Rs_EngCtrl_Pr2 = %d\n", intval);
	filePutString (buffer, elcount(buffer), hFile);
	intval = getSignal(CHASSIS::Eng_Rs_EngCtrl_AR2::OFC_Stat_PT);
	snprintf(buffer, elcount(buffer), "   0.000000 F1 CPC::Eng_Rs_EngCtrl_AR2::OFC_Stat_PT = %d\n", intval);
	filePutString (buffer, elcount(buffer), hFile);
	intval = getSignal(CHASSIS::Eng_Rs_EngCtrl_AR2::EngStyle);
	snprintf(buffer, elcount(buffer), "   0.000000 F1 CPC::Eng_Rs_EngCtrl_AR2::EngStyle = %d\n", intval);
	filePutString (buffer, elcount(buffer), hFile);
	intval = getSignal(CHASSIS::EngCtrl_Disp_Rq_AR2::AirStrIndLmp_On_Rq);
	snprintf(buffer, elcount(buffer), "   0.000000 F1 CPC::EngCtrl_Disp_Rq_AR2::AirStrIndLmp_On_Rq = %d\n", intval);
	filePutString (buffer, elcount(buffer), hFile);
	intval = getSignal(CHASSIS::EngCtrl_Disp_Rq_AR2::ParticleFltrWarn);
	snprintf(buffer, elcount(buffer), "   0.000000 F1 CPC::EngCtrl_Disp_Rq_AR2::ParticleFltrWarn = %d\n", intval);
	filePutString (buffer, elcount(buffer), hFile);
	intval = getSignal(CHASSIS::EngCtrl_Disp_Rq_AR2::MIL_On_Rq);
	snprintf(buffer, elcount(buffer), "   0.000000 F1 CPC::EngCtrl_Disp_Rq_AR2::MIL_On_Rq = %d\n", intval);
	filePutString (buffer, elcount(buffer), hFile);
	intval = getSignal(CHASSIS::EngCtrl_Disp_Rq_AR2::PreHtIndLmp_On_Rq);
	snprintf(buffer, elcount(buffer), "   0.000000 F1 CPC::EngCtrl_Disp_Rq_AR2::PreHtIndLmp_On_Rq = %d\n", intval);
	filePutString (buffer, elcount(buffer), hFile);
	intval = getSignal(CHASSIS::EngCtrl_Disp_Rq_AR2::TankCapIndLmp_On_Rq);
	snprintf(buffer, elcount(buffer), "   0.000000 F1 CPC::EngCtrl_Disp_Rq_AR2::TankCapIndLmp_On_Rq = %d\n", intval);
	filePutString (buffer, elcount(buffer), hFile);
	intval = getSignal(CHASSIS::EngCtrl_Disp_Rq_AR2::WtrFuelIndLmp_On_Rq);
	snprintf(buffer, elcount(buffer), "   0.000000 F1 CPC::EngCtrl_Disp_Rq_AR2::WtrFuelIndLmp_On_Rq = %d\n", intval);
	filePutString (buffer, elcount(buffer), hFile);
	intval = getSignal(CHASSIS::EngCtrl_Disp_Rq_AR2::DAC_StErr);
	snprintf(buffer, elcount(buffer), "   0.000000 F1 CPC::EngCtrl_Disp_Rq_AR2::DAC_StErr = %d\n", intval);
	filePutString (buffer, elcount(buffer), hFile);
	intval = getSignal(CHASSIS::EngCtrl_Disp_Rq_AR2::EngOilLvl_Sens_Foam_Dtct);
	snprintf(buffer, elcount(buffer), "   0.000000 F1 CPC::EngCtrl_Disp_Rq_AR2::EngOilLvl_Sens_Foam_Dtct = %d\n", intval);
	filePutString (buffer, elcount(buffer), hFile);
	intval = getSignal(CHASSIS::EngCtrl_Disp_Rq_AR2::EngOilLvl_Sens_LowTemp_Dtct);
	snprintf(buffer, elcount(buffer), "   0.000000 F1 CPC::EngCtrl_Disp_Rq_AR2::EngOilLvl_Sens_LowTemp_Dtct = %d\n", intval);
	filePutString (buffer, elcount(buffer), hFile);
	intval = getSignal(CHASSIS::EngCtrl_Disp_Rq_AR2::OvrRPM_Actv);
	snprintf(buffer, elcount(buffer), "   0.000000 F1 CPC::EngCtrl_Disp_Rq_AR2::OvrRPM_Actv = %d\n", intval);
	filePutString (buffer, elcount(buffer), hFile);
	intval = getSignal(CHASSIS::EngCtrl_Disp_Rq_AR2::TankPressCtrlDisp_Rq);
	snprintf(buffer, elcount(buffer), "   0.000000 F1 CPC::EngCtrl_Disp_Rq_AR2::TankPressCtrlDisp_Rq = %d\n", intval);
	filePutString (buffer, elcount(buffer), hFile);
	intval = getSignal(CHASSIS::EngCtrl_Disp_Rq_AR2::EngOilLvl_V2);
	snprintf(buffer, elcount(buffer), "   0.000000 F1 CPC::EngCtrl_Disp_Rq_AR2::EngOilLvl_V2 = %d\n", intval);
	filePutString (buffer, elcount(buffer), hFile);
	floatval = getSignal(CHASSIS::EngCtrl_Disp_Rq_AR2::EngOilPress_Disp_Rq);
	snprintf(buffer, elcount(buffer), "   0.000000 F1 CPC::EngCtrl_Disp_Rq_AR2::EngOilPress_Disp_Rq = %f\n", floatval);
	filePutString (buffer, elcount(buffer), hFile);
	floatval = getSignal(CHASSIS::EngCtrl_Disp_Rq_AR2::BoostPress_Disp_Rq);
	snprintf(buffer, elcount(buffer), "   0.000000 F1 CPC::EngCtrl_Disp_Rq_AR2::BoostPress_Disp_Rq = %f\n", floatval);
	filePutString (buffer, elcount(buffer), hFile);
	intval = getSignal(CHASSIS::EngCtrl_Disp_Rq_AR2::EngCoolTemp_Disp_Rq);
	snprintf(buffer, elcount(buffer), "   0.000000 F1 CPC::EngCtrl_Disp_Rq_AR2::EngCoolTemp_Disp_Rq = %d\n", intval);
	filePutString (buffer, elcount(buffer), hFile);
	intval = getSignal(CHASSIS::EngCtrl_Disp_Rq_AR2::EngIdleRPM_Dsr);
	snprintf(buffer, elcount(buffer), "   0.000000 F1 CPC::EngCtrl_Disp_Rq_AR2::EngIdleRPM_Dsr = %d\n", intval);
	filePutString (buffer, elcount(buffer), hFile);
	intval = getSignal(CHASSIS::EngCtrl_Disp_Rq_AR2::EngOilIndLmp_On_Rq);
	snprintf(buffer, elcount(buffer), "   0.000000 F1 CPC::EngCtrl_Disp_Rq_AR2::EngOilIndLmp_On_Rq = %d\n", intval);
	filePutString (buffer, elcount(buffer), hFile);
	intval = getSignal(CHASSIS::EngCtrl_Disp_Rq_AR2::EngOilTemp_Above_Max);
	snprintf(buffer, elcount(buffer), "   0.000000 F1 CPC::EngCtrl_Disp_Rq_AR2::EngOilTemp_Above_Max = %d\n", intval);
	filePutString (buffer, elcount(buffer), hFile);
	intval = getSignal(CHASSIS::EngCtrl_OBD1_AR::FuelPress_OBD);
	snprintf(buffer, elcount(buffer), "   0.000000 F1 CPC::EngCtrl_OBD1_AR::FuelPress_OBD = %d\n", intval);
	filePutString (buffer, elcount(buffer), hFile);
	floatval = getSignal(CHASSIS::EngCtrl_OBD1_AR::AirFlowRate);
	snprintf(buffer, elcount(buffer), "   0.000000 F1 CPC::EngCtrl_OBD1_AR::AirFlowRate = %f\n", floatval);
	filePutString (buffer, elcount(buffer), hFile);
	intval = getSignal(CHASSIS::EngCtrl_OBD1_AR::AirPress_Manifold);
	snprintf(buffer, elcount(buffer), "   0.000000 F1 CPC::EngCtrl_OBD1_AR::AirPress_Manifold = %d\n", intval);
	filePutString (buffer, elcount(buffer), hFile);
	floatval = getSignal(CHASSIS::EngCtrl_OBD1_AR::EngLoad_OBD);
	snprintf(buffer, elcount(buffer), "   0.000000 F1 CPC::EngCtrl_OBD1_AR::EngLoad_OBD = %f\n", floatval);
	filePutString (buffer, elcount(buffer), hFile);
	intval = getSignal(CHASSIS::EngCtrl_OBD1_AR::OBD_DrvCycCond_Stat);
	snprintf(buffer, elcount(buffer), "   0.000000 F1 CPC::EngCtrl_OBD1_AR::OBD_DrvCycCond_Stat = %d\n", intval);
	filePutString (buffer, elcount(buffer), hFile);
	intval = getSignal(CHASSIS::EngCtrl_OBD1_AR::OBD_GnrlDenCond_Stat);
	snprintf(buffer, elcount(buffer), "   0.000000 F1 CPC::EngCtrl_OBD1_AR::OBD_GnrlDenCond_Stat = %d\n", intval);
	filePutString (buffer, elcount(buffer), hFile);
	intval = getSignal(CHASSIS::EngCtrl_OBD1_AR::OBD_WarmupCond_Actv);
	snprintf(buffer, elcount(buffer), "   0.000000 F1 CPC::EngCtrl_OBD1_AR::OBD_WarmupCond_Actv = %d\n", intval);
	filePutString (buffer, elcount(buffer), hFile);
	intval = getSignal(CHASSIS::EngCtrl_OBD1_AR::AirTemp_Outsd_Sens_Flt);
	snprintf(buffer, elcount(buffer), "   0.000000 F1 CPC::EngCtrl_OBD1_AR::AirTemp_Outsd_Sens_Flt = %d\n", intval);
	filePutString (buffer, elcount(buffer), hFile);
	intval = getSignal(CHASSIS::EngCtrl_OBD1_AR::OBD_GnrlDenCond_PDTC_Del);
	snprintf(buffer, elcount(buffer), "   0.000000 F1 CPC::EngCtrl_OBD1_AR::OBD_GnrlDenCond_PDTC_Del = %d\n", intval);
	filePutString (buffer, elcount(buffer), hFile);
	intval = getSignal(CHASSIS::EngCtrl_OBD1_AR::OBD_Clr_Rq);
	snprintf(buffer, elcount(buffer), "   0.000000 F1 CPC::EngCtrl_OBD1_AR::OBD_Clr_Rq = %d\n", intval);
	filePutString (buffer, elcount(buffer), hFile);
	intval = getSignal(CHASSIS::EngCtrl_OBD1_AR::OBD_ColdStartDenCond_Stat);
	snprintf(buffer, elcount(buffer), "   0.000000 F1 CPC::EngCtrl_OBD1_AR::OBD_ColdStartDenCond_Stat = %d\n", intval);
	filePutString (buffer, elcount(buffer), hFile);
	intval = getSignal(CHASSIS::EngCtrl_OBD1_AR::OBD_IgnCycCond_Stat);
	snprintf(buffer, elcount(buffer), "   0.000000 F1 CPC::EngCtrl_OBD1_AR::OBD_IgnCycCond_Stat = %d\n", intval);
	filePutString (buffer, elcount(buffer), hFile);
	intval = getSignal(CHASSIS::EngCtrl_OBD1_AR::OBD_IgnCycCondICE_Stat);
	snprintf(buffer, elcount(buffer), "   0.000000 F1 CPC::EngCtrl_OBD1_AR::OBD_IgnCycCondICE_Stat = %d\n", intval);
	filePutString (buffer, elcount(buffer), hFile);
	intval = getSignal(CHASSIS::EngCtrl_OBD1_AR::OBD_ColdStartERS_Actv);
	snprintf(buffer, elcount(buffer), "   0.000000 F1 CPC::EngCtrl_OBD1_AR::OBD_ColdStartERS_Actv = %d\n", intval);
	filePutString (buffer, elcount(buffer), hFile);
	intval = getSignal(CHASSIS::EngCtrl_OBD1_AR::OBD_Md04_enbl);
	snprintf(buffer, elcount(buffer), "   0.000000 F1 CPC::EngCtrl_OBD1_AR::OBD_Md04_enbl = %d\n", intval);
	filePutString (buffer, elcount(buffer), hFile);
	floatval = getSignal(CHASSIS::EngCtrl_Stat_AR2::EngOilQual);
	snprintf(buffer, elcount(buffer), "   0.000000 F1 CPC::EngCtrl_Stat_AR2::EngOilQual = %f\n", floatval);
	filePutString (buffer, elcount(buffer), hFile);
	floatval = getSignal(CHASSIS::EngCtrl_Stat_AR2::FuelCons);
	snprintf(buffer, elcount(buffer), "   0.000000 F1 CPC::EngCtrl_Stat_AR2::FuelCons = %f\n", floatval);
	filePutString (buffer, elcount(buffer), hFile);
	intval = getSignal(CHASSIS::EngCtrl_Stat_AR2::IntkAirTemp);
	snprintf(buffer, elcount(buffer), "   0.000000 F1 CPC::EngCtrl_Stat_AR2::IntkAirTemp = %d\n", intval);
	filePutString (buffer, elcount(buffer), hFile);
	intval = getSignal(CHASSIS::EngCtrl_Stat_AR2::EngCoolTemp);
	snprintf(buffer, elcount(buffer), "   0.000000 F1 CPC::EngCtrl_Stat_AR2::EngCoolTemp = %d\n", intval);
	filePutString (buffer, elcount(buffer), hFile);
	floatval = getSignal(CHASSIS::EngCtrl_Stat_AR2::AirPress_Outsd);
	snprintf(buffer, elcount(buffer), "   0.000000 F1 CPC::EngCtrl_Stat_AR2::AirPress_Outsd = %f\n", floatval);
	filePutString (buffer, elcount(buffer), hFile);
	intval = getSignal(CHASSIS::EngCtrl_Stat_AR2::PN14_EHC_Prio_Rq);
	snprintf(buffer, elcount(buffer), "   0.000000 F1 CPC::EngCtrl_Stat_AR2::PN14_EHC_Prio_Rq = %d\n", intval);
	filePutString (buffer, elcount(buffer), hFile);
	intval = getSignal(CHASSIS::EngCtrl_Stat_AR2::PreHt_Stat);
	snprintf(buffer, elcount(buffer), "   0.000000 F1 CPC::EngCtrl_Stat_AR2::PreHt_Stat = %d\n", intval);
	filePutString (buffer, elcount(buffer), hFile);
	intval = getSignal(CHASSIS::EngCtrl_Stat_AR2::CylCutoff_Stat);
	snprintf(buffer, elcount(buffer), "   0.000000 F1 CPC::EngCtrl_Stat_AR2::CylCutoff_Stat = %d\n", intval);
	filePutString (buffer, elcount(buffer), hFile);
	floatval = getSignal(CHASSIS::ESP_OBD_Data_AR::AccelPdlPosn_OBD);
	snprintf(buffer, elcount(buffer), "   0.000000 F1 CPC::ESP_OBD_Data_AR::AccelPdlPosn_OBD = %f\n", floatval);
	filePutString (buffer, elcount(buffer), hFile);
	floatval = getSignal(CHASSIS::ESP_OBD_Data_AR::AccelPdlPosn_Red_OBD);
	snprintf(buffer, elcount(buffer), "   0.000000 F1 CPC::ESP_OBD_Data_AR::AccelPdlPosn_Red_OBD = %f\n", floatval);
	filePutString (buffer, elcount(buffer), hFile);
	intval = getSignal(CHASSIS::Fuel_Stat2_AR2::TankRng);
	snprintf(buffer, elcount(buffer), "   0.000000 F1 CPC::Fuel_Stat2_AR2::TankRng = %d\n", intval);
	filePutString (buffer, elcount(buffer), hFile);
	intval = getSignal(CHASSIS::Fuel_Stat2_AR2::FuelType_Gasoline_Avl);
	snprintf(buffer, elcount(buffer), "   0.000000 F1 CPC::Fuel_Stat2_AR2::FuelType_Gasoline_Avl = %d\n", intval);
	filePutString (buffer, elcount(buffer), hFile);
	intval = getSignal(CHASSIS::Fuel_Stat2_AR2::FuelType_Diesel_Avl);
	snprintf(buffer, elcount(buffer), "   0.000000 F1 CPC::Fuel_Stat2_AR2::FuelType_Diesel_Avl = %d\n", intval);
	filePutString (buffer, elcount(buffer), hFile);
	intval = getSignal(CHASSIS::Fuel_Stat2_AR2::FuelType_CNG_Avl);
	snprintf(buffer, elcount(buffer), "   0.000000 F1 CPC::Fuel_Stat2_AR2::FuelType_CNG_Avl = %d\n", intval);
	filePutString (buffer, elcount(buffer), hFile);
	intval = getSignal(CHASSIS::Fuel_Stat2_AR2::FuelType_ElecPlugIn_Avl);
	snprintf(buffer, elcount(buffer), "   0.000000 F1 CPC::Fuel_Stat2_AR2::FuelType_ElecPlugIn_Avl = %d\n", intval);
	filePutString (buffer, elcount(buffer), hFile);
}
/*@@end*/

/*@@caplFunc:saveVars_7(dword):*/
void saveVars_7(dword hFile)
{
	intval = getSignal(CHASSIS::Fuel_Stat2_AR2::FuelType_Ethanol_Avl);
	snprintf(buffer, elcount(buffer), "   0.000000 F1 CPC::Fuel_Stat2_AR2::FuelType_Ethanol_Avl = %d\n", intval);
	filePutString (buffer, elcount(buffer), hFile);
	intval = getSignal(CHASSIS::Fuel_Stat2_AR2::FuelType_Hydrogen_Avl);
	snprintf(buffer, elcount(buffer), "   0.000000 F1 CPC::Fuel_Stat2_AR2::FuelType_Hydrogen_Avl = %d\n", intval);
	filePutString (buffer, elcount(buffer), hFile);
	intval = getSignal(CHASSIS::Fuel_Stat2_AR2::FuelType_AdBlue_Avl);
	snprintf(buffer, elcount(buffer), "   0.000000 F1 CPC::Fuel_Stat2_AR2::FuelType_AdBlue_Avl = %d\n", intval);
	filePutString (buffer, elcount(buffer), hFile);
	intval = getSignal(CHASSIS::Fuel_Stat2_AR2::FuelTypeCfg_Vld);
	snprintf(buffer, elcount(buffer), "   0.000000 F1 CPC::Fuel_Stat2_AR2::FuelTypeCfg_Vld = %d\n", intval);
	filePutString (buffer, elcount(buffer), hFile);
	intval = getSignal(CHASSIS::Fuel_Stat2_AR2::HybDrv_Avl);
	snprintf(buffer, elcount(buffer), "   0.000000 F1 CPC::Fuel_Stat2_AR2::HybDrv_Avl = %d\n", intval);
	filePutString (buffer, elcount(buffer), hFile);
	intval = getSignal(CHASSIS::Fuel_Stat2_AR2::PNHV_Avl);
	snprintf(buffer, elcount(buffer), "   0.000000 F1 CPC::Fuel_Stat2_AR2::PNHV_Avl = %d\n", intval);
	filePutString (buffer, elcount(buffer), hFile);
	intval = getSignal(CHASSIS::Fuel_Stat2_AR2::CNG_Style);
	snprintf(buffer, elcount(buffer), "   0.000000 F1 CPC::Fuel_Stat2_AR2::CNG_Style = %d\n", intval);
	filePutString (buffer, elcount(buffer), hFile);
	intval = getSignal(CHASSIS::FuelLvl_Stat_AR2::TankLvl);
	snprintf(buffer, elcount(buffer), "   0.000000 F1 CPC::FuelLvl_Stat_AR2::TankLvl = %d\n", intval);
	filePutString (buffer, elcount(buffer), hFile);
	intval = getSignal(CHASSIS::FuelLvl_Stat_AR2::TankLvl_Min);
	snprintf(buffer, elcount(buffer), "   0.000000 F1 CPC::FuelLvl_Stat_AR2::TankLvl_Min = %d\n", intval);
	filePutString (buffer, elcount(buffer), hFile);
	intval = getSignal(CHASSIS::FuelLvl_Stat_AR2::TankLvl_Max);
	snprintf(buffer, elcount(buffer), "   0.000000 F1 CPC::FuelLvl_Stat_AR2::TankLvl_Max = %d\n", intval);
	filePutString (buffer, elcount(buffer), hFile);
	intval = getSignal(CHASSIS::FuelLvl_Stat_AR2::FuelTemp);
	snprintf(buffer, elcount(buffer), "   0.000000 F1 CPC::FuelLvl_Stat_AR2::FuelTemp = %d\n", intval);
	filePutString (buffer, elcount(buffer), hFile);
	floatval = getSignal(CHASSIS::FuelLvl_Stat_AR2::TankLvl_Disp_V2);
	snprintf(buffer, elcount(buffer), "   0.000000 F1 CPC::FuelLvl_Stat_AR2::TankLvl_Disp_V2 = %f\n", floatval);
	filePutString (buffer, elcount(buffer), hFile);
	intval = getSignal(CHASSIS::FuelLvl_Stat_AR2::MIL_On_Rq_FSCM);
	snprintf(buffer, elcount(buffer), "   0.000000 F1 CPC::FuelLvl_Stat_AR2::MIL_On_Rq_FSCM = %d\n", intval);
	filePutString (buffer, elcount(buffer), hFile);
	intval = getSignal(CHASSIS::FuelLvl_Stat_AR2::FSCM_FuelRefillEvent_Dtct);
	snprintf(buffer, elcount(buffer), "   0.000000 F1 CPC::FuelLvl_Stat_AR2::FSCM_FuelRefillEvent_Dtct = %d\n", intval);
	filePutString (buffer, elcount(buffer), hFile);
	intval = getSignal(CHASSIS::FuelLvl_Stat_AR2::FSCM_TankLvl_Min_50);
	snprintf(buffer, elcount(buffer), "   0.000000 F1 CPC::FuelLvl_Stat_AR2::FSCM_TankLvl_Min_50 = %d\n", intval);
	filePutString (buffer, elcount(buffer), hFile);
	intval = getSignal(CHASSIS::FuelLvl_Stat_AR2::Fuel_Lvl_Critic);
	snprintf(buffer, elcount(buffer), "   0.000000 F1 CPC::FuelLvl_Stat_AR2::Fuel_Lvl_Critic = %d\n", intval);
	filePutString (buffer, elcount(buffer), hFile);
	intval = getSignal(CHASSIS::HumanMachineIfc_AR2::Gr_Target_Disp_Rq_ECM);
	snprintf(buffer, elcount(buffer), "   0.000000 F1 CPC::HumanMachineIfc_AR2::Gr_Target_Disp_Rq_ECM = %d\n", intval);
	filePutString (buffer, elcount(buffer), hFile);
	intval = getSignal(CHASSIS::HumanMachineIfc_AR2::Gr_MTX_Disp_Rq_ECM_V2);
	snprintf(buffer, elcount(buffer), "   0.000000 F1 CPC::HumanMachineIfc_AR2::Gr_MTX_Disp_Rq_ECM_V2 = %d\n", intval);
	filePutString (buffer, elcount(buffer), hFile);
	floatval = getSignal(CHASSIS::HumanMachineIfc_AR2::ClutchPdlPosn);
	snprintf(buffer, elcount(buffer), "   0.000000 F1 CPC::HumanMachineIfc_AR2::ClutchPdlPosn = %f\n", floatval);
	filePutString (buffer, elcount(buffer), hFile);
	intval = getSignal(CHASSIS::HumanMachineIfc_AR2::TxShiftRcmmnd_Disp_Rq_ECM);
	snprintf(buffer, elcount(buffer), "   0.000000 F1 CPC::HumanMachineIfc_AR2::TxShiftRcmmnd_Disp_Rq_ECM = %d\n", intval);
	filePutString (buffer, elcount(buffer), hFile);
	intval = getSignal(CHASSIS::HumanMachineIfc_AR2::ClutchCoolDn_WaitTm_Second_Disp_Rq);
	snprintf(buffer, elcount(buffer), "   0.000000 F1 CPC::HumanMachineIfc_AR2::ClutchCoolDn_WaitTm_Second_Disp_Rq = %d\n", intval);
	filePutString (buffer, elcount(buffer), hFile);
	intval = getSignal(CHASSIS::HumanMachineIfc_AR2::ClutchCoolDn_WaitTm_Minute_Disp_Rq);
	snprintf(buffer, elcount(buffer), "   0.000000 F1 CPC::HumanMachineIfc_AR2::ClutchCoolDn_WaitTm_Minute_Disp_Rq = %d\n", intval);
	filePutString (buffer, elcount(buffer), hFile);
	floatval = getSignal(CHASSIS::HumanMachineIfc_AR2::PNHV_Perf_Total_Disp_Rq);
	snprintf(buffer, elcount(buffer), "   0.000000 F1 CPC::HumanMachineIfc_AR2::PNHV_Perf_Total_Disp_Rq = %f\n", floatval);
	filePutString (buffer, elcount(buffer), hFile);
	intval = getSignal(CHASSIS::HumanMachineIfc_AR2::EngRPMDisp_RedRngStart);
	snprintf(buffer, elcount(buffer), "   0.000000 F1 CPC::HumanMachineIfc_AR2::EngRPMDisp_RedRngStart = %d\n", intval);
	filePutString (buffer, elcount(buffer), hFile);
	intval = getSignal(CHASSIS::HumanMachineIfc_Rq_AR::EngRPM_Dyn_Disp_Rq);
	snprintf(buffer, elcount(buffer), "   0.000000 F1 CPC::HumanMachineIfc_Rq_AR::EngRPM_Dyn_Disp_Rq = %d\n", intval);
	filePutString (buffer, elcount(buffer), hFile);
	intval = getSignal(CHASSIS::ISM_DAC4_AR::ISM_DAC_Data1);
	snprintf(buffer, elcount(buffer), "   0.000000 F1 CPC::ISM_DAC4_AR::ISM_DAC_Data1 = %d\n", intval);
	filePutString (buffer, elcount(buffer), hFile);
	intval = getSignal(CHASSIS::ISM_DAC4_AR::ISM_DAC_Data2);
	snprintf(buffer, elcount(buffer), "   0.000000 F1 CPC::ISM_DAC4_AR::ISM_DAC_Data2 = %d\n", intval);
	filePutString (buffer, elcount(buffer), hFile);
	intval = getSignal(CHASSIS::ISM_DAC4_AR::ISM_DAC_Data3);
	snprintf(buffer, elcount(buffer), "   0.000000 F1 CPC::ISM_DAC4_AR::ISM_DAC_Data3 = %d\n", intval);
	filePutString (buffer, elcount(buffer), hFile);
	intval = getSignal(CHASSIS::ISM_DAC4_AR::ISM_DAC_Data4);
	snprintf(buffer, elcount(buffer), "   0.000000 F1 CPC::ISM_DAC4_AR::ISM_DAC_Data4 = %d\n", intval);
	filePutString (buffer, elcount(buffer), hFile);
	intval = getSignal(CHASSIS::ISM_DAC4_AR::ISM_DAC_Data5);
	snprintf(buffer, elcount(buffer), "   0.000000 F1 CPC::ISM_DAC4_AR::ISM_DAC_Data5 = %d\n", intval);
	filePutString (buffer, elcount(buffer), hFile);
	intval = getSignal(CHASSIS::ISM_DAC4_AR::ISM_DAC_Data6);
	snprintf(buffer, elcount(buffer), "   0.000000 F1 CPC::ISM_DAC4_AR::ISM_DAC_Data6 = %d\n", intval);
	filePutString (buffer, elcount(buffer), hFile);
	intval = getSignal(CHASSIS::ISM_DAC4_AR::ISM_DAC_Data7);
	snprintf(buffer, elcount(buffer), "   0.000000 F1 CPC::ISM_DAC4_AR::ISM_DAC_Data7 = %d\n", intval);
	filePutString (buffer, elcount(buffer), hFile);
	intval = getSignal(CHASSIS::ISM_DAC4_AR::ISM_DAC_Data8);
	snprintf(buffer, elcount(buffer), "   0.000000 F1 CPC::ISM_DAC4_AR::ISM_DAC_Data8 = %d\n", intval);
	filePutString (buffer, elcount(buffer), hFile);
	floatval = getSignal(CHASSIS::OBL_DC_Output_AR::OBL_HVDC_Volt);
	snprintf(buffer, elcount(buffer), "   0.000000 F1 CPC::OBL_DC_Output_AR::OBL_HVDC_Volt = %f\n", floatval);
	filePutString (buffer, elcount(buffer), hFile);
	intval = getSignal(CHASSIS::OBL_DC_Output_AR::OBL_Md);
	snprintf(buffer, elcount(buffer), "   0.000000 F1 CPC::OBL_DC_Output_AR::OBL_Md = %d\n", intval);
	filePutString (buffer, elcount(buffer), hFile);
	floatval = getSignal(CHASSIS::OBL_DC_Output_AR::OBL_HVDC_Curr);
	snprintf(buffer, elcount(buffer), "   0.000000 F1 CPC::OBL_DC_Output_AR::OBL_HVDC_Curr = %f\n", floatval);
	filePutString (buffer, elcount(buffer), hFile);
	intval = getSignal(CHASSIS::OBL_DC_Output_AR::OBL_CVN_Actv);
	snprintf(buffer, elcount(buffer), "   0.000000 F1 CPC::OBL_DC_Output_AR::OBL_CVN_Actv = %d\n", intval);
	filePutString (buffer, elcount(buffer), hFile);
	intval = getSignal(CHASSIS::OBL_DC_Output_AR::OBL_ErrChk_Stat1);
	snprintf(buffer, elcount(buffer), "   0.000000 F1 CPC::OBL_DC_Output_AR::OBL_ErrChk_Stat1 = %d\n", intval);
	filePutString (buffer, elcount(buffer), hFile);
	intval = getSignal(CHASSIS::OBL_DC_Output_AR::OBL_ErrChk_Stat4);
	snprintf(buffer, elcount(buffer), "   0.000000 F1 CPC::OBL_DC_Output_AR::OBL_ErrChk_Stat4 = %d\n", intval);
	filePutString (buffer, elcount(buffer), hFile);
	intval = getSignal(CHASSIS::OBL_DC_Output_AR::OBL_ErrChk_Stat2);
	snprintf(buffer, elcount(buffer), "   0.000000 F1 CPC::OBL_DC_Output_AR::OBL_ErrChk_Stat2 = %d\n", intval);
	filePutString (buffer, elcount(buffer), hFile);
	intval = getSignal(CHASSIS::OBL_DC_Output_AR::OBL_ErrChk_Stat3);
	snprintf(buffer, elcount(buffer), "   0.000000 F1 CPC::OBL_DC_Output_AR::OBL_ErrChk_Stat3 = %d\n", intval);
	filePutString (buffer, elcount(buffer), hFile);
	intval = getSignal(CHASSIS::OBL_DC_Output_AR::OBL_CALID_CVN_ErrNum);
	snprintf(buffer, elcount(buffer), "   0.000000 F1 CPC::OBL_DC_Output_AR::OBL_CALID_CVN_ErrNum = %d\n", intval);
	filePutString (buffer, elcount(buffer), hFile);
	intval = getSignal(CHASSIS::OBL_DC_Output_AR::OBL_Data);
	snprintf(buffer, elcount(buffer), "   0.000000 F1 CPC::OBL_DC_Output_AR::OBL_Data = %d\n", intval);
	filePutString (buffer, elcount(buffer), hFile);
	intval = @sysvar::CH_Nodes::CH_CPCCRC_PARK_Drv_Rs_TCM_P_AUTO;
	snprintf(buffer, elcount(buffer), "   0.000000    SV: 2 0 0 ::CH_Nodes::CH_CPCCRC_PARK_Drv_Rs_TCM_P_AUTO = %d\n", intval);
	filePutString (buffer, elcount(buffer), hFile);
	intval = getSignal(CHASSIS::PARK_Drv_Rs_TCM_AR2::CRC_PARK_Drv_Rs_TCM_Pr2);
	snprintf(buffer, elcount(buffer), "   0.000000 F1 CPC::PARK_Drv_Rs_TCM_AR2::CRC_PARK_Drv_Rs_TCM_Pr2 = %d\n", intval);
	filePutString (buffer, elcount(buffer), hFile);
	intval = @sysvar::CH_Nodes::CH_CPCSQC_PARK_Drv_Rs_TCM_P_AUTO;
	snprintf(buffer, elcount(buffer), "   0.000000    SV: 2 0 0 ::CH_Nodes::CH_CPCSQC_PARK_Drv_Rs_TCM_P_AUTO = %d\n", intval);
	filePutString (buffer, elcount(buffer), hFile);
	intval = getSignal(CHASSIS::PARK_Drv_Rs_TCM_AR2::SQC_PARK_Drv_Rs_TCM_Pr2);
	snprintf(buffer, elcount(buffer), "   0.000000 F1 CPC::PARK_Drv_Rs_TCM_AR2::SQC_PARK_Drv_Rs_TCM_Pr2 = %d\n", intval);
	filePutString (buffer, elcount(buffer), hFile);
	intval = getSignal(CHASSIS::PARK_Drv_Rs_TCM_AR2::PARK_DrvDir_Stat_TCM);
	snprintf(buffer, elcount(buffer), "   0.000000 F1 CPC::PARK_Drv_Rs_TCM_AR2::PARK_DrvDir_Stat_TCM = %d\n", intval);
	filePutString (buffer, elcount(buffer), hFile);
	intval = getSignal(CHASSIS::PARK_Drv_Rs_TCM_AR2::TCM_Dir_Stat);
	snprintf(buffer, elcount(buffer), "   0.000000 F1 CPC::PARK_Drv_Rs_TCM_AR2::TCM_Dir_Stat = %d\n", intval);
	filePutString (buffer, elcount(buffer), hFile);
	intval = getSignal(CHASSIS::PARK_Drv_Rs_TCM_AR2::Rsrv1_PARK_Drv_Rs_TCM_Pr2);
	snprintf(buffer, elcount(buffer), "   0.000000 F1 CPC::PARK_Drv_Rs_TCM_AR2::Rsrv1_PARK_Drv_Rs_TCM_Pr2 = %d\n", intval);
	filePutString (buffer, elcount(buffer), hFile);
	intval = getSignal(CHASSIS::PARK_Drv_Rs_TCM_AR2::Rsrv2_PARK_Drv_Rs_TCM_Pr2);
	snprintf(buffer, elcount(buffer), "   0.000000 F1 CPC::PARK_Drv_Rs_TCM_AR2::Rsrv2_PARK_Drv_Rs_TCM_Pr2 = %d\n", intval);
	filePutString (buffer, elcount(buffer), hFile);
	floatval = getSignal(CHASSIS::PN14_Gen_Rs_AR::EngIdleRPMCurr_Inc1);
	snprintf(buffer, elcount(buffer), "   0.000000 F1 CPC::PN14_Gen_Rs_AR::EngIdleRPMCurr_Inc1 = %f\n", floatval);
	filePutString (buffer, elcount(buffer), hFile);
	intval = getSignal(CHASSIS::PN14_Gen_Rs_AR::PN14_GenAllTrq_Actv);
	snprintf(buffer, elcount(buffer), "   0.000000 F1 CPC::PN14_Gen_Rs_AR::PN14_GenAllTrq_Actv = %d\n", intval);
	filePutString (buffer, elcount(buffer), hFile);
}
/*@@end*/

/*@@caplFunc:saveVars_8(dword):*/
void saveVars_8(dword hFile)
{
	intval = getSignal(CHASSIS::PN14_Gen_Rs_AR::PN14_GenExctLmtDyn_Actv);
	snprintf(buffer, elcount(buffer), "   0.000000 F1 CPC::PN14_Gen_Rs_AR::PN14_GenExctLmtDyn_Actv = %d\n", intval);
	filePutString (buffer, elcount(buffer), hFile);
	intval = getSignal(CHASSIS::PN14_Gen_Rs_AR::PN14_GenExctLmtStat_Actv);
	snprintf(buffer, elcount(buffer), "   0.000000 F1 CPC::PN14_Gen_Rs_AR::PN14_GenExctLmtStat_Actv = %d\n", intval);
	filePutString (buffer, elcount(buffer), hFile);
	intval = getSignal(CHASSIS::PN14_Gen_Rs_AR::PN14_GenLastTrq_Actv);
	snprintf(buffer, elcount(buffer), "   0.000000 F1 CPC::PN14_Gen_Rs_AR::PN14_GenLastTrq_Actv = %d\n", intval);
	filePutString (buffer, elcount(buffer), hFile);
	intval = getSignal(CHASSIS::PN14_Gen_Rs_AR::PN14_GenNormChrg_Actv);
	snprintf(buffer, elcount(buffer), "   0.000000 F1 CPC::PN14_Gen_Rs_AR::PN14_GenNormChrg_Actv = %d\n", intval);
	filePutString (buffer, elcount(buffer), hFile);
	intval = getSignal(CHASSIS::PN14_Gen_Rs_AR::PN14_GenNoTrq_Actv);
	snprintf(buffer, elcount(buffer), "   0.000000 F1 CPC::PN14_Gen_Rs_AR::PN14_GenNoTrq_Actv = %d\n", intval);
	filePutString (buffer, elcount(buffer), hFile);
	floatval = getSignal(CHASSIS::PN14_Gen_Rs_AR::EngIdleRPMCurr_Inc2);
	snprintf(buffer, elcount(buffer), "   0.000000 F1 CPC::PN14_Gen_Rs_AR::EngIdleRPMCurr_Inc2 = %f\n", floatval);
	filePutString (buffer, elcount(buffer), hFile);
	intval = getSignal(CHASSIS::PN14_Gen_Rs_AR::PN14_GenWarmUp_Actv);
	snprintf(buffer, elcount(buffer), "   0.000000 F1 CPC::PN14_Gen_Rs_AR::PN14_GenWarmUp_Actv = %d\n", intval);
	filePutString (buffer, elcount(buffer), hFile);
	intval = getSignal(CHASSIS::PN14_Gen_Rs_AR::PN14_GenRekupChrg_Actv);
	snprintf(buffer, elcount(buffer), "   0.000000 F1 CPC::PN14_Gen_Rs_AR::PN14_GenRekupChrg_Actv = %d\n", intval);
	filePutString (buffer, elcount(buffer), hFile);
	intval = getSignal(CHASSIS::PN14_Gen_Rs_AR::PN14_GenVoltMaxLmt_Actv);
	snprintf(buffer, elcount(buffer), "   0.000000 F1 CPC::PN14_Gen_Rs_AR::PN14_GenVoltMaxLmt_Actv = %d\n", intval);
	filePutString (buffer, elcount(buffer), hFile);
	intval = getSignal(CHASSIS::PN14_Gen_Rs_AR::PN14_GenVoltMinLmt_Actv);
	snprintf(buffer, elcount(buffer), "   0.000000 F1 CPC::PN14_Gen_Rs_AR::PN14_GenVoltMinLmt_Actv = %d\n", intval);
	filePutString (buffer, elcount(buffer), hFile);
	floatval = getSignal(CHASSIS::PN14_Gen_Rs_AR::EngIdleRPMCurr_Min);
	snprintf(buffer, elcount(buffer), "   0.000000 F1 CPC::PN14_Gen_Rs_AR::EngIdleRPMCurr_Min = %f\n", floatval);
	filePutString (buffer, elcount(buffer), hFile);
	intval = getSignal(CHASSIS::PN14_Gen_Rs_AR::PN14_GenCurr);
	snprintf(buffer, elcount(buffer), "   0.000000 F1 CPC::PN14_Gen_Rs_AR::PN14_GenCurr = %d\n", intval);
	filePutString (buffer, elcount(buffer), hFile);
	floatval = getSignal(CHASSIS::PNHV_BMS_Stat_AR2::PNHV_LinkVolt_BMS);
	snprintf(buffer, elcount(buffer), "   0.000000 F1 CPC::PNHV_BMS_Stat_AR2::PNHV_LinkVolt_BMS = %f\n", floatval);
	filePutString (buffer, elcount(buffer), hFile);
	intval = getSignal(CHASSIS::PNHV_BMS_Stat_AR2::PNHV_Bat_Temp_Max);
	snprintf(buffer, elcount(buffer), "   0.000000 F1 CPC::PNHV_BMS_Stat_AR2::PNHV_Bat_Temp_Max = %d\n", intval);
	filePutString (buffer, elcount(buffer), hFile);
	intval = getSignal(CHASSIS::PNHV_BMS_Stat_AR2::PNHV_Bat_Temp_Min);
	snprintf(buffer, elcount(buffer), "   0.000000 F1 CPC::PNHV_BMS_Stat_AR2::PNHV_Bat_Temp_Min = %d\n", intval);
	filePutString (buffer, elcount(buffer), hFile);
	floatval = getSignal(CHASSIS::PNHV_BMS_Stat_AR2::PNHV_CoolInletTemp);
	snprintf(buffer, elcount(buffer), "   0.000000 F1 CPC::PNHV_BMS_Stat_AR2::PNHV_CoolInletTemp = %f\n", floatval);
	filePutString (buffer, elcount(buffer), hFile);
	floatval = getSignal(CHASSIS::PNHV_EnergyMngmnt_Disp_Rq_AR::PNHV_ChrgPwr_Disp_Rq);
	snprintf(buffer, elcount(buffer), "   0.000000 F1 CPC::PNHV_EnergyMngmnt_Disp_Rq_AR::PNHV_ChrgPwr_Disp_Rq = %f\n", floatval);
	filePutString (buffer, elcount(buffer), hFile);
	intval = getSignal(CHASSIS::PNHV_EnergyMngmnt_Disp_Rq_AR::PNHV_ChrgEnergyFlow_Disp_Rq);
	snprintf(buffer, elcount(buffer), "   0.000000 F1 CPC::PNHV_EnergyMngmnt_Disp_Rq_AR::PNHV_ChrgEnergyFlow_Disp_Rq = %d\n", intval);
	filePutString (buffer, elcount(buffer), hFile);
	intval = getSignal(CHASSIS::PNHV_EnergyMngmnt_Disp_Rq_AR::PNHV_EOC_Tm_Hour_Disp_Rq);
	snprintf(buffer, elcount(buffer), "   0.000000 F1 CPC::PNHV_EnergyMngmnt_Disp_Rq_AR::PNHV_EOC_Tm_Hour_Disp_Rq = %d\n", intval);
	filePutString (buffer, elcount(buffer), hFile);
	intval = getSignal(CHASSIS::PNHV_EnergyMngmnt_Disp_Rq_AR::PNHV_ConChrgPlug_MsgDisp_Rq);
	snprintf(buffer, elcount(buffer), "   0.000000 F1 CPC::PNHV_EnergyMngmnt_Disp_Rq_AR::PNHV_ConChrgPlug_MsgDisp_Rq = %d\n", intval);
	filePutString (buffer, elcount(buffer), hFile);
	intval = getSignal(CHASSIS::PNHV_EnergyMngmnt_Disp_Rq_AR::PNHV_ChrgStatInfo_Disp_Rq);
	snprintf(buffer, elcount(buffer), "   0.000000 F1 CPC::PNHV_EnergyMngmnt_Disp_Rq_AR::PNHV_ChrgStatInfo_Disp_Rq = %d\n", intval);
	filePutString (buffer, elcount(buffer), hFile);
	intval = getSignal(CHASSIS::PNHV_EnergyMngmnt_Disp_Rq_AR::PNHV_EOC_Tm_Minute_Disp_Rq);
	snprintf(buffer, elcount(buffer), "   0.000000 F1 CPC::PNHV_EnergyMngmnt_Disp_Rq_AR::PNHV_EOC_Tm_Minute_Disp_Rq = %d\n", intval);
	filePutString (buffer, elcount(buffer), hFile);
	intval = getSignal(CHASSIS::PNHV_EnergyMngmnt_Disp_Rq_AR::PNHV_IC_Disp_On_Rq);
	snprintf(buffer, elcount(buffer), "   0.000000 F1 CPC::PNHV_EnergyMngmnt_Disp_Rq_AR::PNHV_IC_Disp_On_Rq = %d\n", intval);
	filePutString (buffer, elcount(buffer), hFile);
	intval = getSignal(CHASSIS::PNHV_EnergyMngmnt_Disp_Rq_AR::PNHV_ChrgIcon_Disp_Rq);
	snprintf(buffer, elcount(buffer), "   0.000000 F1 CPC::PNHV_EnergyMngmnt_Disp_Rq_AR::PNHV_ChrgIcon_Disp_Rq = %d\n", intval);
	filePutString (buffer, elcount(buffer), hFile);
	intval = getSignal(CHASSIS::PNHV_EnergyMngmnt_Disp_Rq_AR::PNHV_EOC_Tm_WeekDay_Disp_Rq);
	snprintf(buffer, elcount(buffer), "   0.000000 F1 CPC::PNHV_EnergyMngmnt_Disp_Rq_AR::PNHV_EOC_Tm_WeekDay_Disp_Rq = %d\n", intval);
	filePutString (buffer, elcount(buffer), hFile);
	intval = getSignal(CHASSIS::PNHV_EnergyMngmnt_Disp_Rq_AR::PNHV_ChrgSrc_Type_Disp_Rq);
	snprintf(buffer, elcount(buffer), "   0.000000 F1 CPC::PNHV_EnergyMngmnt_Disp_Rq_AR::PNHV_ChrgSrc_Type_Disp_Rq = %d\n", intval);
	filePutString (buffer, elcount(buffer), hFile);
	intval = getSignal(CHASSIS::PNHV_EnergyMngmnt_Disp_Rq_AR::EMM_MaxSOC_Disp_Rq);
	snprintf(buffer, elcount(buffer), "   0.000000 F1 CPC::PNHV_EnergyMngmnt_Disp_Rq_AR::EMM_MaxSOC_Disp_Rq = %d\n", intval);
	filePutString (buffer, elcount(buffer), hFile);
	intval = getSignal(CHASSIS::PNHV_EnergyMngmnt_Disp_Rq_AR::EMM_MaxSOC_Disp_On_Rq);
	snprintf(buffer, elcount(buffer), "   0.000000 F1 CPC::PNHV_EnergyMngmnt_Disp_Rq_AR::EMM_MaxSOC_Disp_On_Rq = %d\n", intval);
	filePutString (buffer, elcount(buffer), hFile);
	floatval = getSignal(CHASSIS::PNHV_EnergyMngmnt_Stat2_AR2::EAC_MaxCurr);
	snprintf(buffer, elcount(buffer), "   0.000000 F1 CPC::PNHV_EnergyMngmnt_Stat2_AR2::EAC_MaxCurr = %f\n", floatval);
	filePutString (buffer, elcount(buffer), hFile);
	intval = getSignal(CHASSIS::PNHV_EnergyMngmnt_Stat2_AR2::EMM_WPT_ManSet_Stat);
	snprintf(buffer, elcount(buffer), "   0.000000 F1 CPC::PNHV_EnergyMngmnt_Stat2_AR2::EMM_WPT_ManSet_Stat = %d\n", intval);
	filePutString (buffer, elcount(buffer), hFile);
	intval = getSignal(CHASSIS::PNHV_EnergyMngmnt_Stat2_AR2::EMM_PosnInfo_Disp_Rq);
	snprintf(buffer, elcount(buffer), "   0.000000 F1 CPC::PNHV_EnergyMngmnt_Stat2_AR2::EMM_PosnInfo_Disp_Rq = %d\n", intval);
	filePutString (buffer, elcount(buffer), hFile);
	intval = getSignal(CHASSIS::PNHV_EnergyMngmnt_Stat2_AR2::EMM_PosnTxt_Disp_Rq);
	snprintf(buffer, elcount(buffer), "   0.000000 F1 CPC::PNHV_EnergyMngmnt_Stat2_AR2::EMM_PosnTxt_Disp_Rq = %d\n", intval);
	filePutString (buffer, elcount(buffer), hFile);
	intval = getSignal(CHASSIS::PNHV_EnergyMngmnt_Stat2_AR2::PNHV_Bat_Curr_Disp_Rq);
	snprintf(buffer, elcount(buffer), "   0.000000 F1 CPC::PNHV_EnergyMngmnt_Stat2_AR2::PNHV_Bat_Curr_Disp_Rq = %d\n", intval);
	filePutString (buffer, elcount(buffer), hFile);
	floatval = getSignal(CHASSIS::PNHV_EnergyMngmnt_Stat2_AR2::EAC_MinVolt_V2);
	snprintf(buffer, elcount(buffer), "   0.000000 F1 CPC::PNHV_EnergyMngmnt_Stat2_AR2::EAC_MinVolt_V2 = %f\n", floatval);
	filePutString (buffer, elcount(buffer), hFile);
	intval = getSignal(CHASSIS::PNHV_EnergyMngmnt_Stat2_AR2::PNHV_VoltDn_Disp_Rq);
	snprintf(buffer, elcount(buffer), "   0.000000 F1 CPC::PNHV_EnergyMngmnt_Stat2_AR2::PNHV_VoltDn_Disp_Rq = %d\n", intval);
	filePutString (buffer, elcount(buffer), hFile);
	intval = getSignal(CHASSIS::PNHV_EnergyMngmnt_Stat2_AR2::DCDC_PNHV_GrndStrpFlt_Disp_Rq);
	snprintf(buffer, elcount(buffer), "   0.000000 F1 CPC::PNHV_EnergyMngmnt_Stat2_AR2::DCDC_PNHV_GrndStrpFlt_Disp_Rq = %d\n", intval);
	filePutString (buffer, elcount(buffer), hFile);
	intval = getSignal(CHASSIS::PNHV_EnergyMngmnt_Stat2_AR2::PNHV_Bat_VoltMax_Disp_Rq);
	snprintf(buffer, elcount(buffer), "   0.000000 F1 CPC::PNHV_EnergyMngmnt_Stat2_AR2::PNHV_Bat_VoltMax_Disp_Rq = %d\n", intval);
	filePutString (buffer, elcount(buffer), hFile);
	intval = getSignal(CHASSIS::PNHV_EnergyMngmnt_Stat2_AR2::Term61_Actv);
	snprintf(buffer, elcount(buffer), "   0.000000 F1 CPC::PNHV_EnergyMngmnt_Stat2_AR2::Term61_Actv = %d\n", intval);
	filePutString (buffer, elcount(buffer), hFile);
	intval = @sysvar::CH_Nodes::CH_CPCTerm61_ActvPNHV_En_UB_AUTO;
	snprintf(buffer, elcount(buffer), "   0.000000    SV: 2 0 0 ::CH_Nodes::CH_CPCTerm61_ActvPNHV_En_UB_AUTO = %d\n", intval);
	filePutString (buffer, elcount(buffer), hFile);
	intval = @sysvar::CH_Nodes::CH_CPCTerm61_ActvPNHV_Energy_UB_;
	snprintf(buffer, elcount(buffer), "   0.000000    SV: 2 0 0 ::CH_Nodes::CH_CPCTerm61_ActvPNHV_Energy_UB_ = %d\n", intval);
	filePutString (buffer, elcount(buffer), hFile);
	floatval = getSignal(CHASSIS::PNHV_EnergyMngmnt_Stat3_AR2::PNHV_PTC_MaxCurr);
	snprintf(buffer, elcount(buffer), "   0.000000 F1 CPC::PNHV_EnergyMngmnt_Stat3_AR2::PNHV_PTC_MaxCurr = %f\n", floatval);
	filePutString (buffer, elcount(buffer), hFile);
	floatval = getSignal(CHASSIS::PNHV_EnergyMngmnt_Stat3_AR2::PNHV_PTC_MinVolt);
	snprintf(buffer, elcount(buffer), "   0.000000 F1 CPC::PNHV_EnergyMngmnt_Stat3_AR2::PNHV_PTC_MinVolt = %f\n", floatval);
	filePutString (buffer, elcount(buffer), hFile);
	intval = getSignal(CHASSIS::PNHV_EnergyMngmnt_Stat3_AR2::PNHV_Comp_On_Rq);
	snprintf(buffer, elcount(buffer), "   0.000000 F1 CPC::PNHV_EnergyMngmnt_Stat3_AR2::PNHV_Comp_On_Rq = %d\n", intval);
	filePutString (buffer, elcount(buffer), hFile);
	intval = getSignal(CHASSIS::PNHV_EnergyMngmnt_Stat3_AR2::PNHV_PTC_On_Rq);
	snprintf(buffer, elcount(buffer), "   0.000000 F1 CPC::PNHV_EnergyMngmnt_Stat3_AR2::PNHV_PTC_On_Rq = %d\n", intval);
	filePutString (buffer, elcount(buffer), hFile);
	intval = getSignal(CHASSIS::PNHV_EnergyMngmnt_Stat3_AR2::PNHV_PTC_Dschrg_Rq);
	snprintf(buffer, elcount(buffer), "   0.000000 F1 CPC::PNHV_EnergyMngmnt_Stat3_AR2::PNHV_PTC_Dschrg_Rq = %d\n", intval);
	filePutString (buffer, elcount(buffer), hFile);
	floatval = getSignal(CHASSIS::PNHV_EnergyMngmnt_Stat3_AR2::PNHV_PTC_Pwr_Rq);
	snprintf(buffer, elcount(buffer), "   0.000000 F1 CPC::PNHV_EnergyMngmnt_Stat3_AR2::PNHV_PTC_Pwr_Rq = %f\n", floatval);
	filePutString (buffer, elcount(buffer), hFile);
	intval = @sysvar::CH_Nodes::CH_CPCPNM_CALID_CVN_ErrNum__AUTO;
	snprintf(buffer, elcount(buffer), "   0.000000    SV: 2 0 0 ::CH_Nodes::CH_CPCPNM_CALID_CVN_ErrNum__AUTO = %d\n", intval);
	filePutString (buffer, elcount(buffer), hFile);
	intval = getSignal(CHASSIS::PNHV_EnergyMngmnt_Stat3_AR2::PNM_CALID_CVN_ErrNum_Tgl);
	snprintf(buffer, elcount(buffer), "   0.000000 F1 CPC::PNHV_EnergyMngmnt_Stat3_AR2::PNM_CALID_CVN_ErrNum_Tgl = %d\n", intval);
	filePutString (buffer, elcount(buffer), hFile);
	intval = getSignal(CHASSIS::PNHV_EnergyMngmntSet_Rs1_AR2::PNHV_DepTmManSet_Minute_Stat);
	snprintf(buffer, elcount(buffer), "   0.000000 F1 CPC::PNHV_EnergyMngmntSet_Rs1_AR2::PNHV_DepTmManSet_Minute_Stat = %d\n", intval);
	filePutString (buffer, elcount(buffer), hFile);
	intval = getSignal(CHASSIS::PNHV_EnergyMngmntSet_Rs1_AR2::PNHV_ConChrgPlug_Disp_Rq);
	snprintf(buffer, elcount(buffer), "   0.000000 F1 CPC::PNHV_EnergyMngmntSet_Rs1_AR2::PNHV_ConChrgPlug_Disp_Rq = %d\n", intval);
	filePutString (buffer, elcount(buffer), hFile);
	intval = getSignal(CHASSIS::PNHV_EnergyMngmntSet_Rs1_AR2::PNHV_DepTmManSet_Hour_Stat);
	snprintf(buffer, elcount(buffer), "   0.000000 F1 CPC::PNHV_EnergyMngmntSet_Rs1_AR2::PNHV_DepTmManSet_Hour_Stat = %d\n", intval);
	filePutString (buffer, elcount(buffer), hFile);
	intval = getSignal(CHASSIS::PNHV_EnergyMngmntSet_Rs1_AR2::PNHV_DepTm_Icon_Disp_Rq);
	snprintf(buffer, elcount(buffer), "   0.000000 F1 CPC::PNHV_EnergyMngmntSet_Rs1_AR2::PNHV_DepTm_Icon_Disp_Rq = %d\n", intval);
	filePutString (buffer, elcount(buffer), hFile);
	intval = getSignal(CHASSIS::PNHV_EnergyMngmntSet_Rs1_AR2::PNHV_DepTm_Avl_Stat);
	snprintf(buffer, elcount(buffer), "   0.000000 F1 CPC::PNHV_EnergyMngmntSet_Rs1_AR2::PNHV_DepTm_Avl_Stat = %d\n", intval);
	filePutString (buffer, elcount(buffer), hFile);
}
/*@@end*/

/*@@caplFunc:saveVars_9(dword):*/
void saveVars_9(dword hFile)
{
	intval = getSignal(CHASSIS::PNHV_EnergyMngmntSet_Rs1_AR2::PNHV_DepTm_Actv);
	snprintf(buffer, elcount(buffer), "   0.000000 F1 CPC::PNHV_EnergyMngmntSet_Rs1_AR2::PNHV_DepTm_Actv = %d\n", intval);
	filePutString (buffer, elcount(buffer), hFile);
	intval = getSignal(CHASSIS::PNHV_EnergyMngmntSet_Rs1_AR2::Hyb_Msg_Disp_Rq);
	snprintf(buffer, elcount(buffer), "   0.000000 F1 CPC::PNHV_EnergyMngmntSet_Rs1_AR2::Hyb_Msg_Disp_Rq = %d\n", intval);
	filePutString (buffer, elcount(buffer), hFile);
	intval = getSignal(CHASSIS::PNHV_EnergyMngmntSet_Rs1_AR2::PNHV_Precond2_ManSet_Icon_Disp_Rq);
	snprintf(buffer, elcount(buffer), "   0.000000 F1 CPC::PNHV_EnergyMngmntSet_Rs1_AR2::PNHV_Precond2_ManSet_Icon_Disp_Rq = %d\n", intval);
	filePutString (buffer, elcount(buffer), hFile);
	intval = getSignal(CHASSIS::PNHV_EnergyMngmntSet_Rs1_AR2::HDC_IHS_Disp_Rq);
	snprintf(buffer, elcount(buffer), "   0.000000 F1 CPC::PNHV_EnergyMngmntSet_Rs1_AR2::HDC_IHS_Disp_Rq = %d\n", intval);
	filePutString (buffer, elcount(buffer), hFile);
	intval = getSignal(CHASSIS::PNHV_EnergyMngmntSet_Rs1_AR2::HPPRM_IconDisp_Rq);
	snprintf(buffer, elcount(buffer), "   0.000000 F1 CPC::PNHV_EnergyMngmntSet_Rs1_AR2::HPPRM_IconDisp_Rq = %d\n", intval);
	filePutString (buffer, elcount(buffer), hFile);
	intval = getSignal(CHASSIS::PNHV_EnergyMngmntSet_Rs1_AR2::PNHV_PreCond1_ManSet_Stat);
	snprintf(buffer, elcount(buffer), "   0.000000 F1 CPC::PNHV_EnergyMngmntSet_Rs1_AR2::PNHV_PreCond1_ManSet_Stat = %d\n", intval);
	filePutString (buffer, elcount(buffer), hFile);
	intval = getSignal(CHASSIS::PNHV_EnergyMngmntSet_Rs1_AR2::PNHV_PreCond2_ManSet_Stat);
	snprintf(buffer, elcount(buffer), "   0.000000 F1 CPC::PNHV_EnergyMngmntSet_Rs1_AR2::PNHV_PreCond2_ManSet_Stat = %d\n", intval);
	filePutString (buffer, elcount(buffer), hFile);
	intval = getSignal(CHASSIS::PNHV_EnergyMngmntSet_Rs1_AR2::PNHV_ChrgTmDisp_WeekDay);
	snprintf(buffer, elcount(buffer), "   0.000000 F1 CPC::PNHV_EnergyMngmntSet_Rs1_AR2::PNHV_ChrgTmDisp_WeekDay = %d\n", intval);
	filePutString (buffer, elcount(buffer), hFile);
	intval = getSignal(CHASSIS::PNHV_EnergyMngmntSet_Rs1_AR2::PNHV_PreCond2_Dur);
	snprintf(buffer, elcount(buffer), "   0.000000 F1 CPC::PNHV_EnergyMngmntSet_Rs1_AR2::PNHV_PreCond2_Dur = %d\n", intval);
	filePutString (buffer, elcount(buffer), hFile);
	intval = getSignal(CHASSIS::PNHV_EnergyMngmntSet_Rs1_AR2::HPPRM_EffDisp_Rq);
	snprintf(buffer, elcount(buffer), "   0.000000 F1 CPC::PNHV_EnergyMngmntSet_Rs1_AR2::HPPRM_EffDisp_Rq = %d\n", intval);
	filePutString (buffer, elcount(buffer), hFile);
	floatval = getSignal(CHASSIS::PNHV_EnergyMngmntSet_Rs1_AR2::PNHV_AC_Curr_Max);
	snprintf(buffer, elcount(buffer), "   0.000000 F1 CPC::PNHV_EnergyMngmntSet_Rs1_AR2::PNHV_AC_Curr_Max = %f\n", floatval);
	filePutString (buffer, elcount(buffer), hFile);
	intval = getSignal(CHASSIS::PNHV_EnergyMngmntSet_Rs2_AR::PNHV_ChrgTmDisp_Minute);
	snprintf(buffer, elcount(buffer), "   0.000000 F1 CPC::PNHV_EnergyMngmntSet_Rs2_AR::PNHV_ChrgTmDisp_Minute = %d\n", intval);
	filePutString (buffer, elcount(buffer), hFile);
	intval = getSignal(CHASSIS::PNHV_EnergyMngmntSet_Rs2_AR::PNHV_ChrgTmDisp_Hour);
	snprintf(buffer, elcount(buffer), "   0.000000 F1 CPC::PNHV_EnergyMngmntSet_Rs2_AR::PNHV_ChrgTmDisp_Hour = %d\n", intval);
	filePutString (buffer, elcount(buffer), hFile);
	intval = getSignal(CHASSIS::PNHV_EnergyMngmntSet_Rs2_AR::PNHV_WeekDepTmTbl_Avl_Stat);
	snprintf(buffer, elcount(buffer), "   0.000000 F1 CPC::PNHV_EnergyMngmntSet_Rs2_AR::PNHV_WeekDepTmTbl_Avl_Stat = %d\n", intval);
	filePutString (buffer, elcount(buffer), hFile);
	floatval = getSignal(CHASSIS::PNHV_EnergyMngmntSet_Rs2_AR::PNHV_SOC_Max_Disp_Rq);
	snprintf(buffer, elcount(buffer), "   0.000000 F1 CPC::PNHV_EnergyMngmntSet_Rs2_AR::PNHV_SOC_Max_Disp_Rq = %f\n", floatval);
	filePutString (buffer, elcount(buffer), hFile);
	floatval = getSignal(CHASSIS::PNHV_EnergyMngmntSet_Rs2_AR::EMM_AC_MaxPwr);
	snprintf(buffer, elcount(buffer), "   0.000000 F1 CPC::PNHV_EnergyMngmntSet_Rs2_AR::EMM_AC_MaxPwr = %f\n", floatval);
	filePutString (buffer, elcount(buffer), hFile);
	floatval = getSignal(CHASSIS::PNHV_EnergyMngmntSet_Rs2_AR::EMM_AC_Curr_Lmt);
	snprintf(buffer, elcount(buffer), "   0.000000 F1 CPC::PNHV_EnergyMngmntSet_Rs2_AR::EMM_AC_Curr_Lmt = %f\n", floatval);
	filePutString (buffer, elcount(buffer), hFile);
	intval = getSignal(CHASSIS::PNHV_EnergyMngmntSet_Rs2_AR::PNHV_WeekDepTmTbl_ActvDay);
	snprintf(buffer, elcount(buffer), "   0.000000 F1 CPC::PNHV_EnergyMngmntSet_Rs2_AR::PNHV_WeekDepTmTbl_ActvDay = %d\n", intval);
	filePutString (buffer, elcount(buffer), hFile);
	intval = getSignal(CHASSIS::PNHV_EnergyMngmntSet_Rs2_AR::PNHV_Wakeup_Rq_CntDn);
	snprintf(buffer, elcount(buffer), "   0.000000 F1 CPC::PNHV_EnergyMngmntSet_Rs2_AR::PNHV_Wakeup_Rq_CntDn = %d\n", intval);
	filePutString (buffer, elcount(buffer), hFile);
	intval = @sysvar::CH_Nodes::CH_CPCCRC_PNHV_Stat_Pr2PNHV_AUTO;
	snprintf(buffer, elcount(buffer), "   0.000000    SV: 2 0 0 ::CH_Nodes::CH_CPCCRC_PNHV_Stat_Pr2PNHV_AUTO = %d\n", intval);
	filePutString (buffer, elcount(buffer), hFile);
	intval = getSignal(CHASSIS::PNHV_Stat_AR2::CRC_PNHV_Stat_Pr2);
	snprintf(buffer, elcount(buffer), "   0.000000 F1 CPC::PNHV_Stat_AR2::CRC_PNHV_Stat_Pr2 = %d\n", intval);
	filePutString (buffer, elcount(buffer), hFile);
	intval = @sysvar::CH_Nodes::CH_CPCSQC_PNHV_Stat_Pr2PNHV_AUTO;
	snprintf(buffer, elcount(buffer), "   0.000000    SV: 2 0 0 ::CH_Nodes::CH_CPCSQC_PNHV_Stat_Pr2PNHV_AUTO = %d\n", intval);
	filePutString (buffer, elcount(buffer), hFile);
	intval = getSignal(CHASSIS::PNHV_Stat_AR2::SQC_PNHV_Stat_Pr2);
	snprintf(buffer, elcount(buffer), "   0.000000 F1 CPC::PNHV_Stat_AR2::SQC_PNHV_Stat_Pr2 = %d\n", intval);
	filePutString (buffer, elcount(buffer), hFile);
	intval = getSignal(CHASSIS::PNHV_Stat_AR2::PNHV_BatCutSw_Err_V2);
	snprintf(buffer, elcount(buffer), "   0.000000 F1 CPC::PNHV_Stat_AR2::PNHV_BatCutSw_Err_V2 = %d\n", intval);
	filePutString (buffer, elcount(buffer), hFile);
	intval = getSignal(CHASSIS::PNHV_Stat_AR2::PNHV_BatCutSw_Stat);
	snprintf(buffer, elcount(buffer), "   0.000000 F1 CPC::PNHV_Stat_AR2::PNHV_BatCutSw_Stat = %d\n", intval);
	filePutString (buffer, elcount(buffer), hFile);
	intval = getSignal(CHASSIS::PNHV_Stat_AR2::PNHV_ExtIso_Err_V2);
	snprintf(buffer, elcount(buffer), "   0.000000 F1 CPC::PNHV_Stat_AR2::PNHV_ExtIso_Err_V2 = %d\n", intval);
	filePutString (buffer, elcount(buffer), hFile);
	intval = getSignal(CHASSIS::PNHV_Stat_AR2::PNHV_IntIso_Err_V2);
	snprintf(buffer, elcount(buffer), "   0.000000 F1 CPC::PNHV_Stat_AR2::PNHV_IntIso_Err_V2 = %d\n", intval);
	filePutString (buffer, elcount(buffer), hFile);
	intval = getSignal(CHASSIS::PNHV_Stat_AR2::PNHV_Bat_Intrlk_Err);
	snprintf(buffer, elcount(buffer), "   0.000000 F1 CPC::PNHV_Stat_AR2::PNHV_Bat_Intrlk_Err = %d\n", intval);
	filePutString (buffer, elcount(buffer), hFile);
	intval = getSignal(CHASSIS::PNHV_Stat_AR2::PNHV_Bat_SOC_Recal_Rq);
	snprintf(buffer, elcount(buffer), "   0.000000 F1 CPC::PNHV_Stat_AR2::PNHV_Bat_SOC_Recal_Rq = %d\n", intval);
	filePutString (buffer, elcount(buffer), hFile);
	intval = getSignal(CHASSIS::PNHV_Stat_AR2::PNHV_Bat_Volt_Src);
	snprintf(buffer, elcount(buffer), "   0.000000 F1 CPC::PNHV_Stat_AR2::PNHV_Bat_Volt_Src = %d\n", intval);
	filePutString (buffer, elcount(buffer), hFile);
	intval = getSignal(CHASSIS::PNHV_Stat_AR2::PNHV_Iso_Warn);
	snprintf(buffer, elcount(buffer), "   0.000000 F1 CPC::PNHV_Stat_AR2::PNHV_Iso_Warn = %d\n", intval);
	filePutString (buffer, elcount(buffer), hFile);
	intval = getSignal(CHASSIS::PNHV_Stat_AR2::PNHV_Bat_LHOM);
	snprintf(buffer, elcount(buffer), "   0.000000 F1 CPC::PNHV_Stat_AR2::PNHV_Bat_LHOM = %d\n", intval);
	filePutString (buffer, elcount(buffer), hFile);
	intval = getSignal(CHASSIS::PNHV_Stat_AR2::PNHV_PreChrgRst_Ovrht);
	snprintf(buffer, elcount(buffer), "   0.000000 F1 CPC::PNHV_Stat_AR2::PNHV_PreChrgRst_Ovrht = %d\n", intval);
	filePutString (buffer, elcount(buffer), hFile);
	intval = getSignal(CHASSIS::PNHV_Stat_AR2::PNHV_Bat_Fuse_Stat);
	snprintf(buffer, elcount(buffer), "   0.000000 F1 CPC::PNHV_Stat_AR2::PNHV_Bat_Fuse_Stat = %d\n", intval);
	filePutString (buffer, elcount(buffer), hFile);
	intval = getSignal(CHASSIS::PNHV_Stat_AR2::MIL_On_Rq_BMS);
	snprintf(buffer, elcount(buffer), "   0.000000 F1 CPC::PNHV_Stat_AR2::MIL_On_Rq_BMS = %d\n", intval);
	filePutString (buffer, elcount(buffer), hFile);
	intval = getSignal(CHASSIS::PNHV_Stat_AR2::PNHV_BatSrv_Rq);
	snprintf(buffer, elcount(buffer), "   0.000000 F1 CPC::PNHV_Stat_AR2::PNHV_BatSrv_Rq = %d\n", intval);
	filePutString (buffer, elcount(buffer), hFile);
	intval = getSignal(CHASSIS::PNHV_Stat_AR2::PNHV_Bat_Cool_Rq);
	snprintf(buffer, elcount(buffer), "   0.000000 F1 CPC::PNHV_Stat_AR2::PNHV_Bat_Cool_Rq = %d\n", intval);
	filePutString (buffer, elcount(buffer), hFile);
	intval = getSignal(CHASSIS::PNHV_Stat_AR2::PNHV_BatCutFast_Opn_Rq);
	snprintf(buffer, elcount(buffer), "   0.000000 F1 CPC::PNHV_Stat_AR2::PNHV_BatCutFast_Opn_Rq = %d\n", intval);
	filePutString (buffer, elcount(buffer), hFile);
	intval = getSignal(CHASSIS::PNHV_Stat_AR2::PNHV_BatCutImm_Opn_Rq);
	snprintf(buffer, elcount(buffer), "   0.000000 F1 CPC::PNHV_Stat_AR2::PNHV_BatCutImm_Opn_Rq = %d\n", intval);
	filePutString (buffer, elcount(buffer), hFile);
	intval = getSignal(CHASSIS::PNHV_Stat_AR2::PNHV_BatNoCurr_Rq);
	snprintf(buffer, elcount(buffer), "   0.000000 F1 CPC::PNHV_Stat_AR2::PNHV_BatNoCurr_Rq = %d\n", intval);
	filePutString (buffer, elcount(buffer), hFile);
	floatval = getSignal(CHASSIS::PNHV_Stat_AR2::PNHV_Bat_SOC);
	snprintf(buffer, elcount(buffer), "   0.000000 F1 CPC::PNHV_Stat_AR2::PNHV_Bat_SOC = %f\n", floatval);
	filePutString (buffer, elcount(buffer), hFile);
	intval = getSignal(CHASSIS::PNHV_Stat_AR2::PNHV_Bat_Temp);
	snprintf(buffer, elcount(buffer), "   0.000000 F1 CPC::PNHV_Stat_AR2::PNHV_Bat_Temp = %d\n", intval);
	filePutString (buffer, elcount(buffer), hFile);
	intval = getSignal(CHASSIS::PNHV_WeekDepTmTbl_Stat_AR2::PNHV_WeekDepTmTbl_TxActv);
	snprintf(buffer, elcount(buffer), "   0.000000 F1 CPC::PNHV_WeekDepTmTbl_Stat_AR2::PNHV_WeekDepTmTbl_TxActv = %d\n", intval);
	filePutString (buffer, elcount(buffer), hFile);
	intval = getSignal(CHASSIS::PNHV_WeekDepTmTbl_Stat_AR2::PNHV_WeekDepTmTbl_New);
	snprintf(buffer, elcount(buffer), "   0.000000 F1 CPC::PNHV_WeekDepTmTbl_Stat_AR2::PNHV_WeekDepTmTbl_New = %d\n", intval);
	filePutString (buffer, elcount(buffer), hFile);
	intval = getSignal(CHASSIS::PNHV_WeekDepTmTbl_Stat_AR2::PNHV_WeekDepTmTbl_PartId);
	snprintf(buffer, elcount(buffer), "   0.000000 F1 CPC::PNHV_WeekDepTmTbl_Stat_AR2::PNHV_WeekDepTmTbl_PartId = %d\n", intval);
	filePutString (buffer, elcount(buffer), hFile);
	intval = getSignal(CHASSIS::PNHV_WeekDepTmTbl_Stat_AR2::PNHV_DepTmUpdtCnt_1To4);
	snprintf(buffer, elcount(buffer), "   0.000000 F1 CPC::PNHV_WeekDepTmTbl_Stat_AR2::PNHV_DepTmUpdtCnt_1To4 = %d\n", intval);
	filePutString (buffer, elcount(buffer), hFile);
	intval = getSignal(CHASSIS::PNHV_WeekDepTmTbl_Stat_AR2::PNHV_DepTm01);
	snprintf(buffer, elcount(buffer), "   0.000000 F1 CPC::PNHV_WeekDepTmTbl_Stat_AR2::PNHV_DepTm01 = %d\n", intval);
	filePutString (buffer, elcount(buffer), hFile);
	intval = getSignal(CHASSIS::PNHV_WeekDepTmTbl_Stat_AR2::PNHV_DepTm02);
	snprintf(buffer, elcount(buffer), "   0.000000 F1 CPC::PNHV_WeekDepTmTbl_Stat_AR2::PNHV_DepTm02 = %d\n", intval);
	filePutString (buffer, elcount(buffer), hFile);
	intval = getSignal(CHASSIS::PNHV_WeekDepTmTbl_Stat_AR2::PNHV_DepTm03);
	snprintf(buffer, elcount(buffer), "   0.000000 F1 CPC::PNHV_WeekDepTmTbl_Stat_AR2::PNHV_DepTm03 = %d\n", intval);
	filePutString (buffer, elcount(buffer), hFile);
	intval = getSignal(CHASSIS::PNHV_WeekDepTmTbl_Stat_AR2::PNHV_DepTm04);
	snprintf(buffer, elcount(buffer), "   0.000000 F1 CPC::PNHV_WeekDepTmTbl_Stat_AR2::PNHV_DepTm04 = %d\n", intval);
	filePutString (buffer, elcount(buffer), hFile);
	intval = getSignal(CHASSIS::PNHV_WeekDepTmTbl_Stat_AR2::PNHV_DepTmUpdtCnt_5To8);
	snprintf(buffer, elcount(buffer), "   0.000000 F1 CPC::PNHV_WeekDepTmTbl_Stat_AR2::PNHV_DepTmUpdtCnt_5To8 = %d\n", intval);
	filePutString (buffer, elcount(buffer), hFile);
	intval = getSignal(CHASSIS::PNHV_WeekDepTmTbl_Stat_AR2::PNHV_DepTm05);
	snprintf(buffer, elcount(buffer), "   0.000000 F1 CPC::PNHV_WeekDepTmTbl_Stat_AR2::PNHV_DepTm05 = %d\n", intval);
	filePutString (buffer, elcount(buffer), hFile);
	intval = getSignal(CHASSIS::PNHV_WeekDepTmTbl_Stat_AR2::PNHV_DepTm06);
	snprintf(buffer, elcount(buffer), "   0.000000 F1 CPC::PNHV_WeekDepTmTbl_Stat_AR2::PNHV_DepTm06 = %d\n", intval);
	filePutString (buffer, elcount(buffer), hFile);
}
/*@@end*/

/*@@caplFunc:saveVars_10(dword):*/
void saveVars_10(dword hFile)
{
	intval = getSignal(CHASSIS::PNHV_WeekDepTmTbl_Stat_AR2::PNHV_DepTm07);
	snprintf(buffer, elcount(buffer), "   0.000000 F1 CPC::PNHV_WeekDepTmTbl_Stat_AR2::PNHV_DepTm07 = %d\n", intval);
	filePutString (buffer, elcount(buffer), hFile);
	intval = getSignal(CHASSIS::PNHV_WeekDepTmTbl_Stat_AR2::PNHV_DepTm08);
	snprintf(buffer, elcount(buffer), "   0.000000 F1 CPC::PNHV_WeekDepTmTbl_Stat_AR2::PNHV_DepTm08 = %d\n", intval);
	filePutString (buffer, elcount(buffer), hFile);
	intval = getSignal(CHASSIS::PNHV_WeekDepTmTbl_Stat_AR2::PNHV_DepTmUpdtCnt_9To12);
	snprintf(buffer, elcount(buffer), "   0.000000 F1 CPC::PNHV_WeekDepTmTbl_Stat_AR2::PNHV_DepTmUpdtCnt_9To12 = %d\n", intval);
	filePutString (buffer, elcount(buffer), hFile);
	intval = getSignal(CHASSIS::PNHV_WeekDepTmTbl_Stat_AR2::PNHV_DepTm09);
	snprintf(buffer, elcount(buffer), "   0.000000 F1 CPC::PNHV_WeekDepTmTbl_Stat_AR2::PNHV_DepTm09 = %d\n", intval);
	filePutString (buffer, elcount(buffer), hFile);
	intval = getSignal(CHASSIS::PNHV_WeekDepTmTbl_Stat_AR2::PNHV_DepTm10);
	snprintf(buffer, elcount(buffer), "   0.000000 F1 CPC::PNHV_WeekDepTmTbl_Stat_AR2::PNHV_DepTm10 = %d\n", intval);
	filePutString (buffer, elcount(buffer), hFile);
	intval = getSignal(CHASSIS::PNHV_WeekDepTmTbl_Stat_AR2::PNHV_DepTm11);
	snprintf(buffer, elcount(buffer), "   0.000000 F1 CPC::PNHV_WeekDepTmTbl_Stat_AR2::PNHV_DepTm11 = %d\n", intval);
	filePutString (buffer, elcount(buffer), hFile);
	intval = getSignal(CHASSIS::PNHV_WeekDepTmTbl_Stat_AR2::PNHV_DepTm12);
	snprintf(buffer, elcount(buffer), "   0.000000 F1 CPC::PNHV_WeekDepTmTbl_Stat_AR2::PNHV_DepTm12 = %d\n", intval);
	filePutString (buffer, elcount(buffer), hFile);
	intval = getSignal(CHASSIS::PNHV_WeekDepTmTbl_Stat_AR2::PNHV_DepTmUpdtCnt_13To16);
	snprintf(buffer, elcount(buffer), "   0.000000 F1 CPC::PNHV_WeekDepTmTbl_Stat_AR2::PNHV_DepTmUpdtCnt_13To16 = %d\n", intval);
	filePutString (buffer, elcount(buffer), hFile);
	intval = getSignal(CHASSIS::PNHV_WeekDepTmTbl_Stat_AR2::PNHV_DepTm13);
	snprintf(buffer, elcount(buffer), "   0.000000 F1 CPC::PNHV_WeekDepTmTbl_Stat_AR2::PNHV_DepTm13 = %d\n", intval);
	filePutString (buffer, elcount(buffer), hFile);
	intval = getSignal(CHASSIS::PNHV_WeekDepTmTbl_Stat_AR2::PNHV_DepTm14);
	snprintf(buffer, elcount(buffer), "   0.000000 F1 CPC::PNHV_WeekDepTmTbl_Stat_AR2::PNHV_DepTm14 = %d\n", intval);
	filePutString (buffer, elcount(buffer), hFile);
	intval = getSignal(CHASSIS::PNHV_WeekDepTmTbl_Stat_AR2::PNHV_DepTm15);
	snprintf(buffer, elcount(buffer), "   0.000000 F1 CPC::PNHV_WeekDepTmTbl_Stat_AR2::PNHV_DepTm15 = %d\n", intval);
	filePutString (buffer, elcount(buffer), hFile);
	intval = getSignal(CHASSIS::PNHV_WeekDepTmTbl_Stat_AR2::PNHV_DepTm16);
	snprintf(buffer, elcount(buffer), "   0.000000 F1 CPC::PNHV_WeekDepTmTbl_Stat_AR2::PNHV_DepTm16 = %d\n", intval);
	filePutString (buffer, elcount(buffer), hFile);
	intval = getSignal(CHASSIS::PNHV_WeekDepTmTbl_Stat_AR2::PNHV_DepTmUpdtCnt_17To20);
	snprintf(buffer, elcount(buffer), "   0.000000 F1 CPC::PNHV_WeekDepTmTbl_Stat_AR2::PNHV_DepTmUpdtCnt_17To20 = %d\n", intval);
	filePutString (buffer, elcount(buffer), hFile);
	intval = getSignal(CHASSIS::PNHV_WeekDepTmTbl_Stat_AR2::PNHV_DepTm17);
	snprintf(buffer, elcount(buffer), "   0.000000 F1 CPC::PNHV_WeekDepTmTbl_Stat_AR2::PNHV_DepTm17 = %d\n", intval);
	filePutString (buffer, elcount(buffer), hFile);
	intval = getSignal(CHASSIS::PNHV_WeekDepTmTbl_Stat_AR2::PNHV_DepTm18);
	snprintf(buffer, elcount(buffer), "   0.000000 F1 CPC::PNHV_WeekDepTmTbl_Stat_AR2::PNHV_DepTm18 = %d\n", intval);
	filePutString (buffer, elcount(buffer), hFile);
	intval = getSignal(CHASSIS::PNHV_WeekDepTmTbl_Stat_AR2::PNHV_DepTm19);
	snprintf(buffer, elcount(buffer), "   0.000000 F1 CPC::PNHV_WeekDepTmTbl_Stat_AR2::PNHV_DepTm19 = %d\n", intval);
	filePutString (buffer, elcount(buffer), hFile);
	intval = getSignal(CHASSIS::PNHV_WeekDepTmTbl_Stat_AR2::PNHV_DepTm20);
	snprintf(buffer, elcount(buffer), "   0.000000 F1 CPC::PNHV_WeekDepTmTbl_Stat_AR2::PNHV_DepTm20 = %d\n", intval);
	filePutString (buffer, elcount(buffer), hFile);
	intval = getSignal(CHASSIS::PNHV_WeekDepTmTbl_Stat_AR2::PNHV_DepTmUpdtCnt_21);
	snprintf(buffer, elcount(buffer), "   0.000000 F1 CPC::PNHV_WeekDepTmTbl_Stat_AR2::PNHV_DepTmUpdtCnt_21 = %d\n", intval);
	filePutString (buffer, elcount(buffer), hFile);
	intval = getSignal(CHASSIS::PNHV_WeekDepTmTbl_Stat_AR2::PNHV_DepTm21);
	snprintf(buffer, elcount(buffer), "   0.000000 F1 CPC::PNHV_WeekDepTmTbl_Stat_AR2::PNHV_DepTm21 = %d\n", intval);
	filePutString (buffer, elcount(buffer), hFile);
	intval = getSignal(CHASSIS::PT_DataContain_Rq_AR2::HDC_SvContain_Rq);
	snprintf(buffer, elcount(buffer), "   0.000000 F1 CPC::PT_DataContain_Rq_AR2::HDC_SvContain_Rq = %d\n", intval);
	filePutString (buffer, elcount(buffer), hFile);
	intval = getSignal(CHASSIS::PT_DataContain_Rq_AR2::HDC_AttribData);
	snprintf(buffer, elcount(buffer), "   0.000000 F1 CPC::PT_DataContain_Rq_AR2::HDC_AttribData = %d\n", intval);
	filePutString (buffer, elcount(buffer), hFile);
	intval = getSignal(CHASSIS::PT_DataContain_Rq_AR2::HDC_AttribNum);
	snprintf(buffer, elcount(buffer), "   0.000000 F1 CPC::PT_DataContain_Rq_AR2::HDC_AttribNum = %d\n", intval);
	filePutString (buffer, elcount(buffer), hFile);
	intval = getSignal(CHASSIS::PT_DataContain_Rq_AR2::HDC_RouteNum);
	snprintf(buffer, elcount(buffer), "   0.000000 F1 CPC::PT_DataContain_Rq_AR2::HDC_RouteNum = %d\n", intval);
	filePutString (buffer, elcount(buffer), hFile);
	intval = getSignal(CHASSIS::PT_DataContain_Rq_AR2::HDC_PosnMark);
	snprintf(buffer, elcount(buffer), "   0.000000 F1 CPC::PT_DataContain_Rq_AR2::HDC_PosnMark = %d\n", intval);
	filePutString (buffer, elcount(buffer), hFile);
	intval = getSignal(CHASSIS::PT_Disp_Rq2_AR::EngTrqDisp_Max);
	snprintf(buffer, elcount(buffer), "   0.000000 F1 CPC::PT_Disp_Rq2_AR::EngTrqDisp_Max = %d\n", intval);
	filePutString (buffer, elcount(buffer), hFile);
	intval = getSignal(CHASSIS::PT_Disp_Rq2_AR::PT_DispLrnMax);
	snprintf(buffer, elcount(buffer), "   0.000000 F1 CPC::PT_Disp_Rq2_AR::PT_DispLrnMax = %d\n", intval);
	filePutString (buffer, elcount(buffer), hFile);
	intval = getSignal(CHASSIS::PT_Disp_Rq2_AR::EngPwrDisp_Max);
	snprintf(buffer, elcount(buffer), "   0.000000 F1 CPC::PT_Disp_Rq2_AR::EngPwrDisp_Max = %d\n", intval);
	filePutString (buffer, elcount(buffer), hFile);
	intval = getSignal(CHASSIS::PT_Disp_Rq2_AR::EngTrqDisp);
	snprintf(buffer, elcount(buffer), "   0.000000 F1 CPC::PT_Disp_Rq2_AR::EngTrqDisp = %d\n", intval);
	filePutString (buffer, elcount(buffer), hFile);
	intval = getSignal(CHASSIS::PT_Disp_Rq2_AR::EngPwrDisp);
	snprintf(buffer, elcount(buffer), "   0.000000 F1 CPC::PT_Disp_Rq2_AR::EngPwrDisp = %d\n", intval);
	filePutString (buffer, elcount(buffer), hFile);
	intval = getSignal(CHASSIS::PT_ThermM_AR2::EngOilTemp);
	snprintf(buffer, elcount(buffer), "   0.000000 F1 CPC::PT_ThermM_AR2::EngOilTemp = %d\n", intval);
	filePutString (buffer, elcount(buffer), hFile);
	intval = getSignal(CHASSIS::PT_ThermM_AR2::HtPwr_Stat);
	snprintf(buffer, elcount(buffer), "   0.000000 F1 CPC::PT_ThermM_AR2::HtPwr_Stat = %d\n", intval);
	filePutString (buffer, elcount(buffer), hFile);
	intval = getSignal(CHASSIS::PT_ThermM_Rq_AR2::LowTempCoolIndLmp_On_Rq);
	snprintf(buffer, elcount(buffer), "   0.000000 F1 CPC::PT_ThermM_Rq_AR2::LowTempCoolIndLmp_On_Rq = %d\n", intval);
	filePutString (buffer, elcount(buffer), hFile);
	intval = getSignal(CHASSIS::PT_ThermM_Rq_AR2::FanMtrIndLmp_On_Rq);
	snprintf(buffer, elcount(buffer), "   0.000000 F1 CPC::PT_ThermM_Rq_AR2::FanMtrIndLmp_On_Rq = %d\n", intval);
	filePutString (buffer, elcount(buffer), hFile);
	intval = getSignal(CHASSIS::PtHyb_Mngmnt_Rq1_AR::RemTank_Unlk_Rq);
	snprintf(buffer, elcount(buffer), "   0.000000 F1 CPC::PtHyb_Mngmnt_Rq1_AR::RemTank_Unlk_Rq = %d\n", intval);
	filePutString (buffer, elcount(buffer), hFile);
	intval = getSignal(CHASSIS::PtHyb_Mngmnt_Rq1_AR::RemTank_SwLED_Rq);
	snprintf(buffer, elcount(buffer), "   0.000000 F1 CPC::PtHyb_Mngmnt_Rq1_AR::RemTank_SwLED_Rq = %d\n", intval);
	filePutString (buffer, elcount(buffer), hFile);
	intval = getSignal(CHASSIS::PtMngmnt_Disp_Rq_AR2::SSA_Msg_Disp_Rq);
	snprintf(buffer, elcount(buffer), "   0.000000 F1 CPC::PtMngmnt_Disp_Rq_AR2::SSA_Msg_Disp_Rq = %d\n", intval);
	filePutString (buffer, elcount(buffer), hFile);
	intval = getSignal(CHASSIS::PtMngmnt_Disp_Rq_AR2::SSA_ECO_Md_DispCol_Rq);
	snprintf(buffer, elcount(buffer), "   0.000000 F1 CPC::PtMngmnt_Disp_Rq_AR2::SSA_ECO_Md_DispCol_Rq = %d\n", intval);
	filePutString (buffer, elcount(buffer), hFile);
	intval = getSignal(CHASSIS::PtMngmnt_Disp_Rq_AR2::SSA_ECO_Md_Actv_Disp_Rq);
	snprintf(buffer, elcount(buffer), "   0.000000 F1 CPC::PtMngmnt_Disp_Rq_AR2::SSA_ECO_Md_Actv_Disp_Rq = %d\n", intval);
	filePutString (buffer, elcount(buffer), hFile);
	intval = getSignal(CHASSIS::PtMngmnt_Disp_Rq_AR2::Hyb_EnergyFlow_Disp_Rq_V2);
	snprintf(buffer, elcount(buffer), "   0.000000 F1 CPC::PtMngmnt_Disp_Rq_AR2::Hyb_EnergyFlow_Disp_Rq_V2 = %d\n", intval);
	filePutString (buffer, elcount(buffer), hFile);
	intval = getSignal(CHASSIS::PtMngmnt_Disp_Rq_AR2::EngOilPress_Warn_Rq);
	snprintf(buffer, elcount(buffer), "   0.000000 F1 CPC::PtMngmnt_Disp_Rq_AR2::EngOilPress_Warn_Rq = %d\n", intval);
	filePutString (buffer, elcount(buffer), hFile);
	intval = getSignal(CHASSIS::PtMngmnt_Disp_Rq_AR2::Hyb_WarnDisp_Rq);
	snprintf(buffer, elcount(buffer), "   0.000000 F1 CPC::PtMngmnt_Disp_Rq_AR2::Hyb_WarnDisp_Rq = %d\n", intval);
	filePutString (buffer, elcount(buffer), hFile);
	intval = getSignal(CHASSIS::PtMngmnt_Disp_Rq_AR2::PlugInHyb_OprtnMd_V2);
	snprintf(buffer, elcount(buffer), "   0.000000 F1 CPC::PtMngmnt_Disp_Rq_AR2::PlugInHyb_OprtnMd_V2 = %d\n", intval);
	filePutString (buffer, elcount(buffer), hFile);
	intval = getSignal(CHASSIS::PtMngmnt_Disp_Rq_AR2::PressClutchPdl_MsgDisp_Rq);
	snprintf(buffer, elcount(buffer), "   0.000000 F1 CPC::PtMngmnt_Disp_Rq_AR2::PressClutchPdl_MsgDisp_Rq = %d\n", intval);
	filePutString (buffer, elcount(buffer), hFile);
	intval = getSignal(CHASSIS::PtMngmnt_Disp_Rq_AR2::IndLmpChk_Off_Rq);
	snprintf(buffer, elcount(buffer), "   0.000000 F1 CPC::PtMngmnt_Disp_Rq_AR2::IndLmpChk_Off_Rq = %d\n", intval);
	filePutString (buffer, elcount(buffer), hFile);
	intval = getSignal(CHASSIS::PtMngmnt_Disp_Rq_AR2::ClutchOverTemp_Disp_Rq);
	snprintf(buffer, elcount(buffer), "   0.000000 F1 CPC::PtMngmnt_Disp_Rq_AR2::ClutchOverTemp_Disp_Rq = %d\n", intval);
	filePutString (buffer, elcount(buffer), hFile);
	intval = getSignal(CHASSIS::PtMngmnt_Disp_Rq_AR2::SSA_ECO_Sw_LED_On_Rq);
	snprintf(buffer, elcount(buffer), "   0.000000 F1 CPC::PtMngmnt_Disp_Rq_AR2::SSA_ECO_Sw_LED_On_Rq = %d\n", intval);
	filePutString (buffer, elcount(buffer), hFile);
	floatval = getSignal(CHASSIS::PtMngmnt_Disp_Rq_AR2::PNHV_Bat_SOC_Disp_Rq);
	snprintf(buffer, elcount(buffer), "   0.000000 F1 CPC::PtMngmnt_Disp_Rq_AR2::PNHV_Bat_SOC_Disp_Rq = %f\n", floatval);
	filePutString (buffer, elcount(buffer), hFile);
	intval = getSignal(CHASSIS::PtMngmnt_Disp_Rq_AR2::PT_Rdy_IndLmp_Rq);
	snprintf(buffer, elcount(buffer), "   0.000000 F1 CPC::PtMngmnt_Disp_Rq_AR2::PT_Rdy_IndLmp_Rq = %d\n", intval);
	filePutString (buffer, elcount(buffer), hFile);
	intval = getSignal(CHASSIS::PtMngmnt_Disp_Rq_AR2::Hyb_Energy_WarnDisp_Rq);
	snprintf(buffer, elcount(buffer), "   0.000000 F1 CPC::PtMngmnt_Disp_Rq_AR2::Hyb_Energy_WarnDisp_Rq = %d\n", intval);
	filePutString (buffer, elcount(buffer), hFile);
	intval = getSignal(CHASSIS::PtMngmnt_Disp_Rq_AR2::PlugInHyb_OprtnMdMsg_V2);
	snprintf(buffer, elcount(buffer), "   0.000000 F1 CPC::PtMngmnt_Disp_Rq_AR2::PlugInHyb_OprtnMdMsg_V2 = %d\n", intval);
	filePutString (buffer, elcount(buffer), hFile);
	intval = getSignal(CHASSIS::PtMngmnt_Disp_Rq_AR2::HybPwr_Disp_Rq);
	snprintf(buffer, elcount(buffer), "   0.000000 F1 CPC::PtMngmnt_Disp_Rq_AR2::HybPwr_Disp_Rq = %d\n", intval);
	filePutString (buffer, elcount(buffer), hFile);
}
/*@@end*/

/*@@caplFunc:saveVars_11(dword):*/
void saveVars_11(dword hFile)
{
	intval = @sysvar::CH_Nodes::CH_CPCCRC_PtMngmnt_Rq_Pr2Pt_AUTO;
	snprintf(buffer, elcount(buffer), "   0.000000    SV: 2 0 0 ::CH_Nodes::CH_CPCCRC_PtMngmnt_Rq_Pr2Pt_AUTO = %d\n", intval);
	filePutString (buffer, elcount(buffer), hFile);
	intval = getSignal(CHASSIS::PtMngmnt_Rq_AR2::CRC_PtMngmnt_Rq_Pr2);
	snprintf(buffer, elcount(buffer), "   0.000000 F1 CPC::PtMngmnt_Rq_AR2::CRC_PtMngmnt_Rq_Pr2 = %d\n", intval);
	filePutString (buffer, elcount(buffer), hFile);
	intval = @sysvar::CH_Nodes::CH_CPCSQC_PtMngmnt_Rq_Pr2Pt_AUTO;
	snprintf(buffer, elcount(buffer), "   0.000000    SV: 2 0 0 ::CH_Nodes::CH_CPCSQC_PtMngmnt_Rq_Pr2Pt_AUTO = %d\n", intval);
	filePutString (buffer, elcount(buffer), hFile);
	intval = getSignal(CHASSIS::PtMngmnt_Rq_AR2::SQC_PtMngmnt_Rq_Pr2);
	snprintf(buffer, elcount(buffer), "   0.000000 F1 CPC::PtMngmnt_Rq_AR2::SQC_PtMngmnt_Rq_Pr2 = %d\n", intval);
	filePutString (buffer, elcount(buffer), hFile);
	intval = getSignal(CHASSIS::PtMngmnt_Rq_AR2::TxPkPosn_Rq_ECM);
	snprintf(buffer, elcount(buffer), "   0.000000 F1 CPC::PtMngmnt_Rq_AR2::TxPkPosn_Rq_ECM = %d\n", intval);
	filePutString (buffer, elcount(buffer), hFile);
	intval = getSignal(CHASSIS::PtMngmnt_Rq_AR2::SSA_EngSp);
	snprintf(buffer, elcount(buffer), "   0.000000 F1 CPC::PtMngmnt_Rq_AR2::SSA_EngSp = %d\n", intval);
	filePutString (buffer, elcount(buffer), hFile);
	intval = getSignal(CHASSIS::PtMngmnt_Rq_AR2::SSA_Sp_Warn);
	snprintf(buffer, elcount(buffer), "   0.000000 F1 CPC::PtMngmnt_Rq_AR2::SSA_Sp_Warn = %d\n", intval);
	filePutString (buffer, elcount(buffer), hFile);
	intval = getSignal(CHASSIS::PtMngmnt_Rq_AR2::Rsrv2_PtMngmnt_Rq_Pr2);
	snprintf(buffer, elcount(buffer), "   0.000000 F1 CPC::PtMngmnt_Rq_AR2::Rsrv2_PtMngmnt_Rq_Pr2 = %d\n", intval);
	filePutString (buffer, elcount(buffer), hFile);
	intval = getSignal(CHASSIS::PtMngmnt_Rq_AR2::GrMin_Rq_ECM_V2);
	snprintf(buffer, elcount(buffer), "   0.000000 F1 CPC::PtMngmnt_Rq_AR2::GrMin_Rq_ECM_V2 = %d\n", intval);
	filePutString (buffer, elcount(buffer), hFile);
	intval = getSignal(CHASSIS::PtMngmnt_Rq_AR2::GrMax_Rq_ECM_V2);
	snprintf(buffer, elcount(buffer), "   0.000000 F1 CPC::PtMngmnt_Rq_AR2::GrMax_Rq_ECM_V2 = %d\n", intval);
	filePutString (buffer, elcount(buffer), hFile);
	intval = getSignal(CHASSIS::PtMngmnt_Rq_AR2::Recup_Dsabl_Rq_PT);
	snprintf(buffer, elcount(buffer), "   0.000000 F1 CPC::PtMngmnt_Rq_AR2::Recup_Dsabl_Rq_PT = %d\n", intval);
	filePutString (buffer, elcount(buffer), hFile);
	intval = getSignal(CHASSIS::PtMngmnt_Rq_AR2::Rsrv1_PtMngmnt_Rq_Pr2);
	snprintf(buffer, elcount(buffer), "   0.000000 F1 CPC::PtMngmnt_Rq_AR2::Rsrv1_PtMngmnt_Rq_Pr2 = %d\n", intval);
	filePutString (buffer, elcount(buffer), hFile);
	intval = getSignal(CHASSIS::PtMngmnt_Rq_AR2::ExhstFlap_Stg_AMG);
	snprintf(buffer, elcount(buffer), "   0.000000 F1 CPC::PtMngmnt_Rq_AR2::ExhstFlap_Stg_AMG = %d\n", intval);
	filePutString (buffer, elcount(buffer), hFile);
	floatval = getSignal(CHASSIS::PtMngmnt_Rq_AR2::TCC_Opn_RemainTm_HDC);
	snprintf(buffer, elcount(buffer), "   0.000000 F1 CPC::PtMngmnt_Rq_AR2::TCC_Opn_RemainTm_HDC = %f\n", floatval);
	filePutString (buffer, elcount(buffer), hFile);
	intval = getSignal(CHASSIS::PtMngmnt_Rq_AR2::Clutch_Adpn_Enbl);
	snprintf(buffer, elcount(buffer), "   0.000000 F1 CPC::PtMngmnt_Rq_AR2::Clutch_Adpn_Enbl = %d\n", intval);
	filePutString (buffer, elcount(buffer), hFile);
	intval = getSignal(CHASSIS::PtMngmnt_Rq_AR2::ESP_Intrvntn_Stat_ECM);
	snprintf(buffer, elcount(buffer), "   0.000000 F1 CPC::PtMngmnt_Rq_AR2::ESP_Intrvntn_Stat_ECM = %d\n", intval);
	filePutString (buffer, elcount(buffer), hFile);
	intval = getSignal(CHASSIS::PtMngmnt_Rq_AR2::ECM_Creep_Abort_Stat);
	snprintf(buffer, elcount(buffer), "   0.000000 F1 CPC::PtMngmnt_Rq_AR2::ECM_Creep_Abort_Stat = %d\n", intval);
	filePutString (buffer, elcount(buffer), hFile);
	intval = getSignal(CHASSIS::PtMngmnt_Rq_AR2::WDC_Intrvntn_ECM);
	snprintf(buffer, elcount(buffer), "   0.000000 F1 CPC::PtMngmnt_Rq_AR2::WDC_Intrvntn_ECM = %d\n", intval);
	filePutString (buffer, elcount(buffer), hFile);
	intval = getSignal(CHASSIS::PtMngmnt_Rq_AR2::TCM_DHill_ShftChrDsp_Rq);
	snprintf(buffer, elcount(buffer), "   0.000000 F1 CPC::PtMngmnt_Rq_AR2::TCM_DHill_ShftChrDsp_Rq = %d\n", intval);
	filePutString (buffer, elcount(buffer), hFile);
	intval = getSignal(CHASSIS::PtMngmnt_Rq_AR2::PwrFreeD_Rq_ECM);
	snprintf(buffer, elcount(buffer), "   0.000000 F1 CPC::PtMngmnt_Rq_AR2::PwrFreeD_Rq_ECM = %d\n", intval);
	filePutString (buffer, elcount(buffer), hFile);
	intval = @sysvar::CH_Nodes::CH_CPCCRC_PtMngmnt_Stat2_Pr_AUTO;
	snprintf(buffer, elcount(buffer), "   0.000000    SV: 2 0 0 ::CH_Nodes::CH_CPCCRC_PtMngmnt_Stat2_Pr_AUTO = %d\n", intval);
	filePutString (buffer, elcount(buffer), hFile);
	intval = getSignal(CHASSIS::PtMngmnt_Stat2_AR2::CRC_PtMngmnt_Stat2_Pr2);
	snprintf(buffer, elcount(buffer), "   0.000000 F1 CPC::PtMngmnt_Stat2_AR2::CRC_PtMngmnt_Stat2_Pr2 = %d\n", intval);
	filePutString (buffer, elcount(buffer), hFile);
	intval = @sysvar::CH_Nodes::CH_CPCSQC_PtMngmnt_Stat2_Pr_AUTO;
	snprintf(buffer, elcount(buffer), "   0.000000    SV: 2 0 0 ::CH_Nodes::CH_CPCSQC_PtMngmnt_Stat2_Pr_AUTO = %d\n", intval);
	filePutString (buffer, elcount(buffer), hFile);
	intval = getSignal(CHASSIS::PtMngmnt_Stat2_AR2::SQC_PtMngmnt_Stat2_Pr2);
	snprintf(buffer, elcount(buffer), "   0.000000 F1 CPC::PtMngmnt_Stat2_AR2::SQC_PtMngmnt_Stat2_Pr2 = %d\n", intval);
	filePutString (buffer, elcount(buffer), hFile);
	floatval = getSignal(CHASSIS::PtMngmnt_Stat2_AR2::WDC_OutTrq_Rq_ECM_V3);
	snprintf(buffer, elcount(buffer), "   0.000000 F1 CPC::PtMngmnt_Stat2_AR2::WDC_OutTrq_Rq_ECM_V3 = %f\n", floatval);
	filePutString (buffer, elcount(buffer), hFile);
	floatval = getSignal(CHASSIS::PtMngmnt_Stat2_AR2::EM2_BoostTrqMax_TCM);
	snprintf(buffer, elcount(buffer), "   0.000000 F1 CPC::PtMngmnt_Stat2_AR2::EM2_BoostTrqMax_TCM = %f\n", floatval);
	filePutString (buffer, elcount(buffer), hFile);
	intval = getSignal(CHASSIS::PtMngmnt_Stat2_AR2::PushStrtCtl_Rq_CPC);
	snprintf(buffer, elcount(buffer), "   0.000000 F1 CPC::PtMngmnt_Stat2_AR2::PushStrtCtl_Rq_CPC = %d\n", intval);
	filePutString (buffer, elcount(buffer), hFile);
	intval = getSignal(CHASSIS::PtMngmnt_Stat2_AR2::HDC_NoShiftDwn_Rq);
	snprintf(buffer, elcount(buffer), "   0.000000 F1 CPC::PtMngmnt_Stat2_AR2::HDC_NoShiftDwn_Rq = %d\n", intval);
	filePutString (buffer, elcount(buffer), hFile);
	intval = getSignal(CHASSIS::PtMngmnt_Stat2_AR2::HDC_GrdntMd_Rq_WDC);
	snprintf(buffer, elcount(buffer), "   0.000000 F1 CPC::PtMngmnt_Stat2_AR2::HDC_GrdntMd_Rq_WDC = %d\n", intval);
	filePutString (buffer, elcount(buffer), hFile);
	intval = getSignal(CHASSIS::PtMngmnt_Stat2_AR2::Rsrv1_PtMngmnt_Stat2_Pr2);
	snprintf(buffer, elcount(buffer), "   0.000000 F1 CPC::PtMngmnt_Stat2_AR2::Rsrv1_PtMngmnt_Stat2_Pr2 = %d\n", intval);
	filePutString (buffer, elcount(buffer), hFile);
	intval = getSignal(CHASSIS::PtMngmnt_Stat2_AR2::HybStartMd_ECM);
	snprintf(buffer, elcount(buffer), "   0.000000 F1 CPC::PtMngmnt_Stat2_AR2::HybStartMd_ECM = %d\n", intval);
	filePutString (buffer, elcount(buffer), hFile);
	intval = getSignal(CHASSIS::PtMngmnt_Stat2_AR2::HybSys_Actv);
	snprintf(buffer, elcount(buffer), "   0.000000 F1 CPC::PtMngmnt_Stat2_AR2::HybSys_Actv = %d\n", intval);
	filePutString (buffer, elcount(buffer), hFile);
	intval = getSignal(CHASSIS::PtMngmnt_Stat2_AR2::SSA_Start_Warn);
	snprintf(buffer, elcount(buffer), "   0.000000 F1 CPC::PtMngmnt_Stat2_AR2::SSA_Start_Warn = %d\n", intval);
	filePutString (buffer, elcount(buffer), hFile);
	intval = getSignal(CHASSIS::PtMngmnt_Stat2_AR2::HybDrv_Md);
	snprintf(buffer, elcount(buffer), "   0.000000 F1 CPC::PtMngmnt_Stat2_AR2::HybDrv_Md = %d\n", intval);
	filePutString (buffer, elcount(buffer), hFile);
	intval = getSignal(CHASSIS::PtMngmnt_Stat2_AR2::Hyb_GrChg_Rq);
	snprintf(buffer, elcount(buffer), "   0.000000 F1 CPC::PtMngmnt_Stat2_AR2::Hyb_GrChg_Rq = %d\n", intval);
	filePutString (buffer, elcount(buffer), hFile);
	intval = getSignal(CHASSIS::PtMngmnt_Stat2_AR2::Hyb_ActvCmbstEng_Start);
	snprintf(buffer, elcount(buffer), "   0.000000 F1 CPC::PtMngmnt_Stat2_AR2::Hyb_ActvCmbstEng_Start = %d\n", intval);
	filePutString (buffer, elcount(buffer), hFile);
	intval = getSignal(CHASSIS::PtMngmnt_Stat2_AR2::HDC_EM01_Err);
	snprintf(buffer, elcount(buffer), "   0.000000 F1 CPC::PtMngmnt_Stat2_AR2::HDC_EM01_Err = %d\n", intval);
	filePutString (buffer, elcount(buffer), hFile);
	intval = getSignal(CHASSIS::PtMngmnt_Stat_AR2::Clutch_Disengg);
	snprintf(buffer, elcount(buffer), "   0.000000 F1 CPC::PtMngmnt_Stat_AR2::Clutch_Disengg = %d\n", intval);
	filePutString (buffer, elcount(buffer), hFile);
	intval = getSignal(CHASSIS::PtMngmnt_Stat_AR2::EngTrqInc_Enbl_TCM);
	snprintf(buffer, elcount(buffer), "   0.000000 F1 CPC::PtMngmnt_Stat_AR2::EngTrqInc_Enbl_TCM = %d\n", intval);
	filePutString (buffer, elcount(buffer), hFile);
	intval = getSignal(CHASSIS::PtMngmnt_Stat_AR2::EngTrqIncChk_Avl);
	snprintf(buffer, elcount(buffer), "   0.000000 F1 CPC::PtMngmnt_Stat_AR2::EngTrqIncChk_Avl = %d\n", intval);
	filePutString (buffer, elcount(buffer), hFile);
	intval = getSignal(CHASSIS::PtMngmnt_Stat_AR2::GrN_Engg_MTX);
	snprintf(buffer, elcount(buffer), "   0.000000 F1 CPC::PtMngmnt_Stat_AR2::GrN_Engg_MTX = %d\n", intval);
	filePutString (buffer, elcount(buffer), hFile);
	intval = getSignal(CHASSIS::PtMngmnt_Stat_AR2::LowFuelQual_Dtct);
	snprintf(buffer, elcount(buffer), "   0.000000 F1 CPC::PtMngmnt_Stat_AR2::LowFuelQual_Dtct = %d\n", intval);
	filePutString (buffer, elcount(buffer), hFile);
	intval = getSignal(CHASSIS::PtMngmnt_Stat_AR2::RevGr_Engg_MTX_ECM);
	snprintf(buffer, elcount(buffer), "   0.000000 F1 CPC::PtMngmnt_Stat_AR2::RevGr_Engg_MTX_ECM = %d\n", intval);
	filePutString (buffer, elcount(buffer), hFile);
	intval = getSignal(CHASSIS::PtMngmnt_Stat_AR2::DL_AllDr_Stat_CPC);
	snprintf(buffer, elcount(buffer), "   0.000000 F1 CPC::PtMngmnt_Stat_AR2::DL_AllDr_Stat_CPC = %d\n", intval);
	filePutString (buffer, elcount(buffer), hFile);
	floatval = getSignal(CHASSIS::PtMngmnt_Stat_AR2::HVAC_CompTrq_Max);
	snprintf(buffer, elcount(buffer), "   0.000000 F1 CPC::PtMngmnt_Stat_AR2::HVAC_CompTrq_Max = %f\n", floatval);
	filePutString (buffer, elcount(buffer), hFile);
	intval = getSignal(CHASSIS::PtMngmnt_Stat_AR2::VehFixMaxSpd_V2);
	snprintf(buffer, elcount(buffer), "   0.000000 F1 CPC::PtMngmnt_Stat_AR2::VehFixMaxSpd_V2 = %d\n", intval);
	filePutString (buffer, elcount(buffer), hFile);
	intval = getSignal(CHASSIS::PtMngmnt_Stat_AR2::DPC_Md_SSA_Rs);
	snprintf(buffer, elcount(buffer), "   0.000000 F1 CPC::PtMngmnt_Stat_AR2::DPC_Md_SSA_Rs = %d\n", intval);
	filePutString (buffer, elcount(buffer), hFile);
	intval = getSignal(CHASSIS::PtMngmnt_Stat_AR2::DPC_Md_eDrv_Rs);
	snprintf(buffer, elcount(buffer), "   0.000000 F1 CPC::PtMngmnt_Stat_AR2::DPC_Md_eDrv_Rs = %d\n", intval);
	filePutString (buffer, elcount(buffer), hFile);
	intval = getSignal(CHASSIS::PtMngmnt_Stat_AR2::CoastMd_Disp_Rq);
	snprintf(buffer, elcount(buffer), "   0.000000 F1 CPC::PtMngmnt_Stat_AR2::CoastMd_Disp_Rq = %d\n", intval);
	filePutString (buffer, elcount(buffer), hFile);
	intval = getSignal(CHASSIS::PtMngmnt_Stat_AR2::DPC_Md_ExhstFlap_Rs);
	snprintf(buffer, elcount(buffer), "   0.000000 F1 CPC::PtMngmnt_Stat_AR2::DPC_Md_ExhstFlap_Rs = %d\n", intval);
	filePutString (buffer, elcount(buffer), hFile);
	intval = getSignal(CHASSIS::PtMngmnt_Stat_AR2::SSP_Pwr_Rq);
	snprintf(buffer, elcount(buffer), "   0.000000 F1 CPC::PtMngmnt_Stat_AR2::SSP_Pwr_Rq = %d\n", intval);
	filePutString (buffer, elcount(buffer), hFile);
	intval = getSignal(CHASSIS::PtMngmnt_Stat_AR2::TC_Start_Reset_Trgr);
	snprintf(buffer, elcount(buffer), "   0.000000 F1 CPC::PtMngmnt_Stat_AR2::TC_Start_Reset_Trgr = %d\n", intval);
	filePutString (buffer, elcount(buffer), hFile);
	intval = getSignal(CHASSIS::PtMngmnt_Stat_AR2::HVAC_CompOff_Rq);
	snprintf(buffer, elcount(buffer), "   0.000000 F1 CPC::PtMngmnt_Stat_AR2::HVAC_CompOff_Rq = %d\n", intval);
	filePutString (buffer, elcount(buffer), hFile);
	intval = @sysvar::CH_Nodes::CH_CPCCRC_PT_Stat_Pr2PtMngm_AUTO;
	snprintf(buffer, elcount(buffer), "   0.000000    SV: 2 0 0 ::CH_Nodes::CH_CPCCRC_PT_Stat_Pr2PtMngm_AUTO = %d\n", intval);
	filePutString (buffer, elcount(buffer), hFile);
	intval = getSignal(CHASSIS::PtMngmnt_Stat_AR2::CRC_PT_Stat_Pr2);
	snprintf(buffer, elcount(buffer), "   0.000000 F1 CPC::PtMngmnt_Stat_AR2::CRC_PT_Stat_Pr2 = %d\n", intval);
	filePutString (buffer, elcount(buffer), hFile);
	intval = @sysvar::CH_Nodes::CH_CPCSQC_PT_Stat_Pr2PtMngm_AUTO;
	snprintf(buffer, elcount(buffer), "   0.000000    SV: 2 0 0 ::CH_Nodes::CH_CPCSQC_PT_Stat_Pr2PtMngm_AUTO = %d\n", intval);
	filePutString (buffer, elcount(buffer), hFile);
	intval = getSignal(CHASSIS::PtMngmnt_Stat_AR2::SQC_PT_Stat_Pr2);
	snprintf(buffer, elcount(buffer), "   0.000000 F1 CPC::PtMngmnt_Stat_AR2::SQC_PT_Stat_Pr2 = %d\n", intval);
	filePutString (buffer, elcount(buffer), hFile);
}
/*@@end*/

/*@@caplFunc:saveVars_12(dword):*/
void saveVars_12(dword hFile)
{
	intval = getSignal(CHASSIS::PtMngmnt_Stat_AR2::PT_Rdy_V2);
	snprintf(buffer, elcount(buffer), "   0.000000 F1 CPC::PtMngmnt_Stat_AR2::PT_Rdy_V2 = %d\n", intval);
	filePutString (buffer, elcount(buffer), hFile);
	intval = getSignal(CHASSIS::PtMngmnt_Stat_AR2::SSA_Standby_Stat);
	snprintf(buffer, elcount(buffer), "   0.000000 F1 CPC::PtMngmnt_Stat_AR2::SSA_Standby_Stat = %d\n", intval);
	filePutString (buffer, elcount(buffer), hFile);
	intval = @sysvar::CH_Nodes::CH_CPCCRC_ISM_TxDrvPosn_Dis_AUTO;
	snprintf(buffer, elcount(buffer), "   0.000000    SV: 2 0 0 ::CH_Nodes::CH_CPCCRC_ISM_TxDrvPosn_Dis_AUTO = %d\n", intval);
	filePutString (buffer, elcount(buffer), hFile);
	intval = getSignal(CHASSIS::SBW_DrvPosn_Disp_Rq_ISM_AR2::CRC_ISM_TxDrvPosn_Disp_Rq_Pr2);
	snprintf(buffer, elcount(buffer), "   0.000000 F1 CPC::SBW_DrvPosn_Disp_Rq_ISM_AR2::CRC_ISM_TxDrvPosn_Disp_Rq_Pr2 = %d\n", intval);
	filePutString (buffer, elcount(buffer), hFile);
	intval = @sysvar::CH_Nodes::CH_CPCSQC_ISM_TxDrvPosn_Dis_AUTO;
	snprintf(buffer, elcount(buffer), "   0.000000    SV: 2 0 0 ::CH_Nodes::CH_CPCSQC_ISM_TxDrvPosn_Dis_AUTO = %d\n", intval);
	filePutString (buffer, elcount(buffer), hFile);
	intval = getSignal(CHASSIS::SBW_DrvPosn_Disp_Rq_ISM_AR2::SQC_ISM_TxDrvPosn_Disp_Rq_Pr2);
	snprintf(buffer, elcount(buffer), "   0.000000 F1 CPC::SBW_DrvPosn_Disp_Rq_ISM_AR2::SQC_ISM_TxDrvPosn_Disp_Rq_Pr2 = %d\n", intval);
	filePutString (buffer, elcount(buffer), hFile);
	intval = getSignal(CHASSIS::SBW_DrvPosn_Disp_Rq_ISM_AR2::SBW_ShiftLk_Msg_RevGr_ISM);
	snprintf(buffer, elcount(buffer), "   0.000000 F1 CPC::SBW_DrvPosn_Disp_Rq_ISM_AR2::SBW_ShiftLk_Msg_RevGr_ISM = %d\n", intval);
	filePutString (buffer, elcount(buffer), hFile);
	intval = getSignal(CHASSIS::SBW_DrvPosn_Disp_Rq_ISM_AR2::Rsrv3_ISM_TxDrvPosn_Disp_Rq_Pr2);
	snprintf(buffer, elcount(buffer), "   0.000000 F1 CPC::SBW_DrvPosn_Disp_Rq_ISM_AR2::Rsrv3_ISM_TxDrvPosn_Disp_Rq_Pr2 = %d\n", intval);
	filePutString (buffer, elcount(buffer), hFile);
	intval = getSignal(CHASSIS::SBW_DrvPosn_Disp_Rq_ISM_AR2::TxDrvPosn_Disp_Rq_ISM);
	snprintf(buffer, elcount(buffer), "   0.000000 F1 CPC::SBW_DrvPosn_Disp_Rq_ISM_AR2::TxDrvPosn_Disp_Rq_ISM = %d\n", intval);
	filePutString (buffer, elcount(buffer), hFile);
	intval = getSignal(CHASSIS::SBW_DrvPosn_Disp_Rq_ISM_AR2::TSL_MtnLk1_Disp_Rq_ISM_V2);
	snprintf(buffer, elcount(buffer), "   0.000000 F1 CPC::SBW_DrvPosn_Disp_Rq_ISM_AR2::TSL_MtnLk1_Disp_Rq_ISM_V2 = %d\n", intval);
	filePutString (buffer, elcount(buffer), hFile);
	intval = getSignal(CHASSIS::SBW_DrvPosn_Disp_Rq_ISM_AR2::TSL_MtnLk2_Disp_Rq_ISM_V2);
	snprintf(buffer, elcount(buffer), "   0.000000 F1 CPC::SBW_DrvPosn_Disp_Rq_ISM_AR2::TSL_MtnLk2_Disp_Rq_ISM_V2 = %d\n", intval);
	filePutString (buffer, elcount(buffer), hFile);
	intval = getSignal(CHASSIS::SBW_DrvPosn_Disp_Rq_ISM_AR2::TSL_MtnLk3_Disp_Rq_ISM_V2);
	snprintf(buffer, elcount(buffer), "   0.000000 F1 CPC::SBW_DrvPosn_Disp_Rq_ISM_AR2::TSL_MtnLk3_Disp_Rq_ISM_V2 = %d\n", intval);
	filePutString (buffer, elcount(buffer), hFile);
	intval = getSignal(CHASSIS::SBW_DrvPosn_Disp_Rq_ISM_AR2::SBW_Msg_Disp_Rq_ISM);
	snprintf(buffer, elcount(buffer), "   0.000000 F1 CPC::SBW_DrvPosn_Disp_Rq_ISM_AR2::SBW_Msg_Disp_Rq_ISM = %d\n", intval);
	filePutString (buffer, elcount(buffer), hFile);
	intval = @sysvar::CH_Nodes::CH_CPCCRC_SBW_Drv_Pk_Posn_T_AUTO;
	snprintf(buffer, elcount(buffer), "   0.000000    SV: 2 0 0 ::CH_Nodes::CH_CPCCRC_SBW_Drv_Pk_Posn_T_AUTO = %d\n", intval);
	filePutString (buffer, elcount(buffer), hFile);
	intval = getSignal(CHASSIS::SBW_DrvPosn_Disp_Rq_TCM_AR2::CRC_SBW_Drv_Pk_Posn_TCM_Pr2);
	snprintf(buffer, elcount(buffer), "   0.000000 F1 CPC::SBW_DrvPosn_Disp_Rq_TCM_AR2::CRC_SBW_Drv_Pk_Posn_TCM_Pr2 = %d\n", intval);
	filePutString (buffer, elcount(buffer), hFile);
	intval = @sysvar::CH_Nodes::CH_CPCSQC_SBW_Drv_Pk_Posn_T_AUTO;
	snprintf(buffer, elcount(buffer), "   0.000000    SV: 2 0 0 ::CH_Nodes::CH_CPCSQC_SBW_Drv_Pk_Posn_T_AUTO = %d\n", intval);
	filePutString (buffer, elcount(buffer), hFile);
	intval = getSignal(CHASSIS::SBW_DrvPosn_Disp_Rq_TCM_AR2::SQC_SBW_Drv_Pk_Posn_TCM_Pr2);
	snprintf(buffer, elcount(buffer), "   0.000000 F1 CPC::SBW_DrvPosn_Disp_Rq_TCM_AR2::SQC_SBW_Drv_Pk_Posn_TCM_Pr2 = %d\n", intval);
	filePutString (buffer, elcount(buffer), hFile);
	intval = getSignal(CHASSIS::SBW_DrvPosn_Disp_Rq_TCM_AR2::SBW_ShiftLk_Msg_RevGr_TCM);
	snprintf(buffer, elcount(buffer), "   0.000000 F1 CPC::SBW_DrvPosn_Disp_Rq_TCM_AR2::SBW_ShiftLk_Msg_RevGr_TCM = %d\n", intval);
	filePutString (buffer, elcount(buffer), hFile);
	intval = getSignal(CHASSIS::SBW_DrvPosn_Disp_Rq_TCM_AR2::TCM_PkPosn_Flt_Stat);
	snprintf(buffer, elcount(buffer), "   0.000000 F1 CPC::SBW_DrvPosn_Disp_Rq_TCM_AR2::TCM_PkPosn_Flt_Stat = %d\n", intval);
	filePutString (buffer, elcount(buffer), hFile);
	intval = getSignal(CHASSIS::SBW_DrvPosn_Disp_Rq_TCM_AR2::TxDrvPosn_Disp_Rq_TCM);
	snprintf(buffer, elcount(buffer), "   0.000000 F1 CPC::SBW_DrvPosn_Disp_Rq_TCM_AR2::TxDrvPosn_Disp_Rq_TCM = %d\n", intval);
	filePutString (buffer, elcount(buffer), hFile);
	intval = getSignal(CHASSIS::SBW_DrvPosn_Disp_Rq_TCM_AR2::TSL_MtnLk1_Disp_Rq_TCM_V2);
	snprintf(buffer, elcount(buffer), "   0.000000 F1 CPC::SBW_DrvPosn_Disp_Rq_TCM_AR2::TSL_MtnLk1_Disp_Rq_TCM_V2 = %d\n", intval);
	filePutString (buffer, elcount(buffer), hFile);
	intval = getSignal(CHASSIS::SBW_DrvPosn_Disp_Rq_TCM_AR2::TSL_MtnLk2_Disp_Rq_TCM_V2);
	snprintf(buffer, elcount(buffer), "   0.000000 F1 CPC::SBW_DrvPosn_Disp_Rq_TCM_AR2::TSL_MtnLk2_Disp_Rq_TCM_V2 = %d\n", intval);
	filePutString (buffer, elcount(buffer), hFile);
	intval = getSignal(CHASSIS::SBW_DrvPosn_Disp_Rq_TCM_AR2::TSL_MtnLk3_Disp_Rq_TCM_V2);
	snprintf(buffer, elcount(buffer), "   0.000000 F1 CPC::SBW_DrvPosn_Disp_Rq_TCM_AR2::TSL_MtnLk3_Disp_Rq_TCM_V2 = %d\n", intval);
	filePutString (buffer, elcount(buffer), hFile);
	intval = getSignal(CHASSIS::SBW_DrvPosn_Disp_Rq_TCM_AR2::Gr_Target_Disp_Rq_V2);
	snprintf(buffer, elcount(buffer), "   0.000000 F1 CPC::SBW_DrvPosn_Disp_Rq_TCM_AR2::Gr_Target_Disp_Rq_V2 = %d\n", intval);
	filePutString (buffer, elcount(buffer), hFile);
	intval = getSignal(CHASSIS::SBW_DrvPosn_Disp_Rq_TCM_AR2::TCM_LHOM_Stat);
	snprintf(buffer, elcount(buffer), "   0.000000 F1 CPC::SBW_DrvPosn_Disp_Rq_TCM_AR2::TCM_LHOM_Stat = %d\n", intval);
	filePutString (buffer, elcount(buffer), hFile);
	intval = getSignal(CHASSIS::SBW_DrvPosn_Disp_Rq_TCM_AR2::TCM_Temp_Flt_Stat);
	snprintf(buffer, elcount(buffer), "   0.000000 F1 CPC::SBW_DrvPosn_Disp_Rq_TCM_AR2::TCM_Temp_Flt_Stat = %d\n", intval);
	filePutString (buffer, elcount(buffer), hFile);
	intval = getSignal(CHASSIS::SBW_DrvPosn_Disp_Rq_TCM_AR2::TxDrvProg_Disp_Rq_TCM);
	snprintf(buffer, elcount(buffer), "   0.000000 F1 CPC::SBW_DrvPosn_Disp_Rq_TCM_AR2::TxDrvProg_Disp_Rq_TCM = %d\n", intval);
	filePutString (buffer, elcount(buffer), hFile);
	intval = getSignal(CHASSIS::SBW_DrvPosn_Disp_Rq_TCM_AR2::SBW_Msg_Disp_Rq_TCM);
	snprintf(buffer, elcount(buffer), "   0.000000 F1 CPC::SBW_DrvPosn_Disp_Rq_TCM_AR2::SBW_Msg_Disp_Rq_TCM = %d\n", intval);
	filePutString (buffer, elcount(buffer), hFile);
	intval = getSignal(CHASSIS::SBW_DrvPosn_Disp_Rq_TCM_AR2::RaceStartMd_Disp_Rq_AMG);
	snprintf(buffer, elcount(buffer), "   0.000000 F1 CPC::SBW_DrvPosn_Disp_Rq_TCM_AR2::RaceStartMd_Disp_Rq_AMG = %d\n", intval);
	filePutString (buffer, elcount(buffer), hFile);
	intval = getSignal(CHASSIS::SBW_DrvPosn_Disp_Rq_TCM_AR2::TxShiftRcmmnd_Disp_Rq_TCM);
	snprintf(buffer, elcount(buffer), "   0.000000 F1 CPC::SBW_DrvPosn_Disp_Rq_TCM_AR2::TxShiftRcmmnd_Disp_Rq_TCM = %d\n", intval);
	filePutString (buffer, elcount(buffer), hFile);
	intval = @sysvar::CH_Nodes::CH_CPCCRC_SBW_Stat_Pr2SBW_S_AUTO;
	snprintf(buffer, elcount(buffer), "   0.000000    SV: 2 0 0 ::CH_Nodes::CH_CPCCRC_SBW_Stat_Pr2SBW_S_AUTO = %d\n", intval);
	filePutString (buffer, elcount(buffer), hFile);
	intval = getSignal(CHASSIS::SBW_Stat_AR2::CRC_SBW_Stat_Pr2);
	snprintf(buffer, elcount(buffer), "   0.000000 F1 CPC::SBW_Stat_AR2::CRC_SBW_Stat_Pr2 = %d\n", intval);
	filePutString (buffer, elcount(buffer), hFile);
	intval = @sysvar::CH_Nodes::CH_CPCSQC_SBW_Stat_Pr2SBW_S_AUTO;
	snprintf(buffer, elcount(buffer), "   0.000000    SV: 2 0 0 ::CH_Nodes::CH_CPCSQC_SBW_Stat_Pr2SBW_S_AUTO = %d\n", intval);
	filePutString (buffer, elcount(buffer), hFile);
	intval = getSignal(CHASSIS::SBW_Stat_AR2::SQC_SBW_Stat_Pr2);
	snprintf(buffer, elcount(buffer), "   0.000000 F1 CPC::SBW_Stat_AR2::SQC_SBW_Stat_Pr2 = %d\n", intval);
	filePutString (buffer, elcount(buffer), hFile);
	intval = getSignal(CHASSIS::SBW_Stat_AR2::EmgPath_Enbl);
	snprintf(buffer, elcount(buffer), "   0.000000 F1 CPC::SBW_Stat_AR2::EmgPath_Enbl = %d\n", intval);
	filePutString (buffer, elcount(buffer), hFile);
	intval = getSignal(CHASSIS::SBW_Stat_AR2::Key_P_Enbl);
	snprintf(buffer, elcount(buffer), "   0.000000 F1 CPC::SBW_Stat_AR2::Key_P_Enbl = %d\n", intval);
	filePutString (buffer, elcount(buffer), hFile);
	intval = getSignal(CHASSIS::SBW_Stat_AR2::SPCR_Dsabl_Rq_ISM);
	snprintf(buffer, elcount(buffer), "   0.000000 F1 CPC::SBW_Stat_AR2::SPCR_Dsabl_Rq_ISM = %d\n", intval);
	filePutString (buffer, elcount(buffer), hFile);
	intval = getSignal(CHASSIS::SBW_Stat_AR2::ISM_LHOM);
	snprintf(buffer, elcount(buffer), "   0.000000 F1 CPC::SBW_Stat_AR2::ISM_LHOM = %d\n", intval);
	filePutString (buffer, elcount(buffer), hFile);
	intval = getSignal(CHASSIS::SBW_Stat_AR2::TSL_Posn_ISM);
	snprintf(buffer, elcount(buffer), "   0.000000 F1 CPC::SBW_Stat_AR2::TSL_Posn_ISM = %d\n", intval);
	filePutString (buffer, elcount(buffer), hFile);
	intval = getSignal(CHASSIS::SBW_Stat_AR2::TSL_Posn_Target);
	snprintf(buffer, elcount(buffer), "   0.000000 F1 CPC::SBW_Stat_AR2::TSL_Posn_Target = %d\n", intval);
	filePutString (buffer, elcount(buffer), hFile);
	floatval = getSignal(CHASSIS::SBW_Stat_AR2::EmgPath_Volt);
	snprintf(buffer, elcount(buffer), "   0.000000 F1 CPC::SBW_Stat_AR2::EmgPath_Volt = %f\n", floatval);
	filePutString (buffer, elcount(buffer), hFile);
	intval = getSignal(CHASSIS::SBW_Stat_AR2::TSL_ShiftLk_Stat);
	snprintf(buffer, elcount(buffer), "   0.000000 F1 CPC::SBW_Stat_AR2::TSL_ShiftLk_Stat = %d\n", intval);
	filePutString (buffer, elcount(buffer), hFile);
	intval = getSignal(CHASSIS::SBW_Stat_AR2::TxPkPosn_Emg_Actv);
	snprintf(buffer, elcount(buffer), "   0.000000 F1 CPC::SBW_Stat_AR2::TxPkPosn_Emg_Actv = %d\n", intval);
	filePutString (buffer, elcount(buffer), hFile);
	intval = getSignal(CHASSIS::SBW_Stat_AR2::TxN_Posn_Rq_D_V2);
	snprintf(buffer, elcount(buffer), "   0.000000 F1 CPC::SBW_Stat_AR2::TxN_Posn_Rq_D_V2 = %d\n", intval);
	filePutString (buffer, elcount(buffer), hFile);
	intval = getSignal(CHASSIS::SBW_Stat_AR2::TSL_Posn_P_ISM);
	snprintf(buffer, elcount(buffer), "   0.000000 F1 CPC::SBW_Stat_AR2::TSL_Posn_P_ISM = %d\n", intval);
	filePutString (buffer, elcount(buffer), hFile);
	intval = getSignal(CHASSIS::SBW_Stat_AR2::Rsrv1_SBW_Stat_Pr2);
	snprintf(buffer, elcount(buffer), "   0.000000 F1 CPC::SBW_Stat_AR2::Rsrv1_SBW_Stat_Pr2 = %d\n", intval);
	filePutString (buffer, elcount(buffer), hFile);
	intval = getSignal(CHASSIS::SBW_Stat_AR2::Rsrv2_SBW_Stat_Pr2);
	snprintf(buffer, elcount(buffer), "   0.000000 F1 CPC::SBW_Stat_AR2::Rsrv2_SBW_Stat_Pr2 = %d\n", intval);
	filePutString (buffer, elcount(buffer), hFile);
	intval = getSignal(CHASSIS::SND_GEN_Stat_AR::SND_GEN_Md_Stat);
	snprintf(buffer, elcount(buffer), "   0.000000 F1 CPC::SND_GEN_Stat_AR::SND_GEN_Md_Stat = %d\n", intval);
	filePutString (buffer, elcount(buffer), hFile);
	intval = getSignal(CHASSIS::SND_GEN_Stat_AR::SND_GEN_Err);
	snprintf(buffer, elcount(buffer), "   0.000000 F1 CPC::SND_GEN_Stat_AR::SND_GEN_Err = %d\n", intval);
	filePutString (buffer, elcount(buffer), hFile);
	floatval = getSignal(CHASSIS::TC_Disp_Rq_ECM_AR::TC_PN14_RecupPwr);
	snprintf(buffer, elcount(buffer), "   0.000000 F1 CPC::TC_Disp_Rq_ECM_AR::TC_PN14_RecupPwr = %f\n", floatval);
	filePutString (buffer, elcount(buffer), hFile);
	intval = getSignal(CHASSIS::TC_Disp_Rq_ECM_AR::ZeroEmission_Actv);
	snprintf(buffer, elcount(buffer), "   0.000000 F1 CPC::TC_Disp_Rq_ECM_AR::ZeroEmission_Actv = %d\n", intval);
	filePutString (buffer, elcount(buffer), hFile);
	intval = getSignal(CHASSIS::TC_Disp_Rq_ECM_AR::TC_GasFuelConsRecup);
	snprintf(buffer, elcount(buffer), "   0.000000 F1 CPC::TC_Disp_Rq_ECM_AR::TC_GasFuelConsRecup = %d\n", intval);
	filePutString (buffer, elcount(buffer), hFile);
	floatval = getSignal(CHASSIS::TC_Disp_Rq_ECM_AR::TC_GasFuelCons);
	snprintf(buffer, elcount(buffer), "   0.000000 F1 CPC::TC_Disp_Rq_ECM_AR::TC_GasFuelCons = %f\n", floatval);
	filePutString (buffer, elcount(buffer), hFile);
	floatval = getSignal(CHASSIS::TC_Disp_Rq_ECM_AR::TC_GasFuelCons_Reset);
	snprintf(buffer, elcount(buffer), "   0.000000 F1 CPC::TC_Disp_Rq_ECM_AR::TC_GasFuelCons_Reset = %f\n", floatval);
	filePutString (buffer, elcount(buffer), hFile);
	floatval = getSignal(CHASSIS::TC_Disp_Rq_ECM_AR::TC_GasFuelCons_Start);
	snprintf(buffer, elcount(buffer), "   0.000000 F1 CPC::TC_Disp_Rq_ECM_AR::TC_GasFuelCons_Start = %f\n", floatval);
	filePutString (buffer, elcount(buffer), hFile);
	intval = getSignal(CHASSIS::TC_Disp_Rq_ECM_AR::TC_GasFuelTankRng);
	snprintf(buffer, elcount(buffer), "   0.000000 F1 CPC::TC_Disp_Rq_ECM_AR::TC_GasFuelTankRng = %d\n", intval);
	filePutString (buffer, elcount(buffer), hFile);
	intval = getSignal(CHASSIS::TC_Disp_Rq_ECM_AR::TC_GasFuelTankLvl_Min_50);
	snprintf(buffer, elcount(buffer), "   0.000000 F1 CPC::TC_Disp_Rq_ECM_AR::TC_GasFuelTankLvl_Min_50 = %d\n", intval);
	filePutString (buffer, elcount(buffer), hFile);
}
/*@@end*/

/*@@caplFunc:saveVars_13(dword):*/
void saveVars_13(dword hFile)
{
	intval = getSignal(CHASSIS::TC_Disp_Rq_ECM_AR::TC_LiquidFuelConsRecup);
	snprintf(buffer, elcount(buffer), "   0.000000 F1 CPC::TC_Disp_Rq_ECM_AR::TC_LiquidFuelConsRecup = %d\n", intval);
	filePutString (buffer, elcount(buffer), hFile);
	floatval = getSignal(CHASSIS::TC_Disp_Rq_ECM_AR::TC_LiquidFuelCons);
	snprintf(buffer, elcount(buffer), "   0.000000 F1 CPC::TC_Disp_Rq_ECM_AR::TC_LiquidFuelCons = %f\n", floatval);
	filePutString (buffer, elcount(buffer), hFile);
	floatval = getSignal(CHASSIS::TC_Disp_Rq_ECM_AR::TC_LiquidFuelCons_Reset);
	snprintf(buffer, elcount(buffer), "   0.000000 F1 CPC::TC_Disp_Rq_ECM_AR::TC_LiquidFuelCons_Reset = %f\n", floatval);
	filePutString (buffer, elcount(buffer), hFile);
	floatval = getSignal(CHASSIS::TC_Disp_Rq_ECM_AR::TC_LiquidFuelCons_Start);
	snprintf(buffer, elcount(buffer), "   0.000000 F1 CPC::TC_Disp_Rq_ECM_AR::TC_LiquidFuelCons_Start = %f\n", floatval);
	filePutString (buffer, elcount(buffer), hFile);
	intval = getSignal(CHASSIS::TC_Disp_Rq_ECM_AR::TC_LiquidFuelTankRng);
	snprintf(buffer, elcount(buffer), "   0.000000 F1 CPC::TC_Disp_Rq_ECM_AR::TC_LiquidFuelTankRng = %d\n", intval);
	filePutString (buffer, elcount(buffer), hFile);
	intval = getSignal(CHASSIS::TC_Disp_Rq_ECM_AR::TC_LiquidFuelTankLvl_Min_50);
	snprintf(buffer, elcount(buffer), "   0.000000 F1 CPC::TC_Disp_Rq_ECM_AR::TC_LiquidFuelTankLvl_Min_50 = %d\n", intval);
	filePutString (buffer, elcount(buffer), hFile);
	intval = getSignal(CHASSIS::TC_Disp_Rq_ECM_AR::TC_SkipRng_Disp_Rq);
	snprintf(buffer, elcount(buffer), "   0.000000 F1 CPC::TC_Disp_Rq_ECM_AR::TC_SkipRng_Disp_Rq = %d\n", intval);
	filePutString (buffer, elcount(buffer), hFile);
	floatval = getSignal(CHASSIS::TC_Disp_Rq_ECM_AR::TC_ElecEnergyCons);
	snprintf(buffer, elcount(buffer), "   0.000000 F1 CPC::TC_Disp_Rq_ECM_AR::TC_ElecEnergyCons = %f\n", floatval);
	filePutString (buffer, elcount(buffer), hFile);
	floatval = getSignal(CHASSIS::TC_Disp_Rq_ECM_AR::TC_ElecEnergyCons_Reset);
	snprintf(buffer, elcount(buffer), "   0.000000 F1 CPC::TC_Disp_Rq_ECM_AR::TC_ElecEnergyCons_Reset = %f\n", floatval);
	filePutString (buffer, elcount(buffer), hFile);
	floatval = getSignal(CHASSIS::TC_Disp_Rq_ECM_AR::TC_ElecEnergyCons_Start);
	snprintf(buffer, elcount(buffer), "   0.000000 F1 CPC::TC_Disp_Rq_ECM_AR::TC_ElecEnergyCons_Start = %f\n", floatval);
	filePutString (buffer, elcount(buffer), hFile);
	intval = getSignal(CHASSIS::TC_Disp_Rq_ECM_AR::TC_ElecEnergyRng);
	snprintf(buffer, elcount(buffer), "   0.000000 F1 CPC::TC_Disp_Rq_ECM_AR::TC_ElecEnergyRng = %d\n", intval);
	filePutString (buffer, elcount(buffer), hFile);
	intval = getSignal(CHASSIS::TC_Disp_Rq_ECM_AR::TC_ElecEnergyLvl_Min_50);
	snprintf(buffer, elcount(buffer), "   0.000000 F1 CPC::TC_Disp_Rq_ECM_AR::TC_ElecEnergyLvl_Min_50 = %d\n", intval);
	filePutString (buffer, elcount(buffer), hFile);
	intval = getSignal(CHASSIS::TC_Disp_Rq_ECM_AR::TC_SkipRng_Disp_Rq);
	snprintf(buffer, elcount(buffer), "   0.000000 F1 CPC::TC_Disp_Rq_ECM_AR::TC_SkipRng_Disp_Rq = %d\n", intval);
	filePutString (buffer, elcount(buffer), hFile);
	intval = getSignal(CHASSIS::TC_Disp_Rq_ECM_AR::TC_FuelType_TC_DISP_RQ);
	snprintf(buffer, elcount(buffer), "   0.000000 F1 CPC::TC_Disp_Rq_ECM_AR::TC_FuelType_TC_DISP_RQ = %d\n", intval);
	filePutString (buffer, elcount(buffer), hFile);
	floatval = getSignal(CHASSIS::TC_EBBC_Disp_Rq_ECM_AR::TC_EBBC_AvgFuelCons1);
	snprintf(buffer, elcount(buffer), "   0.000000 F1 CPC::TC_EBBC_Disp_Rq_ECM_AR::TC_EBBC_AvgFuelCons1 = %f\n", floatval);
	filePutString (buffer, elcount(buffer), hFile);
	intval = getSignal(CHASSIS::TC_EBBC_Disp_Rq_ECM_AR::TC_EBBC_DispCnt1);
	snprintf(buffer, elcount(buffer), "   0.000000 F1 CPC::TC_EBBC_Disp_Rq_ECM_AR::TC_EBBC_DispCnt1 = %d\n", intval);
	filePutString (buffer, elcount(buffer), hFile);
	floatval = getSignal(CHASSIS::TC_EBBC_Disp_Rq_ECM_AR::TC_EBBC_AvgRecupLvl1);
	snprintf(buffer, elcount(buffer), "   0.000000 F1 CPC::TC_EBBC_Disp_Rq_ECM_AR::TC_EBBC_AvgRecupLvl1 = %f\n", floatval);
	filePutString (buffer, elcount(buffer), hFile);
	floatval = getSignal(CHASSIS::TC_EBBC_Disp_Rq_ECM_AR::TC_EBBC_AvgFuelCons2);
	snprintf(buffer, elcount(buffer), "   0.000000 F1 CPC::TC_EBBC_Disp_Rq_ECM_AR::TC_EBBC_AvgFuelCons2 = %f\n", floatval);
	filePutString (buffer, elcount(buffer), hFile);
	intval = getSignal(CHASSIS::TC_EBBC_Disp_Rq_ECM_AR::TC_EBBC_DispCnt2);
	snprintf(buffer, elcount(buffer), "   0.000000 F1 CPC::TC_EBBC_Disp_Rq_ECM_AR::TC_EBBC_DispCnt2 = %d\n", intval);
	filePutString (buffer, elcount(buffer), hFile);
	floatval = getSignal(CHASSIS::TC_EBBC_Disp_Rq_ECM_AR::TC_EBBC_AvgRecupLvl2);
	snprintf(buffer, elcount(buffer), "   0.000000 F1 CPC::TC_EBBC_Disp_Rq_ECM_AR::TC_EBBC_AvgRecupLvl2 = %f\n", floatval);
	filePutString (buffer, elcount(buffer), hFile);
	floatval = getSignal(CHASSIS::TC_EBBC_Disp_Rq_ECM_AR::TC_EBBC_FuelCons);
	snprintf(buffer, elcount(buffer), "   0.000000 F1 CPC::TC_EBBC_Disp_Rq_ECM_AR::TC_EBBC_FuelCons = %f\n", floatval);
	filePutString (buffer, elcount(buffer), hFile);
	intval = getSignal(CHASSIS::TC_EBBC_Disp_Rq_ECM_AR::TC_EBBC_DispIdx);
	snprintf(buffer, elcount(buffer), "   0.000000 F1 CPC::TC_EBBC_Disp_Rq_ECM_AR::TC_EBBC_DispIdx = %d\n", intval);
	filePutString (buffer, elcount(buffer), hFile);
	floatval = getSignal(CHASSIS::TC_EEBBC_Disp_Rq_AR::TC_EEBBC_AvgEnergyCons1);
	snprintf(buffer, elcount(buffer), "   0.000000 F1 CPC::TC_EEBBC_Disp_Rq_AR::TC_EEBBC_AvgEnergyCons1 = %f\n", floatval);
	filePutString (buffer, elcount(buffer), hFile);
	intval = getSignal(CHASSIS::TC_EEBBC_Disp_Rq_AR::TC_EEBBC_DispCnt1);
	snprintf(buffer, elcount(buffer), "   0.000000 F1 CPC::TC_EEBBC_Disp_Rq_AR::TC_EEBBC_DispCnt1 = %d\n", intval);
	filePutString (buffer, elcount(buffer), hFile);
	intval = getSignal(CHASSIS::TC_EEBBC_Disp_Rq_AR::TC_EEBBC_DrvProg1);
	snprintf(buffer, elcount(buffer), "   0.000000 F1 CPC::TC_EEBBC_Disp_Rq_AR::TC_EEBBC_DrvProg1 = %d\n", intval);
	filePutString (buffer, elcount(buffer), hFile);
	intval = getSignal(CHASSIS::TC_EEBBC_Disp_Rq_AR::TC_EEBBC_OprtnMd1);
	snprintf(buffer, elcount(buffer), "   0.000000 F1 CPC::TC_EEBBC_Disp_Rq_AR::TC_EEBBC_OprtnMd1 = %d\n", intval);
	filePutString (buffer, elcount(buffer), hFile);
	floatval = getSignal(CHASSIS::TC_EEBBC_Disp_Rq_AR::TC_EEBBC_AvgEnergyCons2);
	snprintf(buffer, elcount(buffer), "   0.000000 F1 CPC::TC_EEBBC_Disp_Rq_AR::TC_EEBBC_AvgEnergyCons2 = %f\n", floatval);
	filePutString (buffer, elcount(buffer), hFile);
	intval = getSignal(CHASSIS::TC_EEBBC_Disp_Rq_AR::TC_EEBBC_DispCnt2);
	snprintf(buffer, elcount(buffer), "   0.000000 F1 CPC::TC_EEBBC_Disp_Rq_AR::TC_EEBBC_DispCnt2 = %d\n", intval);
	filePutString (buffer, elcount(buffer), hFile);
	intval = getSignal(CHASSIS::TC_EEBBC_Disp_Rq_AR::TC_EEBBC_DrvProg2);
	snprintf(buffer, elcount(buffer), "   0.000000 F1 CPC::TC_EEBBC_Disp_Rq_AR::TC_EEBBC_DrvProg2 = %d\n", intval);
	filePutString (buffer, elcount(buffer), hFile);
	intval = getSignal(CHASSIS::TC_EEBBC_Disp_Rq_AR::TC_EEBBC_OprtnMd2);
	snprintf(buffer, elcount(buffer), "   0.000000 F1 CPC::TC_EEBBC_Disp_Rq_AR::TC_EEBBC_OprtnMd2 = %d\n", intval);
	filePutString (buffer, elcount(buffer), hFile);
	intval = getSignal(CHASSIS::TC_EEBBC_Disp_Rq_AR::TC_EEBBC_DispIdx);
	snprintf(buffer, elcount(buffer), "   0.000000 F1 CPC::TC_EEBBC_Disp_Rq_AR::TC_EEBBC_DispIdx = %d\n", intval);
	filePutString (buffer, elcount(buffer), hFile);
	intval = getSignal(CHASSIS::TC_EEBBC_Disp_Rq_AR::TC_EEBBC_TmRng);
	snprintf(buffer, elcount(buffer), "   0.000000 F1 CPC::TC_EEBBC_Disp_Rq_AR::TC_EEBBC_TmRng = %d\n", intval);
	filePutString (buffer, elcount(buffer), hFile);
	intval = getSignal(CHASSIS::TCM_DAC4_AR::TCM_DAC_Data1);
	snprintf(buffer, elcount(buffer), "   0.000000 F1 CPC::TCM_DAC4_AR::TCM_DAC_Data1 = %d\n", intval);
	filePutString (buffer, elcount(buffer), hFile);
	intval = getSignal(CHASSIS::TCM_DAC4_AR::TCM_DAC_Data2);
	snprintf(buffer, elcount(buffer), "   0.000000 F1 CPC::TCM_DAC4_AR::TCM_DAC_Data2 = %d\n", intval);
	filePutString (buffer, elcount(buffer), hFile);
	intval = getSignal(CHASSIS::TCM_DAC4_AR::TCM_DAC_Data3);
	snprintf(buffer, elcount(buffer), "   0.000000 F1 CPC::TCM_DAC4_AR::TCM_DAC_Data3 = %d\n", intval);
	filePutString (buffer, elcount(buffer), hFile);
	intval = getSignal(CHASSIS::TCM_DAC4_AR::TCM_DAC_Data4);
	snprintf(buffer, elcount(buffer), "   0.000000 F1 CPC::TCM_DAC4_AR::TCM_DAC_Data4 = %d\n", intval);
	filePutString (buffer, elcount(buffer), hFile);
	intval = getSignal(CHASSIS::TCM_DAC4_AR::TCM_DAC_Data5);
	snprintf(buffer, elcount(buffer), "   0.000000 F1 CPC::TCM_DAC4_AR::TCM_DAC_Data5 = %d\n", intval);
	filePutString (buffer, elcount(buffer), hFile);
	intval = getSignal(CHASSIS::TCM_DAC4_AR::TCM_DAC_Data6);
	snprintf(buffer, elcount(buffer), "   0.000000 F1 CPC::TCM_DAC4_AR::TCM_DAC_Data6 = %d\n", intval);
	filePutString (buffer, elcount(buffer), hFile);
	intval = getSignal(CHASSIS::TCM_DAC4_AR::TCM_DAC_Data7);
	snprintf(buffer, elcount(buffer), "   0.000000 F1 CPC::TCM_DAC4_AR::TCM_DAC_Data7 = %d\n", intval);
	filePutString (buffer, elcount(buffer), hFile);
	intval = getSignal(CHASSIS::TCM_DAC4_AR::TCM_DAC_Data8);
	snprintf(buffer, elcount(buffer), "   0.000000 F1 CPC::TCM_DAC4_AR::TCM_DAC_Data8 = %d\n", intval);
	filePutString (buffer, elcount(buffer), hFile);
	intval = @sysvar::CH_Nodes::CH_CPCCRC_TCM_Data2_Pr2TCM__AUTO;
	snprintf(buffer, elcount(buffer), "   0.000000    SV: 2 0 0 ::CH_Nodes::CH_CPCCRC_TCM_Data2_Pr2TCM__AUTO = %d\n", intval);
	filePutString (buffer, elcount(buffer), hFile);
	intval = getSignal(CHASSIS::TCM_Data2_AR2::CRC_TCM_Data2_Pr2);
	snprintf(buffer, elcount(buffer), "   0.000000 F1 CPC::TCM_Data2_AR2::CRC_TCM_Data2_Pr2 = %d\n", intval);
	filePutString (buffer, elcount(buffer), hFile);
	intval = @sysvar::CH_Nodes::CH_CPCSQC_TCM_Data2_Pr2TCM__AUTO;
	snprintf(buffer, elcount(buffer), "   0.000000    SV: 2 0 0 ::CH_Nodes::CH_CPCSQC_TCM_Data2_Pr2TCM__AUTO = %d\n", intval);
	filePutString (buffer, elcount(buffer), hFile);
	intval = getSignal(CHASSIS::TCM_Data2_AR2::SQC_TCM_Data2_Pr2);
	snprintf(buffer, elcount(buffer), "   0.000000 F1 CPC::TCM_Data2_AR2::SQC_TCM_Data2_Pr2 = %d\n", intval);
	filePutString (buffer, elcount(buffer), hFile);
	intval = getSignal(CHASSIS::TCM_Data2_AR2::Gr);
	snprintf(buffer, elcount(buffer), "   0.000000 F1 CPC::TCM_Data2_AR2::Gr = %d\n", intval);
	filePutString (buffer, elcount(buffer), hFile);
	floatval = getSignal(CHASSIS::TCM_Data2_AR2::EngWhlTrqRatio_TCM);
	snprintf(buffer, elcount(buffer), "   0.000000 F1 CPC::TCM_Data2_AR2::EngWhlTrqRatio_TCM = %f\n", floatval);
	filePutString (buffer, elcount(buffer), hFile);
	intval = getSignal(CHASSIS::TCM_Data2_AR2::SSA_Enbl_Stat_TCM);
	snprintf(buffer, elcount(buffer), "   0.000000 F1 CPC::TCM_Data2_AR2::SSA_Enbl_Stat_TCM = %d\n", intval);
	filePutString (buffer, elcount(buffer), hFile);
	intval = getSignal(CHASSIS::TCM_Data2_AR2::TxDrvTrqAbsVal);
	snprintf(buffer, elcount(buffer), "   0.000000 F1 CPC::TCM_Data2_AR2::TxDrvTrqAbsVal = %d\n", intval);
	filePutString (buffer, elcount(buffer), hFile);
	intval = getSignal(CHASSIS::TCM_Data2_AR2::TSL_Posn_TCM);
	snprintf(buffer, elcount(buffer), "   0.000000 F1 CPC::TCM_Data2_AR2::TSL_Posn_TCM = %d\n", intval);
	filePutString (buffer, elcount(buffer), hFile);
	intval = getSignal(CHASSIS::TCM_Data2_AR2::Gr_Target);
	snprintf(buffer, elcount(buffer), "   0.000000 F1 CPC::TCM_Data2_AR2::Gr_Target = %d\n", intval);
	filePutString (buffer, elcount(buffer), hFile);
	intval = getSignal(CHASSIS::TCM_Data2_AR2::SSA_Enbl_Rq_TCM);
	snprintf(buffer, elcount(buffer), "   0.000000 F1 CPC::TCM_Data2_AR2::SSA_Enbl_Rq_TCM = %d\n", intval);
	filePutString (buffer, elcount(buffer), hFile);
	intval = getSignal(CHASSIS::TCM_Data2_AR2::EM_BoostTrq_Rq_TCM);
	snprintf(buffer, elcount(buffer), "   0.000000 F1 CPC::TCM_Data2_AR2::EM_BoostTrq_Rq_TCM = %d\n", intval);
	filePutString (buffer, elcount(buffer), hFile);
	intval = @sysvar::CH_Nodes::CH_CPCCRC_TCM_Data3_Pr2TCM__AUTO;
	snprintf(buffer, elcount(buffer), "   0.000000    SV: 2 0 0 ::CH_Nodes::CH_CPCCRC_TCM_Data3_Pr2TCM__AUTO = %d\n", intval);
	filePutString (buffer, elcount(buffer), hFile);
	intval = getSignal(CHASSIS::TCM_Data3_AR2::CRC_TCM_Data3_Pr2);
	snprintf(buffer, elcount(buffer), "   0.000000 F1 CPC::TCM_Data3_AR2::CRC_TCM_Data3_Pr2 = %d\n", intval);
	filePutString (buffer, elcount(buffer), hFile);
}
/*@@end*/

/*@@caplFunc:saveVars_14(dword):*/
void saveVars_14(dword hFile)
{
	intval = @sysvar::CH_Nodes::CH_CPCSQC_TCM_Data3_Pr2TCM__AUTO;
	snprintf(buffer, elcount(buffer), "   0.000000    SV: 2 0 0 ::CH_Nodes::CH_CPCSQC_TCM_Data3_Pr2TCM__AUTO = %d\n", intval);
	filePutString (buffer, elcount(buffer), hFile);
	intval = getSignal(CHASSIS::TCM_Data3_AR2::SQC_TCM_Data3_Pr2);
	snprintf(buffer, elcount(buffer), "   0.000000 F1 CPC::TCM_Data3_AR2::SQC_TCM_Data3_Pr2 = %d\n", intval);
	filePutString (buffer, elcount(buffer), hFile);
	intval = getSignal(CHASSIS::TCM_Data3_AR2::TxTurbineRPM_V2);
	snprintf(buffer, elcount(buffer), "   0.000000 F1 CPC::TCM_Data3_AR2::TxTurbineRPM_V2 = %d\n", intval);
	filePutString (buffer, elcount(buffer), hFile);
	intval = getSignal(CHASSIS::TCM_Data3_AR2::TxOutRPM_V2);
	snprintf(buffer, elcount(buffer), "   0.000000 F1 CPC::TCM_Data3_AR2::TxOutRPM_V2 = %d\n", intval);
	filePutString (buffer, elcount(buffer), hFile);
	intval = getSignal(CHASSIS::TCM_Data3_AR2::Tx_Safe_Cls);
	snprintf(buffer, elcount(buffer), "   0.000000 F1 CPC::TCM_Data3_AR2::Tx_Safe_Cls = %d\n", intval);
	filePutString (buffer, elcount(buffer), hFile);
	intval = getSignal(CHASSIS::TCM_Data3_AR2::Tx_Safe_Opn);
	snprintf(buffer, elcount(buffer), "   0.000000 F1 CPC::TCM_Data3_AR2::Tx_Safe_Opn = %d\n", intval);
	filePutString (buffer, elcount(buffer), hFile);
	intval = getSignal(CHASSIS::TCM_Data3_AR2::EngTrqMax_Rq_TCM);
	snprintf(buffer, elcount(buffer), "   0.000000 F1 CPC::TCM_Data3_AR2::EngTrqMax_Rq_TCM = %d\n", intval);
	filePutString (buffer, elcount(buffer), hFile);
	intval = getSignal(CHASSIS::TCM_Data3_AR2::EngTrqMin_Rq_TCM);
	snprintf(buffer, elcount(buffer), "   0.000000 F1 CPC::TCM_Data3_AR2::EngTrqMin_Rq_TCM = %d\n", intval);
	filePutString (buffer, elcount(buffer), hFile);
	intval = getSignal(CHASSIS::TCM_Data3_AR2::Gr_Target_TxShiftRcmmnd);
	snprintf(buffer, elcount(buffer), "   0.000000 F1 CPC::TCM_Data3_AR2::Gr_Target_TxShiftRcmmnd = %d\n", intval);
	filePutString (buffer, elcount(buffer), hFile);
	intval = getSignal(CHASSIS::TCM_Data3_AR2::Ratio_Chg_Cont_Actv);
	snprintf(buffer, elcount(buffer), "   0.000000 F1 CPC::TCM_Data3_AR2::Ratio_Chg_Cont_Actv = %d\n", intval);
	filePutString (buffer, elcount(buffer), hFile);
	intval = getSignal(CHASSIS::TCM_Data3_AR2::TxRatioChgRq_Actv);
	snprintf(buffer, elcount(buffer), "   0.000000 F1 CPC::TCM_Data3_AR2::TxRatioChgRq_Actv = %d\n", intval);
	filePutString (buffer, elcount(buffer), hFile);
	intval = getSignal(CHASSIS::TCM_Data3_AR2::PwrFreeD_Actv);
	snprintf(buffer, elcount(buffer), "   0.000000 F1 CPC::TCM_Data3_AR2::PwrFreeD_Actv = %d\n", intval);
	filePutString (buffer, elcount(buffer), hFile);
	intval = getSignal(CHASSIS::TCM_Data3_AR2::TCM_EngIdleRPM_Lvl_Rq);
	snprintf(buffer, elcount(buffer), "   0.000000 F1 CPC::TCM_Data3_AR2::TCM_EngIdleRPM_Lvl_Rq = %d\n", intval);
	filePutString (buffer, elcount(buffer), hFile);
	intval = getSignal(CHASSIS::TCM_Data3_AR2::TCC_NoLoad);
	snprintf(buffer, elcount(buffer), "   0.000000 F1 CPC::TCM_Data3_AR2::TCC_NoLoad = %d\n", intval);
	filePutString (buffer, elcount(buffer), hFile);
	intval = getSignal(CHASSIS::TCM_Data3_AR2::Clutch_Stat);
	snprintf(buffer, elcount(buffer), "   0.000000 F1 CPC::TCM_Data3_AR2::Clutch_Stat = %d\n", intval);
	filePutString (buffer, elcount(buffer), hFile);
	intval = getSignal(CHASSIS::TCM_Data3_AR2::Clutch_Actv_Stat);
	snprintf(buffer, elcount(buffer), "   0.000000 F1 CPC::TCM_Data3_AR2::Clutch_Actv_Stat = %d\n", intval);
	filePutString (buffer, elcount(buffer), hFile);
	intval = getSignal(CHASSIS::TCM_Data3_AR2::Ratio_Chg_Actv);
	snprintf(buffer, elcount(buffer), "   0.000000 F1 CPC::TCM_Data3_AR2::Ratio_Chg_Actv = %d\n", intval);
	filePutString (buffer, elcount(buffer), hFile);
	intval = getSignal(CHASSIS::TCM_Data3_AR2::EM_Trq_RecupGrdnt_Max);
	snprintf(buffer, elcount(buffer), "   0.000000 F1 CPC::TCM_Data3_AR2::EM_Trq_RecupGrdnt_Max = %d\n", intval);
	filePutString (buffer, elcount(buffer), hFile);
	intval = getSignal(CHASSIS::TCM_Data3_AR2::StartBrk_Rq_TCM);
	snprintf(buffer, elcount(buffer), "   0.000000 F1 CPC::TCM_Data3_AR2::StartBrk_Rq_TCM = %d\n", intval);
	filePutString (buffer, elcount(buffer), hFile);
	intval = getSignal(CHASSIS::TCM_Disp_Rq_AMG_AR::TCM_TxLED_Disp_Rq);
	snprintf(buffer, elcount(buffer), "   0.000000 F1 CPC::TCM_Disp_Rq_AMG_AR::TCM_TxLED_Disp_Rq = %d\n", intval);
	filePutString (buffer, elcount(buffer), hFile);
	intval = getSignal(CHASSIS::TCM_Disp_Rq_AMG_AR::TxBurnOut_Stat);
	snprintf(buffer, elcount(buffer), "   0.000000 F1 CPC::TCM_Disp_Rq_AMG_AR::TxBurnOut_Stat = %d\n", intval);
	filePutString (buffer, elcount(buffer), hFile);
	intval = getSignal(CHASSIS::TCM_Disp_Rq_AMG_AR::TCM_TxShift_Disp_Rq);
	snprintf(buffer, elcount(buffer), "   0.000000 F1 CPC::TCM_Disp_Rq_AMG_AR::TCM_TxShift_Disp_Rq = %d\n", intval);
	filePutString (buffer, elcount(buffer), hFile);
	intval = getSignal(CHASSIS::TCM_State3_AR2::VehDrvProg_TCM_V3);
	snprintf(buffer, elcount(buffer), "   0.000000 F1 CPC::TCM_State3_AR2::VehDrvProg_TCM_V3 = %d\n", intval);
	filePutString (buffer, elcount(buffer), hFile);
	intval = getSignal(CHASSIS::TCM_State3_AR2::MIL_On_Rq_TCM);
	snprintf(buffer, elcount(buffer), "   0.000000 F1 CPC::TCM_State3_AR2::MIL_On_Rq_TCM = %d\n", intval);
	filePutString (buffer, elcount(buffer), hFile);
	intval = getSignal(CHASSIS::TCM_State3_AR2::DrvRst_Hi);
	snprintf(buffer, elcount(buffer), "   0.000000 F1 CPC::TCM_State3_AR2::DrvRst_Hi = %d\n", intval);
	filePutString (buffer, elcount(buffer), hFile);
	intval = getSignal(CHASSIS::TCM_State3_AR2::TxTemp_Excess);
	snprintf(buffer, elcount(buffer), "   0.000000 F1 CPC::TCM_State3_AR2::TxTemp_Excess = %d\n", intval);
	filePutString (buffer, elcount(buffer), hFile);
	intval = getSignal(CHASSIS::TCM_State3_AR2::TxDrvProgMan_Actv);
	snprintf(buffer, elcount(buffer), "   0.000000 F1 CPC::TCM_State3_AR2::TxDrvProgMan_Actv = %d\n", intval);
	filePutString (buffer, elcount(buffer), hFile);
	intval = getSignal(CHASSIS::TCM_State3_AR2::TxOilTemp);
	snprintf(buffer, elcount(buffer), "   0.000000 F1 CPC::TCM_State3_AR2::TxOilTemp = %d\n", intval);
	filePutString (buffer, elcount(buffer), hFile);
	intval = getSignal(CHASSIS::TCM_State3_AR2::TxOffRd_Actv);
	snprintf(buffer, elcount(buffer), "   0.000000 F1 CPC::TCM_State3_AR2::TxOffRd_Actv = %d\n", intval);
	filePutString (buffer, elcount(buffer), hFile);
	intval = getSignal(CHASSIS::TCM_State3_AR2::TxDrvProgManTemp_Actv);
	snprintf(buffer, elcount(buffer), "   0.000000 F1 CPC::TCM_State3_AR2::TxDrvProgManTemp_Actv = %d\n", intval);
	filePutString (buffer, elcount(buffer), hFile);
	intval = getSignal(CHASSIS::TCM_State3_AR2::Adap_K0);
	snprintf(buffer, elcount(buffer), "   0.000000 F1 CPC::TCM_State3_AR2::Adap_K0 = %d\n", intval);
	filePutString (buffer, elcount(buffer), hFile);
	intval = getSignal(CHASSIS::TCM_State3_AR2::Adap_KUEB);
	snprintf(buffer, elcount(buffer), "   0.000000 F1 CPC::TCM_State3_AR2::Adap_KUEB = %d\n", intval);
	filePutString (buffer, elcount(buffer), hFile);
	intval = getSignal(CHASSIS::TCM_State3_AR2::TxMechStyle_V2);
	snprintf(buffer, elcount(buffer), "   0.000000 F1 CPC::TCM_State3_AR2::TxMechStyle_V2 = %d\n", intval);
	filePutString (buffer, elcount(buffer), hFile);
	intval = getSignal(CHASSIS::TCM_State3_AR2::BasShftProg_Ok);
	snprintf(buffer, elcount(buffer), "   0.000000 F1 CPC::TCM_State3_AR2::BasShftProg_Ok = %d\n", intval);
	filePutString (buffer, elcount(buffer), hFile);
	intval = getSignal(CHASSIS::TCM_State3_AR2::TxShiftStyle_V2);
	snprintf(buffer, elcount(buffer), "   0.000000 F1 CPC::TCM_State3_AR2::TxShiftStyle_V2 = %d\n", intval);
	filePutString (buffer, elcount(buffer), hFile);
	intval = getSignal(CHASSIS::TCM_State3_AR2::CoastMd_Stat_TCM);
	snprintf(buffer, elcount(buffer), "   0.000000 F1 CPC::TCM_State3_AR2::CoastMd_Stat_TCM = %d\n", intval);
	filePutString (buffer, elcount(buffer), hFile);
	intval = getSignal(CHASSIS::TCM_State3_AR2::AdapTrq_Rq);
	snprintf(buffer, elcount(buffer), "   0.000000 F1 CPC::TCM_State3_AR2::AdapTrq_Rq = %d\n", intval);
	filePutString (buffer, elcount(buffer), hFile);
	intval = getSignal(CHASSIS::TCM_State3_AR2::DrvAwElmtAdap_Rq);
	snprintf(buffer, elcount(buffer), "   0.000000 F1 CPC::TCM_State3_AR2::DrvAwElmtAdap_Rq = %d\n", intval);
	filePutString (buffer, elcount(buffer), hFile);
	intval = getSignal(CHASSIS::TCM_State3_AR2::DPC_Md_PwrFreeD_Plus_Rs);
	snprintf(buffer, elcount(buffer), "   0.000000 F1 CPC::TCM_State3_AR2::DPC_Md_PwrFreeD_Plus_Rs = %d\n", intval);
	filePutString (buffer, elcount(buffer), hFile);
	intval = getSignal(CHASSIS::TCM_State3_AR2::Tx_Agility_Stat);
	snprintf(buffer, elcount(buffer), "   0.000000 F1 CPC::TCM_State3_AR2::Tx_Agility_Stat = %d\n", intval);
	filePutString (buffer, elcount(buffer), hFile);
	intval = getSignal(CHASSIS::TCM_State3_AR2::TxLHOM2_Stat_Clutch);
	snprintf(buffer, elcount(buffer), "   0.000000 F1 CPC::TCM_State3_AR2::TxLHOM2_Stat_Clutch = %d\n", intval);
	filePutString (buffer, elcount(buffer), hFile);
	intval = getSignal(CHASSIS::TCM_State3_AR2::TxLHOM2_Stat_OilPump);
	snprintf(buffer, elcount(buffer), "   0.000000 F1 CPC::TCM_State3_AR2::TxLHOM2_Stat_OilPump = %d\n", intval);
	filePutString (buffer, elcount(buffer), hFile);
	intval = getSignal(CHASSIS::TCM_State3_AR2::TxLHOM2_Stat_Hybrid);
	snprintf(buffer, elcount(buffer), "   0.000000 F1 CPC::TCM_State3_AR2::TxLHOM2_Stat_Hybrid = %d\n", intval);
	filePutString (buffer, elcount(buffer), hFile);
	intval = getSignal(CHASSIS::TCM_State3_AR2::TxLHOM2_TX_Tractn);
	snprintf(buffer, elcount(buffer), "   0.000000 F1 CPC::TCM_State3_AR2::TxLHOM2_TX_Tractn = %d\n", intval);
	filePutString (buffer, elcount(buffer), hFile);
	intval = getSignal(CHASSIS::TCM_State3_AR2::TxLHOM2_Gr_Lock);
	snprintf(buffer, elcount(buffer), "   0.000000 F1 CPC::TCM_State3_AR2::TxLHOM2_Gr_Lock = %d\n", intval);
	filePutString (buffer, elcount(buffer), hFile);
	intval = getSignal(CHASSIS::TCM_State3_AR2::TxLHOM2_Gr_Hold);
	snprintf(buffer, elcount(buffer), "   0.000000 F1 CPC::TCM_State3_AR2::TxLHOM2_Gr_Hold = %d\n", intval);
	filePutString (buffer, elcount(buffer), hFile);
	intval = getSignal(CHASSIS::TCM_State3_AR2::TxLHOM2_TX_PwrFree);
	snprintf(buffer, elcount(buffer), "   0.000000 F1 CPC::TCM_State3_AR2::TxLHOM2_TX_PwrFree = %d\n", intval);
	filePutString (buffer, elcount(buffer), hFile);
	intval = getSignal(CHASSIS::TCM_State3_AR2::TxLHOM2_TX_Hydr);
	snprintf(buffer, elcount(buffer), "   0.000000 F1 CPC::TCM_State3_AR2::TxLHOM2_TX_Hydr = %d\n", intval);
	filePutString (buffer, elcount(buffer), hFile);
	intval = getSignal(CHASSIS::TCM_State3_AR2::DPC_Md_Tx_Rs);
	snprintf(buffer, elcount(buffer), "   0.000000 F1 CPC::TCM_State3_AR2::DPC_Md_Tx_Rs = %d\n", intval);
	filePutString (buffer, elcount(buffer), hFile);
	intval = getSignal(CHASSIS::TCM_State3_AR2::CylCutoff_Enbl_TCM);
	snprintf(buffer, elcount(buffer), "   0.000000 F1 CPC::TCM_State3_AR2::CylCutoff_Enbl_TCM = %d\n", intval);
	filePutString (buffer, elcount(buffer), hFile);
	intval = getSignal(CHASSIS::TCM_State3_AR2::CylCutoff_Shift_Enbl);
	snprintf(buffer, elcount(buffer), "   0.000000 F1 CPC::TCM_State3_AR2::CylCutoff_Shift_Enbl = %d\n", intval);
	filePutString (buffer, elcount(buffer), hFile);
	floatval = getSignal(CHASSIS::TCM_State3_AR2::TCC_Opn_RemainTm_TCM);
	snprintf(buffer, elcount(buffer), "   0.000000 F1 CPC::TCM_State3_AR2::TCC_Opn_RemainTm_TCM = %f\n", floatval);
	filePutString (buffer, elcount(buffer), hFile);
}
/*@@end*/

/*@@caplFunc:saveVars_15(dword):*/
void saveVars_15(dword hFile)
{
	intval = getSignal(CHASSIS::TCM_State3_AR2::TxOil_Recirc_Rq);
	snprintf(buffer, elcount(buffer), "   0.000000 F1 CPC::TCM_State3_AR2::TxOil_Recirc_Rq = %d\n", intval);
	filePutString (buffer, elcount(buffer), hFile);
	intval = getSignal(CHASSIS::TCU_Disp_Rq_AR2::EF_on_Rq_TCU);
	snprintf(buffer, elcount(buffer), "   0.000000 F1 CPC::TCU_Disp_Rq_AR2::EF_on_Rq_TCU = %d\n", intval);
	filePutString (buffer, elcount(buffer), hFile);
	intval = getSignal(CHASSIS::TCU_Disp_Rq_AR2::TCU_TankRes_CtrlLmp);
	snprintf(buffer, elcount(buffer), "   0.000000 F1 CPC::TCU_Disp_Rq_AR2::TCU_TankRes_CtrlLmp = %d\n", intval);
	filePutString (buffer, elcount(buffer), hFile);
	intval = getSignal(CHASSIS::TCU_Disp_Rq_AR2::TCU_RefuelFlag);
	snprintf(buffer, elcount(buffer), "   0.000000 F1 CPC::TCU_Disp_Rq_AR2::TCU_RefuelFlag = %d\n", intval);
	filePutString (buffer, elcount(buffer), hFile);
	intval = getSignal(CHASSIS::TCU_Disp_Rq_AR2::TCU_HSNoRestart);
	snprintf(buffer, elcount(buffer), "   0.000000 F1 CPC::TCU_Disp_Rq_AR2::TCU_HSNoRestart = %d\n", intval);
	filePutString (buffer, elcount(buffer), hFile);
	intval = getSignal(CHASSIS::TCU_Disp_Rq_AR2::TCU_H2_CtrlLmp);
	snprintf(buffer, elcount(buffer), "   0.000000 F1 CPC::TCU_Disp_Rq_AR2::TCU_H2_CtrlLmp = %d\n", intval);
	filePutString (buffer, elcount(buffer), hFile);
	intval = getSignal(CHASSIS::TCU_Disp_Rq_AR2::TCU_H2Err);
	snprintf(buffer, elcount(buffer), "   0.000000 F1 CPC::TCU_Disp_Rq_AR2::TCU_H2Err = %d\n", intval);
	filePutString (buffer, elcount(buffer), hFile);
	intval = getSignal(CHASSIS::TCU_Disp_Rq_AR2::TCU_H2Stop);
	snprintf(buffer, elcount(buffer), "   0.000000 F1 CPC::TCU_Disp_Rq_AR2::TCU_H2Stop = %d\n", intval);
	filePutString (buffer, elcount(buffer), hFile);
	intval = getSignal(CHASSIS::TCU_Disp_Rq_AR2::TCU_H2StopFill);
	snprintf(buffer, elcount(buffer), "   0.000000 F1 CPC::TCU_Disp_Rq_AR2::TCU_H2StopFill = %d\n", intval);
	filePutString (buffer, elcount(buffer), hFile);
	intval = getSignal(CHASSIS::TCU_Disp_Rq_AR2::TCU_HSErr);
	snprintf(buffer, elcount(buffer), "   0.000000 F1 CPC::TCU_Disp_Rq_AR2::TCU_HSErr = %d\n", intval);
	filePutString (buffer, elcount(buffer), hFile);
	intval = getSignal(CHASSIS::TCU_Disp_Rq_AR2::TCU_HSStop);
	snprintf(buffer, elcount(buffer), "   0.000000 F1 CPC::TCU_Disp_Rq_AR2::TCU_HSStop = %d\n", intval);
	filePutString (buffer, elcount(buffer), hFile);
	intval = getSignal(CHASSIS::TCU_Disp_Rq_AR2::TCU_TankCap_Opn);
	snprintf(buffer, elcount(buffer), "   0.000000 F1 CPC::TCU_Disp_Rq_AR2::TCU_TankCap_Opn = %d\n", intval);
	filePutString (buffer, elcount(buffer), hFile);
	intval = getSignal(CHASSIS::TCU_Disp_Rq_AR2::TCU_Service_Rq);
	snprintf(buffer, elcount(buffer), "   0.000000 F1 CPC::TCU_Disp_Rq_AR2::TCU_Service_Rq = %d\n", intval);
	filePutString (buffer, elcount(buffer), hFile);
	intval = getSignal(CHASSIS::TCU_Disp_Rq_AR2::TCU_TankCpcty);
	snprintf(buffer, elcount(buffer), "   0.000000 F1 CPC::TCU_Disp_Rq_AR2::TCU_TankCpcty = %d\n", intval);
	filePutString (buffer, elcount(buffer), hFile);
	floatval = getSignal(CHASSIS::TCU_Disp_Rq_AR2::TCU_H2SOC);
	snprintf(buffer, elcount(buffer), "   0.000000 F1 CPC::TCU_Disp_Rq_AR2::TCU_H2SOC = %f\n", floatval);
	filePutString (buffer, elcount(buffer), hFile);
	intval = getSignal(CHASSIS::ThermMngmnt_1_AR2::TM_ECM_ECU_Temp);
	snprintf(buffer, elcount(buffer), "   0.000000 F1 CPC::ThermMngmnt_1_AR2::TM_ECM_ECU_Temp = %d\n", intval);
	filePutString (buffer, elcount(buffer), hFile);
	intval = getSignal(CHASSIS::ThermMngmnt_1_AR2::TM_Exhst_AirTemp_Outsd);
	snprintf(buffer, elcount(buffer), "   0.000000 F1 CPC::ThermMngmnt_1_AR2::TM_Exhst_AirTemp_Outsd = %d\n", intval);
	filePutString (buffer, elcount(buffer), hFile);
	intval = getSignal(CHASSIS::ThermMngmnt_1_AR2::TM_Thermstat_BasDem_Rq);
	snprintf(buffer, elcount(buffer), "   0.000000 F1 CPC::ThermMngmnt_1_AR2::TM_Thermstat_BasDem_Rq = %d\n", intval);
	filePutString (buffer, elcount(buffer), hFile);
	intval = getSignal(CHASSIS::ThermMngmnt_1_AR2::AddWtrPmp_Afterrun_Rq_Pt);
	snprintf(buffer, elcount(buffer), "   0.000000 F1 CPC::ThermMngmnt_1_AR2::AddWtrPmp_Afterrun_Rq_Pt = %d\n", intval);
	filePutString (buffer, elcount(buffer), hFile);
	intval = getSignal(CHASSIS::ThermMngmnt_1_AR2::ECP_4_Actv);
	snprintf(buffer, elcount(buffer), "   0.000000 F1 CPC::ThermMngmnt_1_AR2::ECP_4_Actv = %d\n", intval);
	filePutString (buffer, elcount(buffer), hFile);
	intval = getSignal(CHASSIS::ThermMngmnt_1_AR2::TM_ExhstFlap_ModelTemp);
	snprintf(buffer, elcount(buffer), "   0.000000 F1 CPC::ThermMngmnt_1_AR2::TM_ExhstFlap_ModelTemp = %d\n", intval);
	filePutString (buffer, elcount(buffer), hFile);
	floatval = getSignal(CHASSIS::ThermMngmnt_4_AR::PNHV_Bat_CoolTemp_ChilVlv);
	snprintf(buffer, elcount(buffer), "   0.000000 F1 CPC::ThermMngmnt_4_AR::PNHV_Bat_CoolTemp_ChilVlv = %f\n", floatval);
	filePutString (buffer, elcount(buffer), hFile);
	intval = getSignal(CHASSIS::ThermMngmnt_4_AR::PNHV_CoolPwr_Rq_CPC);
	snprintf(buffer, elcount(buffer), "   0.000000 F1 CPC::ThermMngmnt_4_AR::PNHV_CoolPwr_Rq_CPC = %d\n", intval);
	filePutString (buffer, elcount(buffer), hFile);
	intval = getSignal(CHASSIS::ThermMngmnt_4_AR::PNHV_Bat_Cool_Rq_CPC);
	snprintf(buffer, elcount(buffer), "   0.000000 F1 CPC::ThermMngmnt_4_AR::PNHV_Bat_Cool_Rq_CPC = %d\n", intval);
	filePutString (buffer, elcount(buffer), hFile);
	intval = getSignal(CHASSIS::ThermMngmnt_4_AR::PNHV_Bat_CoolVlv_Stat_CPC);
	snprintf(buffer, elcount(buffer), "   0.000000 F1 CPC::ThermMngmnt_4_AR::PNHV_Bat_CoolVlv_Stat_CPC = %d\n", intval);
	filePutString (buffer, elcount(buffer), hFile);
	intval = getSignal(CHASSIS::ThermMngmnt_4_AR::CabinAC_Off_Rq_ThermCtrl);
	snprintf(buffer, elcount(buffer), "   0.000000 F1 CPC::ThermMngmnt_4_AR::CabinAC_Off_Rq_ThermCtrl = %d\n", intval);
	filePutString (buffer, elcount(buffer), hFile);
	intval = getSignal(CHASSIS::ThermMngmnt_4_AR::TM_Cool_SwVlv_AuxHeat_Opn_Rq);
	snprintf(buffer, elcount(buffer), "   0.000000 F1 CPC::ThermMngmnt_4_AR::TM_Cool_SwVlv_AuxHeat_Opn_Rq = %d\n", intval);
	filePutString (buffer, elcount(buffer), hFile);
	intval = getSignal(CHASSIS::ThermMngmnt_4_AR::TM_PP48_MaxCool_Stat);
	snprintf(buffer, elcount(buffer), "   0.000000 F1 CPC::ThermMngmnt_4_AR::TM_PP48_MaxCool_Stat = %d\n", intval);
	filePutString (buffer, elcount(buffer), hFile);
	floatval = getSignal(CHASSIS::ThermMngmnt_4_AR::Chiller_Rq_ThermCtrl);
	snprintf(buffer, elcount(buffer), "   0.000000 F1 CPC::ThermMngmnt_4_AR::Chiller_Rq_ThermCtrl = %f\n", floatval);
	filePutString (buffer, elcount(buffer), hFile);
	floatval = getSignal(CHASSIS::ThermMngmnt_4_AR::EV_PTGW_RefrigSuctPress);
	snprintf(buffer, elcount(buffer), "   0.000000 F1 CPC::ThermMngmnt_4_AR::EV_PTGW_RefrigSuctPress = %f\n", floatval);
	filePutString (buffer, elcount(buffer), hFile);
	intval = getSignal(CHASSIS::ThermMngmnt_4_AR::TM_HV_Bat_Cool_Rq);
	snprintf(buffer, elcount(buffer), "   0.000000 F1 CPC::ThermMngmnt_4_AR::TM_HV_Bat_Cool_Rq = %d\n", intval);
	filePutString (buffer, elcount(buffer), hFile);
	floatval = getSignal(CHASSIS::ThermMngmnt_4_AR::TM_LowTempClnt_FlowRate);
	snprintf(buffer, elcount(buffer), "   0.000000 F1 CPC::ThermMngmnt_4_AR::TM_LowTempClnt_FlowRate = %f\n", floatval);
	filePutString (buffer, elcount(buffer), hFile);
	intval = getSignal(CHASSIS::ThermMngmnt_4_AR::TM_TempChillerUpstr);
	snprintf(buffer, elcount(buffer), "   0.000000 F1 CPC::ThermMngmnt_4_AR::TM_TempChillerUpstr = %d\n", intval);
	filePutString (buffer, elcount(buffer), hFile);
	intval = getSignal(CHASSIS::ThermMngmnt_4_AR::TM_HVAC_Lim_Rq);
	snprintf(buffer, elcount(buffer), "   0.000000 F1 CPC::ThermMngmnt_4_AR::TM_HVAC_Lim_Rq = %d\n", intval);
	filePutString (buffer, elcount(buffer), hFile);
	intval = getSignal(CHASSIS::ThermMngmnt_EV_1_AR2::TM_Oprtn_Stat);
	snprintf(buffer, elcount(buffer), "   0.000000 F1 CPC::ThermMngmnt_EV_1_AR2::TM_Oprtn_Stat = %d\n", intval);
	filePutString (buffer, elcount(buffer), hFile);
	intval = getSignal(CHASSIS::ThermMngmnt_EV_1_AR2::TM_HV_PTC_Vlv_Rq);
	snprintf(buffer, elcount(buffer), "   0.000000 F1 CPC::ThermMngmnt_EV_1_AR2::TM_HV_PTC_Vlv_Rq = %d\n", intval);
	filePutString (buffer, elcount(buffer), hFile);
	intval = getSignal(CHASSIS::ThermMngmnt_EV_1_AR2::TM_EHP_Pump_Rq);
	snprintf(buffer, elcount(buffer), "   0.000000 F1 CPC::ThermMngmnt_EV_1_AR2::TM_EHP_Pump_Rq = %d\n", intval);
	filePutString (buffer, elcount(buffer), hFile);
	intval = getSignal(CHASSIS::ThermMngmnt_EV_1_AR2::TM_FC_Pump_RPM_Stat);
	snprintf(buffer, elcount(buffer), "   0.000000 F1 CPC::ThermMngmnt_EV_1_AR2::TM_FC_Pump_RPM_Stat = %d\n", intval);
	filePutString (buffer, elcount(buffer), hFile);
	floatval = getSignal(CHASSIS::VehPwrMngmnt_EMM_Stat2_AR2::PNHV_EnergyConsStart);
	snprintf(buffer, elcount(buffer), "   0.000000 F1 CPC::VehPwrMngmnt_EMM_Stat2_AR2::PNHV_EnergyConsStart = %f\n", floatval);
	filePutString (buffer, elcount(buffer), hFile);
	floatval = getSignal(CHASSIS::VehPwrMngmnt_EMM_Stat2_AR2::PNHV_EnergyConsReset);
	snprintf(buffer, elcount(buffer), "   0.000000 F1 CPC::VehPwrMngmnt_EMM_Stat2_AR2::PNHV_EnergyConsReset = %f\n", floatval);
	filePutString (buffer, elcount(buffer), hFile);
	intval = getSignal(CHASSIS::VehPwrMngmnt_EMM_Stat2_AR2::PNHV_PN14_QuiesCurr_Md_Rq);
	snprintf(buffer, elcount(buffer), "   0.000000 F1 CPC::VehPwrMngmnt_EMM_Stat2_AR2::PNHV_PN14_QuiesCurr_Md_Rq = %d\n", intval);
	filePutString (buffer, elcount(buffer), hFile);
	intval = getSignal(CHASSIS::VehPwrMngmnt_EMM_Stat2_AR2::PNHV_HV_WarnLmp_On_Rq);
	snprintf(buffer, elcount(buffer), "   0.000000 F1 CPC::VehPwrMngmnt_EMM_Stat2_AR2::PNHV_HV_WarnLmp_On_Rq = %d\n", intval);
	filePutString (buffer, elcount(buffer), hFile);
	intval = getSignal(CHASSIS::VehPwrMngmnt_EMM_Stat2_AR2::PNHV_NoEngStart_Disp_Rq);
	snprintf(buffer, elcount(buffer), "   0.000000 F1 CPC::VehPwrMngmnt_EMM_Stat2_AR2::PNHV_NoEngStart_Disp_Rq = %d\n", intval);
	filePutString (buffer, elcount(buffer), hFile);
	intval = @sysvar::CH_Nodes::CH_CPCCRC_EMM_Disp_Rq_Pr2Ve_AUTO;
	snprintf(buffer, elcount(buffer), "   0.000000    SV: 2 0 0 ::CH_Nodes::CH_CPCCRC_EMM_Disp_Rq_Pr2Ve_AUTO = %d\n", intval);
	filePutString (buffer, elcount(buffer), hFile);
	intval = getSignal(CHASSIS::VehPwrMngmnt_EMM_Stat2_AR2::CRC_EMM_Disp_Rq_Pr2);
	snprintf(buffer, elcount(buffer), "   0.000000 F1 CPC::VehPwrMngmnt_EMM_Stat2_AR2::CRC_EMM_Disp_Rq_Pr2 = %d\n", intval);
	filePutString (buffer, elcount(buffer), hFile);
	intval = @sysvar::CH_Nodes::CH_CPCSQC_EMM_Disp_Rq_Pr2Ve_AUTO;
	snprintf(buffer, elcount(buffer), "   0.000000    SV: 2 0 0 ::CH_Nodes::CH_CPCSQC_EMM_Disp_Rq_Pr2Ve_AUTO = %d\n", intval);
	filePutString (buffer, elcount(buffer), hFile);
	intval = getSignal(CHASSIS::VehPwrMngmnt_EMM_Stat2_AR2::SQC_EMM_Disp_Rq_Pr2);
	snprintf(buffer, elcount(buffer), "   0.000000 F1 CPC::VehPwrMngmnt_EMM_Stat2_AR2::SQC_EMM_Disp_Rq_Pr2 = %d\n", intval);
	filePutString (buffer, elcount(buffer), hFile);
	intval = getSignal(CHASSIS::VehPwrMngmnt_EMM_Stat2_AR2::EMM_DriveNoShift);
	snprintf(buffer, elcount(buffer), "   0.000000 F1 CPC::VehPwrMngmnt_EMM_Stat2_AR2::EMM_DriveNoShift = %d\n", intval);
	filePutString (buffer, elcount(buffer), hFile);
	intval = getSignal(CHASSIS::VehPwrMngmnt_EMM_Stat2_AR2::PNHV_Term61_WarnIcon_Disp_Rq);
	snprintf(buffer, elcount(buffer), "   0.000000 F1 CPC::VehPwrMngmnt_EMM_Stat2_AR2::PNHV_Term61_WarnIcon_Disp_Rq = %d\n", intval);
	filePutString (buffer, elcount(buffer), hFile);
	intval = getSignal(CHASSIS::VehPwrMngmnt_EMM_Stat2_AR2::EMM_TowProhibit_MsgDisp_Rq);
	snprintf(buffer, elcount(buffer), "   0.000000 F1 CPC::VehPwrMngmnt_EMM_Stat2_AR2::EMM_TowProhibit_MsgDisp_Rq = %d\n", intval);
	filePutString (buffer, elcount(buffer), hFile);
	intval = getSignal(CHASSIS::VehPwrMngmnt_EMM_Stat2_AR2::Rsrv1_EMM_Disp_Rq_Pr2);
	snprintf(buffer, elcount(buffer), "   0.000000 F1 CPC::VehPwrMngmnt_EMM_Stat2_AR2::Rsrv1_EMM_Disp_Rq_Pr2 = %d\n", intval);
	filePutString (buffer, elcount(buffer), hFile);
	floatval = getSignal(CHASSIS::VehPwrMngmnt_Rq_AR::PN14_GenExctCurr);
	snprintf(buffer, elcount(buffer), "   0.000000 F1 CPC::VehPwrMngmnt_Rq_AR::PN14_GenExctCurr = %f\n", floatval);
	filePutString (buffer, elcount(buffer), hFile);
	floatval = getSignal(CHASSIS::VehPwrMngmnt_Rq_AR::GenLoad);
	snprintf(buffer, elcount(buffer), "   0.000000 F1 CPC::VehPwrMngmnt_Rq_AR::GenLoad = %f\n", floatval);
	filePutString (buffer, elcount(buffer), hFile);
}
/*@@end*/

/*@@caplFunc:saveVars_16(dword):*/
void saveVars_16(dword hFile)
{
	floatval = getSignal(CHASSIS::VehPwrMngmnt_Rq_AR::EM_OutDC_Curr_ECM);
	snprintf(buffer, elcount(buffer), "   0.000000 F1 CPC::VehPwrMngmnt_Rq_AR::EM_OutDC_Curr_ECM = %f\n", floatval);
	filePutString (buffer, elcount(buffer), hFile);
	floatval = getSignal(CHASSIS::VehPwrMngmnt_Rq_AR::EM_OutDC_Volt_ECM);
	snprintf(buffer, elcount(buffer), "   0.000000 F1 CPC::VehPwrMngmnt_Rq_AR::EM_OutDC_Volt_ECM = %f\n", floatval);
	filePutString (buffer, elcount(buffer), hFile);
	intval = getSignal(CHASSIS::VehPwrMngmnt_Rq_AR::PN14_GenStyle);
	snprintf(buffer, elcount(buffer), "   0.000000 F1 CPC::VehPwrMngmnt_Rq_AR::PN14_GenStyle = %d\n", intval);
	filePutString (buffer, elcount(buffer), hFile);
	floatval = getSignal(CHASSIS::WIA_EngTrq_AR::WIA_EngTrqStatic);
	snprintf(buffer, elcount(buffer), "   0.000000 F1 CPC::WIA_EngTrq_AR::WIA_EngTrqStatic = %f\n", floatval);
	filePutString (buffer, elcount(buffer), hFile);
	floatval = getSignal(CHASSIS::WIA_EngTrq_AR::WIA_EngTrqMax);
	snprintf(buffer, elcount(buffer), "   0.000000 F1 CPC::WIA_EngTrq_AR::WIA_EngTrqMax = %f\n", floatval);
	filePutString (buffer, elcount(buffer), hFile);
	floatval = getSignal(CHASSIS::WIA_EngTrq_AR::WIA_EngTrqMin);
	snprintf(buffer, elcount(buffer), "   0.000000 F1 CPC::WIA_EngTrq_AR::WIA_EngTrqMin = %f\n", floatval);
	filePutString (buffer, elcount(buffer), hFile);
	intval = getSignal(CHASSIS::WPT_Stat2_AR2::WPT_ObjDtct);
	snprintf(buffer, elcount(buffer), "   0.000000 F1 CPC::WPT_Stat2_AR2::WPT_ObjDtct = %d\n", intval);
	filePutString (buffer, elcount(buffer), hFile);
	intval = getSignal(CHASSIS::WPT_Stat2_AR2::WPT_GPM_CPM_Con_Stat);
	snprintf(buffer, elcount(buffer), "   0.000000 F1 CPC::WPT_Stat2_AR2::WPT_GPM_CPM_Con_Stat = %d\n", intval);
	filePutString (buffer, elcount(buffer), hFile);
	intval = getSignal(CHASSIS::WPT_Stat2_AR2::WPT_Posn_Stat);
	snprintf(buffer, elcount(buffer), "   0.000000 F1 CPC::WPT_Stat2_AR2::WPT_Posn_Stat = %d\n", intval);
	filePutString (buffer, elcount(buffer), hFile);
	intval = getSignal(CHASSIS::WPT_Stat2_AR2::WPT_Sound_Rq);
	snprintf(buffer, elcount(buffer), "   0.000000 F1 CPC::WPT_Stat2_AR2::WPT_Sound_Rq = %d\n", intval);
	filePutString (buffer, elcount(buffer), hFile);
	floatval = getSignal(CHASSIS::WPT_Stat2_AR2::WPT_Posn_DstrtnAngl);
	snprintf(buffer, elcount(buffer), "   0.000000 F1 CPC::WPT_Stat2_AR2::WPT_Posn_DstrtnAngl = %f\n", floatval);
	filePutString (buffer, elcount(buffer), hFile);
	floatval = getSignal(CHASSIS::WPT_Stat2_AR2::WPT_Posn_X_Disp_Rq);
	snprintf(buffer, elcount(buffer), "   0.000000 F1 CPC::WPT_Stat2_AR2::WPT_Posn_X_Disp_Rq = %f\n", floatval);
	filePutString (buffer, elcount(buffer), hFile);
	floatval = getSignal(CHASSIS::WPT_Stat2_AR2::WPT_Posn_Y_Disp_Rq);
	snprintf(buffer, elcount(buffer), "   0.000000 F1 CPC::WPT_Stat2_AR2::WPT_Posn_Y_Disp_Rq = %f\n", floatval);
	filePutString (buffer, elcount(buffer), hFile);
	intval = getSignal(CHASSIS::WPT_Stat2_AR2::WPT_Posn_Stat_Disp_Rq);
	snprintf(buffer, elcount(buffer), "   0.000000 F1 CPC::WPT_Stat2_AR2::WPT_Posn_Stat_Disp_Rq = %d\n", intval);
	filePutString (buffer, elcount(buffer), hFile);
	snprintf(buffer, elcount(buffer), "   0.000000    SV: 2 0 0 ::CH_Nodes::CH__NMActive_DRVU = %X\n", @sysvar::CH_Nodes::CH__NMActive_DRVU);
	filePutString (buffer, elcount(buffer), hFile);
	snprintf(buffer, elcount(buffer), "   0.000000    SV: 2 0 0 ::CH_Nodes::CH__NMAwake_DRVU = %X\n", @sysvar::CH_Nodes::CH__NMAwake_DRVU);
	filePutString (buffer, elcount(buffer), hFile);
	intval = @sysvar::CH_Nodes::CH_DRVUCRC_DPC_Disp_Rq_AMG__AUTO;
	snprintf(buffer, elcount(buffer), "   0.000000    SV: 2 0 0 ::CH_Nodes::CH_DRVUCRC_DPC_Disp_Rq_AMG__AUTO = %d\n", intval);
	filePutString (buffer, elcount(buffer), hFile);
	intval = getSignal(CHASSIS::DPC_Disp_Rq_AMG_AR2::CRC_DPC_Disp_Rq_AMG_Pr2);
	snprintf(buffer, elcount(buffer), "   0.000000 F1 DRVU::DPC_Disp_Rq_AMG_AR2::CRC_DPC_Disp_Rq_AMG_Pr2 = %d\n", intval);
	filePutString (buffer, elcount(buffer), hFile);
	intval = @sysvar::CH_Nodes::CH_DRVUSQC_DPC_Disp_Rq_AMG__AUTO;
	snprintf(buffer, elcount(buffer), "   0.000000    SV: 2 0 0 ::CH_Nodes::CH_DRVUSQC_DPC_Disp_Rq_AMG__AUTO = %d\n", intval);
	filePutString (buffer, elcount(buffer), hFile);
	intval = getSignal(CHASSIS::DPC_Disp_Rq_AMG_AR2::SQC_DPC_Disp_Rq_AMG_Pr2);
	snprintf(buffer, elcount(buffer), "   0.000000 F1 DRVU::DPC_Disp_Rq_AMG_AR2::SQC_DPC_Disp_Rq_AMG_Pr2 = %d\n", intval);
	filePutString (buffer, elcount(buffer), hFile);
	intval = getSignal(CHASSIS::DPC_Disp_Rq_AMG_AR2::DPC_Md_Disp_Rq_AMG);
	snprintf(buffer, elcount(buffer), "   0.000000 F1 DRVU::DPC_Disp_Rq_AMG_AR2::DPC_Md_Disp_Rq_AMG = %d\n", intval);
	filePutString (buffer, elcount(buffer), hFile);
	intval = getSignal(CHASSIS::DPC_Disp_Rq_AMG_AR2::DPC_OnroadMd_Disp_Rq_AMG);
	snprintf(buffer, elcount(buffer), "   0.000000 F1 DRVU::DPC_Disp_Rq_AMG_AR2::DPC_OnroadMd_Disp_Rq_AMG = %d\n", intval);
	filePutString (buffer, elcount(buffer), hFile);
	intval = getSignal(CHASSIS::DPC_Disp_Rq_AMG_AR2::DPC_OnroadMd_Disp_TrgRq_AMG);
	snprintf(buffer, elcount(buffer), "   0.000000 F1 DRVU::DPC_Disp_Rq_AMG_AR2::DPC_OnroadMd_Disp_TrgRq_AMG = %d\n", intval);
	filePutString (buffer, elcount(buffer), hFile);
	intval = getSignal(CHASSIS::DPC_Disp_Rq_AMG_AR2::DPC_Offroad_Abort_Disp_Rq_AMG);
	snprintf(buffer, elcount(buffer), "   0.000000 F1 DRVU::DPC_Disp_Rq_AMG_AR2::DPC_Offroad_Abort_Disp_Rq_AMG = %d\n", intval);
	filePutString (buffer, elcount(buffer), hFile);
	intval = getSignal(CHASSIS::DPC_Disp_Rq_AMG_AR2::DPC_OnroadMd_Style_AMG);
	snprintf(buffer, elcount(buffer), "   0.000000 F1 DRVU::DPC_Disp_Rq_AMG_AR2::DPC_OnroadMd_Style_AMG = %d\n", intval);
	filePutString (buffer, elcount(buffer), hFile);
	intval = getSignal(CHASSIS::DPC_Disp_Rq_AMG_AR2::Rsrv1_DPC_Disp_Rq_AMG_Pr2);
	snprintf(buffer, elcount(buffer), "   0.000000 F1 DRVU::DPC_Disp_Rq_AMG_AR2::Rsrv1_DPC_Disp_Rq_AMG_Pr2 = %d\n", intval);
	filePutString (buffer, elcount(buffer), hFile);
	intval = getSignal(CHASSIS::DPC_Disp_Rq_AMG_AR2::Rsrv2_DPC_Disp_Rq_AMG_Pr2);
	snprintf(buffer, elcount(buffer), "   0.000000 F1 DRVU::DPC_Disp_Rq_AMG_AR2::Rsrv2_DPC_Disp_Rq_AMG_Pr2 = %d\n", intval);
	filePutString (buffer, elcount(buffer), hFile);
	intval = @sysvar::CH_Nodes::CH_DRVUCRC_DPC_IndMd_Stat_A_AUTO;
	snprintf(buffer, elcount(buffer), "   0.000000    SV: 2 0 0 ::CH_Nodes::CH_DRVUCRC_DPC_IndMd_Stat_A_AUTO = %d\n", intval);
	filePutString (buffer, elcount(buffer), hFile);
	intval = getSignal(CHASSIS::DPC_IndMd_Stat_AMG_AR2::CRC_DPC_IndMd_Stat_AMG_Pr2);
	snprintf(buffer, elcount(buffer), "   0.000000 F1 DRVU::DPC_IndMd_Stat_AMG_AR2::CRC_DPC_IndMd_Stat_AMG_Pr2 = %d\n", intval);
	filePutString (buffer, elcount(buffer), hFile);
	intval = @sysvar::CH_Nodes::CH_DRVUSQC_DPC_IndMd_Stat_A_AUTO;
	snprintf(buffer, elcount(buffer), "   0.000000    SV: 2 0 0 ::CH_Nodes::CH_DRVUSQC_DPC_IndMd_Stat_A_AUTO = %d\n", intval);
	filePutString (buffer, elcount(buffer), hFile);
	intval = getSignal(CHASSIS::DPC_IndMd_Stat_AMG_AR2::SQC_DPC_IndMd_Stat_AMG_Pr2);
	snprintf(buffer, elcount(buffer), "   0.000000 F1 DRVU::DPC_IndMd_Stat_AMG_AR2::SQC_DPC_IndMd_Stat_AMG_Pr2 = %d\n", intval);
	filePutString (buffer, elcount(buffer), hFile);
	intval = getSignal(CHASSIS::DPC_IndMd_Stat_AMG_AR2::DPC_IndMd_PT_Stat_AMG);
	snprintf(buffer, elcount(buffer), "   0.000000 F1 DRVU::DPC_IndMd_Stat_AMG_AR2::DPC_IndMd_PT_Stat_AMG = %d\n", intval);
	filePutString (buffer, elcount(buffer), hFile);
	intval = getSignal(CHASSIS::DPC_IndMd_Stat_AMG_AR2::DPC_IndMd_St_Stat_AMG);
	snprintf(buffer, elcount(buffer), "   0.000000 F1 DRVU::DPC_IndMd_Stat_AMG_AR2::DPC_IndMd_St_Stat_AMG = %d\n", intval);
	filePutString (buffer, elcount(buffer), hFile);
	intval = getSignal(CHASSIS::DPC_IndMd_Stat_AMG_AR2::DPC_IndMd_Susp_Stat_AMG);
	snprintf(buffer, elcount(buffer), "   0.000000 F1 DRVU::DPC_IndMd_Stat_AMG_AR2::DPC_IndMd_Susp_Stat_AMG = %d\n", intval);
	filePutString (buffer, elcount(buffer), hFile);
	intval = getSignal(CHASSIS::DPC_IndMd_Stat_AMG_AR2::DPC_IndMd_SSA_Stat_AMG);
	snprintf(buffer, elcount(buffer), "   0.000000 F1 DRVU::DPC_IndMd_Stat_AMG_AR2::DPC_IndMd_SSA_Stat_AMG = %d\n", intval);
	filePutString (buffer, elcount(buffer), hFile);
	intval = getSignal(CHASSIS::DPC_IndMd_Stat_AMG_AR2::DPC_OffroadMd_Stat_AMG);
	snprintf(buffer, elcount(buffer), "   0.000000 F1 DRVU::DPC_IndMd_Stat_AMG_AR2::DPC_OffroadMd_Stat_AMG = %d\n", intval);
	filePutString (buffer, elcount(buffer), hFile);
	intval = getSignal(CHASSIS::DPC_IndMd_Stat_AMG_AR2::DPC_IndMd_eDrv_Stat_AMG);
	snprintf(buffer, elcount(buffer), "   0.000000 F1 DRVU::DPC_IndMd_Stat_AMG_AR2::DPC_IndMd_eDrv_Stat_AMG = %d\n", intval);
	filePutString (buffer, elcount(buffer), hFile);
	intval = getSignal(CHASSIS::DPC_IndMd_Stat_AMG_AR2::DPC_IndMd_PwrFreeD_Plus_Stat_AMG);
	snprintf(buffer, elcount(buffer), "   0.000000 F1 DRVU::DPC_IndMd_Stat_AMG_AR2::DPC_IndMd_PwrFreeD_Plus_Stat_AMG = %d\n", intval);
	filePutString (buffer, elcount(buffer), hFile);
	intval = getSignal(CHASSIS::DPC_IndMd_Stat_AMG_AR2::DPC_IndMd_ECO_Assist_Stat_AMG);
	snprintf(buffer, elcount(buffer), "   0.000000 F1 DRVU::DPC_IndMd_Stat_AMG_AR2::DPC_IndMd_ECO_Assist_Stat_AMG = %d\n", intval);
	filePutString (buffer, elcount(buffer), hFile);
	intval = getSignal(CHASSIS::DPC_IndMd_Stat_AMG_AR2::DPC_IndMd_AC_Stat_AMG);
	snprintf(buffer, elcount(buffer), "   0.000000 F1 DRVU::DPC_IndMd_Stat_AMG_AR2::DPC_IndMd_AC_Stat_AMG = %d\n", intval);
	filePutString (buffer, elcount(buffer), hFile);
	intval = getSignal(CHASSIS::DPC_IndMd_Stat_AMG_AR2::DPC_IndMd_Ht_Stat_AMG);
	snprintf(buffer, elcount(buffer), "   0.000000 F1 DRVU::DPC_IndMd_Stat_AMG_AR2::DPC_IndMd_Ht_Stat_AMG = %d\n", intval);
	filePutString (buffer, elcount(buffer), hFile);
	intval = getSignal(CHASSIS::DPC_IndMd_Stat_AMG_AR2::DPC_IndMd_ExhstFlap_Stat_AMG);
	snprintf(buffer, elcount(buffer), "   0.000000 F1 DRVU::DPC_IndMd_Stat_AMG_AR2::DPC_IndMd_ExhstFlap_Stat_AMG = %d\n", intval);
	filePutString (buffer, elcount(buffer), hFile);
	intval = getSignal(CHASSIS::DPC_IndMd_Stat_AMG_AR2::DPC_IndMd_ESP_Stat_AMG);
	snprintf(buffer, elcount(buffer), "   0.000000 F1 DRVU::DPC_IndMd_Stat_AMG_AR2::DPC_IndMd_ESP_Stat_AMG = %d\n", intval);
	filePutString (buffer, elcount(buffer), hFile);
	intval = getSignal(CHASSIS::DPC_IndMd_Stat_AMG_AR2::DPC_IndMd_Tx_Stat_AMG);
	snprintf(buffer, elcount(buffer), "   0.000000 F1 DRVU::DPC_IndMd_Stat_AMG_AR2::DPC_IndMd_Tx_Stat_AMG = %d\n", intval);
	filePutString (buffer, elcount(buffer), hFile);
	intval = getSignal(CHASSIS::DPC_IndMd_Stat_AMG_AR2::DPC_IndMd_AS_Stat_AMG);
	snprintf(buffer, elcount(buffer), "   0.000000 F1 DRVU::DPC_IndMd_Stat_AMG_AR2::DPC_IndMd_AS_Stat_AMG = %d\n", intval);
	filePutString (buffer, elcount(buffer), hFile);
	intval = getSignal(CHASSIS::DPC_IndMd_Stat_AMG_AR2::DPC_IndMd_ABC_Stat_AMG);
	snprintf(buffer, elcount(buffer), "   0.000000 F1 DRVU::DPC_IndMd_Stat_AMG_AR2::DPC_IndMd_ABC_Stat_AMG = %d\n", intval);
	filePutString (buffer, elcount(buffer), hFile);
	intval = getSignal(CHASSIS::DPC_IndMd_Stat_AMG_AR2::Rsrv2_DPC_IndMd_Stat_AMG_Pr2);
	snprintf(buffer, elcount(buffer), "   0.000000 F1 DRVU::DPC_IndMd_Stat_AMG_AR2::Rsrv2_DPC_IndMd_Stat_AMG_Pr2 = %d\n", intval);
	filePutString (buffer, elcount(buffer), hFile);
	intval = getSignal(CHASSIS::DPC_IndMd_Stat_AMG_AR2::Rsrv3_DPC_IndMd_Stat_AMG_Pr2);
	snprintf(buffer, elcount(buffer), "   0.000000 F1 DRVU::DPC_IndMd_Stat_AMG_AR2::Rsrv3_DPC_IndMd_Stat_AMG_Pr2 = %d\n", intval);
	filePutString (buffer, elcount(buffer), hFile);
	intval = @sysvar::CH_Nodes::CH_DRVUCRC_DPC_IndMd_Style2_AUTO;
	snprintf(buffer, elcount(buffer), "   0.000000    SV: 2 0 0 ::CH_Nodes::CH_DRVUCRC_DPC_IndMd_Style2_AUTO = %d\n", intval);
	filePutString (buffer, elcount(buffer), hFile);
	intval = getSignal(CHASSIS::DPC_IndMd_Style2_AMG_AR2::CRC_DPC_IndMd_Style2_AMG_Pr2);
	snprintf(buffer, elcount(buffer), "   0.000000 F1 DRVU::DPC_IndMd_Style2_AMG_AR2::CRC_DPC_IndMd_Style2_AMG_Pr2 = %d\n", intval);
	filePutString (buffer, elcount(buffer), hFile);
	intval = @sysvar::CH_Nodes::CH_DRVUSQC_DPC_IndMd_Style2_AUTO;
	snprintf(buffer, elcount(buffer), "   0.000000    SV: 2 0 0 ::CH_Nodes::CH_DRVUSQC_DPC_IndMd_Style2_AUTO = %d\n", intval);
	filePutString (buffer, elcount(buffer), hFile);
	intval = getSignal(CHASSIS::DPC_IndMd_Style2_AMG_AR2::SQC_DPC_IndMd_Style2_AMG_Pr2);
	snprintf(buffer, elcount(buffer), "   0.000000 F1 DRVU::DPC_IndMd_Style2_AMG_AR2::SQC_DPC_IndMd_Style2_AMG_Pr2 = %d\n", intval);
	filePutString (buffer, elcount(buffer), hFile);
	intval = getSignal(CHASSIS::DPC_IndMd_Style2_AMG_AR2::Rsrv0_DPC_IndMd_Style2_AMG_Pr2);
	snprintf(buffer, elcount(buffer), "   0.000000 F1 DRVU::DPC_IndMd_Style2_AMG_AR2::Rsrv0_DPC_IndMd_Style2_AMG_Pr2 = %d\n", intval);
	filePutString (buffer, elcount(buffer), hFile);
	intval = getSignal(CHASSIS::DPC_IndMd_Style2_AMG_AR2::DPC_IndMd_ABC_Style_AMG);
	snprintf(buffer, elcount(buffer), "   0.000000 F1 DRVU::DPC_IndMd_Style2_AMG_AR2::DPC_IndMd_ABC_Style_AMG = %d\n", intval);
	filePutString (buffer, elcount(buffer), hFile);
	intval = getSignal(CHASSIS::DPC_IndMd_Style2_AMG_AR2::Rsrv1_DPC_IndMd_Style2_AMG_Pr2);
	snprintf(buffer, elcount(buffer), "   0.000000 F1 DRVU::DPC_IndMd_Style2_AMG_AR2::Rsrv1_DPC_IndMd_Style2_AMG_Pr2 = %d\n", intval);
	filePutString (buffer, elcount(buffer), hFile);
	intval = getSignal(CHASSIS::DPC_IndMd_Style2_AMG_AR2::Rsrv2_DPC_IndMd_Style2_AMG_Pr2);
	snprintf(buffer, elcount(buffer), "   0.000000 F1 DRVU::DPC_IndMd_Style2_AMG_AR2::Rsrv2_DPC_IndMd_Style2_AMG_Pr2 = %d\n", intval);
	filePutString (buffer, elcount(buffer), hFile);
	intval = getSignal(CHASSIS::DPC_IndMd_Style2_AMG_AR2::Rsrv3_DPC_IndMd_Style2_AMG_Pr2);
	snprintf(buffer, elcount(buffer), "   0.000000 F1 DRVU::DPC_IndMd_Style2_AMG_AR2::Rsrv3_DPC_IndMd_Style2_AMG_Pr2 = %d\n", intval);
	filePutString (buffer, elcount(buffer), hFile);
}
/*@@end*/

/*@@caplFunc:saveVars_17(dword):*/
void saveVars_17(dword hFile)
{
	intval = getSignal(CHASSIS::DPC_IndMd_Style2_AMG_AR2::Rsrv4_DPC_IndMd_Style2_AMG_Pr2);
	snprintf(buffer, elcount(buffer), "   0.000000 F1 DRVU::DPC_IndMd_Style2_AMG_AR2::Rsrv4_DPC_IndMd_Style2_AMG_Pr2 = %d\n", intval);
	filePutString (buffer, elcount(buffer), hFile);
	intval = getSignal(CHASSIS::DPC_IndMd_Style2_AMG_AR2::Rsrv5_DPC_IndMd_Style2_AMG_Pr2);
	snprintf(buffer, elcount(buffer), "   0.000000 F1 DRVU::DPC_IndMd_Style2_AMG_AR2::Rsrv5_DPC_IndMd_Style2_AMG_Pr2 = %d\n", intval);
	filePutString (buffer, elcount(buffer), hFile);
	intval = getSignal(CHASSIS::DPC_IndMd_Style2_AMG_AR2::Rsrv6_DPC_IndMd_Style2_AMG_Pr2);
	snprintf(buffer, elcount(buffer), "   0.000000 F1 DRVU::DPC_IndMd_Style2_AMG_AR2::Rsrv6_DPC_IndMd_Style2_AMG_Pr2 = %d\n", intval);
	filePutString (buffer, elcount(buffer), hFile);
	intval = @sysvar::CH_Nodes::CH_DRVUCRC_DPC_IndMd_Style__AUTO;
	snprintf(buffer, elcount(buffer), "   0.000000    SV: 2 0 0 ::CH_Nodes::CH_DRVUCRC_DPC_IndMd_Style__AUTO = %d\n", intval);
	filePutString (buffer, elcount(buffer), hFile);
	intval = getSignal(CHASSIS::DPC_IndMd_Style_AMG_AR2::CRC_DPC_IndMd_Style_AMG_Pr2);
	snprintf(buffer, elcount(buffer), "   0.000000 F1 DRVU::DPC_IndMd_Style_AMG_AR2::CRC_DPC_IndMd_Style_AMG_Pr2 = %d\n", intval);
	filePutString (buffer, elcount(buffer), hFile);
	intval = @sysvar::CH_Nodes::CH_DRVUSQC_DPC_IndMd_Style__AUTO;
	snprintf(buffer, elcount(buffer), "   0.000000    SV: 2 0 0 ::CH_Nodes::CH_DRVUSQC_DPC_IndMd_Style__AUTO = %d\n", intval);
	filePutString (buffer, elcount(buffer), hFile);
	intval = getSignal(CHASSIS::DPC_IndMd_Style_AMG_AR2::SQC_DPC_IndMd_Style_AMG_Pr2);
	snprintf(buffer, elcount(buffer), "   0.000000 F1 DRVU::DPC_IndMd_Style_AMG_AR2::SQC_DPC_IndMd_Style_AMG_Pr2 = %d\n", intval);
	filePutString (buffer, elcount(buffer), hFile);
	intval = getSignal(CHASSIS::DPC_IndMd_Style_AMG_AR2::DPC_IndMd_St_Style_AMG);
	snprintf(buffer, elcount(buffer), "   0.000000 F1 DRVU::DPC_IndMd_Style_AMG_AR2::DPC_IndMd_St_Style_AMG = %d\n", intval);
	filePutString (buffer, elcount(buffer), hFile);
	intval = getSignal(CHASSIS::DPC_IndMd_Style_AMG_AR2::DPC_IndMd_PT_Style_AMG);
	snprintf(buffer, elcount(buffer), "   0.000000 F1 DRVU::DPC_IndMd_Style_AMG_AR2::DPC_IndMd_PT_Style_AMG = %d\n", intval);
	filePutString (buffer, elcount(buffer), hFile);
	intval = getSignal(CHASSIS::DPC_IndMd_Style_AMG_AR2::DPC_IndMd_Susp_Style_AMG);
	snprintf(buffer, elcount(buffer), "   0.000000 F1 DRVU::DPC_IndMd_Style_AMG_AR2::DPC_IndMd_Susp_Style_AMG = %d\n", intval);
	filePutString (buffer, elcount(buffer), hFile);
	intval = getSignal(CHASSIS::DPC_IndMd_Style_AMG_AR2::DPC_IndMd_SSA_Style_AMG);
	snprintf(buffer, elcount(buffer), "   0.000000 F1 DRVU::DPC_IndMd_Style_AMG_AR2::DPC_IndMd_SSA_Style_AMG = %d\n", intval);
	filePutString (buffer, elcount(buffer), hFile);
	intval = getSignal(CHASSIS::DPC_IndMd_Style_AMG_AR2::DPC_IndMd_AS_Style_AMG);
	snprintf(buffer, elcount(buffer), "   0.000000 F1 DRVU::DPC_IndMd_Style_AMG_AR2::DPC_IndMd_AS_Style_AMG = %d\n", intval);
	filePutString (buffer, elcount(buffer), hFile);
	intval = getSignal(CHASSIS::DPC_IndMd_Style_AMG_AR2::DPC_IndMd_eDrv_Style_AMG);
	snprintf(buffer, elcount(buffer), "   0.000000 F1 DRVU::DPC_IndMd_Style_AMG_AR2::DPC_IndMd_eDrv_Style_AMG = %d\n", intval);
	filePutString (buffer, elcount(buffer), hFile);
	intval = getSignal(CHASSIS::DPC_IndMd_Style_AMG_AR2::DPC_IndMd_PwrFreeD_Plus_Style_AMG);
	snprintf(buffer, elcount(buffer), "   0.000000 F1 DRVU::DPC_IndMd_Style_AMG_AR2::DPC_IndMd_PwrFreeD_Plus_Style_AMG = %d\n", intval);
	filePutString (buffer, elcount(buffer), hFile);
	intval = getSignal(CHASSIS::DPC_IndMd_Style_AMG_AR2::DPC_IndMd_ECO_Assist_Style_AMG);
	snprintf(buffer, elcount(buffer), "   0.000000 F1 DRVU::DPC_IndMd_Style_AMG_AR2::DPC_IndMd_ECO_Assist_Style_AMG = %d\n", intval);
	filePutString (buffer, elcount(buffer), hFile);
	intval = getSignal(CHASSIS::DPC_IndMd_Style_AMG_AR2::DPC_IndMd_AC_Style_AMG);
	snprintf(buffer, elcount(buffer), "   0.000000 F1 DRVU::DPC_IndMd_Style_AMG_AR2::DPC_IndMd_AC_Style_AMG = %d\n", intval);
	filePutString (buffer, elcount(buffer), hFile);
	intval = getSignal(CHASSIS::DPC_IndMd_Style_AMG_AR2::DPC_IndMd_Ht_Style_AMG);
	snprintf(buffer, elcount(buffer), "   0.000000 F1 DRVU::DPC_IndMd_Style_AMG_AR2::DPC_IndMd_Ht_Style_AMG = %d\n", intval);
	filePutString (buffer, elcount(buffer), hFile);
	intval = getSignal(CHASSIS::DPC_IndMd_Style_AMG_AR2::DPC_IndMd_ExhstFlap_Style_AMG);
	snprintf(buffer, elcount(buffer), "   0.000000 F1 DRVU::DPC_IndMd_Style_AMG_AR2::DPC_IndMd_ExhstFlap_Style_AMG = %d\n", intval);
	filePutString (buffer, elcount(buffer), hFile);
	intval = getSignal(CHASSIS::DPC_IndMd_Style_AMG_AR2::DPC_IndMd_ESP_Style_AMG);
	snprintf(buffer, elcount(buffer), "   0.000000 F1 DRVU::DPC_IndMd_Style_AMG_AR2::DPC_IndMd_ESP_Style_AMG = %d\n", intval);
	filePutString (buffer, elcount(buffer), hFile);
	intval = getSignal(CHASSIS::DPC_IndMd_Style_AMG_AR2::DPC_IndMd_Tx_Style_AMG);
	snprintf(buffer, elcount(buffer), "   0.000000 F1 DRVU::DPC_IndMd_Style_AMG_AR2::DPC_IndMd_Tx_Style_AMG = %d\n", intval);
	filePutString (buffer, elcount(buffer), hFile);
	intval = getSignal(CHASSIS::DPC_IndMd_Style_AMG_AR2::DPC_OffroadMd_Style_AMG);
	snprintf(buffer, elcount(buffer), "   0.000000 F1 DRVU::DPC_IndMd_Style_AMG_AR2::DPC_OffroadMd_Style_AMG = %d\n", intval);
	filePutString (buffer, elcount(buffer), hFile);
	intval = @sysvar::CH_Nodes::CH_DRVUCRC_DPC_Master_Rq_AM_AUTO;
	snprintf(buffer, elcount(buffer), "   0.000000    SV: 2 0 0 ::CH_Nodes::CH_DRVUCRC_DPC_Master_Rq_AM_AUTO = %d\n", intval);
	filePutString (buffer, elcount(buffer), hFile);
	intval = getSignal(CHASSIS::DPC_Master_Rq_AMG_AR2::CRC_DPC_Master_Rq_AMG_Pr2);
	snprintf(buffer, elcount(buffer), "   0.000000 F1 DRVU::DPC_Master_Rq_AMG_AR2::CRC_DPC_Master_Rq_AMG_Pr2 = %d\n", intval);
	filePutString (buffer, elcount(buffer), hFile);
	intval = @sysvar::CH_Nodes::CH_DRVUSQC_DPC_Master_Rq_AM_AUTO;
	snprintf(buffer, elcount(buffer), "   0.000000    SV: 2 0 0 ::CH_Nodes::CH_DRVUSQC_DPC_Master_Rq_AM_AUTO = %d\n", intval);
	filePutString (buffer, elcount(buffer), hFile);
	intval = getSignal(CHASSIS::DPC_Master_Rq_AMG_AR2::SQC_DPC_Master_Rq_AMG_Pr2);
	snprintf(buffer, elcount(buffer), "   0.000000 F1 DRVU::DPC_Master_Rq_AMG_AR2::SQC_DPC_Master_Rq_AMG_Pr2 = %d\n", intval);
	filePutString (buffer, elcount(buffer), hFile);
	intval = getSignal(CHASSIS::DPC_Master_Rq_AMG_AR2::DPC_GlobalMd_Rq_AMG);
	snprintf(buffer, elcount(buffer), "   0.000000 F1 DRVU::DPC_Master_Rq_AMG_AR2::DPC_GlobalMd_Rq_AMG = %d\n", intval);
	filePutString (buffer, elcount(buffer), hFile);
	intval = getSignal(CHASSIS::DPC_Master_Rq_AMG_AR2::DPC_Md_St_Rq_AMG);
	snprintf(buffer, elcount(buffer), "   0.000000 F1 DRVU::DPC_Master_Rq_AMG_AR2::DPC_Md_St_Rq_AMG = %d\n", intval);
	filePutString (buffer, elcount(buffer), hFile);
	intval = getSignal(CHASSIS::DPC_Master_Rq_AMG_AR2::DPC_Md_Susp_Rq_V2_AMG);
	snprintf(buffer, elcount(buffer), "   0.000000 F1 DRVU::DPC_Master_Rq_AMG_AR2::DPC_Md_Susp_Rq_V2_AMG = %d\n", intval);
	filePutString (buffer, elcount(buffer), hFile);
	intval = getSignal(CHASSIS::DPC_Master_Rq_AMG_AR2::DPC_Md_PT_Rq_AMG);
	snprintf(buffer, elcount(buffer), "   0.000000 F1 DRVU::DPC_Master_Rq_AMG_AR2::DPC_Md_PT_Rq_AMG = %d\n", intval);
	filePutString (buffer, elcount(buffer), hFile);
	intval = getSignal(CHASSIS::DPC_Master_Rq_AMG_AR2::DPC_Md_eDrv_Rq_AMG);
	snprintf(buffer, elcount(buffer), "   0.000000 F1 DRVU::DPC_Master_Rq_AMG_AR2::DPC_Md_eDrv_Rq_AMG = %d\n", intval);
	filePutString (buffer, elcount(buffer), hFile);
	intval = getSignal(CHASSIS::DPC_Master_Rq_AMG_AR2::DPC_Md_PwrFreeD_Plus_Rq_AMG);
	snprintf(buffer, elcount(buffer), "   0.000000 F1 DRVU::DPC_Master_Rq_AMG_AR2::DPC_Md_PwrFreeD_Plus_Rq_AMG = %d\n", intval);
	filePutString (buffer, elcount(buffer), hFile);
	intval = getSignal(CHASSIS::DPC_Master_Rq_AMG_AR2::DPC_Md_ECO_Assist_Rq_AMG);
	snprintf(buffer, elcount(buffer), "   0.000000 F1 DRVU::DPC_Master_Rq_AMG_AR2::DPC_Md_ECO_Assist_Rq_AMG = %d\n", intval);
	filePutString (buffer, elcount(buffer), hFile);
	intval = getSignal(CHASSIS::DPC_Master_Rq_AMG_AR2::DPC_Md_AC_Rq_AMG);
	snprintf(buffer, elcount(buffer), "   0.000000 F1 DRVU::DPC_Master_Rq_AMG_AR2::DPC_Md_AC_Rq_AMG = %d\n", intval);
	filePutString (buffer, elcount(buffer), hFile);
	intval = getSignal(CHASSIS::DPC_Master_Rq_AMG_AR2::DPC_Md_Ht_Rq_AMG);
	snprintf(buffer, elcount(buffer), "   0.000000 F1 DRVU::DPC_Master_Rq_AMG_AR2::DPC_Md_Ht_Rq_AMG = %d\n", intval);
	filePutString (buffer, elcount(buffer), hFile);
	intval = getSignal(CHASSIS::DPC_Master_Rq_AMG_AR2::DPC_Md_ABC_Preview_Rq_AMG);
	snprintf(buffer, elcount(buffer), "   0.000000 F1 DRVU::DPC_Master_Rq_AMG_AR2::DPC_Md_ABC_Preview_Rq_AMG = %d\n", intval);
	filePutString (buffer, elcount(buffer), hFile);
	intval = getSignal(CHASSIS::DPC_Master_Rq_AMG_AR2::DPC_Md_SSA_Rq_AMG);
	snprintf(buffer, elcount(buffer), "   0.000000 F1 DRVU::DPC_Master_Rq_AMG_AR2::DPC_Md_SSA_Rq_AMG = %d\n", intval);
	filePutString (buffer, elcount(buffer), hFile);
	intval = getSignal(CHASSIS::DPC_Master_Rq_AMG_AR2::DPC_Md_AS_Rq_AMG);
	snprintf(buffer, elcount(buffer), "   0.000000 F1 DRVU::DPC_Master_Rq_AMG_AR2::DPC_Md_AS_Rq_AMG = %d\n", intval);
	filePutString (buffer, elcount(buffer), hFile);
	intval = getSignal(CHASSIS::DPC_Master_Rq_AMG_AR2::DPC_Md_ExhstFlap_Rq_AMG);
	snprintf(buffer, elcount(buffer), "   0.000000 F1 DRVU::DPC_Master_Rq_AMG_AR2::DPC_Md_ExhstFlap_Rq_AMG = %d\n", intval);
	filePutString (buffer, elcount(buffer), hFile);
	intval = getSignal(CHASSIS::DPC_Master_Rq_AMG_AR2::DPC_Md_ESP_Rq_AMG);
	snprintf(buffer, elcount(buffer), "   0.000000 F1 DRVU::DPC_Master_Rq_AMG_AR2::DPC_Md_ESP_Rq_AMG = %d\n", intval);
	filePutString (buffer, elcount(buffer), hFile);
	intval = getSignal(CHASSIS::DPC_Master_Rq_AMG_AR2::DPC_Md_Tx_Rq_AMG);
	snprintf(buffer, elcount(buffer), "   0.000000 F1 DRVU::DPC_Master_Rq_AMG_AR2::DPC_Md_Tx_Rq_AMG = %d\n", intval);
	filePutString (buffer, elcount(buffer), hFile);
	intval = getSignal(CHASSIS::DPC_Master_Rq_AMG_AR2::DPC_PopupDisp_Rq_AMG);
	snprintf(buffer, elcount(buffer), "   0.000000 F1 DRVU::DPC_Master_Rq_AMG_AR2::DPC_PopupDisp_Rq_AMG = %d\n", intval);
	filePutString (buffer, elcount(buffer), hFile);
	intval = getSignal(CHASSIS::DPC_Master_Rq_AMG_AR2::DPC_PopupSupp_Rq_AMG);
	snprintf(buffer, elcount(buffer), "   0.000000 F1 DRVU::DPC_Master_Rq_AMG_AR2::DPC_PopupSupp_Rq_AMG = %d\n", intval);
	filePutString (buffer, elcount(buffer), hFile);
	intval = getSignal(CHASSIS::DPC_Master_Rq_AMG_AR2::Rsrv2_DPC_Master_Rq_AMG_Pr2);
	snprintf(buffer, elcount(buffer), "   0.000000 F1 DRVU::DPC_Master_Rq_AMG_AR2::Rsrv2_DPC_Master_Rq_AMG_Pr2 = %d\n", intval);
	filePutString (buffer, elcount(buffer), hFile);
	intval = getSignal(CHASSIS::DPC_Master_Rq_AMG_AR2::DPC_Md_ABC_Carv_Rq_AMG);
	snprintf(buffer, elcount(buffer), "   0.000000 F1 DRVU::DPC_Master_Rq_AMG_AR2::DPC_Md_ABC_Carv_Rq_AMG = %d\n", intval);
	filePutString (buffer, elcount(buffer), hFile);
	intval = getSignal(CHASSIS::DPC_Master_Rq_AMG_AR2::Rsrv3_DPC_Master_Rq_AMG_Pr2);
	snprintf(buffer, elcount(buffer), "   0.000000 F1 DRVU::DPC_Master_Rq_AMG_AR2::Rsrv3_DPC_Master_Rq_AMG_Pr2 = %d\n", intval);
	filePutString (buffer, elcount(buffer), hFile);
	intval = getSignal(CHASSIS::DRVU_Stat_AR::AMG_MenuSw_Psd);
	snprintf(buffer, elcount(buffer), "   0.000000 F1 DRVU::DRVU_Stat_AR::AMG_MenuSw_Psd = %d\n", intval);
	filePutString (buffer, elcount(buffer), hFile);
	intval = getSignal(CHASSIS::DRVU_Stat_AR::EDIFF_MsgDisp_Rq_AMG);
	snprintf(buffer, elcount(buffer), "   0.000000 F1 DRVU::DRVU_Stat_AR::EDIFF_MsgDisp_Rq_AMG = %d\n", intval);
	filePutString (buffer, elcount(buffer), hFile);
	intval = getSignal(CHASSIS::DRVU_Stat_AR::Spoil_R_MsgDisp_Rq_AMG);
	snprintf(buffer, elcount(buffer), "   0.000000 F1 DRVU::DRVU_Stat_AR::Spoil_R_MsgDisp_Rq_AMG = %d\n", intval);
	filePutString (buffer, elcount(buffer), hFile);
	intval = getSignal(CHASSIS::DRVU_Stat_AR::ExhstFlap_SwLED_Rq_AMG);
	snprintf(buffer, elcount(buffer), "   0.000000 F1 DRVU::DRVU_Stat_AR::ExhstFlap_SwLED_Rq_AMG = %d\n", intval);
	filePutString (buffer, elcount(buffer), hFile);
	intval = getSignal(CHASSIS::DRVU_Stat_AR::ExhstFlap_Stg_Rq_AMG);
	snprintf(buffer, elcount(buffer), "   0.000000 F1 DRVU::DRVU_Stat_AR::ExhstFlap_Stg_Rq_AMG = %d\n", intval);
	filePutString (buffer, elcount(buffer), hFile);
	intval = getSignal(CHASSIS::DRVU_Stat_AR::ESP_Md_Rq_AMG);
	snprintf(buffer, elcount(buffer), "   0.000000 F1 DRVU::DRVU_Stat_AR::ESP_Md_Rq_AMG = %d\n", intval);
	filePutString (buffer, elcount(buffer), hFile);
	intval = getSignal(CHASSIS::DRVU_Stat_AR::Spoil_R_Posn_AMG);
	snprintf(buffer, elcount(buffer), "   0.000000 F1 DRVU::DRVU_Stat_AR::Spoil_R_Posn_AMG = %d\n", intval);
	filePutString (buffer, elcount(buffer), hFile);
	intval = getSignal(CHASSIS::DRVU_Stat_AR::EngMountCtrl_Stat);
	snprintf(buffer, elcount(buffer), "   0.000000 F1 DRVU::DRVU_Stat_AR::EngMountCtrl_Stat = %d\n", intval);
	filePutString (buffer, elcount(buffer), hFile);
	intval = getSignal(CHASSIS::DRVU_Stat_AR::EngMountCtrl_Hard);
	snprintf(buffer, elcount(buffer), "   0.000000 F1 DRVU::DRVU_Stat_AR::EngMountCtrl_Hard = %d\n", intval);
	filePutString (buffer, elcount(buffer), hFile);
	intval = getSignal(CHASSIS::DRVU_Stat_AR::AMG_StartSw_Psd);
	snprintf(buffer, elcount(buffer), "   0.000000 F1 DRVU::DRVU_Stat_AR::AMG_StartSw_Psd = %d\n", intval);
	filePutString (buffer, elcount(buffer), hFile);
}
/*@@end*/

/*@@caplFunc:saveVars_18(dword):*/
void saveVars_18(dword hFile)
{
	intval = getSignal(CHASSIS::DRVU_Stat_AR::DiffLk_Trq_Rq_AMG);
	snprintf(buffer, elcount(buffer), "   0.000000 F1 DRVU::DRVU_Stat_AR::DiffLk_Trq_Rq_AMG = %d\n", intval);
	filePutString (buffer, elcount(buffer), hFile);
	intval = getSignal(CHASSIS::DRVU_Stat_AR::DiffLk_M_LkTrq_Rq_AMG);
	snprintf(buffer, elcount(buffer), "   0.000000 F1 DRVU::DRVU_Stat_AR::DiffLk_M_LkTrq_Rq_AMG = %d\n", intval);
	filePutString (buffer, elcount(buffer), hFile);
	intval = @sysvar::CH_Nodes::CH_DRVUCRC_ESP_EDIFF_RsESP__AUTO;
	snprintf(buffer, elcount(buffer), "   0.000000    SV: 2 0 0 ::CH_Nodes::CH_DRVUCRC_ESP_EDIFF_RsESP__AUTO = %d\n", intval);
	filePutString (buffer, elcount(buffer), hFile);
	intval = getSignal(CHASSIS::ESP_EDIFF_Rs_AR::CRC_ESP_EDIFF_Rs);
	snprintf(buffer, elcount(buffer), "   0.000000 F1 DRVU::ESP_EDIFF_Rs_AR::CRC_ESP_EDIFF_Rs = %d\n", intval);
	filePutString (buffer, elcount(buffer), hFile);
	intval = @sysvar::CH_Nodes::CH_DRVUSQC_ESP_EDIFF_RsESP__AUTO;
	snprintf(buffer, elcount(buffer), "   0.000000    SV: 2 0 0 ::CH_Nodes::CH_DRVUSQC_ESP_EDIFF_RsESP__AUTO = %d\n", intval);
	filePutString (buffer, elcount(buffer), hFile);
	intval = getSignal(CHASSIS::ESP_EDIFF_Rs_AR::SQC_ESP_EDIFF_Rs);
	snprintf(buffer, elcount(buffer), "   0.000000 F1 DRVU::ESP_EDIFF_Rs_AR::SQC_ESP_EDIFF_Rs = %d\n", intval);
	filePutString (buffer, elcount(buffer), hFile);
	intval = getSignal(CHASSIS::ESP_EDIFF_Rs_AR::Rsrv1_EDIFF_ESP_Rs);
	snprintf(buffer, elcount(buffer), "   0.000000 F1 DRVU::ESP_EDIFF_Rs_AR::Rsrv1_EDIFF_ESP_Rs = %d\n", intval);
	filePutString (buffer, elcount(buffer), hFile);
	intval = getSignal(CHASSIS::ESP_EDIFF_Rs_AR::EDIFF_ActPosn);
	snprintf(buffer, elcount(buffer), "   0.000000 F1 DRVU::ESP_EDIFF_Rs_AR::EDIFF_ActPosn = %d\n", intval);
	filePutString (buffer, elcount(buffer), hFile);
	intval = getSignal(CHASSIS::ESP_EDIFF_Rs_AR::EDIFF_Oprtn_Stat);
	snprintf(buffer, elcount(buffer), "   0.000000 F1 DRVU::ESP_EDIFF_Rs_AR::EDIFF_Oprtn_Stat = %d\n", intval);
	filePutString (buffer, elcount(buffer), hFile);
	floatval = getSignal(CHASSIS::ESP_EDIFF_Rs_AR::EDIFF_LkRate_Rs);
	snprintf(buffer, elcount(buffer), "   0.000000 F1 DRVU::ESP_EDIFF_Rs_AR::EDIFF_LkRate_Rs = %f\n", floatval);
	filePutString (buffer, elcount(buffer), hFile);
	intval = getSignal(CHASSIS::ESP_EDIFF_Rs_AR::EDIFF_Act_Stat);
	snprintf(buffer, elcount(buffer), "   0.000000 F1 DRVU::ESP_EDIFF_Rs_AR::EDIFF_Act_Stat = %d\n", intval);
	filePutString (buffer, elcount(buffer), hFile);
	intval = getSignal(CHASSIS::ESP_EDIFF_Rs_AR::Rsrv2_ESP_EDIFF_Rs);
	snprintf(buffer, elcount(buffer), "   0.000000 F1 DRVU::ESP_EDIFF_Rs_AR::Rsrv2_ESP_EDIFF_Rs = %d\n", intval);
	filePutString (buffer, elcount(buffer), hFile);
	snprintf(buffer, elcount(buffer), "   0.000000    SV: 2 0 0 ::CH_Nodes::CH__NMActive_EIS = %X\n", @sysvar::CH_Nodes::CH__NMActive_EIS);
	filePutString (buffer, elcount(buffer), hFile);
	snprintf(buffer, elcount(buffer), "   0.000000    SV: 2 0 0 ::CH_Nodes::CH__NMAwake_EIS = %X\n", @sysvar::CH_Nodes::CH__NMAwake_EIS);
	filePutString (buffer, elcount(buffer), hFile);
	intval = getSignal(CHASSIS::ActvComf_Rq_AR2::MCMS_ActvComf_FL_Rq);
	snprintf(buffer, elcount(buffer), "   0.000000 F1 EIS::ActvComf_Rq_AR2::MCMS_ActvComf_FL_Rq = %d\n", intval);
	filePutString (buffer, elcount(buffer), hFile);
	intval = getSignal(CHASSIS::ActvComf_Rq_AR2::MCMS_ActvComf_FR_Rq);
	snprintf(buffer, elcount(buffer), "   0.000000 F1 EIS::ActvComf_Rq_AR2::MCMS_ActvComf_FR_Rq = %d\n", intval);
	filePutString (buffer, elcount(buffer), hFile);
	intval = getSignal(CHASSIS::ActvComf_Rq_AR2::MCMS_ActvComf_RL_Rq);
	snprintf(buffer, elcount(buffer), "   0.000000 F1 EIS::ActvComf_Rq_AR2::MCMS_ActvComf_RL_Rq = %d\n", intval);
	filePutString (buffer, elcount(buffer), hFile);
	intval = getSignal(CHASSIS::ActvComf_Rq_AR2::MCMS_ActvComf_RR_Rq);
	snprintf(buffer, elcount(buffer), "   0.000000 F1 EIS::ActvComf_Rq_AR2::MCMS_ActvComf_RR_Rq = %d\n", intval);
	filePutString (buffer, elcount(buffer), hFile);
	intval = getSignal(CHASSIS::ActvComf_Rq_AR2::MCMS_ActvComfProg_Rq);
	snprintf(buffer, elcount(buffer), "   0.000000 F1 EIS::ActvComf_Rq_AR2::MCMS_ActvComfProg_Rq = %d\n", intval);
	filePutString (buffer, elcount(buffer), hFile);
	intval = getSignal(CHASSIS::ActvComf_Rq_AR2::SeatCond_ActvComfProg_Rq);
	snprintf(buffer, elcount(buffer), "   0.000000 F1 EIS::ActvComf_Rq_AR2::SeatCond_ActvComfProg_Rq = %d\n", intval);
	filePutString (buffer, elcount(buffer), hFile);
	intval = getSignal(CHASSIS::ActvComf_Rq_AR2::SeatCond_ActvComf_Seat_FL_Rq);
	snprintf(buffer, elcount(buffer), "   0.000000 F1 EIS::ActvComf_Rq_AR2::SeatCond_ActvComf_Seat_FL_Rq = %d\n", intval);
	filePutString (buffer, elcount(buffer), hFile);
	intval = getSignal(CHASSIS::ActvComf_Rq_AR2::SeatCond_ActvComf_Seat_FR_Rq);
	snprintf(buffer, elcount(buffer), "   0.000000 F1 EIS::ActvComf_Rq_AR2::SeatCond_ActvComf_Seat_FR_Rq = %d\n", intval);
	filePutString (buffer, elcount(buffer), hFile);
	intval = getSignal(CHASSIS::ActvComf_Rq_AR2::SeatCond_ActvComf_Seat_RL_Rq);
	snprintf(buffer, elcount(buffer), "   0.000000 F1 EIS::ActvComf_Rq_AR2::SeatCond_ActvComf_Seat_RL_Rq = %d\n", intval);
	filePutString (buffer, elcount(buffer), hFile);
	intval = getSignal(CHASSIS::ActvComf_Rq_AR2::SeatCond_ActvComf_Seat_RR_Rq);
	snprintf(buffer, elcount(buffer), "   0.000000 F1 EIS::ActvComf_Rq_AR2::SeatCond_ActvComf_Seat_RR_Rq = %d\n", intval);
	filePutString (buffer, elcount(buffer), hFile);
	intval = getSignal(CHASSIS::ActvComf_Rq_AR2::HVAC_TempDelta_ActvComf_Rq);
	snprintf(buffer, elcount(buffer), "   0.000000 F1 EIS::ActvComf_Rq_AR2::HVAC_TempDelta_ActvComf_Rq = %d\n", intval);
	filePutString (buffer, elcount(buffer), hFile);
	intval = getSignal(CHASSIS::ActvComf_Rq_AR2::HVAC_TempDir_ActvComf_Rq);
	snprintf(buffer, elcount(buffer), "   0.000000 F1 EIS::ActvComf_Rq_AR2::HVAC_TempDir_ActvComf_Rq = %d\n", intval);
	filePutString (buffer, elcount(buffer), hFile);
	intval = getSignal(CHASSIS::ActvComf_Rq_AR2::HVAC_Pulsation_ActvComf_Rq);
	snprintf(buffer, elcount(buffer), "   0.000000 F1 EIS::ActvComf_Rq_AR2::HVAC_Pulsation_ActvComf_Rq = %d\n", intval);
	filePutString (buffer, elcount(buffer), hFile);
	intval = getSignal(CHASSIS::ActvComf_Rq_AR2::HVAC_RHU_ActvComf_Rq);
	snprintf(buffer, elcount(buffer), "   0.000000 F1 EIS::ActvComf_Rq_AR2::HVAC_RHU_ActvComf_Rq = %d\n", intval);
	filePutString (buffer, elcount(buffer), hFile);
	intval = getSignal(CHASSIS::ActvComf_Rq_AR2::HVAC_FanLvlLimit_ActvComf_Rq);
	snprintf(buffer, elcount(buffer), "   0.000000 F1 EIS::ActvComf_Rq_AR2::HVAC_FanLvlLimit_ActvComf_Rq = %d\n", intval);
	filePutString (buffer, elcount(buffer), hFile);
	intval = getSignal(CHASSIS::ActvComf_Rq_AR2::HVAC_SGEN_ActvComf_Rq);
	snprintf(buffer, elcount(buffer), "   0.000000 F1 EIS::ActvComf_Rq_AR2::HVAC_SGEN_ActvComf_Rq = %d\n", intval);
	filePutString (buffer, elcount(buffer), hFile);
	intval = getSignal(CHASSIS::ActvComf_Rq_AR2::HVAC_Ionzr_ActvComf_Rq);
	snprintf(buffer, elcount(buffer), "   0.000000 F1 EIS::ActvComf_Rq_AR2::HVAC_Ionzr_ActvComf_Rq = %d\n", intval);
	filePutString (buffer, elcount(buffer), hFile);
	intval = getSignal(CHASSIS::ActvComf_Rq_AR2::StWhlHeat_ActvComf_Rq);
	snprintf(buffer, elcount(buffer), "   0.000000 F1 EIS::ActvComf_Rq_AR2::StWhlHeat_ActvComf_Rq = %d\n", intval);
	filePutString (buffer, elcount(buffer), hFile);
	intval = getSignal(CHASSIS::ActvComf_Rq_AR2::ICH_HtVn_ActvComf_Rq);
	snprintf(buffer, elcount(buffer), "   0.000000 F1 EIS::ActvComf_Rq_AR2::ICH_HtVn_ActvComf_Rq = %d\n", intval);
	filePutString (buffer, elcount(buffer), hFile);
	intval = getSignal(CHASSIS::ActvComf_Rq_AR2::CLkS_ActvComf_Rq);
	snprintf(buffer, elcount(buffer), "   0.000000 F1 EIS::ActvComf_Rq_AR2::CLkS_ActvComf_Rq = %d\n", intval);
	filePutString (buffer, elcount(buffer), hFile);
	intval = getSignal(CHASSIS::ActvComf_Rq_AR2::DrowDtct_ActvComf_Prog_Stat);
	snprintf(buffer, elcount(buffer), "   0.000000 F1 EIS::ActvComf_Rq_AR2::DrowDtct_ActvComf_Prog_Stat = %d\n", intval);
	filePutString (buffer, elcount(buffer), hFile);
	intval = getSignal(CHASSIS::ActvComf_Rq_AR2::IL_ActvComf_Prog_Rq);
	snprintf(buffer, elcount(buffer), "   0.000000 F1 EIS::ActvComf_Rq_AR2::IL_ActvComf_Prog_Rq = %d\n", intval);
	filePutString (buffer, elcount(buffer), hFile);
	intval = getSignal(CHASSIS::ActvComf_Rq_AR2::PkBrk_ActvComf_Rq);
	snprintf(buffer, elcount(buffer), "   0.000000 F1 EIS::ActvComf_Rq_AR2::PkBrk_ActvComf_Rq = %d\n", intval);
	filePutString (buffer, elcount(buffer), hFile);
	intval = getSignal(CHASSIS::ActvComf_Rq_AR2::IL_ActvComf_On_Rq);
	snprintf(buffer, elcount(buffer), "   0.000000 F1 EIS::ActvComf_Rq_AR2::IL_ActvComf_On_Rq = %d\n", intval);
	filePutString (buffer, elcount(buffer), hFile);
	intval = getSignal(CHASSIS::ActvComf_Rq_AR2::SwIllLvl_ActvComf_Rq);
	snprintf(buffer, elcount(buffer), "   0.000000 F1 EIS::ActvComf_Rq_AR2::SwIllLvl_ActvComf_Rq = %d\n", intval);
	filePutString (buffer, elcount(buffer), hFile);
	intval = getSignal(CHASSIS::ADAS_CURRENT_ATTRIBUTES_AR::ADAS_CuA_MsgTyp);
	snprintf(buffer, elcount(buffer), "   0.000000 F1 EIS::ADAS_CURRENT_ATTRIBUTES_AR::ADAS_CuA_MsgTyp = %d\n", intval);
	filePutString (buffer, elcount(buffer), hFile);
	intval = getSignal(CHASSIS::ADAS_CURRENT_ATTRIBUTES_AR::ADAS_CuA_Offset);
	snprintf(buffer, elcount(buffer), "   0.000000 F1 EIS::ADAS_CURRENT_ATTRIBUTES_AR::ADAS_CuA_Offset = %d\n", intval);
	filePutString (buffer, elcount(buffer), hFile);
	intval = getSignal(CHASSIS::ADAS_CURRENT_ATTRIBUTES_AR::ADAS_CuA_PathIdx);
	snprintf(buffer, elcount(buffer), "   0.000000 F1 EIS::ADAS_CURRENT_ATTRIBUTES_AR::ADAS_CuA_PathIdx = %d\n", intval);
	filePutString (buffer, elcount(buffer), hFile);
	intval = getSignal(CHASSIS::ADAS_CURRENT_ATTRIBUTES_AR::ADAS_CuA_CycCnt);
	snprintf(buffer, elcount(buffer), "   0.000000 F1 EIS::ADAS_CURRENT_ATTRIBUTES_AR::ADAS_CuA_CycCnt = %d\n", intval);
	filePutString (buffer, elcount(buffer), hFile);
	intval = getSignal(CHASSIS::ADAS_CURRENT_ATTRIBUTES_AR::ADAS_CuA_Updt);
	snprintf(buffer, elcount(buffer), "   0.000000 F1 EIS::ADAS_CURRENT_ATTRIBUTES_AR::ADAS_CuA_Updt = %d\n", intval);
	filePutString (buffer, elcount(buffer), hFile);
	intval = getSignal(CHASSIS::ADAS_CURRENT_ATTRIBUTES_AR::ADAS_CuA_ReTr);
	snprintf(buffer, elcount(buffer), "   0.000000 F1 EIS::ADAS_CURRENT_ATTRIBUTES_AR::ADAS_CuA_ReTr = %d\n", intval);
	filePutString (buffer, elcount(buffer), hFile);
	intval = getSignal(CHASSIS::ADAS_CURRENT_ATTRIBUTES_AR::ADAS_CuA_AreaBuildUp);
	snprintf(buffer, elcount(buffer), "   0.000000 F1 EIS::ADAS_CURRENT_ATTRIBUTES_AR::ADAS_CuA_AreaBuildUp = %d\n", intval);
	filePutString (buffer, elcount(buffer), hFile);
	intval = getSignal(CHASSIS::ADAS_CURRENT_ATTRIBUTES_AR::ADAS_CuA_Bridge);
	snprintf(buffer, elcount(buffer), "   0.000000 F1 EIS::ADAS_CURRENT_ATTRIBUTES_AR::ADAS_CuA_Bridge = %d\n", intval);
	filePutString (buffer, elcount(buffer), hFile);
	intval = getSignal(CHASSIS::ADAS_CURRENT_ATTRIBUTES_AR::ADAS_CuA_Tunnel);
	snprintf(buffer, elcount(buffer), "   0.000000 F1 EIS::ADAS_CURRENT_ATTRIBUTES_AR::ADAS_CuA_Tunnel = %d\n", intval);
	filePutString (buffer, elcount(buffer), hFile);
	intval = getSignal(CHASSIS::ADAS_CURRENT_ATTRIBUTES_AR::ADAS_CuA_FuncRoadClass);
	snprintf(buffer, elcount(buffer), "   0.000000 F1 EIS::ADAS_CURRENT_ATTRIBUTES_AR::ADAS_CuA_FuncRoadClass = %d\n", intval);
	filePutString (buffer, elcount(buffer), hFile);
	floatval = getSignal(CHASSIS::ADAS_CURRENT_ATTRIBUTES_AR::ADAS_CuA_RelProbb);
	snprintf(buffer, elcount(buffer), "   0.000000 F1 EIS::ADAS_CURRENT_ATTRIBUTES_AR::ADAS_CuA_RelProbb = %f\n", floatval);
	filePutString (buffer, elcount(buffer), hFile);
	intval = getSignal(CHASSIS::ADAS_CURRENT_ATTRIBUTES_AR::ADAS_CuA_WayForm);
	snprintf(buffer, elcount(buffer), "   0.000000 F1 EIS::ADAS_CURRENT_ATTRIBUTES_AR::ADAS_CuA_WayForm = %d\n", intval);
	filePutString (buffer, elcount(buffer), hFile);
	intval = getSignal(CHASSIS::ADAS_CURRENT_ATTRIBUTES_AR::ADAS_CuA_CmpxInsct);
	snprintf(buffer, elcount(buffer), "   0.000000 F1 EIS::ADAS_CURRENT_ATTRIBUTES_AR::ADAS_CuA_CmpxInsct = %d\n", intval);
	filePutString (buffer, elcount(buffer), hFile);
	intval = getSignal(CHASSIS::ADAS_CURRENT_ATTRIBUTES_AR::ADAS_CuA_PartRoute);
	snprintf(buffer, elcount(buffer), "   0.000000 F1 EIS::ADAS_CURRENT_ATTRIBUTES_AR::ADAS_CuA_PartRoute = %d\n", intval);
	filePutString (buffer, elcount(buffer), hFile);
}
/*@@end*/

/*@@caplFunc:saveVars_19(dword):*/
void saveVars_19(dword hFile)
{
	intval = getSignal(CHASSIS::ADAS_CURRENT_ATTRIBUTES_AR::ADAS_CuA_EffSpdLmtType);
	snprintf(buffer, elcount(buffer), "   0.000000 F1 EIS::ADAS_CURRENT_ATTRIBUTES_AR::ADAS_CuA_EffSpdLmtType = %d\n", intval);
	filePutString (buffer, elcount(buffer), hFile);
	intval = getSignal(CHASSIS::ADAS_CURRENT_ATTRIBUTES_AR::ADAS_CuA_EffSpdLmt);
	snprintf(buffer, elcount(buffer), "   0.000000 F1 EIS::ADAS_CURRENT_ATTRIBUTES_AR::ADAS_CuA_EffSpdLmt = %d\n", intval);
	filePutString (buffer, elcount(buffer), hFile);
	intval = getSignal(CHASSIS::ADAS_CURRENT_ATTRIBUTES_AR::ADAS_CuA_NumOfLaneDrvDir);
	snprintf(buffer, elcount(buffer), "   0.000000 F1 EIS::ADAS_CURRENT_ATTRIBUTES_AR::ADAS_CuA_NumOfLaneDrvDir = %d\n", intval);
	filePutString (buffer, elcount(buffer), hFile);
	intval = getSignal(CHASSIS::ADAS_CURRENT_ATTRIBUTES_AR::ADAS_CuA_NumOfLaneOppDir);
	snprintf(buffer, elcount(buffer), "   0.000000 F1 EIS::ADAS_CURRENT_ATTRIBUTES_AR::ADAS_CuA_NumOfLaneOppDir = %d\n", intval);
	filePutString (buffer, elcount(buffer), hFile);
	intval = getSignal(CHASSIS::ADAS_CURRENT_ATTRIBUTES_AR::ADAS_CuA_RoadDivd);
	snprintf(buffer, elcount(buffer), "   0.000000 F1 EIS::ADAS_CURRENT_ATTRIBUTES_AR::ADAS_CuA_RoadDivd = %d\n", intval);
	filePutString (buffer, elcount(buffer), hFile);
	intval = getSignal(CHASSIS::ADAS_POSITION_AR::ADAS_Posn_MsgTyp);
	snprintf(buffer, elcount(buffer), "   0.000000 F1 EIS::ADAS_POSITION_AR::ADAS_Posn_MsgTyp = %d\n", intval);
	filePutString (buffer, elcount(buffer), hFile);
	intval = getSignal(CHASSIS::ADAS_POSITION_AR::ADAS_Posn_Offset);
	snprintf(buffer, elcount(buffer), "   0.000000 F1 EIS::ADAS_POSITION_AR::ADAS_Posn_Offset = %d\n", intval);
	filePutString (buffer, elcount(buffer), hFile);
	intval = getSignal(CHASSIS::ADAS_POSITION_AR::ADAS_Posn_PathIdx);
	snprintf(buffer, elcount(buffer), "   0.000000 F1 EIS::ADAS_POSITION_AR::ADAS_Posn_PathIdx = %d\n", intval);
	filePutString (buffer, elcount(buffer), hFile);
	intval = getSignal(CHASSIS::ADAS_POSITION_AR::ADAS_Posn_CycCnt);
	snprintf(buffer, elcount(buffer), "   0.000000 F1 EIS::ADAS_POSITION_AR::ADAS_Posn_CycCnt = %d\n", intval);
	filePutString (buffer, elcount(buffer), hFile);
	floatval = getSignal(CHASSIS::ADAS_POSITION_AR::ADAS_Posn_PosProbb);
	snprintf(buffer, elcount(buffer), "   0.000000 F1 EIS::ADAS_POSITION_AR::ADAS_Posn_PosProbb = %f\n", floatval);
	filePutString (buffer, elcount(buffer), hFile);
	intval = getSignal(CHASSIS::ADAS_POSITION_AR::ADAS_Posn_Idx);
	snprintf(buffer, elcount(buffer), "   0.000000 F1 EIS::ADAS_POSITION_AR::ADAS_Posn_Idx = %d\n", intval);
	filePutString (buffer, elcount(buffer), hFile);
	intval = getSignal(CHASSIS::ADAS_POSITION_AR::ADAS_Posn_Age);
	snprintf(buffer, elcount(buffer), "   0.000000 F1 EIS::ADAS_POSITION_AR::ADAS_Posn_Age = %d\n", intval);
	filePutString (buffer, elcount(buffer), hFile);
	intval = getSignal(CHASSIS::ADAS_POSITION_AR::ADAS_Posn_CurLane);
	snprintf(buffer, elcount(buffer), "   0.000000 F1 EIS::ADAS_POSITION_AR::ADAS_Posn_CurLane = %d\n", intval);
	filePutString (buffer, elcount(buffer), hFile);
	intval = getSignal(CHASSIS::ADAS_POSITION_AR::ADAS_Posn_PosConfdc);
	snprintf(buffer, elcount(buffer), "   0.000000 F1 EIS::ADAS_POSITION_AR::ADAS_Posn_PosConfdc = %d\n", intval);
	filePutString (buffer, elcount(buffer), hFile);
	floatval = getSignal(CHASSIS::ADAS_POSITION_AR::ADAS_Posn_Spd);
	snprintf(buffer, elcount(buffer), "   0.000000 F1 EIS::ADAS_POSITION_AR::ADAS_Posn_Spd = %f\n", floatval);
	filePutString (buffer, elcount(buffer), hFile);
	floatval = getSignal(CHASSIS::ADAS_POSITION_AR::ADAS_Posn_RelHead);
	snprintf(buffer, elcount(buffer), "   0.000000 F1 EIS::ADAS_POSITION_AR::ADAS_Posn_RelHead = %f\n", floatval);
	filePutString (buffer, elcount(buffer), hFile);
	intval = getSignal(CHASSIS::ADAS_PREDICTION_AR::ADAS_Seg_Offset);
	snprintf(buffer, elcount(buffer), "   0.000000 F1 EIS::ADAS_PREDICTION_AR::ADAS_Seg_Offset = %d\n", intval);
	filePutString (buffer, elcount(buffer), hFile);
	intval = getSignal(CHASSIS::ADAS_PREDICTION_AR::ADAS_Seg_PathIdx);
	snprintf(buffer, elcount(buffer), "   0.000000 F1 EIS::ADAS_PREDICTION_AR::ADAS_Seg_PathIdx = %d\n", intval);
	filePutString (buffer, elcount(buffer), hFile);
	intval = getSignal(CHASSIS::ADAS_PREDICTION_AR::ADAS_Seg_CycCnt);
	snprintf(buffer, elcount(buffer), "   0.000000 F1 EIS::ADAS_PREDICTION_AR::ADAS_Seg_CycCnt = %d\n", intval);
	filePutString (buffer, elcount(buffer), hFile);
	intval = getSignal(CHASSIS::ADAS_PREDICTION_AR::ADAS_Seg_Updt);
	snprintf(buffer, elcount(buffer), "   0.000000 F1 EIS::ADAS_PREDICTION_AR::ADAS_Seg_Updt = %d\n", intval);
	filePutString (buffer, elcount(buffer), hFile);
	intval = getSignal(CHASSIS::ADAS_PREDICTION_AR::ADAS_Seg_ReTr);
	snprintf(buffer, elcount(buffer), "   0.000000 F1 EIS::ADAS_PREDICTION_AR::ADAS_Seg_ReTr = %d\n", intval);
	filePutString (buffer, elcount(buffer), hFile);
	intval = getSignal(CHASSIS::ADAS_PREDICTION_AR::ADAS_Seg_AreaBuildUp);
	snprintf(buffer, elcount(buffer), "   0.000000 F1 EIS::ADAS_PREDICTION_AR::ADAS_Seg_AreaBuildUp = %d\n", intval);
	filePutString (buffer, elcount(buffer), hFile);
	intval = getSignal(CHASSIS::ADAS_PREDICTION_AR::ADAS_Seg_Bridge);
	snprintf(buffer, elcount(buffer), "   0.000000 F1 EIS::ADAS_PREDICTION_AR::ADAS_Seg_Bridge = %d\n", intval);
	filePutString (buffer, elcount(buffer), hFile);
	intval = getSignal(CHASSIS::ADAS_PREDICTION_AR::ADAS_Seg_Tunnel);
	snprintf(buffer, elcount(buffer), "   0.000000 F1 EIS::ADAS_PREDICTION_AR::ADAS_Seg_Tunnel = %d\n", intval);
	filePutString (buffer, elcount(buffer), hFile);
	intval = getSignal(CHASSIS::ADAS_PREDICTION_AR::ADAS_Seg_FuncRoadClass);
	snprintf(buffer, elcount(buffer), "   0.000000 F1 EIS::ADAS_PREDICTION_AR::ADAS_Seg_FuncRoadClass = %d\n", intval);
	filePutString (buffer, elcount(buffer), hFile);
	floatval = getSignal(CHASSIS::ADAS_PREDICTION_AR::ADAS_Seg_RelProbb);
	snprintf(buffer, elcount(buffer), "   0.000000 F1 EIS::ADAS_PREDICTION_AR::ADAS_Seg_RelProbb = %f\n", floatval);
	filePutString (buffer, elcount(buffer), hFile);
	intval = getSignal(CHASSIS::ADAS_PREDICTION_AR::ADAS_Seg_WayForm);
	snprintf(buffer, elcount(buffer), "   0.000000 F1 EIS::ADAS_PREDICTION_AR::ADAS_Seg_WayForm = %d\n", intval);
	filePutString (buffer, elcount(buffer), hFile);
	intval = getSignal(CHASSIS::ADAS_PREDICTION_AR::ADAS_Seg_CmpxInsct);
	snprintf(buffer, elcount(buffer), "   0.000000 F1 EIS::ADAS_PREDICTION_AR::ADAS_Seg_CmpxInsct = %d\n", intval);
	filePutString (buffer, elcount(buffer), hFile);
	intval = getSignal(CHASSIS::ADAS_PREDICTION_AR::ADAS_Seg_PartRoute);
	snprintf(buffer, elcount(buffer), "   0.000000 F1 EIS::ADAS_PREDICTION_AR::ADAS_Seg_PartRoute = %d\n", intval);
	filePutString (buffer, elcount(buffer), hFile);
	intval = getSignal(CHASSIS::ADAS_PREDICTION_AR::ADAS_Seg_EffSpdLmtType);
	snprintf(buffer, elcount(buffer), "   0.000000 F1 EIS::ADAS_PREDICTION_AR::ADAS_Seg_EffSpdLmtType = %d\n", intval);
	filePutString (buffer, elcount(buffer), hFile);
	intval = getSignal(CHASSIS::ADAS_PREDICTION_AR::ADAS_Seg_EffSpdLmt);
	snprintf(buffer, elcount(buffer), "   0.000000 F1 EIS::ADAS_PREDICTION_AR::ADAS_Seg_EffSpdLmt = %d\n", intval);
	filePutString (buffer, elcount(buffer), hFile);
	intval = getSignal(CHASSIS::ADAS_PREDICTION_AR::ADAS_Seg_NumOfLaneDrvDir);
	snprintf(buffer, elcount(buffer), "   0.000000 F1 EIS::ADAS_PREDICTION_AR::ADAS_Seg_NumOfLaneDrvDir = %d\n", intval);
	filePutString (buffer, elcount(buffer), hFile);
	intval = getSignal(CHASSIS::ADAS_PREDICTION_AR::ADAS_Seg_NumOfLaneOppDir);
	snprintf(buffer, elcount(buffer), "   0.000000 F1 EIS::ADAS_PREDICTION_AR::ADAS_Seg_NumOfLaneOppDir = %d\n", intval);
	filePutString (buffer, elcount(buffer), hFile);
	intval = getSignal(CHASSIS::ADAS_PREDICTION_AR::ADAS_Seg_RoadDivd);
	snprintf(buffer, elcount(buffer), "   0.000000 F1 EIS::ADAS_PREDICTION_AR::ADAS_Seg_RoadDivd = %d\n", intval);
	filePutString (buffer, elcount(buffer), hFile);
	intval = getSignal(CHASSIS::ADAS_PREDICTION_AR::ADAS_Stub_Offset);
	snprintf(buffer, elcount(buffer), "   0.000000 F1 EIS::ADAS_PREDICTION_AR::ADAS_Stub_Offset = %d\n", intval);
	filePutString (buffer, elcount(buffer), hFile);
	intval = getSignal(CHASSIS::ADAS_PREDICTION_AR::ADAS_Stub_PathIdx);
	snprintf(buffer, elcount(buffer), "   0.000000 F1 EIS::ADAS_PREDICTION_AR::ADAS_Stub_PathIdx = %d\n", intval);
	filePutString (buffer, elcount(buffer), hFile);
	intval = getSignal(CHASSIS::ADAS_PREDICTION_AR::ADAS_Stub_CycCnt);
	snprintf(buffer, elcount(buffer), "   0.000000 F1 EIS::ADAS_PREDICTION_AR::ADAS_Stub_CycCnt = %d\n", intval);
	filePutString (buffer, elcount(buffer), hFile);
	intval = getSignal(CHASSIS::ADAS_PREDICTION_AR::ADAS_Stub_Updt);
	snprintf(buffer, elcount(buffer), "   0.000000 F1 EIS::ADAS_PREDICTION_AR::ADAS_Stub_Updt = %d\n", intval);
	filePutString (buffer, elcount(buffer), hFile);
	intval = getSignal(CHASSIS::ADAS_PREDICTION_AR::ADAS_Stub_ReTr);
	snprintf(buffer, elcount(buffer), "   0.000000 F1 EIS::ADAS_PREDICTION_AR::ADAS_Stub_ReTr = %d\n", intval);
	filePutString (buffer, elcount(buffer), hFile);
	intval = getSignal(CHASSIS::ADAS_PREDICTION_AR::ADAS_Stub_SubPathIdx);
	snprintf(buffer, elcount(buffer), "   0.000000 F1 EIS::ADAS_PREDICTION_AR::ADAS_Stub_SubPathIdx = %d\n", intval);
	filePutString (buffer, elcount(buffer), hFile);
	intval = getSignal(CHASSIS::ADAS_PREDICTION_AR::ADAS_Stub_FuncRoadClass);
	snprintf(buffer, elcount(buffer), "   0.000000 F1 EIS::ADAS_PREDICTION_AR::ADAS_Stub_FuncRoadClass = %d\n", intval);
	filePutString (buffer, elcount(buffer), hFile);
	floatval = getSignal(CHASSIS::ADAS_PREDICTION_AR::ADAS_Stub_RelProbb);
	snprintf(buffer, elcount(buffer), "   0.000000 F1 EIS::ADAS_PREDICTION_AR::ADAS_Stub_RelProbb = %f\n", floatval);
	filePutString (buffer, elcount(buffer), hFile);
	intval = getSignal(CHASSIS::ADAS_PREDICTION_AR::ADAS_Stub_WayForm);
	snprintf(buffer, elcount(buffer), "   0.000000 F1 EIS::ADAS_PREDICTION_AR::ADAS_Stub_WayForm = %d\n", intval);
	filePutString (buffer, elcount(buffer), hFile);
	intval = getSignal(CHASSIS::ADAS_PREDICTION_AR::ADAS_Stub_CmpxInsct);
	snprintf(buffer, elcount(buffer), "   0.000000 F1 EIS::ADAS_PREDICTION_AR::ADAS_Stub_CmpxInsct = %d\n", intval);
	filePutString (buffer, elcount(buffer), hFile);
	intval = getSignal(CHASSIS::ADAS_PREDICTION_AR::ADAS_Stub_PartRoute);
	snprintf(buffer, elcount(buffer), "   0.000000 F1 EIS::ADAS_PREDICTION_AR::ADAS_Stub_PartRoute = %d\n", intval);
	filePutString (buffer, elcount(buffer), hFile);
	floatval = getSignal(CHASSIS::ADAS_PREDICTION_AR::ADAS_Stub_TurnAngl);
	snprintf(buffer, elcount(buffer), "   0.000000 F1 EIS::ADAS_PREDICTION_AR::ADAS_Stub_TurnAngl = %f\n", floatval);
	filePutString (buffer, elcount(buffer), hFile);
	intval = getSignal(CHASSIS::ADAS_PREDICTION_AR::ADAS_Stub_NumOfLaneDrvDir);
	snprintf(buffer, elcount(buffer), "   0.000000 F1 EIS::ADAS_PREDICTION_AR::ADAS_Stub_NumOfLaneDrvDir = %d\n", intval);
	filePutString (buffer, elcount(buffer), hFile);
	intval = getSignal(CHASSIS::ADAS_PREDICTION_AR::ADAS_Stub_NumOfLaneOppDir);
	snprintf(buffer, elcount(buffer), "   0.000000 F1 EIS::ADAS_PREDICTION_AR::ADAS_Stub_NumOfLaneOppDir = %d\n", intval);
	filePutString (buffer, elcount(buffer), hFile);
	intval = getSignal(CHASSIS::ADAS_PREDICTION_AR::ADAS_Stub_WayRt);
	snprintf(buffer, elcount(buffer), "   0.000000 F1 EIS::ADAS_PREDICTION_AR::ADAS_Stub_WayRt = %d\n", intval);
	filePutString (buffer, elcount(buffer), hFile);
	intval = getSignal(CHASSIS::ADAS_PREDICTION_AR::ADAS_Stub_LastStub);
	snprintf(buffer, elcount(buffer), "   0.000000 F1 EIS::ADAS_PREDICTION_AR::ADAS_Stub_LastStub = %d\n", intval);
	filePutString (buffer, elcount(buffer), hFile);
	intval = getSignal(CHASSIS::ADAS_PREDICTION_AR::ADAS_Meta_MapProvid);
	snprintf(buffer, elcount(buffer), "   0.000000 F1 EIS::ADAS_PREDICTION_AR::ADAS_Meta_MapProvid = %d\n", intval);
	filePutString (buffer, elcount(buffer), hFile);
}
/*@@end*/

/*@@caplFunc:saveVars_20(dword):*/
void saveVars_20(dword hFile)
{
	intval = getSignal(CHASSIS::ADAS_PREDICTION_AR::ADAS_Meta_CountryCode);
	snprintf(buffer, elcount(buffer), "   0.000000 F1 EIS::ADAS_PREDICTION_AR::ADAS_Meta_CountryCode = %d\n", intval);
	filePutString (buffer, elcount(buffer), hFile);
	intval = getSignal(CHASSIS::ADAS_PREDICTION_AR::ADAS_Meta_DrvSide);
	snprintf(buffer, elcount(buffer), "   0.000000 F1 EIS::ADAS_PREDICTION_AR::ADAS_Meta_DrvSide = %d\n", intval);
	filePutString (buffer, elcount(buffer), hFile);
	intval = getSignal(CHASSIS::ADAS_PREDICTION_AR::ADAS_Meta_ProtVer_MinorSub);
	snprintf(buffer, elcount(buffer), "   0.000000 F1 EIS::ADAS_PREDICTION_AR::ADAS_Meta_ProtVer_MinorSub = %d\n", intval);
	filePutString (buffer, elcount(buffer), hFile);
	intval = getSignal(CHASSIS::ADAS_PREDICTION_AR::ADAS_Meta_ProtVer_Major);
	snprintf(buffer, elcount(buffer), "   0.000000 F1 EIS::ADAS_PREDICTION_AR::ADAS_Meta_ProtVer_Major = %d\n", intval);
	filePutString (buffer, elcount(buffer), hFile);
	intval = getSignal(CHASSIS::ADAS_PREDICTION_AR::ADAS_Meta_CycCnt);
	snprintf(buffer, elcount(buffer), "   0.000000 F1 EIS::ADAS_PREDICTION_AR::ADAS_Meta_CycCnt = %d\n", intval);
	filePutString (buffer, elcount(buffer), hFile);
	intval = getSignal(CHASSIS::ADAS_PREDICTION_AR::ADAS_Meta_HwVer);
	snprintf(buffer, elcount(buffer), "   0.000000 F1 EIS::ADAS_PREDICTION_AR::ADAS_Meta_HwVer = %d\n", intval);
	filePutString (buffer, elcount(buffer), hFile);
	intval = getSignal(CHASSIS::ADAS_PREDICTION_AR::ADAS_Meta_RegionCode);
	snprintf(buffer, elcount(buffer), "   0.000000 F1 EIS::ADAS_PREDICTION_AR::ADAS_Meta_RegionCode = %d\n", intval);
	filePutString (buffer, elcount(buffer), hFile);
	intval = getSignal(CHASSIS::ADAS_PREDICTION_AR::ADAS_Meta_MapVerYear);
	snprintf(buffer, elcount(buffer), "   0.000000 F1 EIS::ADAS_PREDICTION_AR::ADAS_Meta_MapVerYear = %d\n", intval);
	filePutString (buffer, elcount(buffer), hFile);
	intval = getSignal(CHASSIS::ADAS_PREDICTION_AR::ADAS_Meta_MapVerQuar);
	snprintf(buffer, elcount(buffer), "   0.000000 F1 EIS::ADAS_PREDICTION_AR::ADAS_Meta_MapVerQuar = %d\n", intval);
	filePutString (buffer, elcount(buffer), hFile);
	intval = getSignal(CHASSIS::ADAS_PREDICTION_AR::ADAS_Meta_ProtVer_Minor);
	snprintf(buffer, elcount(buffer), "   0.000000 F1 EIS::ADAS_PREDICTION_AR::ADAS_Meta_ProtVer_Minor = %d\n", intval);
	filePutString (buffer, elcount(buffer), hFile);
	intval = getSignal(CHASSIS::ADAS_PREDICTION_AR::ADAS_Meta_SpdUnits);
	snprintf(buffer, elcount(buffer), "   0.000000 F1 EIS::ADAS_PREDICTION_AR::ADAS_Meta_SpdUnits = %d\n", intval);
	filePutString (buffer, elcount(buffer), hFile);
	intval = getSignal(CHASSIS::ADAS_PREDICTION_AR::ADAS_Prediction_MsgTyp);
	snprintf(buffer, elcount(buffer), "   0.000000 F1 EIS::ADAS_PREDICTION_AR::ADAS_Prediction_MsgTyp = %d\n", intval);
	filePutString (buffer, elcount(buffer), hFile);
	intval = getSignal(CHASSIS::ADAS_PROFILE_LONG_AR::ADAS_ProfLong_MsgTyp_Longi);
	snprintf(buffer, elcount(buffer), "   0.000000 F1 EIS::ADAS_PROFILE_LONG_AR::ADAS_ProfLong_MsgTyp_Longi = %d\n", intval);
	filePutString (buffer, elcount(buffer), hFile);
	intval = getSignal(CHASSIS::ADAS_PROFILE_LONG_AR::ADAS_ProfLong_Offset_Longi);
	snprintf(buffer, elcount(buffer), "   0.000000 F1 EIS::ADAS_PROFILE_LONG_AR::ADAS_ProfLong_Offset_Longi = %d\n", intval);
	filePutString (buffer, elcount(buffer), hFile);
	intval = getSignal(CHASSIS::ADAS_PROFILE_LONG_AR::ADAS_ProfLong_PathIdx_Longi);
	snprintf(buffer, elcount(buffer), "   0.000000 F1 EIS::ADAS_PROFILE_LONG_AR::ADAS_ProfLong_PathIdx_Longi = %d\n", intval);
	filePutString (buffer, elcount(buffer), hFile);
	intval = getSignal(CHASSIS::ADAS_PROFILE_LONG_AR::ADAS_ProfLong_CycCnt_Longi);
	snprintf(buffer, elcount(buffer), "   0.000000 F1 EIS::ADAS_PROFILE_LONG_AR::ADAS_ProfLong_CycCnt_Longi = %d\n", intval);
	filePutString (buffer, elcount(buffer), hFile);
	intval = getSignal(CHASSIS::ADAS_PROFILE_LONG_AR::ADAS_ProfLong_Updt_Longi);
	snprintf(buffer, elcount(buffer), "   0.000000 F1 EIS::ADAS_PROFILE_LONG_AR::ADAS_ProfLong_Updt_Longi = %d\n", intval);
	filePutString (buffer, elcount(buffer), hFile);
	intval = getSignal(CHASSIS::ADAS_PROFILE_LONG_AR::ADAS_ProfLong_ReTr_Longi);
	snprintf(buffer, elcount(buffer), "   0.000000 F1 EIS::ADAS_PROFILE_LONG_AR::ADAS_ProfLong_ReTr_Longi = %d\n", intval);
	filePutString (buffer, elcount(buffer), hFile);
	intval = getSignal(CHASSIS::ADAS_PROFILE_LONG_AR::ADAS_ProfLong_CtrlPoint_Longi);
	snprintf(buffer, elcount(buffer), "   0.000000 F1 EIS::ADAS_PROFILE_LONG_AR::ADAS_ProfLong_CtrlPoint_Longi = %d\n", intval);
	filePutString (buffer, elcount(buffer), hFile);
	intval = getSignal(CHASSIS::ADAS_PROFILE_LONG_AR::ADAS_ProfLong_Val_Longit);
	snprintf(buffer, elcount(buffer), "   0.000000 F1 EIS::ADAS_PROFILE_LONG_AR::ADAS_ProfLong_Val_Longit = %d\n", intval);
	filePutString (buffer, elcount(buffer), hFile);
	intval = getSignal(CHASSIS::ADAS_PROFILE_LONG_AR::ADAS_ProfLong_MsgTyp_Latit);
	snprintf(buffer, elcount(buffer), "   0.000000 F1 EIS::ADAS_PROFILE_LONG_AR::ADAS_ProfLong_MsgTyp_Latit = %d\n", intval);
	filePutString (buffer, elcount(buffer), hFile);
	intval = getSignal(CHASSIS::ADAS_PROFILE_LONG_AR::ADAS_ProfLong_Offset_Latit);
	snprintf(buffer, elcount(buffer), "   0.000000 F1 EIS::ADAS_PROFILE_LONG_AR::ADAS_ProfLong_Offset_Latit = %d\n", intval);
	filePutString (buffer, elcount(buffer), hFile);
	intval = getSignal(CHASSIS::ADAS_PROFILE_LONG_AR::ADAS_ProfLong_PathIdx_Latit);
	snprintf(buffer, elcount(buffer), "   0.000000 F1 EIS::ADAS_PROFILE_LONG_AR::ADAS_ProfLong_PathIdx_Latit = %d\n", intval);
	filePutString (buffer, elcount(buffer), hFile);
	intval = getSignal(CHASSIS::ADAS_PROFILE_LONG_AR::ADAS_ProfLong_CycCnt_Latit);
	snprintf(buffer, elcount(buffer), "   0.000000 F1 EIS::ADAS_PROFILE_LONG_AR::ADAS_ProfLong_CycCnt_Latit = %d\n", intval);
	filePutString (buffer, elcount(buffer), hFile);
	intval = getSignal(CHASSIS::ADAS_PROFILE_LONG_AR::ADAS_ProfLong_Updt_Latit);
	snprintf(buffer, elcount(buffer), "   0.000000 F1 EIS::ADAS_PROFILE_LONG_AR::ADAS_ProfLong_Updt_Latit = %d\n", intval);
	filePutString (buffer, elcount(buffer), hFile);
	intval = getSignal(CHASSIS::ADAS_PROFILE_LONG_AR::ADAS_ProfLong_ReTr_Latit);
	snprintf(buffer, elcount(buffer), "   0.000000 F1 EIS::ADAS_PROFILE_LONG_AR::ADAS_ProfLong_ReTr_Latit = %d\n", intval);
	filePutString (buffer, elcount(buffer), hFile);
	intval = getSignal(CHASSIS::ADAS_PROFILE_LONG_AR::ADAS_ProfLong_CtrlPoint_Latit);
	snprintf(buffer, elcount(buffer), "   0.000000 F1 EIS::ADAS_PROFILE_LONG_AR::ADAS_ProfLong_CtrlPoint_Latit = %d\n", intval);
	filePutString (buffer, elcount(buffer), hFile);
	intval = getSignal(CHASSIS::ADAS_PROFILE_LONG_AR::ADAS_ProfLong_Val_Latit);
	snprintf(buffer, elcount(buffer), "   0.000000 F1 EIS::ADAS_PROFILE_LONG_AR::ADAS_ProfLong_Val_Latit = %d\n", intval);
	filePutString (buffer, elcount(buffer), hFile);
	intval = getSignal(CHASSIS::ADAS_PROFILE_LONG_AR::ADAS_ProfLong_MsgTyp_ExtLane);
	snprintf(buffer, elcount(buffer), "   0.000000 F1 EIS::ADAS_PROFILE_LONG_AR::ADAS_ProfLong_MsgTyp_ExtLane = %d\n", intval);
	filePutString (buffer, elcount(buffer), hFile);
	intval = getSignal(CHASSIS::ADAS_PROFILE_LONG_AR::ADAS_ProfLong_Offset_ExtLane);
	snprintf(buffer, elcount(buffer), "   0.000000 F1 EIS::ADAS_PROFILE_LONG_AR::ADAS_ProfLong_Offset_ExtLane = %d\n", intval);
	filePutString (buffer, elcount(buffer), hFile);
	intval = getSignal(CHASSIS::ADAS_PROFILE_LONG_AR::ADAS_ProfLong_PathIdx_ExtLane);
	snprintf(buffer, elcount(buffer), "   0.000000 F1 EIS::ADAS_PROFILE_LONG_AR::ADAS_ProfLong_PathIdx_ExtLane = %d\n", intval);
	filePutString (buffer, elcount(buffer), hFile);
	intval = getSignal(CHASSIS::ADAS_PROFILE_LONG_AR::ADAS_ProfLong_CycCnt_ExtLane);
	snprintf(buffer, elcount(buffer), "   0.000000 F1 EIS::ADAS_PROFILE_LONG_AR::ADAS_ProfLong_CycCnt_ExtLane = %d\n", intval);
	filePutString (buffer, elcount(buffer), hFile);
	intval = getSignal(CHASSIS::ADAS_PROFILE_LONG_AR::ADAS_ProfLong_Updt_ExtLane);
	snprintf(buffer, elcount(buffer), "   0.000000 F1 EIS::ADAS_PROFILE_LONG_AR::ADAS_ProfLong_Updt_ExtLane = %d\n", intval);
	filePutString (buffer, elcount(buffer), hFile);
	intval = getSignal(CHASSIS::ADAS_PROFILE_LONG_AR::ADAS_ProfLong_ReTr_ExtLane);
	snprintf(buffer, elcount(buffer), "   0.000000 F1 EIS::ADAS_PROFILE_LONG_AR::ADAS_ProfLong_ReTr_ExtLane = %d\n", intval);
	filePutString (buffer, elcount(buffer), hFile);
	intval = getSignal(CHASSIS::ADAS_PROFILE_LONG_AR::ADAS_ProfLong_CtrlPoint_ExtLn);
	snprintf(buffer, elcount(buffer), "   0.000000 F1 EIS::ADAS_PROFILE_LONG_AR::ADAS_ProfLong_CtrlPoint_ExtLn = %d\n", intval);
	filePutString (buffer, elcount(buffer), hFile);
	intval = getSignal(CHASSIS::ADAS_PROFILE_LONG_AR::ADAS_ProfLong_Val_LaneNum);
	snprintf(buffer, elcount(buffer), "   0.000000 F1 EIS::ADAS_PROFILE_LONG_AR::ADAS_ProfLong_Val_LaneNum = %d\n", intval);
	filePutString (buffer, elcount(buffer), hFile);
	intval = getSignal(CHASSIS::ADAS_PROFILE_LONG_AR::ADAS_ProfLong_Val_1stPredLane);
	snprintf(buffer, elcount(buffer), "   0.000000 F1 EIS::ADAS_PROFILE_LONG_AR::ADAS_ProfLong_Val_1stPredLane = %d\n", intval);
	filePutString (buffer, elcount(buffer), hFile);
	intval = getSignal(CHASSIS::ADAS_PROFILE_LONG_AR::ADAS_ProfLong_Val_LstPredLane);
	snprintf(buffer, elcount(buffer), "   0.000000 F1 EIS::ADAS_PROFILE_LONG_AR::ADAS_ProfLong_Val_LstPredLane = %d\n", intval);
	filePutString (buffer, elcount(buffer), hFile);
	intval = getSignal(CHASSIS::ADAS_PROFILE_LONG_AR::ADAS_ProfLong_Val_PrioPredLn);
	snprintf(buffer, elcount(buffer), "   0.000000 F1 EIS::ADAS_PROFILE_LONG_AR::ADAS_ProfLong_Val_PrioPredLn = %d\n", intval);
	filePutString (buffer, elcount(buffer), hFile);
	intval = getSignal(CHASSIS::ADAS_PROFILE_LONG_AR::ADAS_ProfLong_Val_ArrowMark);
	snprintf(buffer, elcount(buffer), "   0.000000 F1 EIS::ADAS_PROFILE_LONG_AR::ADAS_ProfLong_Val_ArrowMark = %d\n", intval);
	filePutString (buffer, elcount(buffer), hFile);
	intval = getSignal(CHASSIS::ADAS_PROFILE_LONG_AR::ADAS_ProfLong_Val_LaneType);
	snprintf(buffer, elcount(buffer), "   0.000000 F1 EIS::ADAS_PROFILE_LONG_AR::ADAS_ProfLong_Val_LaneType = %d\n", intval);
	filePutString (buffer, elcount(buffer), hFile);
	intval = getSignal(CHASSIS::ADAS_PROFILE_LONG_AR::ADAS_ProfLong_Val_LaneMarking);
	snprintf(buffer, elcount(buffer), "   0.000000 F1 EIS::ADAS_PROFILE_LONG_AR::ADAS_ProfLong_Val_LaneMarking = %d\n", intval);
	filePutString (buffer, elcount(buffer), hFile);
	intval = getSignal(CHASSIS::ADAS_PROFILE_LONG_AR::ADAS_ProfLong_Val_Yield);
	snprintf(buffer, elcount(buffer), "   0.000000 F1 EIS::ADAS_PROFILE_LONG_AR::ADAS_ProfLong_Val_Yield = %d\n", intval);
	filePutString (buffer, elcount(buffer), hFile);
	intval = getSignal(CHASSIS::ADAS_PROFILE_LONG_AR::ADAS_ProfLong_MsgTyp_NPSL1);
	snprintf(buffer, elcount(buffer), "   0.000000 F1 EIS::ADAS_PROFILE_LONG_AR::ADAS_ProfLong_MsgTyp_NPSL1 = %d\n", intval);
	filePutString (buffer, elcount(buffer), hFile);
	intval = getSignal(CHASSIS::ADAS_PROFILE_LONG_AR::ADAS_ProfLong_Offset_NPSL1);
	snprintf(buffer, elcount(buffer), "   0.000000 F1 EIS::ADAS_PROFILE_LONG_AR::ADAS_ProfLong_Offset_NPSL1 = %d\n", intval);
	filePutString (buffer, elcount(buffer), hFile);
	intval = getSignal(CHASSIS::ADAS_PROFILE_LONG_AR::ADAS_ProfLong_PathIdx_NPSL1);
	snprintf(buffer, elcount(buffer), "   0.000000 F1 EIS::ADAS_PROFILE_LONG_AR::ADAS_ProfLong_PathIdx_NPSL1 = %d\n", intval);
	filePutString (buffer, elcount(buffer), hFile);
	intval = getSignal(CHASSIS::ADAS_PROFILE_LONG_AR::ADAS_ProfLong_CycCnt_NPSL1);
	snprintf(buffer, elcount(buffer), "   0.000000 F1 EIS::ADAS_PROFILE_LONG_AR::ADAS_ProfLong_CycCnt_NPSL1 = %d\n", intval);
	filePutString (buffer, elcount(buffer), hFile);
	intval = getSignal(CHASSIS::ADAS_PROFILE_LONG_AR::ADAS_ProfLong_Updt_NPSL1);
	snprintf(buffer, elcount(buffer), "   0.000000 F1 EIS::ADAS_PROFILE_LONG_AR::ADAS_ProfLong_Updt_NPSL1 = %d\n", intval);
	filePutString (buffer, elcount(buffer), hFile);
	intval = getSignal(CHASSIS::ADAS_PROFILE_LONG_AR::ADAS_ProfLong_ReTr_NPSL1);
	snprintf(buffer, elcount(buffer), "   0.000000 F1 EIS::ADAS_PROFILE_LONG_AR::ADAS_ProfLong_ReTr_NPSL1 = %d\n", intval);
	filePutString (buffer, elcount(buffer), hFile);
	intval = getSignal(CHASSIS::ADAS_PROFILE_LONG_AR::ADAS_ProfLong_CtrlPoint_NPSL1);
	snprintf(buffer, elcount(buffer), "   0.000000 F1 EIS::ADAS_PROFILE_LONG_AR::ADAS_ProfLong_CtrlPoint_NPSL1 = %d\n", intval);
	filePutString (buffer, elcount(buffer), hFile);
	intval = getSignal(CHASSIS::ADAS_PROFILE_LONG_AR::ADAS_ProfLong_Val_SpdLmt);
	snprintf(buffer, elcount(buffer), "   0.000000 F1 EIS::ADAS_PROFILE_LONG_AR::ADAS_ProfLong_Val_SpdLmt = %d\n", intval);
	filePutString (buffer, elcount(buffer), hFile);
}
/*@@end*/

/*@@caplFunc:saveVars_21(dword):*/
void saveVars_21(dword hFile)
{
	intval = getSignal(CHASSIS::ADAS_PROFILE_LONG_AR::ADAS_ProfLong_Val_SpdUnt);
	snprintf(buffer, elcount(buffer), "   0.000000 F1 EIS::ADAS_PROFILE_LONG_AR::ADAS_ProfLong_Val_SpdUnt = %d\n", intval);
	filePutString (buffer, elcount(buffer), hFile);
	intval = getSignal(CHASSIS::ADAS_PROFILE_LONG_AR::ADAS_ProfLong_Val_SpdVld);
	snprintf(buffer, elcount(buffer), "   0.000000 F1 EIS::ADAS_PROFILE_LONG_AR::ADAS_ProfLong_Val_SpdVld = %d\n", intval);
	filePutString (buffer, elcount(buffer), hFile);
	intval = getSignal(CHASSIS::ADAS_PROFILE_LONG_AR::ADAS_ProfLong_Val_SpdTyp);
	snprintf(buffer, elcount(buffer), "   0.000000 F1 EIS::ADAS_PROFILE_LONG_AR::ADAS_ProfLong_Val_SpdTyp = %d\n", intval);
	filePutString (buffer, elcount(buffer), hFile);
	intval = getSignal(CHASSIS::ADAS_PROFILE_LONG_AR::ADAS_ProfLong_Val_SpdLmt1);
	snprintf(buffer, elcount(buffer), "   0.000000 F1 EIS::ADAS_PROFILE_LONG_AR::ADAS_ProfLong_Val_SpdLmt1 = %d\n", intval);
	filePutString (buffer, elcount(buffer), hFile);
	intval = getSignal(CHASSIS::ADAS_PROFILE_LONG_AR::ADAS_ProfLong_Val_SpdVld1);
	snprintf(buffer, elcount(buffer), "   0.000000 F1 EIS::ADAS_PROFILE_LONG_AR::ADAS_ProfLong_Val_SpdVld1 = %d\n", intval);
	filePutString (buffer, elcount(buffer), hFile);
	intval = getSignal(CHASSIS::ADAS_PROFILE_LONG_AR::ADAS_ProfLong_Val_SpdTyp1);
	snprintf(buffer, elcount(buffer), "   0.000000 F1 EIS::ADAS_PROFILE_LONG_AR::ADAS_ProfLong_Val_SpdTyp1 = %d\n", intval);
	filePutString (buffer, elcount(buffer), hFile);
	intval = getSignal(CHASSIS::ADAS_PROFILE_LONG_AR::ADAS_ProfLong_MsgTyp_NPSL2);
	snprintf(buffer, elcount(buffer), "   0.000000 F1 EIS::ADAS_PROFILE_LONG_AR::ADAS_ProfLong_MsgTyp_NPSL2 = %d\n", intval);
	filePutString (buffer, elcount(buffer), hFile);
	intval = getSignal(CHASSIS::ADAS_PROFILE_LONG_AR::ADAS_ProfLong_Offset_NPSL2);
	snprintf(buffer, elcount(buffer), "   0.000000 F1 EIS::ADAS_PROFILE_LONG_AR::ADAS_ProfLong_Offset_NPSL2 = %d\n", intval);
	filePutString (buffer, elcount(buffer), hFile);
	intval = getSignal(CHASSIS::ADAS_PROFILE_LONG_AR::ADAS_ProfLong_PathIdx_NPSL2);
	snprintf(buffer, elcount(buffer), "   0.000000 F1 EIS::ADAS_PROFILE_LONG_AR::ADAS_ProfLong_PathIdx_NPSL2 = %d\n", intval);
	filePutString (buffer, elcount(buffer), hFile);
	intval = getSignal(CHASSIS::ADAS_PROFILE_LONG_AR::ADAS_ProfLong_CycCnt_NPSL2);
	snprintf(buffer, elcount(buffer), "   0.000000 F1 EIS::ADAS_PROFILE_LONG_AR::ADAS_ProfLong_CycCnt_NPSL2 = %d\n", intval);
	filePutString (buffer, elcount(buffer), hFile);
	intval = getSignal(CHASSIS::ADAS_PROFILE_LONG_AR::ADAS_ProfLong_Updt_NPSL2);
	snprintf(buffer, elcount(buffer), "   0.000000 F1 EIS::ADAS_PROFILE_LONG_AR::ADAS_ProfLong_Updt_NPSL2 = %d\n", intval);
	filePutString (buffer, elcount(buffer), hFile);
	intval = getSignal(CHASSIS::ADAS_PROFILE_LONG_AR::ADAS_ProfLong_ReTr_NPSL2);
	snprintf(buffer, elcount(buffer), "   0.000000 F1 EIS::ADAS_PROFILE_LONG_AR::ADAS_ProfLong_ReTr_NPSL2 = %d\n", intval);
	filePutString (buffer, elcount(buffer), hFile);
	intval = getSignal(CHASSIS::ADAS_PROFILE_LONG_AR::ADAS_ProfLong_CtrlPoint_NPSL2);
	snprintf(buffer, elcount(buffer), "   0.000000 F1 EIS::ADAS_PROFILE_LONG_AR::ADAS_ProfLong_CtrlPoint_NPSL2 = %d\n", intval);
	filePutString (buffer, elcount(buffer), hFile);
	intval = getSignal(CHASSIS::ADAS_PROFILE_LONG_AR::ADAS_ProfLong_Val_SpdLmt2);
	snprintf(buffer, elcount(buffer), "   0.000000 F1 EIS::ADAS_PROFILE_LONG_AR::ADAS_ProfLong_Val_SpdLmt2 = %d\n", intval);
	filePutString (buffer, elcount(buffer), hFile);
	intval = getSignal(CHASSIS::ADAS_PROFILE_LONG_AR::ADAS_ProfLong_Val_SpdUnt2);
	snprintf(buffer, elcount(buffer), "   0.000000 F1 EIS::ADAS_PROFILE_LONG_AR::ADAS_ProfLong_Val_SpdUnt2 = %d\n", intval);
	filePutString (buffer, elcount(buffer), hFile);
	intval = getSignal(CHASSIS::ADAS_PROFILE_LONG_AR::ADAS_ProfLong_Val_SpdVld2);
	snprintf(buffer, elcount(buffer), "   0.000000 F1 EIS::ADAS_PROFILE_LONG_AR::ADAS_ProfLong_Val_SpdVld2 = %d\n", intval);
	filePutString (buffer, elcount(buffer), hFile);
	intval = getSignal(CHASSIS::ADAS_PROFILE_LONG_AR::ADAS_ProfLong_Val_SpdTyp2);
	snprintf(buffer, elcount(buffer), "   0.000000 F1 EIS::ADAS_PROFILE_LONG_AR::ADAS_ProfLong_Val_SpdTyp2 = %d\n", intval);
	filePutString (buffer, elcount(buffer), hFile);
	intval = getSignal(CHASSIS::ADAS_PROFILE_LONG_AR::ADAS_ProfLong_ProfTyp);
	snprintf(buffer, elcount(buffer), "   0.000000 F1 EIS::ADAS_PROFILE_LONG_AR::ADAS_ProfLong_ProfTyp = %d\n", intval);
	filePutString (buffer, elcount(buffer), hFile);
	intval = getSignal(CHASSIS::ADAS_PROFILE_SHORT_AR::ADAS_ProfShort_MsgTyp_CL);
	snprintf(buffer, elcount(buffer), "   0.000000 F1 EIS::ADAS_PROFILE_SHORT_AR::ADAS_ProfShort_MsgTyp_CL = %d\n", intval);
	filePutString (buffer, elcount(buffer), hFile);
	intval = getSignal(CHASSIS::ADAS_PROFILE_SHORT_AR::ADAS_ProfShort_Offset_CL);
	snprintf(buffer, elcount(buffer), "   0.000000 F1 EIS::ADAS_PROFILE_SHORT_AR::ADAS_ProfShort_Offset_CL = %d\n", intval);
	filePutString (buffer, elcount(buffer), hFile);
	intval = getSignal(CHASSIS::ADAS_PROFILE_SHORT_AR::ADAS_ProfShort_PathIdx_CL);
	snprintf(buffer, elcount(buffer), "   0.000000 F1 EIS::ADAS_PROFILE_SHORT_AR::ADAS_ProfShort_PathIdx_CL = %d\n", intval);
	filePutString (buffer, elcount(buffer), hFile);
	intval = getSignal(CHASSIS::ADAS_PROFILE_SHORT_AR::ADAS_ProfShort_CycCnt_CL);
	snprintf(buffer, elcount(buffer), "   0.000000 F1 EIS::ADAS_PROFILE_SHORT_AR::ADAS_ProfShort_CycCnt_CL = %d\n", intval);
	filePutString (buffer, elcount(buffer), hFile);
	intval = getSignal(CHASSIS::ADAS_PROFILE_SHORT_AR::ADAS_ProfShort_Updt_CL);
	snprintf(buffer, elcount(buffer), "   0.000000 F1 EIS::ADAS_PROFILE_SHORT_AR::ADAS_ProfShort_Updt_CL = %d\n", intval);
	filePutString (buffer, elcount(buffer), hFile);
	intval = getSignal(CHASSIS::ADAS_PROFILE_SHORT_AR::ADAS_ProfShort_ReTr_CL);
	snprintf(buffer, elcount(buffer), "   0.000000 F1 EIS::ADAS_PROFILE_SHORT_AR::ADAS_ProfShort_ReTr_CL = %d\n", intval);
	filePutString (buffer, elcount(buffer), hFile);
	intval = getSignal(CHASSIS::ADAS_PROFILE_SHORT_AR::ADAS_ProfShort_CtrlPoint_CL);
	snprintf(buffer, elcount(buffer), "   0.000000 F1 EIS::ADAS_PROFILE_SHORT_AR::ADAS_ProfShort_CtrlPoint_CL = %d\n", intval);
	filePutString (buffer, elcount(buffer), hFile);
	intval = getSignal(CHASSIS::ADAS_PROFILE_SHORT_AR::ADAS_ProfShort_AccurClass_CL);
	snprintf(buffer, elcount(buffer), "   0.000000 F1 EIS::ADAS_PROFILE_SHORT_AR::ADAS_ProfShort_AccurClass_CL = %d\n", intval);
	filePutString (buffer, elcount(buffer), hFile);
	intval = getSignal(CHASSIS::ADAS_PROFILE_SHORT_AR::ADAS_ProfShort_Value0_CL);
	snprintf(buffer, elcount(buffer), "   0.000000 F1 EIS::ADAS_PROFILE_SHORT_AR::ADAS_ProfShort_Value0_CL = %d\n", intval);
	filePutString (buffer, elcount(buffer), hFile);
	intval = getSignal(CHASSIS::ADAS_PROFILE_SHORT_AR::ADAS_ProfShort_Dist1_CL);
	snprintf(buffer, elcount(buffer), "   0.000000 F1 EIS::ADAS_PROFILE_SHORT_AR::ADAS_ProfShort_Dist1_CL = %d\n", intval);
	filePutString (buffer, elcount(buffer), hFile);
	intval = getSignal(CHASSIS::ADAS_PROFILE_SHORT_AR::ADAS_ProfShort_Value1_CL);
	snprintf(buffer, elcount(buffer), "   0.000000 F1 EIS::ADAS_PROFILE_SHORT_AR::ADAS_ProfShort_Value1_CL = %d\n", intval);
	filePutString (buffer, elcount(buffer), hFile);
	intval = getSignal(CHASSIS::ADAS_PROFILE_SHORT_AR::ADAS_ProfShort_MsgTyp_RN);
	snprintf(buffer, elcount(buffer), "   0.000000 F1 EIS::ADAS_PROFILE_SHORT_AR::ADAS_ProfShort_MsgTyp_RN = %d\n", intval);
	filePutString (buffer, elcount(buffer), hFile);
	intval = getSignal(CHASSIS::ADAS_PROFILE_SHORT_AR::ADAS_ProfShort_Offset_RN);
	snprintf(buffer, elcount(buffer), "   0.000000 F1 EIS::ADAS_PROFILE_SHORT_AR::ADAS_ProfShort_Offset_RN = %d\n", intval);
	filePutString (buffer, elcount(buffer), hFile);
	intval = getSignal(CHASSIS::ADAS_PROFILE_SHORT_AR::ADAS_ProfShort_PathIdx_RN);
	snprintf(buffer, elcount(buffer), "   0.000000 F1 EIS::ADAS_PROFILE_SHORT_AR::ADAS_ProfShort_PathIdx_RN = %d\n", intval);
	filePutString (buffer, elcount(buffer), hFile);
	intval = getSignal(CHASSIS::ADAS_PROFILE_SHORT_AR::ADAS_ProfShort_CycCnt_RN);
	snprintf(buffer, elcount(buffer), "   0.000000 F1 EIS::ADAS_PROFILE_SHORT_AR::ADAS_ProfShort_CycCnt_RN = %d\n", intval);
	filePutString (buffer, elcount(buffer), hFile);
	intval = getSignal(CHASSIS::ADAS_PROFILE_SHORT_AR::ADAS_ProfShort_Updt_RN);
	snprintf(buffer, elcount(buffer), "   0.000000 F1 EIS::ADAS_PROFILE_SHORT_AR::ADAS_ProfShort_Updt_RN = %d\n", intval);
	filePutString (buffer, elcount(buffer), hFile);
	intval = getSignal(CHASSIS::ADAS_PROFILE_SHORT_AR::ADAS_ProfShort_ReTr_RN);
	snprintf(buffer, elcount(buffer), "   0.000000 F1 EIS::ADAS_PROFILE_SHORT_AR::ADAS_ProfShort_ReTr_RN = %d\n", intval);
	filePutString (buffer, elcount(buffer), hFile);
	intval = getSignal(CHASSIS::ADAS_PROFILE_SHORT_AR::ADAS_ProfShort_CtrlPoint_RN);
	snprintf(buffer, elcount(buffer), "   0.000000 F1 EIS::ADAS_PROFILE_SHORT_AR::ADAS_ProfShort_CtrlPoint_RN = %d\n", intval);
	filePutString (buffer, elcount(buffer), hFile);
	intval = getSignal(CHASSIS::ADAS_PROFILE_SHORT_AR::ADAS_ProfShort_AccurClass_RN);
	snprintf(buffer, elcount(buffer), "   0.000000 F1 EIS::ADAS_PROFILE_SHORT_AR::ADAS_ProfShort_AccurClass_RN = %d\n", intval);
	filePutString (buffer, elcount(buffer), hFile);
	intval = getSignal(CHASSIS::ADAS_PROFILE_SHORT_AR::ADAS_ProfShort_Value0_RN);
	snprintf(buffer, elcount(buffer), "   0.000000 F1 EIS::ADAS_PROFILE_SHORT_AR::ADAS_ProfShort_Value0_RN = %d\n", intval);
	filePutString (buffer, elcount(buffer), hFile);
	intval = getSignal(CHASSIS::ADAS_PROFILE_SHORT_AR::ADAS_ProfShort_Dist1_RN);
	snprintf(buffer, elcount(buffer), "   0.000000 F1 EIS::ADAS_PROFILE_SHORT_AR::ADAS_ProfShort_Dist1_RN = %d\n", intval);
	filePutString (buffer, elcount(buffer), hFile);
	intval = getSignal(CHASSIS::ADAS_PROFILE_SHORT_AR::ADAS_ProfShort_Value1_RN);
	snprintf(buffer, elcount(buffer), "   0.000000 F1 EIS::ADAS_PROFILE_SHORT_AR::ADAS_ProfShort_Value1_RN = %d\n", intval);
	filePutString (buffer, elcount(buffer), hFile);
	intval = getSignal(CHASSIS::ADAS_PROFILE_SHORT_AR::ADAS_ProfShort_MsgTyp_SS);
	snprintf(buffer, elcount(buffer), "   0.000000 F1 EIS::ADAS_PROFILE_SHORT_AR::ADAS_ProfShort_MsgTyp_SS = %d\n", intval);
	filePutString (buffer, elcount(buffer), hFile);
	intval = getSignal(CHASSIS::ADAS_PROFILE_SHORT_AR::ADAS_ProfShort_Offset_SS);
	snprintf(buffer, elcount(buffer), "   0.000000 F1 EIS::ADAS_PROFILE_SHORT_AR::ADAS_ProfShort_Offset_SS = %d\n", intval);
	filePutString (buffer, elcount(buffer), hFile);
	intval = getSignal(CHASSIS::ADAS_PROFILE_SHORT_AR::ADAS_ProfShort_PathIdx_SS);
	snprintf(buffer, elcount(buffer), "   0.000000 F1 EIS::ADAS_PROFILE_SHORT_AR::ADAS_ProfShort_PathIdx_SS = %d\n", intval);
	filePutString (buffer, elcount(buffer), hFile);
	intval = getSignal(CHASSIS::ADAS_PROFILE_SHORT_AR::ADAS_ProfShort_CycCnt_SS);
	snprintf(buffer, elcount(buffer), "   0.000000 F1 EIS::ADAS_PROFILE_SHORT_AR::ADAS_ProfShort_CycCnt_SS = %d\n", intval);
	filePutString (buffer, elcount(buffer), hFile);
	intval = getSignal(CHASSIS::ADAS_PROFILE_SHORT_AR::ADAS_ProfShort_Updt_SS);
	snprintf(buffer, elcount(buffer), "   0.000000 F1 EIS::ADAS_PROFILE_SHORT_AR::ADAS_ProfShort_Updt_SS = %d\n", intval);
	filePutString (buffer, elcount(buffer), hFile);
	intval = getSignal(CHASSIS::ADAS_PROFILE_SHORT_AR::ADAS_ProfShort_ReTr_SS);
	snprintf(buffer, elcount(buffer), "   0.000000 F1 EIS::ADAS_PROFILE_SHORT_AR::ADAS_ProfShort_ReTr_SS = %d\n", intval);
	filePutString (buffer, elcount(buffer), hFile);
	intval = getSignal(CHASSIS::ADAS_PROFILE_SHORT_AR::ADAS_ProfShort_CtrlPoint_SS);
	snprintf(buffer, elcount(buffer), "   0.000000 F1 EIS::ADAS_PROFILE_SHORT_AR::ADAS_ProfShort_CtrlPoint_SS = %d\n", intval);
	filePutString (buffer, elcount(buffer), hFile);
	intval = getSignal(CHASSIS::ADAS_PROFILE_SHORT_AR::ADAS_ProfShort_AccurClass_SS);
	snprintf(buffer, elcount(buffer), "   0.000000 F1 EIS::ADAS_PROFILE_SHORT_AR::ADAS_ProfShort_AccurClass_SS = %d\n", intval);
	filePutString (buffer, elcount(buffer), hFile);
	intval = getSignal(CHASSIS::ADAS_PROFILE_SHORT_AR::ADAS_ProfShort_Value0_SS);
	snprintf(buffer, elcount(buffer), "   0.000000 F1 EIS::ADAS_PROFILE_SHORT_AR::ADAS_ProfShort_Value0_SS = %d\n", intval);
	filePutString (buffer, elcount(buffer), hFile);
	intval = getSignal(CHASSIS::ADAS_PROFILE_SHORT_AR::ADAS_ProfShort_Dist1_SS);
	snprintf(buffer, elcount(buffer), "   0.000000 F1 EIS::ADAS_PROFILE_SHORT_AR::ADAS_ProfShort_Dist1_SS = %d\n", intval);
	filePutString (buffer, elcount(buffer), hFile);
	intval = getSignal(CHASSIS::ADAS_PROFILE_SHORT_AR::ADAS_ProfShort_Value1_SS);
	snprintf(buffer, elcount(buffer), "   0.000000 F1 EIS::ADAS_PROFILE_SHORT_AR::ADAS_ProfShort_Value1_SS = %d\n", intval);
	filePutString (buffer, elcount(buffer), hFile);
}
/*@@end*/

/*@@caplFunc:saveVars_22(dword):*/
void saveVars_22(dword hFile)
{
	intval = getSignal(CHASSIS::ADAS_PROFILE_SHORT_AR::ADAS_ProfShort_MsgTyp_SL);
	snprintf(buffer, elcount(buffer), "   0.000000 F1 EIS::ADAS_PROFILE_SHORT_AR::ADAS_ProfShort_MsgTyp_SL = %d\n", intval);
	filePutString (buffer, elcount(buffer), hFile);
	intval = getSignal(CHASSIS::ADAS_PROFILE_SHORT_AR::ADAS_ProfShort_Offset_SL);
	snprintf(buffer, elcount(buffer), "   0.000000 F1 EIS::ADAS_PROFILE_SHORT_AR::ADAS_ProfShort_Offset_SL = %d\n", intval);
	filePutString (buffer, elcount(buffer), hFile);
	intval = getSignal(CHASSIS::ADAS_PROFILE_SHORT_AR::ADAS_ProfShort_PathIdx_SL);
	snprintf(buffer, elcount(buffer), "   0.000000 F1 EIS::ADAS_PROFILE_SHORT_AR::ADAS_ProfShort_PathIdx_SL = %d\n", intval);
	filePutString (buffer, elcount(buffer), hFile);
	intval = getSignal(CHASSIS::ADAS_PROFILE_SHORT_AR::ADAS_ProfShort_CycCnt_SL);
	snprintf(buffer, elcount(buffer), "   0.000000 F1 EIS::ADAS_PROFILE_SHORT_AR::ADAS_ProfShort_CycCnt_SL = %d\n", intval);
	filePutString (buffer, elcount(buffer), hFile);
	intval = getSignal(CHASSIS::ADAS_PROFILE_SHORT_AR::ADAS_ProfShort_Updt_SL);
	snprintf(buffer, elcount(buffer), "   0.000000 F1 EIS::ADAS_PROFILE_SHORT_AR::ADAS_ProfShort_Updt_SL = %d\n", intval);
	filePutString (buffer, elcount(buffer), hFile);
	intval = getSignal(CHASSIS::ADAS_PROFILE_SHORT_AR::ADAS_ProfShort_ReTr_SL);
	snprintf(buffer, elcount(buffer), "   0.000000 F1 EIS::ADAS_PROFILE_SHORT_AR::ADAS_ProfShort_ReTr_SL = %d\n", intval);
	filePutString (buffer, elcount(buffer), hFile);
	intval = getSignal(CHASSIS::ADAS_PROFILE_SHORT_AR::ADAS_ProfShort_CtrlPoint_SL);
	snprintf(buffer, elcount(buffer), "   0.000000 F1 EIS::ADAS_PROFILE_SHORT_AR::ADAS_ProfShort_CtrlPoint_SL = %d\n", intval);
	filePutString (buffer, elcount(buffer), hFile);
	intval = getSignal(CHASSIS::ADAS_PROFILE_SHORT_AR::ADAS_ProfShort_AccurClass_SL);
	snprintf(buffer, elcount(buffer), "   0.000000 F1 EIS::ADAS_PROFILE_SHORT_AR::ADAS_ProfShort_AccurClass_SL = %d\n", intval);
	filePutString (buffer, elcount(buffer), hFile);
	intval = getSignal(CHASSIS::ADAS_PROFILE_SHORT_AR::ADAS_ProfShort_Value0_SL);
	snprintf(buffer, elcount(buffer), "   0.000000 F1 EIS::ADAS_PROFILE_SHORT_AR::ADAS_ProfShort_Value0_SL = %d\n", intval);
	filePutString (buffer, elcount(buffer), hFile);
	intval = getSignal(CHASSIS::ADAS_PROFILE_SHORT_AR::ADAS_ProfShort_Dist1_SL);
	snprintf(buffer, elcount(buffer), "   0.000000 F1 EIS::ADAS_PROFILE_SHORT_AR::ADAS_ProfShort_Dist1_SL = %d\n", intval);
	filePutString (buffer, elcount(buffer), hFile);
	intval = getSignal(CHASSIS::ADAS_PROFILE_SHORT_AR::ADAS_ProfShort_Value1_SL);
	snprintf(buffer, elcount(buffer), "   0.000000 F1 EIS::ADAS_PROFILE_SHORT_AR::ADAS_ProfShort_Value1_SL = %d\n", intval);
	filePutString (buffer, elcount(buffer), hFile);
	intval = getSignal(CHASSIS::ADAS_PROFILE_SHORT_AR::ADAS_ProfShort_MsgTyp_RA);
	snprintf(buffer, elcount(buffer), "   0.000000 F1 EIS::ADAS_PROFILE_SHORT_AR::ADAS_ProfShort_MsgTyp_RA = %d\n", intval);
	filePutString (buffer, elcount(buffer), hFile);
	intval = getSignal(CHASSIS::ADAS_PROFILE_SHORT_AR::ADAS_ProfShort_Offset_RA);
	snprintf(buffer, elcount(buffer), "   0.000000 F1 EIS::ADAS_PROFILE_SHORT_AR::ADAS_ProfShort_Offset_RA = %d\n", intval);
	filePutString (buffer, elcount(buffer), hFile);
	intval = getSignal(CHASSIS::ADAS_PROFILE_SHORT_AR::ADAS_ProfShort_PathIdx_RA);
	snprintf(buffer, elcount(buffer), "   0.000000 F1 EIS::ADAS_PROFILE_SHORT_AR::ADAS_ProfShort_PathIdx_RA = %d\n", intval);
	filePutString (buffer, elcount(buffer), hFile);
	intval = getSignal(CHASSIS::ADAS_PROFILE_SHORT_AR::ADAS_ProfShort_CycCnt_RA);
	snprintf(buffer, elcount(buffer), "   0.000000 F1 EIS::ADAS_PROFILE_SHORT_AR::ADAS_ProfShort_CycCnt_RA = %d\n", intval);
	filePutString (buffer, elcount(buffer), hFile);
	intval = getSignal(CHASSIS::ADAS_PROFILE_SHORT_AR::ADAS_ProfShort_Updt_RA);
	snprintf(buffer, elcount(buffer), "   0.000000 F1 EIS::ADAS_PROFILE_SHORT_AR::ADAS_ProfShort_Updt_RA = %d\n", intval);
	filePutString (buffer, elcount(buffer), hFile);
	intval = getSignal(CHASSIS::ADAS_PROFILE_SHORT_AR::ADAS_ProfShort_ReTr_RA);
	snprintf(buffer, elcount(buffer), "   0.000000 F1 EIS::ADAS_PROFILE_SHORT_AR::ADAS_ProfShort_ReTr_RA = %d\n", intval);
	filePutString (buffer, elcount(buffer), hFile);
	intval = getSignal(CHASSIS::ADAS_PROFILE_SHORT_AR::ADAS_ProfShort_CtrlPoint_RA);
	snprintf(buffer, elcount(buffer), "   0.000000 F1 EIS::ADAS_PROFILE_SHORT_AR::ADAS_ProfShort_CtrlPoint_RA = %d\n", intval);
	filePutString (buffer, elcount(buffer), hFile);
	intval = getSignal(CHASSIS::ADAS_PROFILE_SHORT_AR::ADAS_ProfShort_AccurClass_RA);
	snprintf(buffer, elcount(buffer), "   0.000000 F1 EIS::ADAS_PROFILE_SHORT_AR::ADAS_ProfShort_AccurClass_RA = %d\n", intval);
	filePutString (buffer, elcount(buffer), hFile);
	intval = getSignal(CHASSIS::ADAS_PROFILE_SHORT_AR::ADAS_ProfShort_Value0_RA);
	snprintf(buffer, elcount(buffer), "   0.000000 F1 EIS::ADAS_PROFILE_SHORT_AR::ADAS_ProfShort_Value0_RA = %d\n", intval);
	filePutString (buffer, elcount(buffer), hFile);
	intval = getSignal(CHASSIS::ADAS_PROFILE_SHORT_AR::ADAS_ProfShort_Dist1_RA);
	snprintf(buffer, elcount(buffer), "   0.000000 F1 EIS::ADAS_PROFILE_SHORT_AR::ADAS_ProfShort_Dist1_RA = %d\n", intval);
	filePutString (buffer, elcount(buffer), hFile);
	intval = getSignal(CHASSIS::ADAS_PROFILE_SHORT_AR::ADAS_ProfShort_Value1_RA);
	snprintf(buffer, elcount(buffer), "   0.000000 F1 EIS::ADAS_PROFILE_SHORT_AR::ADAS_ProfShort_Value1_RA = %d\n", intval);
	filePutString (buffer, elcount(buffer), hFile);
	intval = getSignal(CHASSIS::ADAS_PROFILE_SHORT_AR::ADAS_ProfShort_MsgTyp_RC);
	snprintf(buffer, elcount(buffer), "   0.000000 F1 EIS::ADAS_PROFILE_SHORT_AR::ADAS_ProfShort_MsgTyp_RC = %d\n", intval);
	filePutString (buffer, elcount(buffer), hFile);
	intval = getSignal(CHASSIS::ADAS_PROFILE_SHORT_AR::ADAS_ProfShort_Offset_RC);
	snprintf(buffer, elcount(buffer), "   0.000000 F1 EIS::ADAS_PROFILE_SHORT_AR::ADAS_ProfShort_Offset_RC = %d\n", intval);
	filePutString (buffer, elcount(buffer), hFile);
	intval = getSignal(CHASSIS::ADAS_PROFILE_SHORT_AR::ADAS_ProfShort_PathIdx_RC);
	snprintf(buffer, elcount(buffer), "   0.000000 F1 EIS::ADAS_PROFILE_SHORT_AR::ADAS_ProfShort_PathIdx_RC = %d\n", intval);
	filePutString (buffer, elcount(buffer), hFile);
	intval = getSignal(CHASSIS::ADAS_PROFILE_SHORT_AR::ADAS_ProfShort_CycCnt_RC);
	snprintf(buffer, elcount(buffer), "   0.000000 F1 EIS::ADAS_PROFILE_SHORT_AR::ADAS_ProfShort_CycCnt_RC = %d\n", intval);
	filePutString (buffer, elcount(buffer), hFile);
	intval = getSignal(CHASSIS::ADAS_PROFILE_SHORT_AR::ADAS_ProfShort_Updt_RC);
	snprintf(buffer, elcount(buffer), "   0.000000 F1 EIS::ADAS_PROFILE_SHORT_AR::ADAS_ProfShort_Updt_RC = %d\n", intval);
	filePutString (buffer, elcount(buffer), hFile);
	intval = getSignal(CHASSIS::ADAS_PROFILE_SHORT_AR::ADAS_ProfShort_ReTr_RC);
	snprintf(buffer, elcount(buffer), "   0.000000 F1 EIS::ADAS_PROFILE_SHORT_AR::ADAS_ProfShort_ReTr_RC = %d\n", intval);
	filePutString (buffer, elcount(buffer), hFile);
	intval = getSignal(CHASSIS::ADAS_PROFILE_SHORT_AR::ADAS_ProfShort_CtrlPoint_RC);
	snprintf(buffer, elcount(buffer), "   0.000000 F1 EIS::ADAS_PROFILE_SHORT_AR::ADAS_ProfShort_CtrlPoint_RC = %d\n", intval);
	filePutString (buffer, elcount(buffer), hFile);
	intval = getSignal(CHASSIS::ADAS_PROFILE_SHORT_AR::ADAS_ProfShort_AccurClass_RC);
	snprintf(buffer, elcount(buffer), "   0.000000 F1 EIS::ADAS_PROFILE_SHORT_AR::ADAS_ProfShort_AccurClass_RC = %d\n", intval);
	filePutString (buffer, elcount(buffer), hFile);
	intval = getSignal(CHASSIS::ADAS_PROFILE_SHORT_AR::ADAS_ProfShort_Value0_RC);
	snprintf(buffer, elcount(buffer), "   0.000000 F1 EIS::ADAS_PROFILE_SHORT_AR::ADAS_ProfShort_Value0_RC = %d\n", intval);
	filePutString (buffer, elcount(buffer), hFile);
	intval = getSignal(CHASSIS::ADAS_PROFILE_SHORT_AR::ADAS_ProfShort_Dist1_RC);
	snprintf(buffer, elcount(buffer), "   0.000000 F1 EIS::ADAS_PROFILE_SHORT_AR::ADAS_ProfShort_Dist1_RC = %d\n", intval);
	filePutString (buffer, elcount(buffer), hFile);
	intval = getSignal(CHASSIS::ADAS_PROFILE_SHORT_AR::ADAS_ProfShort_Value1_RC);
	snprintf(buffer, elcount(buffer), "   0.000000 F1 EIS::ADAS_PROFILE_SHORT_AR::ADAS_ProfShort_Value1_RC = %d\n", intval);
	filePutString (buffer, elcount(buffer), hFile);
	intval = getSignal(CHASSIS::ADAS_PROFILE_SHORT_AR::ADAS_ProfShort_MsgTyp_VSS);
	snprintf(buffer, elcount(buffer), "   0.000000 F1 EIS::ADAS_PROFILE_SHORT_AR::ADAS_ProfShort_MsgTyp_VSS = %d\n", intval);
	filePutString (buffer, elcount(buffer), hFile);
	intval = getSignal(CHASSIS::ADAS_PROFILE_SHORT_AR::ADAS_ProfShort_Offset_VSS);
	snprintf(buffer, elcount(buffer), "   0.000000 F1 EIS::ADAS_PROFILE_SHORT_AR::ADAS_ProfShort_Offset_VSS = %d\n", intval);
	filePutString (buffer, elcount(buffer), hFile);
	intval = getSignal(CHASSIS::ADAS_PROFILE_SHORT_AR::ADAS_ProfShort_PathIdx_VSS);
	snprintf(buffer, elcount(buffer), "   0.000000 F1 EIS::ADAS_PROFILE_SHORT_AR::ADAS_ProfShort_PathIdx_VSS = %d\n", intval);
	filePutString (buffer, elcount(buffer), hFile);
	intval = getSignal(CHASSIS::ADAS_PROFILE_SHORT_AR::ADAS_ProfShort_CycCnt_VSS);
	snprintf(buffer, elcount(buffer), "   0.000000 F1 EIS::ADAS_PROFILE_SHORT_AR::ADAS_ProfShort_CycCnt_VSS = %d\n", intval);
	filePutString (buffer, elcount(buffer), hFile);
	intval = getSignal(CHASSIS::ADAS_PROFILE_SHORT_AR::ADAS_ProfShort_Updt_VSS);
	snprintf(buffer, elcount(buffer), "   0.000000 F1 EIS::ADAS_PROFILE_SHORT_AR::ADAS_ProfShort_Updt_VSS = %d\n", intval);
	filePutString (buffer, elcount(buffer), hFile);
	intval = getSignal(CHASSIS::ADAS_PROFILE_SHORT_AR::ADAS_ProfShort_ReTr_VSS);
	snprintf(buffer, elcount(buffer), "   0.000000 F1 EIS::ADAS_PROFILE_SHORT_AR::ADAS_ProfShort_ReTr_VSS = %d\n", intval);
	filePutString (buffer, elcount(buffer), hFile);
	intval = getSignal(CHASSIS::ADAS_PROFILE_SHORT_AR::ADAS_ProfShort_CtrlPoint_VSS);
	snprintf(buffer, elcount(buffer), "   0.000000 F1 EIS::ADAS_PROFILE_SHORT_AR::ADAS_ProfShort_CtrlPoint_VSS = %d\n", intval);
	filePutString (buffer, elcount(buffer), hFile);
	intval = getSignal(CHASSIS::ADAS_PROFILE_SHORT_AR::ADAS_ProfShort_AccurClass_VSS);
	snprintf(buffer, elcount(buffer), "   0.000000 F1 EIS::ADAS_PROFILE_SHORT_AR::ADAS_ProfShort_AccurClass_VSS = %d\n", intval);
	filePutString (buffer, elcount(buffer), hFile);
	intval = getSignal(CHASSIS::ADAS_PROFILE_SHORT_AR::ADAS_ProfShort_Value0_VSS);
	snprintf(buffer, elcount(buffer), "   0.000000 F1 EIS::ADAS_PROFILE_SHORT_AR::ADAS_ProfShort_Value0_VSS = %d\n", intval);
	filePutString (buffer, elcount(buffer), hFile);
	intval = getSignal(CHASSIS::ADAS_PROFILE_SHORT_AR::ADAS_ProfShort_Dist1_VSS);
	snprintf(buffer, elcount(buffer), "   0.000000 F1 EIS::ADAS_PROFILE_SHORT_AR::ADAS_ProfShort_Dist1_VSS = %d\n", intval);
	filePutString (buffer, elcount(buffer), hFile);
	intval = getSignal(CHASSIS::ADAS_PROFILE_SHORT_AR::ADAS_ProfShort_Value1_VSS);
	snprintf(buffer, elcount(buffer), "   0.000000 F1 EIS::ADAS_PROFILE_SHORT_AR::ADAS_ProfShort_Value1_VSS = %d\n", intval);
	filePutString (buffer, elcount(buffer), hFile);
	intval = getSignal(CHASSIS::ADAS_PROFILE_SHORT_AR::ADAS_ProfShort_MsgTyp_HCS);
	snprintf(buffer, elcount(buffer), "   0.000000 F1 EIS::ADAS_PROFILE_SHORT_AR::ADAS_ProfShort_MsgTyp_HCS = %d\n", intval);
	filePutString (buffer, elcount(buffer), hFile);
	intval = getSignal(CHASSIS::ADAS_PROFILE_SHORT_AR::ADAS_ProfShort_Offset_HCS);
	snprintf(buffer, elcount(buffer), "   0.000000 F1 EIS::ADAS_PROFILE_SHORT_AR::ADAS_ProfShort_Offset_HCS = %d\n", intval);
	filePutString (buffer, elcount(buffer), hFile);
	intval = getSignal(CHASSIS::ADAS_PROFILE_SHORT_AR::ADAS_ProfShort_PathIdx_HCS);
	snprintf(buffer, elcount(buffer), "   0.000000 F1 EIS::ADAS_PROFILE_SHORT_AR::ADAS_ProfShort_PathIdx_HCS = %d\n", intval);
	filePutString (buffer, elcount(buffer), hFile);
	intval = getSignal(CHASSIS::ADAS_PROFILE_SHORT_AR::ADAS_ProfShort_CycCnt_HCS);
	snprintf(buffer, elcount(buffer), "   0.000000 F1 EIS::ADAS_PROFILE_SHORT_AR::ADAS_ProfShort_CycCnt_HCS = %d\n", intval);
	filePutString (buffer, elcount(buffer), hFile);
	intval = getSignal(CHASSIS::ADAS_PROFILE_SHORT_AR::ADAS_ProfShort_Updt_HCS);
	snprintf(buffer, elcount(buffer), "   0.000000 F1 EIS::ADAS_PROFILE_SHORT_AR::ADAS_ProfShort_Updt_HCS = %d\n", intval);
	filePutString (buffer, elcount(buffer), hFile);
	intval = getSignal(CHASSIS::ADAS_PROFILE_SHORT_AR::ADAS_ProfShort_ReTr_HCS);
	snprintf(buffer, elcount(buffer), "   0.000000 F1 EIS::ADAS_PROFILE_SHORT_AR::ADAS_ProfShort_ReTr_HCS = %d\n", intval);
	filePutString (buffer, elcount(buffer), hFile);
	intval = getSignal(CHASSIS::ADAS_PROFILE_SHORT_AR::ADAS_ProfShort_CtrlPoint_HCS);
	snprintf(buffer, elcount(buffer), "   0.000000 F1 EIS::ADAS_PROFILE_SHORT_AR::ADAS_ProfShort_CtrlPoint_HCS = %d\n", intval);
	filePutString (buffer, elcount(buffer), hFile);
}
/*@@end*/

/*@@caplFunc:saveVars_23(dword):*/
void saveVars_23(dword hFile)
{
	intval = getSignal(CHASSIS::ADAS_PROFILE_SHORT_AR::ADAS_ProfShort_AccurClass_HCS);
	snprintf(buffer, elcount(buffer), "   0.000000 F1 EIS::ADAS_PROFILE_SHORT_AR::ADAS_ProfShort_AccurClass_HCS = %d\n", intval);
	filePutString (buffer, elcount(buffer), hFile);
	intval = getSignal(CHASSIS::ADAS_PROFILE_SHORT_AR::ADAS_ProfShort_Value0_HCS);
	snprintf(buffer, elcount(buffer), "   0.000000 F1 EIS::ADAS_PROFILE_SHORT_AR::ADAS_ProfShort_Value0_HCS = %d\n", intval);
	filePutString (buffer, elcount(buffer), hFile);
	intval = getSignal(CHASSIS::ADAS_PROFILE_SHORT_AR::ADAS_ProfShort_Dist1_HCS);
	snprintf(buffer, elcount(buffer), "   0.000000 F1 EIS::ADAS_PROFILE_SHORT_AR::ADAS_ProfShort_Dist1_HCS = %d\n", intval);
	filePutString (buffer, elcount(buffer), hFile);
	intval = getSignal(CHASSIS::ADAS_PROFILE_SHORT_AR::ADAS_ProfShort_Value1_HCS);
	snprintf(buffer, elcount(buffer), "   0.000000 F1 EIS::ADAS_PROFILE_SHORT_AR::ADAS_ProfShort_Value1_HCS = %d\n", intval);
	filePutString (buffer, elcount(buffer), hFile);
	intval = getSignal(CHASSIS::ADAS_PROFILE_SHORT_AR::ADAS_ProfShort_MsgTyp_LD);
	snprintf(buffer, elcount(buffer), "   0.000000 F1 EIS::ADAS_PROFILE_SHORT_AR::ADAS_ProfShort_MsgTyp_LD = %d\n", intval);
	filePutString (buffer, elcount(buffer), hFile);
	intval = getSignal(CHASSIS::ADAS_PROFILE_SHORT_AR::ADAS_ProfShort_Offset_LD);
	snprintf(buffer, elcount(buffer), "   0.000000 F1 EIS::ADAS_PROFILE_SHORT_AR::ADAS_ProfShort_Offset_LD = %d\n", intval);
	filePutString (buffer, elcount(buffer), hFile);
	intval = getSignal(CHASSIS::ADAS_PROFILE_SHORT_AR::ADAS_ProfShort_PathIdx_LD);
	snprintf(buffer, elcount(buffer), "   0.000000 F1 EIS::ADAS_PROFILE_SHORT_AR::ADAS_ProfShort_PathIdx_LD = %d\n", intval);
	filePutString (buffer, elcount(buffer), hFile);
	intval = getSignal(CHASSIS::ADAS_PROFILE_SHORT_AR::ADAS_ProfShort_CycCnt_LD);
	snprintf(buffer, elcount(buffer), "   0.000000 F1 EIS::ADAS_PROFILE_SHORT_AR::ADAS_ProfShort_CycCnt_LD = %d\n", intval);
	filePutString (buffer, elcount(buffer), hFile);
	intval = getSignal(CHASSIS::ADAS_PROFILE_SHORT_AR::ADAS_ProfShort_Updt_LD);
	snprintf(buffer, elcount(buffer), "   0.000000 F1 EIS::ADAS_PROFILE_SHORT_AR::ADAS_ProfShort_Updt_LD = %d\n", intval);
	filePutString (buffer, elcount(buffer), hFile);
	intval = getSignal(CHASSIS::ADAS_PROFILE_SHORT_AR::ADAS_ProfShort_ReTr_LD);
	snprintf(buffer, elcount(buffer), "   0.000000 F1 EIS::ADAS_PROFILE_SHORT_AR::ADAS_ProfShort_ReTr_LD = %d\n", intval);
	filePutString (buffer, elcount(buffer), hFile);
	intval = getSignal(CHASSIS::ADAS_PROFILE_SHORT_AR::ADAS_ProfShort_CtrlPoint_LD);
	snprintf(buffer, elcount(buffer), "   0.000000 F1 EIS::ADAS_PROFILE_SHORT_AR::ADAS_ProfShort_CtrlPoint_LD = %d\n", intval);
	filePutString (buffer, elcount(buffer), hFile);
	intval = getSignal(CHASSIS::ADAS_PROFILE_SHORT_AR::ADAS_ProfShort_AccurClass_LD);
	snprintf(buffer, elcount(buffer), "   0.000000 F1 EIS::ADAS_PROFILE_SHORT_AR::ADAS_ProfShort_AccurClass_LD = %d\n", intval);
	filePutString (buffer, elcount(buffer), hFile);
	intval = getSignal(CHASSIS::ADAS_PROFILE_SHORT_AR::ADAS_ProfShort_Value0_LT);
	snprintf(buffer, elcount(buffer), "   0.000000 F1 EIS::ADAS_PROFILE_SHORT_AR::ADAS_ProfShort_Value0_LT = %d\n", intval);
	filePutString (buffer, elcount(buffer), hFile);
	intval = getSignal(CHASSIS::ADAS_PROFILE_SHORT_AR::ADAS_ProfShort_Value0_DT);
	snprintf(buffer, elcount(buffer), "   0.000000 F1 EIS::ADAS_PROFILE_SHORT_AR::ADAS_ProfShort_Value0_DT = %d\n", intval);
	filePutString (buffer, elcount(buffer), hFile);
	intval = getSignal(CHASSIS::ADAS_PROFILE_SHORT_AR::ADAS_ProfShort_Dist1_LD);
	snprintf(buffer, elcount(buffer), "   0.000000 F1 EIS::ADAS_PROFILE_SHORT_AR::ADAS_ProfShort_Dist1_LD = %d\n", intval);
	filePutString (buffer, elcount(buffer), hFile);
	intval = getSignal(CHASSIS::ADAS_PROFILE_SHORT_AR::ADAS_ProfShort_Value1_LT);
	snprintf(buffer, elcount(buffer), "   0.000000 F1 EIS::ADAS_PROFILE_SHORT_AR::ADAS_ProfShort_Value1_LT = %d\n", intval);
	filePutString (buffer, elcount(buffer), hFile);
	intval = getSignal(CHASSIS::ADAS_PROFILE_SHORT_AR::ADAS_ProfShort_Value1_DT);
	snprintf(buffer, elcount(buffer), "   0.000000 F1 EIS::ADAS_PROFILE_SHORT_AR::ADAS_ProfShort_Value1_DT = %d\n", intval);
	filePutString (buffer, elcount(buffer), hFile);
	intval = getSignal(CHASSIS::ADAS_PROFILE_SHORT_AR::ADAS_ProfShort_ProfTyp);
	snprintf(buffer, elcount(buffer), "   0.000000 F1 EIS::ADAS_PROFILE_SHORT_AR::ADAS_ProfShort_ProfTyp = %d\n", intval);
	filePutString (buffer, elcount(buffer), hFile);
	intval = getSignal(CHASSIS::ADASLR_POSITION_AR::ADASLR_Posn_MsgTyp);
	snprintf(buffer, elcount(buffer), "   0.000000 F1 EIS::ADASLR_POSITION_AR::ADASLR_Posn_MsgTyp = %d\n", intval);
	filePutString (buffer, elcount(buffer), hFile);
	intval = getSignal(CHASSIS::ADASLR_POSITION_AR::ADASLR_Posn_Offset);
	snprintf(buffer, elcount(buffer), "   0.000000 F1 EIS::ADASLR_POSITION_AR::ADASLR_Posn_Offset = %d\n", intval);
	filePutString (buffer, elcount(buffer), hFile);
	intval = getSignal(CHASSIS::ADASLR_POSITION_AR::ADASLR_Posn_PathIdx);
	snprintf(buffer, elcount(buffer), "   0.000000 F1 EIS::ADASLR_POSITION_AR::ADASLR_Posn_PathIdx = %d\n", intval);
	filePutString (buffer, elcount(buffer), hFile);
	intval = getSignal(CHASSIS::ADASLR_POSITION_AR::ADASLR_Posn_CycCnt);
	snprintf(buffer, elcount(buffer), "   0.000000 F1 EIS::ADASLR_POSITION_AR::ADASLR_Posn_CycCnt = %d\n", intval);
	filePutString (buffer, elcount(buffer), hFile);
	floatval = getSignal(CHASSIS::ADASLR_POSITION_AR::ADASLR_Posn_PosProbb);
	snprintf(buffer, elcount(buffer), "   0.000000 F1 EIS::ADASLR_POSITION_AR::ADASLR_Posn_PosProbb = %f\n", floatval);
	filePutString (buffer, elcount(buffer), hFile);
	intval = getSignal(CHASSIS::ADASLR_POSITION_AR::ADASLR_Posn_Idx);
	snprintf(buffer, elcount(buffer), "   0.000000 F1 EIS::ADASLR_POSITION_AR::ADASLR_Posn_Idx = %d\n", intval);
	filePutString (buffer, elcount(buffer), hFile);
	intval = getSignal(CHASSIS::ADASLR_POSITION_AR::ADASLR_Posn_Age);
	snprintf(buffer, elcount(buffer), "   0.000000 F1 EIS::ADASLR_POSITION_AR::ADASLR_Posn_Age = %d\n", intval);
	filePutString (buffer, elcount(buffer), hFile);
	intval = getSignal(CHASSIS::ADASLR_POSITION_AR::ADASLR_Posn_CurLane);
	snprintf(buffer, elcount(buffer), "   0.000000 F1 EIS::ADASLR_POSITION_AR::ADASLR_Posn_CurLane = %d\n", intval);
	filePutString (buffer, elcount(buffer), hFile);
	intval = getSignal(CHASSIS::ADASLR_POSITION_AR::ADASLR_Posn_PosConfdc);
	snprintf(buffer, elcount(buffer), "   0.000000 F1 EIS::ADASLR_POSITION_AR::ADASLR_Posn_PosConfdc = %d\n", intval);
	filePutString (buffer, elcount(buffer), hFile);
	floatval = getSignal(CHASSIS::ADASLR_POSITION_AR::ADASLR_Posn_Spd);
	snprintf(buffer, elcount(buffer), "   0.000000 F1 EIS::ADASLR_POSITION_AR::ADASLR_Posn_Spd = %f\n", floatval);
	filePutString (buffer, elcount(buffer), hFile);
	floatval = getSignal(CHASSIS::ADASLR_POSITION_AR::ADASLR_Posn_RelHead);
	snprintf(buffer, elcount(buffer), "   0.000000 F1 EIS::ADASLR_POSITION_AR::ADASLR_Posn_RelHead = %f\n", floatval);
	filePutString (buffer, elcount(buffer), hFile);
	intval = getSignal(CHASSIS::ADASLR_PROFILE_LONG_AR::ADASLR_ProfLong_MsgTyp_SpdCl);
	snprintf(buffer, elcount(buffer), "   0.000000 F1 EIS::ADASLR_PROFILE_LONG_AR::ADASLR_ProfLong_MsgTyp_SpdCl = %d\n", intval);
	filePutString (buffer, elcount(buffer), hFile);
	intval = getSignal(CHASSIS::ADASLR_PROFILE_LONG_AR::ADASLR_ProfLong_Offset_SpdCl);
	snprintf(buffer, elcount(buffer), "   0.000000 F1 EIS::ADASLR_PROFILE_LONG_AR::ADASLR_ProfLong_Offset_SpdCl = %d\n", intval);
	filePutString (buffer, elcount(buffer), hFile);
	intval = getSignal(CHASSIS::ADASLR_PROFILE_LONG_AR::ADASLR_ProfLong_PathIdx_SpdCl);
	snprintf(buffer, elcount(buffer), "   0.000000 F1 EIS::ADASLR_PROFILE_LONG_AR::ADASLR_ProfLong_PathIdx_SpdCl = %d\n", intval);
	filePutString (buffer, elcount(buffer), hFile);
	intval = getSignal(CHASSIS::ADASLR_PROFILE_LONG_AR::ADASLR_ProfLong_CycCnt_SpdCl);
	snprintf(buffer, elcount(buffer), "   0.000000 F1 EIS::ADASLR_PROFILE_LONG_AR::ADASLR_ProfLong_CycCnt_SpdCl = %d\n", intval);
	filePutString (buffer, elcount(buffer), hFile);
	intval = getSignal(CHASSIS::ADASLR_PROFILE_LONG_AR::ADASLR_ProfLong_Updt_SpdCl);
	snprintf(buffer, elcount(buffer), "   0.000000 F1 EIS::ADASLR_PROFILE_LONG_AR::ADASLR_ProfLong_Updt_SpdCl = %d\n", intval);
	filePutString (buffer, elcount(buffer), hFile);
	intval = getSignal(CHASSIS::ADASLR_PROFILE_LONG_AR::ADASLR_ProfLong_ReTr_SpdCl);
	snprintf(buffer, elcount(buffer), "   0.000000 F1 EIS::ADASLR_PROFILE_LONG_AR::ADASLR_ProfLong_ReTr_SpdCl = %d\n", intval);
	filePutString (buffer, elcount(buffer), hFile);
	intval = getSignal(CHASSIS::ADASLR_PROFILE_LONG_AR::ADASLR_ProfLong_CtrlPnt_SpdCl);
	snprintf(buffer, elcount(buffer), "   0.000000 F1 EIS::ADASLR_PROFILE_LONG_AR::ADASLR_ProfLong_CtrlPnt_SpdCl = %d\n", intval);
	filePutString (buffer, elcount(buffer), hFile);
	intval = getSignal(CHASSIS::ADASLR_PROFILE_LONG_AR::ADASLR_ProfLong_Val_SpdCl);
	snprintf(buffer, elcount(buffer), "   0.000000 F1 EIS::ADASLR_PROFILE_LONG_AR::ADASLR_ProfLong_Val_SpdCl = %d\n", intval);
	filePutString (buffer, elcount(buffer), hFile);
	intval = getSignal(CHASSIS::ADASLR_PROFILE_LONG_AR::ADASLR_ProfLong_MsgTyp_Hght);
	snprintf(buffer, elcount(buffer), "   0.000000 F1 EIS::ADASLR_PROFILE_LONG_AR::ADASLR_ProfLong_MsgTyp_Hght = %d\n", intval);
	filePutString (buffer, elcount(buffer), hFile);
	intval = getSignal(CHASSIS::ADASLR_PROFILE_LONG_AR::ADASLR_ProfLong_Offset_Hght);
	snprintf(buffer, elcount(buffer), "   0.000000 F1 EIS::ADASLR_PROFILE_LONG_AR::ADASLR_ProfLong_Offset_Hght = %d\n", intval);
	filePutString (buffer, elcount(buffer), hFile);
	intval = getSignal(CHASSIS::ADASLR_PROFILE_LONG_AR::ADASLR_ProfLong_PathIdx_Hght);
	snprintf(buffer, elcount(buffer), "   0.000000 F1 EIS::ADASLR_PROFILE_LONG_AR::ADASLR_ProfLong_PathIdx_Hght = %d\n", intval);
	filePutString (buffer, elcount(buffer), hFile);
	intval = getSignal(CHASSIS::ADASLR_PROFILE_LONG_AR::ADASLR_ProfLong_CycCnt_Hght);
	snprintf(buffer, elcount(buffer), "   0.000000 F1 EIS::ADASLR_PROFILE_LONG_AR::ADASLR_ProfLong_CycCnt_Hght = %d\n", intval);
	filePutString (buffer, elcount(buffer), hFile);
	intval = getSignal(CHASSIS::ADASLR_PROFILE_LONG_AR::ADASLR_ProfLong_Updt_Hght);
	snprintf(buffer, elcount(buffer), "   0.000000 F1 EIS::ADASLR_PROFILE_LONG_AR::ADASLR_ProfLong_Updt_Hght = %d\n", intval);
	filePutString (buffer, elcount(buffer), hFile);
	intval = getSignal(CHASSIS::ADASLR_PROFILE_LONG_AR::ADASLR_ProfLong_ReTr_Hght);
	snprintf(buffer, elcount(buffer), "   0.000000 F1 EIS::ADASLR_PROFILE_LONG_AR::ADASLR_ProfLong_ReTr_Hght = %d\n", intval);
	filePutString (buffer, elcount(buffer), hFile);
	intval = getSignal(CHASSIS::ADASLR_PROFILE_LONG_AR::ADASLR_ProfLong_CtrlPnt_Hght);
	snprintf(buffer, elcount(buffer), "   0.000000 F1 EIS::ADASLR_PROFILE_LONG_AR::ADASLR_ProfLong_CtrlPnt_Hght = %d\n", intval);
	filePutString (buffer, elcount(buffer), hFile);
	intval = getSignal(CHASSIS::ADASLR_PROFILE_LONG_AR::ADASLR_ProfLong_Val_Hght);
	snprintf(buffer, elcount(buffer), "   0.000000 F1 EIS::ADASLR_PROFILE_LONG_AR::ADASLR_ProfLong_Val_Hght = %d\n", intval);
	filePutString (buffer, elcount(buffer), hFile);
	intval = getSignal(CHASSIS::ADASLR_PROFILE_LONG_AR::ADASLR_ProfLong_MsgTyp_SpecZ);
	snprintf(buffer, elcount(buffer), "   0.000000 F1 EIS::ADASLR_PROFILE_LONG_AR::ADASLR_ProfLong_MsgTyp_SpecZ = %d\n", intval);
	filePutString (buffer, elcount(buffer), hFile);
	intval = getSignal(CHASSIS::ADASLR_PROFILE_LONG_AR::ADASLR_ProfLong_Offset_SpecZ);
	snprintf(buffer, elcount(buffer), "   0.000000 F1 EIS::ADASLR_PROFILE_LONG_AR::ADASLR_ProfLong_Offset_SpecZ = %d\n", intval);
	filePutString (buffer, elcount(buffer), hFile);
	intval = getSignal(CHASSIS::ADASLR_PROFILE_LONG_AR::ADASLR_ProfLong_PathIdx_SpecZ);
	snprintf(buffer, elcount(buffer), "   0.000000 F1 EIS::ADASLR_PROFILE_LONG_AR::ADASLR_ProfLong_PathIdx_SpecZ = %d\n", intval);
	filePutString (buffer, elcount(buffer), hFile);
	intval = getSignal(CHASSIS::ADASLR_PROFILE_LONG_AR::ADASLR_ProfLong_CycCnt_SpecZ);
	snprintf(buffer, elcount(buffer), "   0.000000 F1 EIS::ADASLR_PROFILE_LONG_AR::ADASLR_ProfLong_CycCnt_SpecZ = %d\n", intval);
	filePutString (buffer, elcount(buffer), hFile);
	intval = getSignal(CHASSIS::ADASLR_PROFILE_LONG_AR::ADASLR_ProfLong_Updt_SpecZ);
	snprintf(buffer, elcount(buffer), "   0.000000 F1 EIS::ADASLR_PROFILE_LONG_AR::ADASLR_ProfLong_Updt_SpecZ = %d\n", intval);
	filePutString (buffer, elcount(buffer), hFile);
	intval = getSignal(CHASSIS::ADASLR_PROFILE_LONG_AR::ADASLR_ProfLong_ReTr_SpecZ);
	snprintf(buffer, elcount(buffer), "   0.000000 F1 EIS::ADASLR_PROFILE_LONG_AR::ADASLR_ProfLong_ReTr_SpecZ = %d\n", intval);
	filePutString (buffer, elcount(buffer), hFile);
}
/*@@end*/

/*@@caplFunc:saveVars_24(dword):*/
void saveVars_24(dword hFile)
{
	intval = getSignal(CHASSIS::ADASLR_PROFILE_LONG_AR::ADASLR_ProfLong_CtrlPnt_SpecZ);
	snprintf(buffer, elcount(buffer), "   0.000000 F1 EIS::ADASLR_PROFILE_LONG_AR::ADASLR_ProfLong_CtrlPnt_SpecZ = %d\n", intval);
	filePutString (buffer, elcount(buffer), hFile);
	intval = getSignal(CHASSIS::ADASLR_PROFILE_LONG_AR::ADASLR_ProfLong_Val_SpecZ);
	snprintf(buffer, elcount(buffer), "   0.000000 F1 EIS::ADASLR_PROFILE_LONG_AR::ADASLR_ProfLong_Val_SpecZ = %d\n", intval);
	filePutString (buffer, elcount(buffer), hFile);
	intval = getSignal(CHASSIS::ADASLR_PROFILE_LONG_AR::ADASLR_ProfLong_Dest_SpecZ);
	snprintf(buffer, elcount(buffer), "   0.000000 F1 EIS::ADASLR_PROFILE_LONG_AR::ADASLR_ProfLong_Dest_SpecZ = %d\n", intval);
	filePutString (buffer, elcount(buffer), hFile);
	intval = getSignal(CHASSIS::ADASLR_PROFILE_LONG_AR::ADASLR_ProfLong_BuA_SpecZ);
	snprintf(buffer, elcount(buffer), "   0.000000 F1 EIS::ADASLR_PROFILE_LONG_AR::ADASLR_ProfLong_BuA_SpecZ = %d\n", intval);
	filePutString (buffer, elcount(buffer), hFile);
	intval = getSignal(CHASSIS::ADASLR_PROFILE_LONG_AR::ADASLR_ProfLong_MsgTyp_RestA);
	snprintf(buffer, elcount(buffer), "   0.000000 F1 EIS::ADASLR_PROFILE_LONG_AR::ADASLR_ProfLong_MsgTyp_RestA = %d\n", intval);
	filePutString (buffer, elcount(buffer), hFile);
	intval = getSignal(CHASSIS::ADASLR_PROFILE_LONG_AR::ADASLR_ProfLong_Offset_RestA);
	snprintf(buffer, elcount(buffer), "   0.000000 F1 EIS::ADASLR_PROFILE_LONG_AR::ADASLR_ProfLong_Offset_RestA = %d\n", intval);
	filePutString (buffer, elcount(buffer), hFile);
	intval = getSignal(CHASSIS::ADASLR_PROFILE_LONG_AR::ADASLR_ProfLong_PathIdx_RestA);
	snprintf(buffer, elcount(buffer), "   0.000000 F1 EIS::ADASLR_PROFILE_LONG_AR::ADASLR_ProfLong_PathIdx_RestA = %d\n", intval);
	filePutString (buffer, elcount(buffer), hFile);
	intval = getSignal(CHASSIS::ADASLR_PROFILE_LONG_AR::ADASLR_ProfLong_CycCnt_RestA);
	snprintf(buffer, elcount(buffer), "   0.000000 F1 EIS::ADASLR_PROFILE_LONG_AR::ADASLR_ProfLong_CycCnt_RestA = %d\n", intval);
	filePutString (buffer, elcount(buffer), hFile);
	intval = getSignal(CHASSIS::ADASLR_PROFILE_LONG_AR::ADASLR_ProfLong_Updt_RestA);
	snprintf(buffer, elcount(buffer), "   0.000000 F1 EIS::ADASLR_PROFILE_LONG_AR::ADASLR_ProfLong_Updt_RestA = %d\n", intval);
	filePutString (buffer, elcount(buffer), hFile);
	intval = getSignal(CHASSIS::ADASLR_PROFILE_LONG_AR::ADASLR_ProfLong_ReTr_RestA);
	snprintf(buffer, elcount(buffer), "   0.000000 F1 EIS::ADASLR_PROFILE_LONG_AR::ADASLR_ProfLong_ReTr_RestA = %d\n", intval);
	filePutString (buffer, elcount(buffer), hFile);
	intval = getSignal(CHASSIS::ADASLR_PROFILE_LONG_AR::ADASLR_ProfLong_CtrlPnt_RestA);
	snprintf(buffer, elcount(buffer), "   0.000000 F1 EIS::ADASLR_PROFILE_LONG_AR::ADASLR_ProfLong_CtrlPnt_RestA = %d\n", intval);
	filePutString (buffer, elcount(buffer), hFile);
	intval = getSignal(CHASSIS::ADASLR_PROFILE_LONG_AR::ADASLR_ProfLong_Val_RestA);
	snprintf(buffer, elcount(buffer), "   0.000000 F1 EIS::ADASLR_PROFILE_LONG_AR::ADASLR_ProfLong_Val_RestA = %d\n", intval);
	filePutString (buffer, elcount(buffer), hFile);
	intval = getSignal(CHASSIS::ADASLR_PROFILE_LONG_AR::ADASLR_ProfLong_MsgTyp_PTData);
	snprintf(buffer, elcount(buffer), "   0.000000 F1 EIS::ADASLR_PROFILE_LONG_AR::ADASLR_ProfLong_MsgTyp_PTData = %d\n", intval);
	filePutString (buffer, elcount(buffer), hFile);
	intval = getSignal(CHASSIS::ADASLR_PROFILE_LONG_AR::ADASLR_ProfLong_Offset_PTData);
	snprintf(buffer, elcount(buffer), "   0.000000 F1 EIS::ADASLR_PROFILE_LONG_AR::ADASLR_ProfLong_Offset_PTData = %d\n", intval);
	filePutString (buffer, elcount(buffer), hFile);
	intval = getSignal(CHASSIS::ADASLR_PROFILE_LONG_AR::ADASLR_ProfLong_PathIdx_PTData);
	snprintf(buffer, elcount(buffer), "   0.000000 F1 EIS::ADASLR_PROFILE_LONG_AR::ADASLR_ProfLong_PathIdx_PTData = %d\n", intval);
	filePutString (buffer, elcount(buffer), hFile);
	intval = getSignal(CHASSIS::ADASLR_PROFILE_LONG_AR::ADASLR_ProfLong_CycCnt_PTData);
	snprintf(buffer, elcount(buffer), "   0.000000 F1 EIS::ADASLR_PROFILE_LONG_AR::ADASLR_ProfLong_CycCnt_PTData = %d\n", intval);
	filePutString (buffer, elcount(buffer), hFile);
	intval = getSignal(CHASSIS::ADASLR_PROFILE_LONG_AR::ADASLR_ProfLong_Updt_PTData);
	snprintf(buffer, elcount(buffer), "   0.000000 F1 EIS::ADASLR_PROFILE_LONG_AR::ADASLR_ProfLong_Updt_PTData = %d\n", intval);
	filePutString (buffer, elcount(buffer), hFile);
	intval = getSignal(CHASSIS::ADASLR_PROFILE_LONG_AR::ADASLR_ProfLong_ReTr_PTData);
	snprintf(buffer, elcount(buffer), "   0.000000 F1 EIS::ADASLR_PROFILE_LONG_AR::ADASLR_ProfLong_ReTr_PTData = %d\n", intval);
	filePutString (buffer, elcount(buffer), hFile);
	intval = getSignal(CHASSIS::ADASLR_PROFILE_LONG_AR::ADASLR_ProfLong_CtrlPnt_PTData);
	snprintf(buffer, elcount(buffer), "   0.000000 F1 EIS::ADASLR_PROFILE_LONG_AR::ADASLR_ProfLong_CtrlPnt_PTData = %d\n", intval);
	filePutString (buffer, elcount(buffer), hFile);
	intval = getSignal(CHASSIS::ADASLR_PROFILE_LONG_AR::ADASLR_ProfLong_Val_AttrOfst_PTData);
	snprintf(buffer, elcount(buffer), "   0.000000 F1 EIS::ADASLR_PROFILE_LONG_AR::ADASLR_ProfLong_Val_AttrOfst_PTData = %d\n", intval);
	filePutString (buffer, elcount(buffer), hFile);
	intval = getSignal(CHASSIS::ADASLR_PROFILE_LONG_AR::ADASLR_ProfLong_Val_ComRtNum_PTData);
	snprintf(buffer, elcount(buffer), "   0.000000 F1 EIS::ADASLR_PROFILE_LONG_AR::ADASLR_ProfLong_Val_ComRtNum_PTData = %d\n", intval);
	filePutString (buffer, elcount(buffer), hFile);
	intval = getSignal(CHASSIS::ADASLR_PROFILE_LONG_AR::ADASLR_ProfLong_Val_PTData);
	snprintf(buffer, elcount(buffer), "   0.000000 F1 EIS::ADASLR_PROFILE_LONG_AR::ADASLR_ProfLong_Val_PTData = %d\n", intval);
	filePutString (buffer, elcount(buffer), hFile);
	intval = getSignal(CHASSIS::ADASLR_PROFILE_LONG_AR::ADASLR_ProfLong_Val_AttrId_PTData);
	snprintf(buffer, elcount(buffer), "   0.000000 F1 EIS::ADASLR_PROFILE_LONG_AR::ADASLR_ProfLong_Val_AttrId_PTData = %d\n", intval);
	filePutString (buffer, elcount(buffer), hFile);
	intval = getSignal(CHASSIS::ADASLR_PROFILE_LONG_AR::ADASLR_ProfLong_ProfTyp);
	snprintf(buffer, elcount(buffer), "   0.000000 F1 EIS::ADASLR_PROFILE_LONG_AR::ADASLR_ProfLong_ProfTyp = %d\n", intval);
	filePutString (buffer, elcount(buffer), hFile);
	intval = getSignal(CHASSIS::Assyst_Rq_AR2::Assyst_CurrOilQual_Para_V2);
	snprintf(buffer, elcount(buffer), "   0.000000 F1 EIS::Assyst_Rq_AR2::Assyst_CurrOilQual_Para_V2 = %d\n", intval);
	filePutString (buffer, elcount(buffer), hFile);
	intval = getSignal(CHASSIS::Assyst_Rq_AR2::Assyst_Can_SPServ);
	snprintf(buffer, elcount(buffer), "   0.000000 F1 EIS::Assyst_Rq_AR2::Assyst_Can_SPServ = %d\n", intval);
	filePutString (buffer, elcount(buffer), hFile);
	intval = getSignal(CHASSIS::Assyst_Rq_AR2::Assyst_OilQuantMeas_Trgr);
	snprintf(buffer, elcount(buffer), "   0.000000 F1 EIS::Assyst_Rq_AR2::Assyst_OilQuantMeas_Trgr = %d\n", intval);
	filePutString (buffer, elcount(buffer), hFile);
	intval = getSignal(CHASSIS::Assyst_Rq_AR2::Assyst_SP3Serv_Trgr);
	snprintf(buffer, elcount(buffer), "   0.000000 F1 EIS::Assyst_Rq_AR2::Assyst_SP3Serv_Trgr = %d\n", intval);
	filePutString (buffer, elcount(buffer), hFile);
	intval = getSignal(CHASSIS::Assyst_Rq_AR2::Assyst_VehHndOvr_Trgr);
	snprintf(buffer, elcount(buffer), "   0.000000 F1 EIS::Assyst_Rq_AR2::Assyst_VehHndOvr_Trgr = %d\n", intval);
	filePutString (buffer, elcount(buffer), hFile);
	intval = getSignal(CHASSIS::BC_F_Disp_Rq_AR::BrkFldIndLmp_On_Rq);
	snprintf(buffer, elcount(buffer), "   0.000000 F1 EIS::BC_F_Disp_Rq_AR::BrkFldIndLmp_On_Rq = %d\n", intval);
	filePutString (buffer, elcount(buffer), hFile);
	intval = getSignal(CHASSIS::BC_F_Disp_Rq_AR::BrkLnWearIndLmp_On_Rq);
	snprintf(buffer, elcount(buffer), "   0.000000 F1 EIS::BC_F_Disp_Rq_AR::BrkLnWearIndLmp_On_Rq = %d\n", intval);
	filePutString (buffer, elcount(buffer), hFile);
	intval = getSignal(CHASSIS::BC_F_Disp_Rq_AR::CoolIndLmp_On_Rq);
	snprintf(buffer, elcount(buffer), "   0.000000 F1 EIS::BC_F_Disp_Rq_AR::CoolIndLmp_On_Rq = %d\n", intval);
	filePutString (buffer, elcount(buffer), hFile);
	intval = getSignal(CHASSIS::BC_F_Disp_Rq_AR::WashWtrIndLmp_On_Rq);
	snprintf(buffer, elcount(buffer), "   0.000000 F1 EIS::BC_F_Disp_Rq_AR::WashWtrIndLmp_On_Rq = %d\n", intval);
	filePutString (buffer, elcount(buffer), hFile);
	intval = getSignal(CHASSIS::BC_F_Disp_Rq_AR::EngHd_Stat_BC_F);
	snprintf(buffer, elcount(buffer), "   0.000000 F1 EIS::BC_F_Disp_Rq_AR::EngHd_Stat_BC_F = %d\n", intval);
	filePutString (buffer, elcount(buffer), hFile);
	intval = getSignal(CHASSIS::BC_F_Disp_Rq_AR::EngHd_Flt_Stat_BC_F);
	snprintf(buffer, elcount(buffer), "   0.000000 F1 EIS::BC_F_Disp_Rq_AR::EngHd_Flt_Stat_BC_F = %d\n", intval);
	filePutString (buffer, elcount(buffer), hFile);
	intval = getSignal(CHASSIS::BC_F_Disp_Rq_AR::SEB_WarnDisp_Rq);
	snprintf(buffer, elcount(buffer), "   0.000000 F1 EIS::BC_F_Disp_Rq_AR::SEB_WarnDisp_Rq = %d\n", intval);
	filePutString (buffer, elcount(buffer), hFile);
	intval = getSignal(CHASSIS::BC_F_Disp_Rq_AR::SRS_IndLmp_Rq_SEB);
	snprintf(buffer, elcount(buffer), "   0.000000 F1 EIS::BC_F_Disp_Rq_AR::SRS_IndLmp_Rq_SEB = %d\n", intval);
	filePutString (buffer, elcount(buffer), hFile);
	intval = getSignal(CHASSIS::BC_F_Disp_Rq_AR::WashWtrIndLmp_LowTemp_On_Rq);
	snprintf(buffer, elcount(buffer), "   0.000000 F1 EIS::BC_F_Disp_Rq_AR::WashWtrIndLmp_LowTemp_On_Rq = %d\n", intval);
	filePutString (buffer, elcount(buffer), hFile);
	intval = getSignal(CHASSIS::BC_F_Stat1_AR::PwrSup15_On);
	snprintf(buffer, elcount(buffer), "   0.000000 F1 EIS::BC_F_Stat1_AR::PwrSup15_On = %d\n", intval);
	filePutString (buffer, elcount(buffer), hFile);
	intval = getSignal(CHASSIS::BC_F_Stat1_AR::PwrSup15R_On);
	snprintf(buffer, elcount(buffer), "   0.000000 F1 EIS::BC_F_Stat1_AR::PwrSup15R_On = %d\n", intval);
	filePutString (buffer, elcount(buffer), hFile);
	intval = getSignal(CHASSIS::BC_F_Stat1_AR::PwrSup15_On_Diag);
	snprintf(buffer, elcount(buffer), "   0.000000 F1 EIS::BC_F_Stat1_AR::PwrSup15_On_Diag = %d\n", intval);
	filePutString (buffer, elcount(buffer), hFile);
	intval = getSignal(CHASSIS::BC_F_Stat1_AR::PwrSup15R_On_Diag);
	snprintf(buffer, elcount(buffer), "   0.000000 F1 EIS::BC_F_Stat1_AR::PwrSup15R_On_Diag = %d\n", intval);
	filePutString (buffer, elcount(buffer), hFile);
	intval = getSignal(CHASSIS::BC_F_Stat1_AR::ESL_Lk_Appl_BC_F);
	snprintf(buffer, elcount(buffer), "   0.000000 F1 EIS::BC_F_Stat1_AR::ESL_Lk_Appl_BC_F = %d\n", intval);
	filePutString (buffer, elcount(buffer), hFile);
	intval = getSignal(CHASSIS::BC_F_Stat1_AR::DL_Lk_V2);
	snprintf(buffer, elcount(buffer), "   0.000000 F1 EIS::BC_F_Stat1_AR::DL_Lk_V2 = %d\n", intval);
	filePutString (buffer, elcount(buffer), hFile);
	intval = getSignal(CHASSIS::BC_F_Stat1_AR::DrSw_D_Vld_Stat);
	snprintf(buffer, elcount(buffer), "   0.000000 F1 EIS::BC_F_Stat1_AR::DrSw_D_Vld_Stat = %d\n", intval);
	filePutString (buffer, elcount(buffer), hFile);
	intval = getSignal(CHASSIS::BC_F_Stat1_AR::CLkS_Emg_Unlk_Rq);
	snprintf(buffer, elcount(buffer), "   0.000000 F1 EIS::BC_F_Stat1_AR::CLkS_Emg_Unlk_Rq = %d\n", intval);
	filePutString (buffer, elcount(buffer), hFile);
	intval = getSignal(CHASSIS::BC_F_Stat1_AR::CLkS_Akust_Lk_Rq_Stat);
	snprintf(buffer, elcount(buffer), "   0.000000 F1 EIS::BC_F_Stat1_AR::CLkS_Akust_Lk_Rq_Stat = %d\n", intval);
	filePutString (buffer, elcount(buffer), hFile);
	floatval = getSignal(CHASSIS::BC_F_Stat1_AR::AirTemp_Outsd);
	snprintf(buffer, elcount(buffer), "   0.000000 F1 EIS::BC_F_Stat1_AR::AirTemp_Outsd = %f\n", floatval);
	filePutString (buffer, elcount(buffer), hFile);
	intval = getSignal(CHASSIS::BC_F_Stat1_AR::SwIllLvl_Ctrl_Style);
	snprintf(buffer, elcount(buffer), "   0.000000 F1 EIS::BC_F_Stat1_AR::SwIllLvl_Ctrl_Style = %d\n", intval);
	filePutString (buffer, elcount(buffer), hFile);
	intval = getSignal(CHASSIS::BC_F_Stat1_AR::Hrn_On);
	snprintf(buffer, elcount(buffer), "   0.000000 F1 EIS::BC_F_Stat1_AR::Hrn_On = %d\n", intval);
	filePutString (buffer, elcount(buffer), hFile);
	intval = getSignal(CHASSIS::BC_F_Stat1_AR::AirTemp_Outsd_Sens_Stat);
	snprintf(buffer, elcount(buffer), "   0.000000 F1 EIS::BC_F_Stat1_AR::AirTemp_Outsd_Sens_Stat = %d\n", intval);
	filePutString (buffer, elcount(buffer), hFile);
}
/*@@end*/

/*@@caplFunc:saveVars_25(dword):*/
void saveVars_25(dword hFile)
{
	intval = getSignal(CHASSIS::BC_F_Stat1_AR::SwIllLvl_Raw);
	snprintf(buffer, elcount(buffer), "   0.000000 F1 EIS::BC_F_Stat1_AR::SwIllLvl_Raw = %d\n", intval);
	filePutString (buffer, elcount(buffer), hFile);
	intval = getSignal(CHASSIS::BC_F_Stat1_AR::IP_Brt);
	snprintf(buffer, elcount(buffer), "   0.000000 F1 EIS::BC_F_Stat1_AR::IP_Brt = %d\n", intval);
	filePutString (buffer, elcount(buffer), hFile);
	intval = getSignal(CHASSIS::BC_F_Stat1_AR::TSSR_Sw_Stat_OHCM);
	snprintf(buffer, elcount(buffer), "   0.000000 F1 EIS::BC_F_Stat1_AR::TSSR_Sw_Stat_OHCM = %d\n", intval);
	filePutString (buffer, elcount(buffer), hFile);
	intval = getSignal(CHASSIS::BC_F_Stat1_AR::TSSR_RB_Sw_Psd_OHCM);
	snprintf(buffer, elcount(buffer), "   0.000000 F1 EIS::BC_F_Stat1_AR::TSSR_RB_Sw_Psd_OHCM = %d\n", intval);
	filePutString (buffer, elcount(buffer), hFile);
	intval = getSignal(CHASSIS::BC_F_Stat1_AR::TSSR_Cls_Rq);
	snprintf(buffer, elcount(buffer), "   0.000000 F1 EIS::BC_F_Stat1_AR::TSSR_Cls_Rq = %d\n", intval);
	filePutString (buffer, elcount(buffer), hFile);
	intval = getSignal(CHASSIS::BC_F_Stat1_AR::TSSR_RainCls_Event_Info);
	snprintf(buffer, elcount(buffer), "   0.000000 F1 EIS::BC_F_Stat1_AR::TSSR_RainCls_Event_Info = %d\n", intval);
	filePutString (buffer, elcount(buffer), hFile);
	intval = getSignal(CHASSIS::BC_F_Stat2_AR2::BeltHdOvrSw_Psd_V2);
	snprintf(buffer, elcount(buffer), "   0.000000 F1 EIS::BC_F_Stat2_AR2::BeltHdOvrSw_Psd_V2 = %d\n", intval);
	filePutString (buffer, elcount(buffer), hFile);
	intval = getSignal(CHASSIS::BC_F_Stat2_AR2::CPF_Ft_Stat);
	snprintf(buffer, elcount(buffer), "   0.000000 F1 EIS::BC_F_Stat2_AR2::CPF_Ft_Stat = %d\n", intval);
	filePutString (buffer, elcount(buffer), hFile);
	intval = getSignal(CHASSIS::BC_F_Stat2_AR2::BrkLnWear_PreWarn_Actv);
	snprintf(buffer, elcount(buffer), "   0.000000 F1 EIS::BC_F_Stat2_AR2::BrkLnWear_PreWarn_Actv = %d\n", intval);
	filePutString (buffer, elcount(buffer), hFile);
	intval = getSignal(CHASSIS::BC_F_Stat2_AR2::SuspLvlAdjSw_Psd_AMG);
	snprintf(buffer, elcount(buffer), "   0.000000 F1 EIS::BC_F_Stat2_AR2::SuspLvlAdjSw_Psd_AMG = %d\n", intval);
	filePutString (buffer, elcount(buffer), hFile);
	intval = getSignal(CHASSIS::BC_F_Stat2_AR2::RB_R_Sw_Psd_Ft);
	snprintf(buffer, elcount(buffer), "   0.000000 F1 EIS::BC_F_Stat2_AR2::RB_R_Sw_Psd_Ft = %d\n", intval);
	filePutString (buffer, elcount(buffer), hFile);
	intval = getSignal(CHASSIS::BC_F_Stat2_AR2::ParkSw_Psd);
	snprintf(buffer, elcount(buffer), "   0.000000 F1 EIS::BC_F_Stat2_AR2::ParkSw_Psd = %d\n", intval);
	filePutString (buffer, elcount(buffer), hFile);
	intval = getSignal(CHASSIS::BC_F_Stat2_AR2::NV_Sw_Psd);
	snprintf(buffer, elcount(buffer), "   0.000000 F1 EIS::BC_F_Stat2_AR2::NV_Sw_Psd = %d\n", intval);
	filePutString (buffer, elcount(buffer), hFile);
	intval = getSignal(CHASSIS::BC_F_Stat2_AR2::SVS_Sw_Psd);
	snprintf(buffer, elcount(buffer), "   0.000000 F1 EIS::BC_F_Stat2_AR2::SVS_Sw_Psd = %d\n", intval);
	filePutString (buffer, elcount(buffer), hFile);
	intval = getSignal(CHASSIS::BC_F_Stat2_AR2::HUD_Sw_Psd);
	snprintf(buffer, elcount(buffer), "   0.000000 F1 EIS::BC_F_Stat2_AR2::HUD_Sw_Psd = %d\n", intval);
	filePutString (buffer, elcount(buffer), hFile);
	intval = getSignal(CHASSIS::BC_F_Stat2_AR2::HdRst_R_Rq);
	snprintf(buffer, elcount(buffer), "   0.000000 F1 EIS::BC_F_Stat2_AR2::HdRst_R_Rq = %d\n", intval);
	filePutString (buffer, elcount(buffer), hFile);
	intval = getSignal(CHASSIS::BC_F_Stat2_AR2::DTQ_Sw_Md);
	snprintf(buffer, elcount(buffer), "   0.000000 F1 EIS::BC_F_Stat2_AR2::DTQ_Sw_Md = %d\n", intval);
	filePutString (buffer, elcount(buffer), hFile);
	intval = getSignal(CHASSIS::BC_F_Stat2_AR2::LDP_Sw_Md);
	snprintf(buffer, elcount(buffer), "   0.000000 F1 EIS::BC_F_Stat2_AR2::LDP_Sw_Md = %d\n", intval);
	filePutString (buffer, elcount(buffer), hFile);
	intval = getSignal(CHASSIS::BC_F_Stat2_AR2::RLS_AutoPosn);
	snprintf(buffer, elcount(buffer), "   0.000000 F1 EIS::BC_F_Stat2_AR2::RLS_AutoPosn = %d\n", intval);
	filePutString (buffer, elcount(buffer), hFile);
	intval = getSignal(CHASSIS::BC_F_Stat2_AR2::RLS_FogLmp_Ft_Posn);
	snprintf(buffer, elcount(buffer), "   0.000000 F1 EIS::BC_F_Stat2_AR2::RLS_FogLmp_Ft_Posn = %d\n", intval);
	filePutString (buffer, elcount(buffer), hFile);
	intval = getSignal(CHASSIS::BC_F_Stat2_AR2::RLS_FogLmp_R_Posn);
	snprintf(buffer, elcount(buffer), "   0.000000 F1 EIS::BC_F_Stat2_AR2::RLS_FogLmp_R_Posn = %d\n", intval);
	filePutString (buffer, elcount(buffer), hFile);
	intval = getSignal(CHASSIS::BC_F_Stat2_AR2::RLS_LoBm_Posn);
	snprintf(buffer, elcount(buffer), "   0.000000 F1 EIS::BC_F_Stat2_AR2::RLS_LoBm_Posn = %d\n", intval);
	filePutString (buffer, elcount(buffer), hFile);
	intval = getSignal(CHASSIS::BC_F_Stat2_AR2::RLS_PkLmp_Posn_Lt);
	snprintf(buffer, elcount(buffer), "   0.000000 F1 EIS::BC_F_Stat2_AR2::RLS_PkLmp_Posn_Lt = %d\n", intval);
	filePutString (buffer, elcount(buffer), hFile);
	intval = getSignal(CHASSIS::BC_F_Stat2_AR2::RLS_PkLmp_Posn_Rt);
	snprintf(buffer, elcount(buffer), "   0.000000 F1 EIS::BC_F_Stat2_AR2::RLS_PkLmp_Posn_Rt = %d\n", intval);
	filePutString (buffer, elcount(buffer), hFile);
	intval = getSignal(CHASSIS::BC_F_Stat2_AR2::RLS_PosnLmp_Posn);
	snprintf(buffer, elcount(buffer), "   0.000000 F1 EIS::BC_F_Stat2_AR2::RLS_PosnLmp_Posn = %d\n", intval);
	filePutString (buffer, elcount(buffer), hFile);
	intval = getSignal(CHASSIS::BC_F_Stat2_AR2::BMM_Status);
	snprintf(buffer, elcount(buffer), "   0.000000 F1 EIS::BC_F_Stat2_AR2::BMM_Status = %d\n", intval);
	filePutString (buffer, elcount(buffer), hFile);
	intval = getSignal(CHASSIS::BC_R_Stat1_AR::DL_Lch_Psd);
	snprintf(buffer, elcount(buffer), "   0.000000 F1 EIS::BC_R_Stat1_AR::DL_Lch_Psd = %d\n", intval);
	filePutString (buffer, elcount(buffer), hFile);
	intval = getSignal(CHASSIS::BC_R_Stat1_AR::DL_LchTrgr_Actv);
	snprintf(buffer, elcount(buffer), "   0.000000 F1 EIS::BC_R_Stat1_AR::DL_LchTrgr_Actv = %d\n", intval);
	filePutString (buffer, elcount(buffer), hFile);
	intval = getSignal(CHASSIS::BC_R_Stat1_AR::DL2_Sw_Psd);
	snprintf(buffer, elcount(buffer), "   0.000000 F1 EIS::BC_R_Stat1_AR::DL2_Sw_Psd = %d\n", intval);
	filePutString (buffer, elcount(buffer), hFile);
	intval = getSignal(CHASSIS::BC_R_Stat1_AR::DL_Lk_Ovruse_Prot_Actv);
	snprintf(buffer, elcount(buffer), "   0.000000 F1 EIS::BC_R_Stat1_AR::DL_Lk_Ovruse_Prot_Actv = %d\n", intval);
	filePutString (buffer, elcount(buffer), hFile);
	intval = getSignal(CHASSIS::BC_R_Stat1_AR::DL_RLtch_Stat);
	snprintf(buffer, elcount(buffer), "   0.000000 F1 EIS::BC_R_Stat1_AR::DL_RLtch_Stat = %d\n", intval);
	filePutString (buffer, elcount(buffer), hFile);
	intval = getSignal(CHASSIS::BC_R_Stat1_AR::DL_Sw_Psd);
	snprintf(buffer, elcount(buffer), "   0.000000 F1 EIS::BC_R_Stat1_AR::DL_Sw_Psd = %d\n", intval);
	filePutString (buffer, elcount(buffer), hFile);
	intval = getSignal(CHASSIS::BC_R_Stat1_AR::DL_SwCls_Psd);
	snprintf(buffer, elcount(buffer), "   0.000000 F1 EIS::BC_R_Stat1_AR::DL_SwCls_Psd = %d\n", intval);
	filePutString (buffer, elcount(buffer), hFile);
	intval = getSignal(CHASSIS::BC_R_Stat1_AR::DL_SwLkCls_Psd);
	snprintf(buffer, elcount(buffer), "   0.000000 F1 EIS::BC_R_Stat1_AR::DL_SwLkCls_Psd = %d\n", intval);
	filePutString (buffer, elcount(buffer), hFile);
	intval = getSignal(CHASSIS::BC_R_Stat1_AR::RB_R_Stat_V2);
	snprintf(buffer, elcount(buffer), "   0.000000 F1 EIS::BC_R_Stat1_AR::RB_R_Stat_V2 = %d\n", intval);
	filePutString (buffer, elcount(buffer), hFile);
	intval = getSignal(CHASSIS::BC_R_Stat1_AR::BrkLnWear_R);
	snprintf(buffer, elcount(buffer), "   0.000000 F1 EIS::BC_R_Stat1_AR::BrkLnWear_R = %d\n", intval);
	filePutString (buffer, elcount(buffer), hFile);
	intval = getSignal(CHASSIS::BC_R_Stat1_AR::Term54_Actv);
	snprintf(buffer, elcount(buffer), "   0.000000 F1 EIS::BC_R_Stat1_AR::Term54_Actv = %d\n", intval);
	filePutString (buffer, elcount(buffer), hFile);
	intval = getSignal(CHASSIS::BC_R_Stat1_AR::BgC_Sw_Psd);
	snprintf(buffer, elcount(buffer), "   0.000000 F1 EIS::BC_R_Stat1_AR::BgC_Sw_Psd = %d\n", intval);
	filePutString (buffer, elcount(buffer), hFile);
	intval = getSignal(CHASSIS::BC_R_Stat1_AR::Wpr_R_OutsdPkPosn);
	snprintf(buffer, elcount(buffer), "   0.000000 F1 EIS::BC_R_Stat1_AR::Wpr_R_OutsdPkPosn = %d\n", intval);
	filePutString (buffer, elcount(buffer), hFile);
	intval = getSignal(CHASSIS::BC_R_Stat1_AR::EBL_Stat);
	snprintf(buffer, elcount(buffer), "   0.000000 F1 EIS::BC_R_Stat1_AR::EBL_Stat = %d\n", intval);
	filePutString (buffer, elcount(buffer), hFile);
	intval = getSignal(CHASSIS::BC_R_Stat1_AR::Bckl_Sw_RL_Stat_SAM_R);
	snprintf(buffer, elcount(buffer), "   0.000000 F1 EIS::BC_R_Stat1_AR::Bckl_Sw_RL_Stat_SAM_R = %d\n", intval);
	filePutString (buffer, elcount(buffer), hFile);
	intval = getSignal(CHASSIS::BC_R_Stat1_AR::Bckl_Sw_RM_Stat_SAM_R);
	snprintf(buffer, elcount(buffer), "   0.000000 F1 EIS::BC_R_Stat1_AR::Bckl_Sw_RM_Stat_SAM_R = %d\n", intval);
	filePutString (buffer, elcount(buffer), hFile);
	intval = getSignal(CHASSIS::BC_R_Stat1_AR::Bckl_Sw_RR_Stat_SAM_R);
	snprintf(buffer, elcount(buffer), "   0.000000 F1 EIS::BC_R_Stat1_AR::Bckl_Sw_RR_Stat_SAM_R = %d\n", intval);
	filePutString (buffer, elcount(buffer), hFile);
	intval = getSignal(CHASSIS::BC_R_Stat1_AR::Bckl_Sw_3L_Stat_SAM_R);
	snprintf(buffer, elcount(buffer), "   0.000000 F1 EIS::BC_R_Stat1_AR::Bckl_Sw_3L_Stat_SAM_R = %d\n", intval);
	filePutString (buffer, elcount(buffer), hFile);
	intval = getSignal(CHASSIS::BC_R_Stat1_AR::Bckl_Sw_3R_Stat_SAM_R);
	snprintf(buffer, elcount(buffer), "   0.000000 F1 EIS::BC_R_Stat1_AR::Bckl_Sw_3R_Stat_SAM_R = %d\n", intval);
	filePutString (buffer, elcount(buffer), hFile);
	intval = getSignal(CHASSIS::BC_R_Stat1_AR::SeatBkRst_RL_Stat);
	snprintf(buffer, elcount(buffer), "   0.000000 F1 EIS::BC_R_Stat1_AR::SeatBkRst_RL_Stat = %d\n", intval);
	filePutString (buffer, elcount(buffer), hFile);
	intval = getSignal(CHASSIS::BC_R_Stat1_AR::SeatBkRst_RR_Stat);
	snprintf(buffer, elcount(buffer), "   0.000000 F1 EIS::BC_R_Stat1_AR::SeatBkRst_RR_Stat = %d\n", intval);
	filePutString (buffer, elcount(buffer), hFile);
	intval = getSignal(CHASSIS::BC_R_Stat1_AR::SeatBkRst_FL_Stat);
	snprintf(buffer, elcount(buffer), "   0.000000 F1 EIS::BC_R_Stat1_AR::SeatBkRst_FL_Stat = %d\n", intval);
	filePutString (buffer, elcount(buffer), hFile);
	intval = getSignal(CHASSIS::BC_R_Stat1_AR::SeatBkRst_FR_Stat);
	snprintf(buffer, elcount(buffer), "   0.000000 F1 EIS::BC_R_Stat1_AR::SeatBkRst_FR_Stat = %d\n", intval);
	filePutString (buffer, elcount(buffer), hFile);
	intval = @sysvar::CH_Nodes::CH_EISBckl_Sw_3L_SAM_R_TglB_AUTO;
	snprintf(buffer, elcount(buffer), "   0.000000    SV: 2 0 0 ::CH_Nodes::CH_EISBckl_Sw_3L_SAM_R_TglB_AUTO = %d\n", intval);
	filePutString (buffer, elcount(buffer), hFile);
	intval = getSignal(CHASSIS::BC_R_Stat1_AR::Bckl_Sw_3L_SAM_R_Tgl);
	snprintf(buffer, elcount(buffer), "   0.000000 F1 EIS::BC_R_Stat1_AR::Bckl_Sw_3L_SAM_R_Tgl = %d\n", intval);
	filePutString (buffer, elcount(buffer), hFile);
	intval = getSignal(CHASSIS::BC_R_Stat1_AR::Parity_Bckl_Sw_3L_SAM_R);
	snprintf(buffer, elcount(buffer), "   0.000000 F1 EIS::BC_R_Stat1_AR::Parity_Bckl_Sw_3L_SAM_R = %d\n", intval);
	filePutString (buffer, elcount(buffer), hFile);
}
/*@@end*/

/*@@caplFunc:saveVars_26(dword):*/
void saveVars_26(dword hFile)
{
	intval = @sysvar::CH_Nodes::CH_EISBckl_Sw_3R_SAM_R_TglB_AUTO;
	snprintf(buffer, elcount(buffer), "   0.000000    SV: 2 0 0 ::CH_Nodes::CH_EISBckl_Sw_3R_SAM_R_TglB_AUTO = %d\n", intval);
	filePutString (buffer, elcount(buffer), hFile);
	intval = getSignal(CHASSIS::BC_R_Stat1_AR::Bckl_Sw_3R_SAM_R_Tgl);
	snprintf(buffer, elcount(buffer), "   0.000000 F1 EIS::BC_R_Stat1_AR::Bckl_Sw_3R_SAM_R_Tgl = %d\n", intval);
	filePutString (buffer, elcount(buffer), hFile);
	intval = getSignal(CHASSIS::BC_R_Stat1_AR::Parity_Bckl_Sw_3R_SAM_R);
	snprintf(buffer, elcount(buffer), "   0.000000 F1 EIS::BC_R_Stat1_AR::Parity_Bckl_Sw_3R_SAM_R = %d\n", intval);
	filePutString (buffer, elcount(buffer), hFile);
	intval = @sysvar::CH_Nodes::CH_EISBckl_Sw_RL_SAM_R_TglB_AUTO;
	snprintf(buffer, elcount(buffer), "   0.000000    SV: 2 0 0 ::CH_Nodes::CH_EISBckl_Sw_RL_SAM_R_TglB_AUTO = %d\n", intval);
	filePutString (buffer, elcount(buffer), hFile);
	intval = getSignal(CHASSIS::BC_R_Stat1_AR::Bckl_Sw_RL_SAM_R_Tgl);
	snprintf(buffer, elcount(buffer), "   0.000000 F1 EIS::BC_R_Stat1_AR::Bckl_Sw_RL_SAM_R_Tgl = %d\n", intval);
	filePutString (buffer, elcount(buffer), hFile);
	intval = getSignal(CHASSIS::BC_R_Stat1_AR::Parity_Bckl_Sw_RL_SAM_R);
	snprintf(buffer, elcount(buffer), "   0.000000 F1 EIS::BC_R_Stat1_AR::Parity_Bckl_Sw_RL_SAM_R = %d\n", intval);
	filePutString (buffer, elcount(buffer), hFile);
	intval = @sysvar::CH_Nodes::CH_EISBckl_Sw_RM_SAM_R_TglB_AUTO;
	snprintf(buffer, elcount(buffer), "   0.000000    SV: 2 0 0 ::CH_Nodes::CH_EISBckl_Sw_RM_SAM_R_TglB_AUTO = %d\n", intval);
	filePutString (buffer, elcount(buffer), hFile);
	intval = getSignal(CHASSIS::BC_R_Stat1_AR::Bckl_Sw_RM_SAM_R_Tgl);
	snprintf(buffer, elcount(buffer), "   0.000000 F1 EIS::BC_R_Stat1_AR::Bckl_Sw_RM_SAM_R_Tgl = %d\n", intval);
	filePutString (buffer, elcount(buffer), hFile);
	intval = getSignal(CHASSIS::BC_R_Stat1_AR::Parity_Bckl_Sw_RM_SAM_R);
	snprintf(buffer, elcount(buffer), "   0.000000 F1 EIS::BC_R_Stat1_AR::Parity_Bckl_Sw_RM_SAM_R = %d\n", intval);
	filePutString (buffer, elcount(buffer), hFile);
	intval = @sysvar::CH_Nodes::CH_EISBckl_Sw_RR_SAM_R_TglB_AUTO;
	snprintf(buffer, elcount(buffer), "   0.000000    SV: 2 0 0 ::CH_Nodes::CH_EISBckl_Sw_RR_SAM_R_TglB_AUTO = %d\n", intval);
	filePutString (buffer, elcount(buffer), hFile);
	intval = getSignal(CHASSIS::BC_R_Stat1_AR::Bckl_Sw_RR_SAM_R_Tgl);
	snprintf(buffer, elcount(buffer), "   0.000000 F1 EIS::BC_R_Stat1_AR::Bckl_Sw_RR_SAM_R_Tgl = %d\n", intval);
	filePutString (buffer, elcount(buffer), hFile);
	intval = getSignal(CHASSIS::BC_R_Stat1_AR::Parity_Bckl_Sw_RR_SAM_R);
	snprintf(buffer, elcount(buffer), "   0.000000 F1 EIS::BC_R_Stat1_AR::Parity_Bckl_Sw_RR_SAM_R = %d\n", intval);
	filePutString (buffer, elcount(buffer), hFile);
	intval = getSignal(CHASSIS::BC_R_Stat1_AR::SeatBkRst_RM_Stat);
	snprintf(buffer, elcount(buffer), "   0.000000 F1 EIS::BC_R_Stat1_AR::SeatBkRst_RM_Stat = %d\n", intval);
	filePutString (buffer, elcount(buffer), hFile);
	intval = getSignal(CHASSIS::BC_R_Stat1_AR::EmgLgt_Term15_In_Stat);
	snprintf(buffer, elcount(buffer), "   0.000000 F1 EIS::BC_R_Stat1_AR::EmgLgt_Term15_In_Stat = %d\n", intval);
	filePutString (buffer, elcount(buffer), hFile);
	intval = getSignal(CHASSIS::BC_R_Stat1_AR::RemTank_Unlk_Stat);
	snprintf(buffer, elcount(buffer), "   0.000000 F1 EIS::BC_R_Stat1_AR::RemTank_Unlk_Stat = %d\n", intval);
	filePutString (buffer, elcount(buffer), hFile);
	intval = getSignal(CHASSIS::BC_R_Stat1_AR::CPF_R_Stat);
	snprintf(buffer, elcount(buffer), "   0.000000 F1 EIS::BC_R_Stat1_AR::CPF_R_Stat = %d\n", intval);
	filePutString (buffer, elcount(buffer), hFile);
	intval = getSignal(CHASSIS::BC_R_Stat1_AR::DL1_Sw_Psd);
	snprintf(buffer, elcount(buffer), "   0.000000 F1 EIS::BC_R_Stat1_AR::DL1_Sw_Psd = %d\n", intval);
	filePutString (buffer, elcount(buffer), hFile);
	intval = getSignal(CHASSIS::BC_R_Stat1_AR::DL_RemActn_3rdRow_Stat);
	snprintf(buffer, elcount(buffer), "   0.000000 F1 EIS::BC_R_Stat1_AR::DL_RemActn_3rdRow_Stat = %d\n", intval);
	filePutString (buffer, elcount(buffer), hFile);
	intval = getSignal(CHASSIS::BLSM_Disp_Stat_AR::BrkLnServMd_MsgDisp_Ack);
	snprintf(buffer, elcount(buffer), "   0.000000 F1 EIS::BLSM_Disp_Stat_AR::BrkLnServMd_MsgDisp_Ack = %d\n", intval);
	filePutString (buffer, elcount(buffer), hFile);
	intval = getSignal(CHASSIS::BLSM_Disp_Stat_AR::BrkLnServMd_Actv);
	snprintf(buffer, elcount(buffer), "   0.000000 F1 EIS::BLSM_Disp_Stat_AR::BrkLnServMd_Actv = %d\n", intval);
	filePutString (buffer, elcount(buffer), hFile);
	intval = getSignal(CHASSIS::BLSM_Disp_Stat_AR::BrkLnServMd_Up_Psd);
	snprintf(buffer, elcount(buffer), "   0.000000 F1 EIS::BLSM_Disp_Stat_AR::BrkLnServMd_Up_Psd = %d\n", intval);
	filePutString (buffer, elcount(buffer), hFile);
	intval = getSignal(CHASSIS::BLSM_Disp_Stat_AR::BrkLnServMd_Dn_Psd);
	snprintf(buffer, elcount(buffer), "   0.000000 F1 EIS::BLSM_Disp_Stat_AR::BrkLnServMd_Dn_Psd = %d\n", intval);
	filePutString (buffer, elcount(buffer), hFile);
	intval = getSignal(CHASSIS::BLSM_Disp_Stat_AR::BrkLnServMd_Lt_Psd);
	snprintf(buffer, elcount(buffer), "   0.000000 F1 EIS::BLSM_Disp_Stat_AR::BrkLnServMd_Lt_Psd = %d\n", intval);
	filePutString (buffer, elcount(buffer), hFile);
	intval = getSignal(CHASSIS::BLSM_Disp_Stat_AR::BrkLnServMd_Rt_Psd);
	snprintf(buffer, elcount(buffer), "   0.000000 F1 EIS::BLSM_Disp_Stat_AR::BrkLnServMd_Rt_Psd = %d\n", intval);
	filePutString (buffer, elcount(buffer), hFile);
	intval = getSignal(CHASSIS::BLSM_Disp_Stat_AR::BrkLnServMd_Ok_Psd);
	snprintf(buffer, elcount(buffer), "   0.000000 F1 EIS::BLSM_Disp_Stat_AR::BrkLnServMd_Ok_Psd = %d\n", intval);
	filePutString (buffer, elcount(buffer), hFile);
	intval = getSignal(CHASSIS::BLSM_Disp_Stat_AR::BrkLnServMd_Back_Psd);
	snprintf(buffer, elcount(buffer), "   0.000000 F1 EIS::BLSM_Disp_Stat_AR::BrkLnServMd_Back_Psd = %d\n", intval);
	filePutString (buffer, elcount(buffer), hFile);
	intval = getSignal(CHASSIS::BODY_CHASSIS_R1_AR::TSSR_Ft_Stat);
	snprintf(buffer, elcount(buffer), "   0.000000 F1 EIS::BODY_CHASSIS_R1_AR::TSSR_Ft_Stat = %d\n", intval);
	filePutString (buffer, elcount(buffer), hFile);
	intval = getSignal(CHASSIS::BODY_CHASSIS_R1_AR::PW_FL_Posn_Stat);
	snprintf(buffer, elcount(buffer), "   0.000000 F1 EIS::BODY_CHASSIS_R1_AR::PW_FL_Posn_Stat = %d\n", intval);
	filePutString (buffer, elcount(buffer), hFile);
	intval = getSignal(CHASSIS::BODY_CHASSIS_R1_AR::PW_FR_Posn_Stat);
	snprintf(buffer, elcount(buffer), "   0.000000 F1 EIS::BODY_CHASSIS_R1_AR::PW_FR_Posn_Stat = %d\n", intval);
	filePutString (buffer, elcount(buffer), hFile);
	intval = getSignal(CHASSIS::BODY_CHASSIS_R1_AR::PW_RL_Posn_Stat);
	snprintf(buffer, elcount(buffer), "   0.000000 F1 EIS::BODY_CHASSIS_R1_AR::PW_RL_Posn_Stat = %d\n", intval);
	filePutString (buffer, elcount(buffer), hFile);
	intval = getSignal(CHASSIS::BODY_CHASSIS_R1_AR::PW_RR_Posn_Stat);
	snprintf(buffer, elcount(buffer), "   0.000000 F1 EIS::BODY_CHASSIS_R1_AR::PW_RR_Posn_Stat = %d\n", intval);
	filePutString (buffer, elcount(buffer), hFile);
	floatval = getSignal(CHASSIS::BSM_Disp_Warn_Rq_AR2::BSM_ObjCls_Lt_Dist_Y);
	snprintf(buffer, elcount(buffer), "   0.000000 F1 EIS::BSM_Disp_Warn_Rq_AR2::BSM_ObjCls_Lt_Dist_Y = %f\n", floatval);
	filePutString (buffer, elcount(buffer), hFile);
	floatval = getSignal(CHASSIS::BSM_Disp_Warn_Rq_AR2::BSM_ObjCls_Rt_Dist_Y);
	snprintf(buffer, elcount(buffer), "   0.000000 F1 EIS::BSM_Disp_Warn_Rq_AR2::BSM_ObjCls_Rt_Dist_Y = %f\n", floatval);
	filePutString (buffer, elcount(buffer), hFile);
	intval = getSignal(CHASSIS::BSM_Disp_Warn_Rq_AR2::BSM_ObjCls_Lt_Type);
	snprintf(buffer, elcount(buffer), "   0.000000 F1 EIS::BSM_Disp_Warn_Rq_AR2::BSM_ObjCls_Lt_Type = %d\n", intval);
	filePutString (buffer, elcount(buffer), hFile);
	intval = getSignal(CHASSIS::BSM_Disp_Warn_Rq_AR2::BSM_ObjCls_Rt_Type);
	snprintf(buffer, elcount(buffer), "   0.000000 F1 EIS::BSM_Disp_Warn_Rq_AR2::BSM_ObjCls_Rt_Type = %d\n", intval);
	filePutString (buffer, elcount(buffer), hFile);
	intval = getSignal(CHASSIS::BSM_Disp_Warn_Rq_AR2::BSM_Md_Stat);
	snprintf(buffer, elcount(buffer), "   0.000000 F1 EIS::BSM_Disp_Warn_Rq_AR2::BSM_Md_Stat = %d\n", intval);
	filePutString (buffer, elcount(buffer), hFile);
	intval = getSignal(CHASSIS::BSM_Disp_Warn_Rq_AR2::CTA_Brk_Rq);
	snprintf(buffer, elcount(buffer), "   0.000000 F1 EIS::BSM_Disp_Warn_Rq_AR2::CTA_Brk_Rq = %d\n", intval);
	filePutString (buffer, elcount(buffer), hFile);
	intval = getSignal(CHASSIS::BSM_Disp_Warn_Rq_AR2::CTA_Stat);
	snprintf(buffer, elcount(buffer), "   0.000000 F1 EIS::BSM_Disp_Warn_Rq_AR2::CTA_Stat = %d\n", intval);
	filePutString (buffer, elcount(buffer), hFile);
	intval = getSignal(CHASSIS::BSM_Disp_Warn_Rq_AR2::CTA_Warn_Lt_Rq);
	snprintf(buffer, elcount(buffer), "   0.000000 F1 EIS::BSM_Disp_Warn_Rq_AR2::CTA_Warn_Lt_Rq = %d\n", intval);
	filePutString (buffer, elcount(buffer), hFile);
	intval = getSignal(CHASSIS::BSM_Disp_Warn_Rq_AR2::CTA_Warn_Rt_Rq);
	snprintf(buffer, elcount(buffer), "   0.000000 F1 EIS::BSM_Disp_Warn_Rq_AR2::CTA_Warn_Rt_Rq = %d\n", intval);
	filePutString (buffer, elcount(buffer), hFile);
	intval = getSignal(CHASSIS::BSM_Disp_Warn_Rq_AR2::BSM_MsgDisp_Rq);
	snprintf(buffer, elcount(buffer), "   0.000000 F1 EIS::BSM_Disp_Warn_Rq_AR2::BSM_MsgDisp_Rq = %d\n", intval);
	filePutString (buffer, elcount(buffer), hFile);
	intval = getSignal(CHASSIS::BSM_Disp_Warn_Rq_AR2::BSM_AcustWarn_Rt_Rq);
	snprintf(buffer, elcount(buffer), "   0.000000 F1 EIS::BSM_Disp_Warn_Rq_AR2::BSM_AcustWarn_Rt_Rq = %d\n", intval);
	filePutString (buffer, elcount(buffer), hFile);
	intval = getSignal(CHASSIS::BSM_Disp_Warn_Rq_AR2::BSM_Stat);
	snprintf(buffer, elcount(buffer), "   0.000000 F1 EIS::BSM_Disp_Warn_Rq_AR2::BSM_Stat = %d\n", intval);
	filePutString (buffer, elcount(buffer), hFile);
	intval = getSignal(CHASSIS::BSM_Disp_Warn_Rq_AR2::BSM_AcustWarn_Rq);
	snprintf(buffer, elcount(buffer), "   0.000000 F1 EIS::BSM_Disp_Warn_Rq_AR2::BSM_AcustWarn_Rq = %d\n", intval);
	filePutString (buffer, elcount(buffer), hFile);
	intval = getSignal(CHASSIS::BSM_Disp_Warn_Rq_AR2::BSM_AcustWarn_Lt_Rq);
	snprintf(buffer, elcount(buffer), "   0.000000 F1 EIS::BSM_Disp_Warn_Rq_AR2::BSM_AcustWarn_Lt_Rq = %d\n", intval);
	filePutString (buffer, elcount(buffer), hFile);
	intval = getSignal(CHASSIS::BSM_Disp_Warn_Rq_AR2::LCMS_BrkMsgDisp_Rq);
	snprintf(buffer, elcount(buffer), "   0.000000 F1 EIS::BSM_Disp_Warn_Rq_AR2::LCMS_BrkMsgDisp_Rq = %d\n", intval);
	filePutString (buffer, elcount(buffer), hFile);
	intval = getSignal(CHASSIS::BSM_Disp_Warn_Rq_AR2::LCMS_MsgDisp_Rq);
	snprintf(buffer, elcount(buffer), "   0.000000 F1 EIS::BSM_Disp_Warn_Rq_AR2::LCMS_MsgDisp_Rq = %d\n", intval);
	filePutString (buffer, elcount(buffer), hFile);
	intval = getSignal(CHASSIS::BSM_Disp_Warn_Rq_AR2::LCMS_Beep_Rq);
	snprintf(buffer, elcount(buffer), "   0.000000 F1 EIS::BSM_Disp_Warn_Rq_AR2::LCMS_Beep_Rq = %d\n", intval);
	filePutString (buffer, elcount(buffer), hFile);
	intval = getSignal(CHASSIS::BSM_Disp_Warn_Rq_AR2::BSM_Warn_Lt_Rq);
	snprintf(buffer, elcount(buffer), "   0.000000 F1 EIS::BSM_Disp_Warn_Rq_AR2::BSM_Warn_Lt_Rq = %d\n", intval);
	filePutString (buffer, elcount(buffer), hFile);
	intval = getSignal(CHASSIS::BSM_Disp_Warn_Rq_AR2::BSM_Warn_Rt_Rq);
	snprintf(buffer, elcount(buffer), "   0.000000 F1 EIS::BSM_Disp_Warn_Rq_AR2::BSM_Warn_Rt_Rq = %d\n", intval);
	filePutString (buffer, elcount(buffer), hFile);
	intval = @sysvar::CH_Nodes::CH_EISCRC_CamLane_Disp_Warn_AUTO;
	snprintf(buffer, elcount(buffer), "   0.000000    SV: 2 0 0 ::CH_Nodes::CH_EISCRC_CamLane_Disp_Warn_AUTO = %d\n", intval);
	filePutString (buffer, elcount(buffer), hFile);
	intval = getSignal(CHASSIS::CamLane_Disp_Warn_Rq_AR2::CRC_CamLane_Disp_Warn_Rq_Pr2);
	snprintf(buffer, elcount(buffer), "   0.000000 F1 EIS::CamLane_Disp_Warn_Rq_AR2::CRC_CamLane_Disp_Warn_Rq_Pr2 = %d\n", intval);
	filePutString (buffer, elcount(buffer), hFile);
	intval = @sysvar::CH_Nodes::CH_EISSQC_CamLane_Disp_Warn_AUTO;
	snprintf(buffer, elcount(buffer), "   0.000000    SV: 2 0 0 ::CH_Nodes::CH_EISSQC_CamLane_Disp_Warn_AUTO = %d\n", intval);
	filePutString (buffer, elcount(buffer), hFile);
	intval = getSignal(CHASSIS::CamLane_Disp_Warn_Rq_AR2::SQC_CamLane_Disp_Warn_Rq_Pr2);
	snprintf(buffer, elcount(buffer), "   0.000000 F1 EIS::CamLane_Disp_Warn_Rq_AR2::SQC_CamLane_Disp_Warn_Rq_Pr2 = %d\n", intval);
	filePutString (buffer, elcount(buffer), hFile);
	intval = getSignal(CHASSIS::CamLane_Disp_Warn_Rq_AR2::PavemntSign_Type_EgoLane);
	snprintf(buffer, elcount(buffer), "   0.000000 F1 EIS::CamLane_Disp_Warn_Rq_AR2::PavemntSign_Type_EgoLane = %d\n", intval);
	filePutString (buffer, elcount(buffer), hFile);
	floatval = getSignal(CHASSIS::CamLane_Disp_Warn_Rq_AR2::CrossWalk_Dist);
	snprintf(buffer, elcount(buffer), "   0.000000 F1 EIS::CamLane_Disp_Warn_Rq_AR2::CrossWalk_Dist = %f\n", floatval);
	filePutString (buffer, elcount(buffer), hFile);
	intval = getSignal(CHASSIS::CamLane_Disp_Warn_Rq_AR2::CrossWalk_Stat);
	snprintf(buffer, elcount(buffer), "   0.000000 F1 EIS::CamLane_Disp_Warn_Rq_AR2::CrossWalk_Stat = %d\n", intval);
	filePutString (buffer, elcount(buffer), hFile);
}
/*@@end*/

/*@@caplFunc:saveVars_27(dword):*/
void saveVars_27(dword hFile)
{
	intval = getSignal(CHASSIS::CamLane_Disp_Warn_Rq_AR2::LDP_IndLmp_SwLED_HU_Rq_MPC);
	snprintf(buffer, elcount(buffer), "   0.000000 F1 EIS::CamLane_Disp_Warn_Rq_AR2::LDP_IndLmp_SwLED_HU_Rq_MPC = %d\n", intval);
	filePutString (buffer, elcount(buffer), hFile);
	intval = getSignal(CHASSIS::CamLane_Disp_Warn_Rq_AR2::LDP_MPC_MsgDisp_Rq);
	snprintf(buffer, elcount(buffer), "   0.000000 F1 EIS::CamLane_Disp_Warn_Rq_AR2::LDP_MPC_MsgDisp_Rq = %d\n", intval);
	filePutString (buffer, elcount(buffer), hFile);
	floatval = getSignal(CHASSIS::CamLane_Disp_Warn_Rq_AR2::PavemntSign_LtrlDist_EgoLane);
	snprintf(buffer, elcount(buffer), "   0.000000 F1 EIS::CamLane_Disp_Warn_Rq_AR2::PavemntSign_LtrlDist_EgoLane = %f\n", floatval);
	filePutString (buffer, elcount(buffer), hFile);
	floatval = getSignal(CHASSIS::CamLane_Disp_Warn_Rq_AR2::PavemntSign_LtrlDist_NghbrLane);
	snprintf(buffer, elcount(buffer), "   0.000000 F1 EIS::CamLane_Disp_Warn_Rq_AR2::PavemntSign_LtrlDist_NghbrLane = %f\n", floatval);
	filePutString (buffer, elcount(buffer), hFile);
	intval = getSignal(CHASSIS::CamLane_Disp_Warn_Rq_AR2::PavemntSign_Type_NghbrLane);
	snprintf(buffer, elcount(buffer), "   0.000000 F1 EIS::CamLane_Disp_Warn_Rq_AR2::PavemntSign_Type_NghbrLane = %d\n", intval);
	filePutString (buffer, elcount(buffer), hFile);
	intval = getSignal(CHASSIS::CamLane_Disp_Warn_Rq_AR2::Rsrv3_CamLane_Disp_Warn_Rq_Pr2);
	snprintf(buffer, elcount(buffer), "   0.000000 F1 EIS::CamLane_Disp_Warn_Rq_AR2::Rsrv3_CamLane_Disp_Warn_Rq_Pr2 = %d\n", intval);
	filePutString (buffer, elcount(buffer), hFile);
	intval = getSignal(CHASSIS::CamLane_Disp_Warn_Rq_AR2::LDP_MPC_Md_Stat);
	snprintf(buffer, elcount(buffer), "   0.000000 F1 EIS::CamLane_Disp_Warn_Rq_AR2::LDP_MPC_Md_Stat = %d\n", intval);
	filePutString (buffer, elcount(buffer), hFile);
	intval = getSignal(CHASSIS::CamLane_Disp_Warn_Rq_AR2::Rsrv4_CamLane_Disp_Warn_Rq_Pr2);
	snprintf(buffer, elcount(buffer), "   0.000000 F1 EIS::CamLane_Disp_Warn_Rq_AR2::Rsrv4_CamLane_Disp_Warn_Rq_Pr2 = %d\n", intval);
	filePutString (buffer, elcount(buffer), hFile);
	intval = getSignal(CHASSIS::CamLane_Disp_Warn_Rq_AR2::Rsrv2_CamLane_Disp_Warn_Rq_Pr2);
	snprintf(buffer, elcount(buffer), "   0.000000 F1 EIS::CamLane_Disp_Warn_Rq_AR2::Rsrv2_CamLane_Disp_Warn_Rq_Pr2 = %d\n", intval);
	filePutString (buffer, elcount(buffer), hFile);
	intval = @sysvar::CH_Nodes::CH_EISCRC_CamLane_LaneAttr1_AUTO;
	snprintf(buffer, elcount(buffer), "   0.000000    SV: 2 0 0 ::CH_Nodes::CH_EISCRC_CamLane_LaneAttr1_AUTO = %d\n", intval);
	filePutString (buffer, elcount(buffer), hFile);
	intval = getSignal(CHASSIS::CamLane_LaneAttr1_AR2::CRC_CamLane_LaneAttr1_Pr2);
	snprintf(buffer, elcount(buffer), "   0.000000 F1 EIS::CamLane_LaneAttr1_AR2::CRC_CamLane_LaneAttr1_Pr2 = %d\n", intval);
	filePutString (buffer, elcount(buffer), hFile);
	intval = @sysvar::CH_Nodes::CH_EISSQC_CamLane_LaneAttr1_AUTO;
	snprintf(buffer, elcount(buffer), "   0.000000    SV: 2 0 0 ::CH_Nodes::CH_EISSQC_CamLane_LaneAttr1_AUTO = %d\n", intval);
	filePutString (buffer, elcount(buffer), hFile);
	intval = getSignal(CHASSIS::CamLane_LaneAttr1_AR2::SQC_CamLane_LaneAttr1_Pr2);
	snprintf(buffer, elcount(buffer), "   0.000000 F1 EIS::CamLane_LaneAttr1_AR2::SQC_CamLane_LaneAttr1_Pr2 = %d\n", intval);
	filePutString (buffer, elcount(buffer), hFile);
	floatval = getSignal(CHASSIS::CamLane_LaneAttr1_AR2::CamLane_LaneDataQual_Lt);
	snprintf(buffer, elcount(buffer), "   0.000000 F1 EIS::CamLane_LaneAttr1_AR2::CamLane_LaneDataQual_Lt = %f\n", floatval);
	filePutString (buffer, elcount(buffer), hFile);
	intval = getSignal(CHASSIS::CamLane_LaneAttr1_AR2::CamLane_DrvActv_LDP);
	snprintf(buffer, elcount(buffer), "   0.000000 F1 EIS::CamLane_LaneAttr1_AR2::CamLane_DrvActv_LDP = %d\n", intval);
	filePutString (buffer, elcount(buffer), hFile);
	floatval = getSignal(CHASSIS::CamLane_LaneAttr1_AR2::NghbrLane_Lt_Width);
	snprintf(buffer, elcount(buffer), "   0.000000 F1 EIS::CamLane_LaneAttr1_AR2::NghbrLane_Lt_Width = %f\n", floatval);
	filePutString (buffer, elcount(buffer), hFile);
	intval = getSignal(CHASSIS::CamLane_LaneAttr1_AR2::CamLane_LaneDscrbSide);
	snprintf(buffer, elcount(buffer), "   0.000000 F1 EIS::CamLane_LaneAttr1_AR2::CamLane_LaneDscrbSide = %d\n", intval);
	filePutString (buffer, elcount(buffer), hFile);
	floatval = getSignal(CHASSIS::CamLane_LaneAttr1_AR2::NghbrLane_Rt_Width);
	snprintf(buffer, elcount(buffer), "   0.000000 F1 EIS::CamLane_LaneAttr1_AR2::NghbrLane_Rt_Width = %f\n", floatval);
	filePutString (buffer, elcount(buffer), hFile);
	intval = getSignal(CHASSIS::CamLane_LaneAttr1_AR2::CamLane_LaneAttr1_Sync);
	snprintf(buffer, elcount(buffer), "   0.000000 F1 EIS::CamLane_LaneAttr1_AR2::CamLane_LaneAttr1_Sync = %d\n", intval);
	filePutString (buffer, elcount(buffer), hFile);
	floatval = getSignal(CHASSIS::CamLane_LaneAttr1_AR2::CamLane_LaneLtrlDist_Lt);
	snprintf(buffer, elcount(buffer), "   0.000000 F1 EIS::CamLane_LaneAttr1_AR2::CamLane_LaneLtrlDist_Lt = %f\n", floatval);
	filePutString (buffer, elcount(buffer), hFile);
	floatval = getSignal(CHASSIS::CamLane_LaneAttr1_AR2::CamLane_LaneDataQual_Rt);
	snprintf(buffer, elcount(buffer), "   0.000000 F1 EIS::CamLane_LaneAttr1_AR2::CamLane_LaneDataQual_Rt = %f\n", floatval);
	filePutString (buffer, elcount(buffer), hFile);
	intval = getSignal(CHASSIS::CamLane_LaneAttr1_AR2::CamLane_RoadExit_Stat);
	snprintf(buffer, elcount(buffer), "   0.000000 F1 EIS::CamLane_LaneAttr1_AR2::CamLane_RoadExit_Stat = %d\n", intval);
	filePutString (buffer, elcount(buffer), hFile);
	floatval = getSignal(CHASSIS::CamLane_LaneAttr1_AR2::CamLane_LaneLtrlDist_Rt);
	snprintf(buffer, elcount(buffer), "   0.000000 F1 EIS::CamLane_LaneAttr1_AR2::CamLane_LaneLtrlDist_Rt = %f\n", floatval);
	filePutString (buffer, elcount(buffer), hFile);
	intval = getSignal(CHASSIS::CamLane_LaneAttr1_AR2::CamLane_LaneChg_Stat);
	snprintf(buffer, elcount(buffer), "   0.000000 F1 EIS::CamLane_LaneAttr1_AR2::CamLane_LaneChg_Stat = %d\n", intval);
	filePutString (buffer, elcount(buffer), hFile);
	intval = getSignal(CHASSIS::CamLane_LaneAttr1_AR2::NghbrLane_Lt_Stat);
	snprintf(buffer, elcount(buffer), "   0.000000 F1 EIS::CamLane_LaneAttr1_AR2::NghbrLane_Lt_Stat = %d\n", intval);
	filePutString (buffer, elcount(buffer), hFile);
	intval = getSignal(CHASSIS::CamLane_LaneAttr1_AR2::NghbrLane_Rt_Stat);
	snprintf(buffer, elcount(buffer), "   0.000000 F1 EIS::CamLane_LaneAttr1_AR2::NghbrLane_Rt_Stat = %d\n", intval);
	filePutString (buffer, elcount(buffer), hFile);
	intval = @sysvar::CH_Nodes::CH_EISCRC_CamLane_LaneAttr2_AUTO;
	snprintf(buffer, elcount(buffer), "   0.000000    SV: 2 0 0 ::CH_Nodes::CH_EISCRC_CamLane_LaneAttr2_AUTO = %d\n", intval);
	filePutString (buffer, elcount(buffer), hFile);
	intval = getSignal(CHASSIS::CamLane_LaneAttr2_AR2::CRC_CamLane_LaneAttr2_Pr2);
	snprintf(buffer, elcount(buffer), "   0.000000 F1 EIS::CamLane_LaneAttr2_AR2::CRC_CamLane_LaneAttr2_Pr2 = %d\n", intval);
	filePutString (buffer, elcount(buffer), hFile);
	intval = @sysvar::CH_Nodes::CH_EISSQC_CamLane_LaneAttr2_AUTO;
	snprintf(buffer, elcount(buffer), "   0.000000    SV: 2 0 0 ::CH_Nodes::CH_EISSQC_CamLane_LaneAttr2_AUTO = %d\n", intval);
	filePutString (buffer, elcount(buffer), hFile);
	intval = getSignal(CHASSIS::CamLane_LaneAttr2_AR2::SQC_CamLane_LaneAttr2_Pr2);
	snprintf(buffer, elcount(buffer), "   0.000000 F1 EIS::CamLane_LaneAttr2_AR2::SQC_CamLane_LaneAttr2_Pr2 = %d\n", intval);
	filePutString (buffer, elcount(buffer), hFile);
	floatval = getSignal(CHASSIS::CamLane_LaneAttr2_AR2::CamLane_2ndClothoid_C1_Lt);
	snprintf(buffer, elcount(buffer), "   0.000000 F1 EIS::CamLane_LaneAttr2_AR2::CamLane_2ndClothoid_C1_Lt = %f\n", floatval);
	filePutString (buffer, elcount(buffer), hFile);
	intval = getSignal(CHASSIS::CamLane_LaneAttr2_AR2::CamLane_2ndClothoid_Stat_Lt);
	snprintf(buffer, elcount(buffer), "   0.000000 F1 EIS::CamLane_LaneAttr2_AR2::CamLane_2ndClothoid_Stat_Lt = %d\n", intval);
	filePutString (buffer, elcount(buffer), hFile);
	intval = getSignal(CHASSIS::CamLane_LaneAttr2_AR2::NghbrLaneMarkType_Lt);
	snprintf(buffer, elcount(buffer), "   0.000000 F1 EIS::CamLane_LaneAttr2_AR2::NghbrLaneMarkType_Lt = %d\n", intval);
	filePutString (buffer, elcount(buffer), hFile);
	intval = getSignal(CHASSIS::CamLane_LaneAttr2_AR2::Rsrv2_CAMLane_LaneAttr2_Pr2);
	snprintf(buffer, elcount(buffer), "   0.000000 F1 EIS::CamLane_LaneAttr2_AR2::Rsrv2_CAMLane_LaneAttr2_Pr2 = %d\n", intval);
	filePutString (buffer, elcount(buffer), hFile);
	floatval = getSignal(CHASSIS::CamLane_LaneAttr2_AR2::VLN_DtctDist_Lt);
	snprintf(buffer, elcount(buffer), "   0.000000 F1 EIS::CamLane_LaneAttr2_AR2::VLN_DtctDist_Lt = %f\n", floatval);
	filePutString (buffer, elcount(buffer), hFile);
	floatval = getSignal(CHASSIS::CamLane_LaneAttr2_AR2::CamLane_2ndClothoid_InitDist_Lt);
	snprintf(buffer, elcount(buffer), "   0.000000 F1 EIS::CamLane_LaneAttr2_AR2::CamLane_2ndClothoid_InitDist_Lt = %f\n", floatval);
	filePutString (buffer, elcount(buffer), hFile);
	floatval = getSignal(CHASSIS::CamLane_LaneAttr2_AR2::CamLane_LaneHrztCrv_Lt);
	snprintf(buffer, elcount(buffer), "   0.000000 F1 EIS::CamLane_LaneAttr2_AR2::CamLane_LaneHrztCrv_Lt = %f\n", floatval);
	filePutString (buffer, elcount(buffer), hFile);
	intval = getSignal(CHASSIS::CamLane_LaneAttr2_AR2::CamLane_LaneMarkType_Lt);
	snprintf(buffer, elcount(buffer), "   0.000000 F1 EIS::CamLane_LaneAttr2_AR2::CamLane_LaneMarkType_Lt = %d\n", intval);
	filePutString (buffer, elcount(buffer), hFile);
	intval = getSignal(CHASSIS::CamLane_LaneAttr2_AR2::CamLane_LaneAttr2_Sync);
	snprintf(buffer, elcount(buffer), "   0.000000 F1 EIS::CamLane_LaneAttr2_AR2::CamLane_LaneAttr2_Sync = %d\n", intval);
	filePutString (buffer, elcount(buffer), hFile);
	intval = @sysvar::CH_Nodes::CH_EISCRC_CamLane_LaneAttr3_AUTO;
	snprintf(buffer, elcount(buffer), "   0.000000    SV: 2 0 0 ::CH_Nodes::CH_EISCRC_CamLane_LaneAttr3_AUTO = %d\n", intval);
	filePutString (buffer, elcount(buffer), hFile);
	intval = getSignal(CHASSIS::CamLane_LaneAttr3_AR2::CRC_CamLane_LaneAttr3_Pr2);
	snprintf(buffer, elcount(buffer), "   0.000000 F1 EIS::CamLane_LaneAttr3_AR2::CRC_CamLane_LaneAttr3_Pr2 = %d\n", intval);
	filePutString (buffer, elcount(buffer), hFile);
	intval = @sysvar::CH_Nodes::CH_EISSQC_CamLane_LaneAttr3_AUTO;
	snprintf(buffer, elcount(buffer), "   0.000000    SV: 2 0 0 ::CH_Nodes::CH_EISSQC_CamLane_LaneAttr3_AUTO = %d\n", intval);
	filePutString (buffer, elcount(buffer), hFile);
	intval = getSignal(CHASSIS::CamLane_LaneAttr3_AR2::SQC_CamLane_LaneAttr3_Pr2);
	snprintf(buffer, elcount(buffer), "   0.000000 F1 EIS::CamLane_LaneAttr3_AR2::SQC_CamLane_LaneAttr3_Pr2 = %d\n", intval);
	filePutString (buffer, elcount(buffer), hFile);
	floatval = getSignal(CHASSIS::CamLane_LaneAttr3_AR2::CamLane_LaneClothoidPara_Lt);
	snprintf(buffer, elcount(buffer), "   0.000000 F1 EIS::CamLane_LaneAttr3_AR2::CamLane_LaneClothoidPara_Lt = %f\n", floatval);
	filePutString (buffer, elcount(buffer), hFile);
	floatval = getSignal(CHASSIS::CamLane_LaneAttr3_AR2::CamLane_LaneClothoidPara_Rt);
	snprintf(buffer, elcount(buffer), "   0.000000 F1 EIS::CamLane_LaneAttr3_AR2::CamLane_LaneClothoidPara_Rt = %f\n", floatval);
	filePutString (buffer, elcount(buffer), hFile);
	floatval = getSignal(CHASSIS::CamLane_LaneAttr3_AR2::CamLane_LaneYawAngl_Lt);
	snprintf(buffer, elcount(buffer), "   0.000000 F1 EIS::CamLane_LaneAttr3_AR2::CamLane_LaneYawAngl_Lt = %f\n", floatval);
	filePutString (buffer, elcount(buffer), hFile);
	floatval = getSignal(CHASSIS::CamLane_LaneAttr3_AR2::CamLane_LaneYawAngl_Rt);
	snprintf(buffer, elcount(buffer), "   0.000000 F1 EIS::CamLane_LaneAttr3_AR2::CamLane_LaneYawAngl_Rt = %f\n", floatval);
	filePutString (buffer, elcount(buffer), hFile);
	intval = @sysvar::CH_Nodes::CH_EISCRC_CamLane_LaneAttr6_AUTO;
	snprintf(buffer, elcount(buffer), "   0.000000    SV: 2 0 0 ::CH_Nodes::CH_EISCRC_CamLane_LaneAttr6_AUTO = %d\n", intval);
	filePutString (buffer, elcount(buffer), hFile);
	intval = getSignal(CHASSIS::CamLane_LaneAttr6_AR2::CRC_CamLane_LaneAttr6_Pr2);
	snprintf(buffer, elcount(buffer), "   0.000000 F1 EIS::CamLane_LaneAttr6_AR2::CRC_CamLane_LaneAttr6_Pr2 = %d\n", intval);
	filePutString (buffer, elcount(buffer), hFile);
	intval = @sysvar::CH_Nodes::CH_EISSQC_CamLane_LaneAttr6_AUTO;
	snprintf(buffer, elcount(buffer), "   0.000000    SV: 2 0 0 ::CH_Nodes::CH_EISSQC_CamLane_LaneAttr6_AUTO = %d\n", intval);
	filePutString (buffer, elcount(buffer), hFile);
	intval = getSignal(CHASSIS::CamLane_LaneAttr6_AR2::SQC_CamLane_LaneAttr6_Pr2);
	snprintf(buffer, elcount(buffer), "   0.000000 F1 EIS::CamLane_LaneAttr6_AR2::SQC_CamLane_LaneAttr6_Pr2 = %d\n", intval);
	filePutString (buffer, elcount(buffer), hFile);
	floatval = getSignal(CHASSIS::CamLane_LaneAttr6_AR2::CamLane_2ndClothoid_C1_Rt);
	snprintf(buffer, elcount(buffer), "   0.000000 F1 EIS::CamLane_LaneAttr6_AR2::CamLane_2ndClothoid_C1_Rt = %f\n", floatval);
	filePutString (buffer, elcount(buffer), hFile);
	intval = getSignal(CHASSIS::CamLane_LaneAttr6_AR2::CamLane_2ndClothoid_Stat_Rt);
	snprintf(buffer, elcount(buffer), "   0.000000 F1 EIS::CamLane_LaneAttr6_AR2::CamLane_2ndClothoid_Stat_Rt = %d\n", intval);
	filePutString (buffer, elcount(buffer), hFile);
	intval = getSignal(CHASSIS::CamLane_LaneAttr6_AR2::NghbrLaneMarkType_Rt);
	snprintf(buffer, elcount(buffer), "   0.000000 F1 EIS::CamLane_LaneAttr6_AR2::NghbrLaneMarkType_Rt = %d\n", intval);
	filePutString (buffer, elcount(buffer), hFile);
	intval = getSignal(CHASSIS::CamLane_LaneAttr6_AR2::Rsrv2_CAMLane_LaneAttr6_Pr2);
	snprintf(buffer, elcount(buffer), "   0.000000 F1 EIS::CamLane_LaneAttr6_AR2::Rsrv2_CAMLane_LaneAttr6_Pr2 = %d\n", intval);
	filePutString (buffer, elcount(buffer), hFile);
	floatval = getSignal(CHASSIS::CamLane_LaneAttr6_AR2::VLN_DtctDist_Rt);
	snprintf(buffer, elcount(buffer), "   0.000000 F1 EIS::CamLane_LaneAttr6_AR2::VLN_DtctDist_Rt = %f\n", floatval);
	filePutString (buffer, elcount(buffer), hFile);
	floatval = getSignal(CHASSIS::CamLane_LaneAttr6_AR2::CamLane_2ndClothoid_InitDist_Rt);
	snprintf(buffer, elcount(buffer), "   0.000000 F1 EIS::CamLane_LaneAttr6_AR2::CamLane_2ndClothoid_InitDist_Rt = %f\n", floatval);
	filePutString (buffer, elcount(buffer), hFile);
	floatval = getSignal(CHASSIS::CamLane_LaneAttr6_AR2::CamLane_LaneHrztCrv_Rt);
	snprintf(buffer, elcount(buffer), "   0.000000 F1 EIS::CamLane_LaneAttr6_AR2::CamLane_LaneHrztCrv_Rt = %f\n", floatval);
	filePutString (buffer, elcount(buffer), hFile);
	intval = getSignal(CHASSIS::CamLane_LaneAttr6_AR2::CamLane_LaneMarkType_Rt);
	snprintf(buffer, elcount(buffer), "   0.000000 F1 EIS::CamLane_LaneAttr6_AR2::CamLane_LaneMarkType_Rt = %d\n", intval);
	filePutString (buffer, elcount(buffer), hFile);
}
/*@@end*/

/*@@caplFunc:saveVars_28(dword):*/
void saveVars_28(dword hFile)
{
	intval = getSignal(CHASSIS::CamLane_LaneAttr6_AR2::CamLane_LaneAttr6_Sync);
	snprintf(buffer, elcount(buffer), "   0.000000 F1 EIS::CamLane_LaneAttr6_AR2::CamLane_LaneAttr6_Sync = %d\n", intval);
	filePutString (buffer, elcount(buffer), hFile);
	intval = @sysvar::CH_Nodes::CH_EISCRC_CamLane_LaneAttr7_AUTO;
	snprintf(buffer, elcount(buffer), "   0.000000    SV: 2 0 0 ::CH_Nodes::CH_EISCRC_CamLane_LaneAttr7_AUTO = %d\n", intval);
	filePutString (buffer, elcount(buffer), hFile);
	intval = getSignal(CHASSIS::CamLane_LaneAttr7_AR2::CRC_CamLane_LaneAttr7_Pr2);
	snprintf(buffer, elcount(buffer), "   0.000000 F1 EIS::CamLane_LaneAttr7_AR2::CRC_CamLane_LaneAttr7_Pr2 = %d\n", intval);
	filePutString (buffer, elcount(buffer), hFile);
	intval = @sysvar::CH_Nodes::CH_EISSQC_CamLane_LaneAttr7_AUTO;
	snprintf(buffer, elcount(buffer), "   0.000000    SV: 2 0 0 ::CH_Nodes::CH_EISSQC_CamLane_LaneAttr7_AUTO = %d\n", intval);
	filePutString (buffer, elcount(buffer), hFile);
	intval = getSignal(CHASSIS::CamLane_LaneAttr7_AR2::SQC_CamLane_LaneAttr7_Pr2);
	snprintf(buffer, elcount(buffer), "   0.000000 F1 EIS::CamLane_LaneAttr7_AR2::SQC_CamLane_LaneAttr7_Pr2 = %d\n", intval);
	filePutString (buffer, elcount(buffer), hFile);
	floatval = getSignal(CHASSIS::CamLane_LaneAttr7_AR2::CamLane_LaneMarkWidth_Rt);
	snprintf(buffer, elcount(buffer), "   0.000000 F1 EIS::CamLane_LaneAttr7_AR2::CamLane_LaneMarkWidth_Rt = %f\n", floatval);
	filePutString (buffer, elcount(buffer), hFile);
	intval = getSignal(CHASSIS::CamLane_LaneAttr7_AR2::CamLane_LaneMark_DtctDist_Lt);
	snprintf(buffer, elcount(buffer), "   0.000000 F1 EIS::CamLane_LaneAttr7_AR2::CamLane_LaneMark_DtctDist_Lt = %d\n", intval);
	filePutString (buffer, elcount(buffer), hFile);
	intval = getSignal(CHASSIS::CamLane_LaneAttr7_AR2::CamLane_LaneMark_DtctDist_Rt);
	snprintf(buffer, elcount(buffer), "   0.000000 F1 EIS::CamLane_LaneAttr7_AR2::CamLane_LaneMark_DtctDist_Rt = %d\n", intval);
	filePutString (buffer, elcount(buffer), hFile);
	intval = getSignal(CHASSIS::CamLane_LaneAttr7_AR2::CamLane_Stat);
	snprintf(buffer, elcount(buffer), "   0.000000 F1 EIS::CamLane_LaneAttr7_AR2::CamLane_Stat = %d\n", intval);
	filePutString (buffer, elcount(buffer), hFile);
	intval = getSignal(CHASSIS::CamLane_LaneAttr7_AR2::ALDW_LDP_PulseTm_Rq);
	snprintf(buffer, elcount(buffer), "   0.000000 F1 EIS::CamLane_LaneAttr7_AR2::ALDW_LDP_PulseTm_Rq = %d\n", intval);
	filePutString (buffer, elcount(buffer), hFile);
	intval = getSignal(CHASSIS::CamLane_LaneAttr7_AR2::ALDW_LDP_VibTm_Rq);
	snprintf(buffer, elcount(buffer), "   0.000000 F1 EIS::CamLane_LaneAttr7_AR2::ALDW_LDP_VibTm_Rq = %d\n", intval);
	filePutString (buffer, elcount(buffer), hFile);
	intval = getSignal(CHASSIS::CamLane_LaneAttr7_AR2::ALDW_LDP_Warn_Rq);
	snprintf(buffer, elcount(buffer), "   0.000000 F1 EIS::CamLane_LaneAttr7_AR2::ALDW_LDP_Warn_Rq = %d\n", intval);
	filePutString (buffer, elcount(buffer), hFile);
	intval = getSignal(CHASSIS::CamLane_LaneAttr7_AR2::LDP_BrkMsgDisp_Rq_MPC);
	snprintf(buffer, elcount(buffer), "   0.000000 F1 EIS::CamLane_LaneAttr7_AR2::LDP_BrkMsgDisp_Rq_MPC = %d\n", intval);
	filePutString (buffer, elcount(buffer), hFile);
	intval = getSignal(CHASSIS::CamLane_LaneAttr7_AR2::CamLane_LaneSiteDtct_Stat);
	snprintf(buffer, elcount(buffer), "   0.000000 F1 EIS::CamLane_LaneAttr7_AR2::CamLane_LaneSiteDtct_Stat = %d\n", intval);
	filePutString (buffer, elcount(buffer), hFile);
	intval = getSignal(CHASSIS::CamLane_LaneAttr7_AR2::Rsrv2_ALDW_LaneAttr7);
	snprintf(buffer, elcount(buffer), "   0.000000 F1 EIS::CamLane_LaneAttr7_AR2::Rsrv2_ALDW_LaneAttr7 = %d\n", intval);
	filePutString (buffer, elcount(buffer), hFile);
	floatval = getSignal(CHASSIS::CamLane_LaneAttr7_AR2::CamLane_LaneMarkWidth_Lt);
	snprintf(buffer, elcount(buffer), "   0.000000 F1 EIS::CamLane_LaneAttr7_AR2::CamLane_LaneMarkWidth_Lt = %f\n", floatval);
	filePutString (buffer, elcount(buffer), hFile);
	floatval = getSignal(CHASSIS::CamLane_LaneAttr7_AR2::CamLane_LaneAttr7_TmStmp);
	snprintf(buffer, elcount(buffer), "   0.000000 F1 EIS::CamLane_LaneAttr7_AR2::CamLane_LaneAttr7_TmStmp = %f\n", floatval);
	filePutString (buffer, elcount(buffer), hFile);
	intval = getSignal(CHASSIS::CLkS_Rq_AR::CLkS_Src_V2);
	snprintf(buffer, elcount(buffer), "   0.000000 F1 EIS::CLkS_Rq_AR::CLkS_Src_V2 = %d\n", intval);
	filePutString (buffer, elcount(buffer), hFile);
	intval = getSignal(CHASSIS::CLkS_Rq_AR::CLkS_DL_Act_Rq);
	snprintf(buffer, elcount(buffer), "   0.000000 F1 EIS::CLkS_Rq_AR::CLkS_DL_Act_Rq = %d\n", intval);
	filePutString (buffer, elcount(buffer), hFile);
	intval = getSignal(CHASSIS::CLkS_Rq_AR::CLkS_Dr_FL_Rq);
	snprintf(buffer, elcount(buffer), "   0.000000 F1 EIS::CLkS_Rq_AR::CLkS_Dr_FL_Rq = %d\n", intval);
	filePutString (buffer, elcount(buffer), hFile);
	intval = getSignal(CHASSIS::CLkS_Rq_AR::CLkS_Dr_FR_Rq);
	snprintf(buffer, elcount(buffer), "   0.000000 F1 EIS::CLkS_Rq_AR::CLkS_Dr_FR_Rq = %d\n", intval);
	filePutString (buffer, elcount(buffer), hFile);
	intval = getSignal(CHASSIS::CLkS_Rq_AR::CLkS_Dr_RL_Rq);
	snprintf(buffer, elcount(buffer), "   0.000000 F1 EIS::CLkS_Rq_AR::CLkS_Dr_RL_Rq = %d\n", intval);
	filePutString (buffer, elcount(buffer), hFile);
	intval = getSignal(CHASSIS::CLkS_Rq_AR::CLkS_Dr_RR_Rq);
	snprintf(buffer, elcount(buffer), "   0.000000 F1 EIS::CLkS_Rq_AR::CLkS_Dr_RR_Rq = %d\n", intval);
	filePutString (buffer, elcount(buffer), hFile);
	intval = getSignal(CHASSIS::CLkS_Rq_AR::CLkS_DL_Rq);
	snprintf(buffer, elcount(buffer), "   0.000000 F1 EIS::CLkS_Rq_AR::CLkS_DL_Rq = %d\n", intval);
	filePutString (buffer, elcount(buffer), hFile);
	intval = getSignal(CHASSIS::CLkS_Rq_AR::CLkS_Gas_Dr_Rq);
	snprintf(buffer, elcount(buffer), "   0.000000 F1 EIS::CLkS_Rq_AR::CLkS_Gas_Dr_Rq = %d\n", intval);
	filePutString (buffer, elcount(buffer), hFile);
	intval = getSignal(CHASSIS::CLkS_Rq_AR::CLkS_Ext_Rq);
	snprintf(buffer, elcount(buffer), "   0.000000 F1 EIS::CLkS_Rq_AR::CLkS_Ext_Rq = %d\n", intval);
	filePutString (buffer, elcount(buffer), hFile);
	intval = getSignal(CHASSIS::CLkS_Rq_AR::CLkS_TurnLmp_Rq);
	snprintf(buffer, elcount(buffer), "   0.000000 F1 EIS::CLkS_Rq_AR::CLkS_TurnLmp_Rq = %d\n", intval);
	filePutString (buffer, elcount(buffer), hFile);
	intval = getSignal(CHASSIS::CLkS_Rq_AR::KeyLine);
	snprintf(buffer, elcount(buffer), "   0.000000 F1 EIS::CLkS_Rq_AR::KeyLine = %d\n", intval);
	filePutString (buffer, elcount(buffer), hFile);
	intval = getSignal(CHASSIS::CLkS_Rq_AR::Key_Sw4_Psd);
	snprintf(buffer, elcount(buffer), "   0.000000 F1 EIS::CLkS_Rq_AR::Key_Sw4_Psd = %d\n", intval);
	filePutString (buffer, elcount(buffer), hFile);
	intval = getSignal(CHASSIS::CLkS_Rq_AR::RemAlm_Rq_MPM);
	snprintf(buffer, elcount(buffer), "   0.000000 F1 EIS::CLkS_Rq_AR::RemAlm_Rq_MPM = %d\n", intval);
	filePutString (buffer, elcount(buffer), hFile);
	intval = getSignal(CHASSIS::CLkS_Rq_AR::TDP_Sw_Cls_Rq_EIS);
	snprintf(buffer, elcount(buffer), "   0.000000 F1 EIS::CLkS_Rq_AR::TDP_Sw_Cls_Rq_EIS = %d\n", intval);
	filePutString (buffer, elcount(buffer), hFile);
	intval = getSignal(CHASSIS::CLkS_State_AR::CLkS_Dr_FL_Stat);
	snprintf(buffer, elcount(buffer), "   0.000000 F1 EIS::CLkS_State_AR::CLkS_Dr_FL_Stat = %d\n", intval);
	filePutString (buffer, elcount(buffer), hFile);
	intval = getSignal(CHASSIS::CLkS_State_AR::CLkS_Dr_FR_Stat);
	snprintf(buffer, elcount(buffer), "   0.000000 F1 EIS::CLkS_State_AR::CLkS_Dr_FR_Stat = %d\n", intval);
	filePutString (buffer, elcount(buffer), hFile);
	intval = getSignal(CHASSIS::CLkS_State_AR::CLkS_Dr_RL_Stat);
	snprintf(buffer, elcount(buffer), "   0.000000 F1 EIS::CLkS_State_AR::CLkS_Dr_RL_Stat = %d\n", intval);
	filePutString (buffer, elcount(buffer), hFile);
	intval = getSignal(CHASSIS::CLkS_State_AR::CLkS_Dr_RR_Stat);
	snprintf(buffer, elcount(buffer), "   0.000000 F1 EIS::CLkS_State_AR::CLkS_Dr_RR_Stat = %d\n", intval);
	filePutString (buffer, elcount(buffer), hFile);
	intval = getSignal(CHASSIS::CLkS_State_AR::CLkS_DL_Stat);
	snprintf(buffer, elcount(buffer), "   0.000000 F1 EIS::CLkS_State_AR::CLkS_DL_Stat = %d\n", intval);
	filePutString (buffer, elcount(buffer), hFile);
	intval = getSignal(CHASSIS::CLkS_State_AR::CLkS_Gas_Dr_Stat);
	snprintf(buffer, elcount(buffer), "   0.000000 F1 EIS::CLkS_State_AR::CLkS_Gas_Dr_Stat = %d\n", intval);
	filePutString (buffer, elcount(buffer), hFile);
	intval = getSignal(CHASSIS::CLkS_State_AR::CLkS_Lk_Stat3);
	snprintf(buffer, elcount(buffer), "   0.000000 F1 EIS::CLkS_State_AR::CLkS_Lk_Stat3 = %d\n", intval);
	filePutString (buffer, elcount(buffer), hFile);
	intval = getSignal(CHASSIS::CLkS_State_AR::AutoDrLk_Stat);
	snprintf(buffer, elcount(buffer), "   0.000000 F1 EIS::CLkS_State_AR::AutoDrLk_Stat = %d\n", intval);
	filePutString (buffer, elcount(buffer), hFile);
	intval = getSignal(CHASSIS::CLkS_State_AR::CLkS_Dsabl);
	snprintf(buffer, elcount(buffer), "   0.000000 F1 EIS::CLkS_State_AR::CLkS_Dsabl = %d\n", intval);
	filePutString (buffer, elcount(buffer), hFile);
	intval = getSignal(CHASSIS::CLkS_State_AR::CLkS_Ovruse_Prot_Actv);
	snprintf(buffer, elcount(buffer), "   0.000000 F1 EIS::CLkS_State_AR::CLkS_Ovruse_Prot_Actv = %d\n", intval);
	filePutString (buffer, elcount(buffer), hFile);
	intval = getSignal(CHASSIS::CLkS_State_AR::AutoDrLk_Rq_Src);
	snprintf(buffer, elcount(buffer), "   0.000000 F1 EIS::CLkS_State_AR::AutoDrLk_Rq_Src = %d\n", intval);
	filePutString (buffer, elcount(buffer), hFile);
	intval = getSignal(CHASSIS::CLkS_State_AR::CLkS_TransMd_Actv);
	snprintf(buffer, elcount(buffer), "   0.000000 F1 EIS::CLkS_State_AR::CLkS_TransMd_Actv = %d\n", intval);
	filePutString (buffer, elcount(buffer), hFile);
	intval = getSignal(CHASSIS::CLkS_State_AR::CLkS_Key_Rq_Raw);
	snprintf(buffer, elcount(buffer), "   0.000000 F1 EIS::CLkS_State_AR::CLkS_Key_Rq_Raw = %d\n", intval);
	filePutString (buffer, elcount(buffer), hFile);
	intval = getSignal(CHASSIS::CLkS_State_AR::KeyId_V2);
	snprintf(buffer, elcount(buffer), "   0.000000 F1 EIS::CLkS_State_AR::KeyId_V2 = %d\n", intval);
	filePutString (buffer, elcount(buffer), hFile);
	intval = getSignal(CHASSIS::ClockSync_Stat_FR2::ClockSync_MsgType);
	snprintf(buffer, elcount(buffer), "   0.000000 F1 EIS::ClockSync_Stat_FR2::ClockSync_MsgType = %d\n", intval);
	filePutString (buffer, elcount(buffer), hFile);
	intval = @sysvar::CH_Nodes::CH_EISCRC_ClockSync_Stat_Pr_AUTO;
	snprintf(buffer, elcount(buffer), "   0.000000    SV: 2 0 0 ::CH_Nodes::CH_EISCRC_ClockSync_Stat_Pr_AUTO = %d\n", intval);
	filePutString (buffer, elcount(buffer), hFile);
	intval = getSignal(CHASSIS::ClockSync_Stat_FR2::CRC_ClockSync_Stat_Pr2);
	snprintf(buffer, elcount(buffer), "   0.000000 F1 EIS::ClockSync_Stat_FR2::CRC_ClockSync_Stat_Pr2 = %d\n", intval);
	filePutString (buffer, elcount(buffer), hFile);
	intval = @sysvar::CH_Nodes::CH_EISSQC_ClockSync_Stat_Pr_AUTO;
	snprintf(buffer, elcount(buffer), "   0.000000    SV: 2 0 0 ::CH_Nodes::CH_EISSQC_ClockSync_Stat_Pr_AUTO = %d\n", intval);
	filePutString (buffer, elcount(buffer), hFile);
	intval = getSignal(CHASSIS::ClockSync_Stat_FR2::SQC_ClockSync_Stat_Pr2);
	snprintf(buffer, elcount(buffer), "   0.000000 F1 EIS::ClockSync_Stat_FR2::SQC_ClockSync_Stat_Pr2 = %d\n", intval);
	filePutString (buffer, elcount(buffer), hFile);
	intval = getSignal(CHASSIS::ClockSync_Stat_FR2::ClockSync_TmDomain);
	snprintf(buffer, elcount(buffer), "   0.000000 F1 EIS::ClockSync_Stat_FR2::ClockSync_TmDomain = %d\n", intval);
	filePutString (buffer, elcount(buffer), hFile);
	intval = getSignal(CHASSIS::ClockSync_Stat_FR2::Rsrv1_ClockSync_Stat_Pr2);
	snprintf(buffer, elcount(buffer), "   0.000000 F1 EIS::ClockSync_Stat_FR2::Rsrv1_ClockSync_Stat_Pr2 = %d\n", intval);
	filePutString (buffer, elcount(buffer), hFile);
	intval = getSignal(CHASSIS::ClockSync_Stat_FR2::ClockSync_SyncTmGw);
	snprintf(buffer, elcount(buffer), "   0.000000 F1 EIS::ClockSync_Stat_FR2::ClockSync_SyncTmGw = %d\n", intval);
	filePutString (buffer, elcount(buffer), hFile);
	intval = getSignal(CHASSIS::ClockSync_Stat_FR2::ClockSync_FR_TxCycle);
	snprintf(buffer, elcount(buffer), "   0.000000 F1 EIS::ClockSync_Stat_FR2::ClockSync_FR_TxCycle = %d\n", intval);
	filePutString (buffer, elcount(buffer), hFile);
	intval = getSignal(CHASSIS::ClockSync_Stat_FR2::Rsrv2_ClockSync_Stat_Pr2);
	snprintf(buffer, elcount(buffer), "   0.000000 F1 EIS::ClockSync_Stat_FR2::Rsrv2_ClockSync_Stat_Pr2 = %d\n", intval);
	filePutString (buffer, elcount(buffer), hFile);
}
/*@@end*/

/*@@caplFunc:saveVars_29(dword):*/
void saveVars_29(dword hFile)
{
	intval = getSignal(CHASSIS::ClockSync_Stat_FR2::ClockSync_User);
	snprintf(buffer, elcount(buffer), "   0.000000 F1 EIS::ClockSync_Stat_FR2::ClockSync_User = %d\n", intval);
	filePutString (buffer, elcount(buffer), hFile);
	intval = getSignal(CHASSIS::ClockSync_Stat_FR2::ClockSync_TmStartZero);
	snprintf(buffer, elcount(buffer), "   0.000000 F1 EIS::ClockSync_Stat_FR2::ClockSync_TmStartZero = %d\n", intval);
	filePutString (buffer, elcount(buffer), hFile);
	intval = getSignal(CHASSIS::ClockSync_Stat_FR2::ClockSync_TmDiscont);
	snprintf(buffer, elcount(buffer), "   0.000000 F1 EIS::ClockSync_Stat_FR2::ClockSync_TmDiscont = %d\n", intval);
	filePutString (buffer, elcount(buffer), hFile);
	intval = getSignal(CHASSIS::ClockSync_Stat_FR2::ClockSync_ReplaceECU);
	snprintf(buffer, elcount(buffer), "   0.000000 F1 EIS::ClockSync_Stat_FR2::ClockSync_ReplaceECU = %d\n", intval);
	filePutString (buffer, elcount(buffer), hFile);
	intval = getSignal(CHASSIS::ClockSync_Stat_FR2::Rsrv3_ClockSync_Stat_Pr2);
	snprintf(buffer, elcount(buffer), "   0.000000 F1 EIS::ClockSync_Stat_FR2::Rsrv3_ClockSync_Stat_Pr2 = %d\n", intval);
	filePutString (buffer, elcount(buffer), hFile);
	floatval = getSignal(CHASSIS::ClockSync_Stat_FR2::ClockSync_Second48_Hi);
	snprintf(buffer, elcount(buffer), "   0.000000 F1 EIS::ClockSync_Stat_FR2::ClockSync_Second48_Hi = %f\n", floatval);
	filePutString (buffer, elcount(buffer), hFile);
	intval = getSignal(CHASSIS::ClockSync_Stat_FR2::ClockSync_Second48);
	snprintf(buffer, elcount(buffer), "   0.000000 F1 EIS::ClockSync_Stat_FR2::ClockSync_Second48 = %d\n", intval);
	filePutString (buffer, elcount(buffer), hFile);
	intval = getSignal(CHASSIS::ClockSync_Stat_FR2::ClockSync_NanoSecond);
	snprintf(buffer, elcount(buffer), "   0.000000 F1 EIS::ClockSync_Stat_FR2::ClockSync_NanoSecond = %d\n", intval);
	filePutString (buffer, elcount(buffer), hFile);
	intval = @sysvar::CH_Nodes::CH_EISCRC_CMS_PI_Stat_Pr2CM_AUTO;
	snprintf(buffer, elcount(buffer), "   0.000000    SV: 2 0 0 ::CH_Nodes::CH_EISCRC_CMS_PI_Stat_Pr2CM_AUTO = %d\n", intval);
	filePutString (buffer, elcount(buffer), hFile);
	intval = getSignal(CHASSIS::CMS_PI_State_Gw_AR2::CRC_CMS_PI_Stat_Pr2);
	snprintf(buffer, elcount(buffer), "   0.000000 F1 EIS::CMS_PI_State_Gw_AR2::CRC_CMS_PI_Stat_Pr2 = %d\n", intval);
	filePutString (buffer, elcount(buffer), hFile);
	intval = @sysvar::CH_Nodes::CH_EISSQC_CMS_PI_Stat_Pr2CM_AUTO;
	snprintf(buffer, elcount(buffer), "   0.000000    SV: 2 0 0 ::CH_Nodes::CH_EISSQC_CMS_PI_Stat_Pr2CM_AUTO = %d\n", intval);
	filePutString (buffer, elcount(buffer), hFile);
	intval = getSignal(CHASSIS::CMS_PI_State_Gw_AR2::SQC_CMS_PI_Stat_Pr2);
	snprintf(buffer, elcount(buffer), "   0.000000 F1 EIS::CMS_PI_State_Gw_AR2::SQC_CMS_PI_Stat_Pr2 = %d\n", intval);
	filePutString (buffer, elcount(buffer), hFile);
	intval = getSignal(CHASSIS::CMS_PI_State_Gw_AR2::PI_Enbl);
	snprintf(buffer, elcount(buffer), "   0.000000 F1 EIS::CMS_PI_State_Gw_AR2::PI_Enbl = %d\n", intval);
	filePutString (buffer, elcount(buffer), hFile);
	intval = getSignal(CHASSIS::CMS_PI_State_Gw_AR2::CMS_Brk_Rq_V2);
	snprintf(buffer, elcount(buffer), "   0.000000 F1 EIS::CMS_PI_State_Gw_AR2::CMS_Brk_Rq_V2 = %d\n", intval);
	filePutString (buffer, elcount(buffer), hFile);
	floatval = getSignal(CHASSIS::CMS_PI_State_Gw_AR2::CMS_VehDecel_Rq);
	snprintf(buffer, elcount(buffer), "   0.000000 F1 EIS::CMS_PI_State_Gw_AR2::CMS_VehDecel_Rq = %f\n", floatval);
	filePutString (buffer, elcount(buffer), hFile);
	floatval = getSignal(CHASSIS::CMS_PI_State_Gw_AR2::PI_Obj_R_RelSpd);
	snprintf(buffer, elcount(buffer), "   0.000000 F1 EIS::CMS_PI_State_Gw_AR2::PI_Obj_R_RelSpd = %f\n", floatval);
	filePutString (buffer, elcount(buffer), hFile);
	intval = getSignal(CHASSIS::CMS_PI_State_Gw_AR2::PI_TTI_R);
	snprintf(buffer, elcount(buffer), "   0.000000 F1 EIS::CMS_PI_State_Gw_AR2::PI_TTI_R = %d\n", intval);
	filePutString (buffer, elcount(buffer), hFile);
	intval = getSignal(CHASSIS::CMS_PI_State_Gw_AR2::CMS_R_Warn_Rq);
	snprintf(buffer, elcount(buffer), "   0.000000 F1 EIS::CMS_PI_State_Gw_AR2::CMS_R_Warn_Rq = %d\n", intval);
	filePutString (buffer, elcount(buffer), hFile);
	intval = getSignal(CHASSIS::CMS_PI_State_Gw_AR2::Rsrv1_CMS_PI_Stat_Pr2);
	snprintf(buffer, elcount(buffer), "   0.000000 F1 EIS::CMS_PI_State_Gw_AR2::Rsrv1_CMS_PI_Stat_Pr2 = %d\n", intval);
	filePutString (buffer, elcount(buffer), hFile);
	intval = getSignal(CHASSIS::CMS_PI_State_Gw_AR2::PI_RelsRcmmnd_R);
	snprintf(buffer, elcount(buffer), "   0.000000 F1 EIS::CMS_PI_State_Gw_AR2::PI_RelsRcmmnd_R = %d\n", intval);
	filePutString (buffer, elcount(buffer), hFile);
	intval = getSignal(CHASSIS::CMS_PI_State_Gw_AR2::PI_R_Enbl);
	snprintf(buffer, elcount(buffer), "   0.000000 F1 EIS::CMS_PI_State_Gw_AR2::PI_R_Enbl = %d\n", intval);
	filePutString (buffer, elcount(buffer), hFile);
	intval = getSignal(CHASSIS::CMS_PI_State_Gw_AR2::PI_RelsRcmmnd_Ft);
	snprintf(buffer, elcount(buffer), "   0.000000 F1 EIS::CMS_PI_State_Gw_AR2::PI_RelsRcmmnd_Ft = %d\n", intval);
	filePutString (buffer, elcount(buffer), hFile);
	intval = getSignal(CHASSIS::CMS_PI_State_Gw_AR2::PI_TTI_Ft);
	snprintf(buffer, elcount(buffer), "   0.000000 F1 EIS::CMS_PI_State_Gw_AR2::PI_TTI_Ft = %d\n", intval);
	filePutString (buffer, elcount(buffer), hFile);
	floatval = getSignal(CHASSIS::CMS_PI_State_Gw_AR2::PI_ObjAhdRelSpd);
	snprintf(buffer, elcount(buffer), "   0.000000 F1 EIS::CMS_PI_State_Gw_AR2::PI_ObjAhdRelSpd = %f\n", floatval);
	filePutString (buffer, elcount(buffer), hFile);
	intval = getSignal(CHASSIS::Config_HU4_AR2::Park_WarnFreq_Ft_Rq_HU);
	snprintf(buffer, elcount(buffer), "   0.000000 F1 EIS::Config_HU4_AR2::Park_WarnFreq_Ft_Rq_HU = %d\n", intval);
	filePutString (buffer, elcount(buffer), hFile);
	intval = getSignal(CHASSIS::Config_HU4_AR2::Park_WarnFreq_R_Rq_HU);
	snprintf(buffer, elcount(buffer), "   0.000000 F1 EIS::Config_HU4_AR2::Park_WarnFreq_R_Rq_HU = %d\n", intval);
	filePutString (buffer, elcount(buffer), hFile);
	intval = getSignal(CHASSIS::Config_HU4_AR2::Park_WarnVol_Ft_Rq_HU);
	snprintf(buffer, elcount(buffer), "   0.000000 F1 EIS::Config_HU4_AR2::Park_WarnVol_Ft_Rq_HU = %d\n", intval);
	filePutString (buffer, elcount(buffer), hFile);
	intval = getSignal(CHASSIS::Config_HU4_AR2::Park_WarnVol_R_Rq_HU);
	snprintf(buffer, elcount(buffer), "   0.000000 F1 EIS::Config_HU4_AR2::Park_WarnVol_R_Rq_HU = %d\n", intval);
	filePutString (buffer, elcount(buffer), hFile);
	intval = getSignal(CHASSIS::Config_HU4_AR2::Park_Sonar_Ft_Md_Rq_HU);
	snprintf(buffer, elcount(buffer), "   0.000000 F1 EIS::Config_HU4_AR2::Park_Sonar_Ft_Md_Rq_HU = %d\n", intval);
	filePutString (buffer, elcount(buffer), hFile);
	intval = getSignal(CHASSIS::Config_HU4_AR2::Park_Sonar_R_Md_Rq_HU);
	snprintf(buffer, elcount(buffer), "   0.000000 F1 EIS::Config_HU4_AR2::Park_Sonar_R_Md_Rq_HU = %d\n", intval);
	filePutString (buffer, elcount(buffer), hFile);
	intval = getSignal(CHASSIS::Config_HU4_AR2::Park_AccelMd_Rq_HU);
	snprintf(buffer, elcount(buffer), "   0.000000 F1 EIS::Config_HU4_AR2::Park_AccelMd_Rq_HU = %d\n", intval);
	filePutString (buffer, elcount(buffer), hFile);
	intval = getSignal(CHASSIS::Config_HU4_AR2::Park_AttenuatMd_Rq_HU);
	snprintf(buffer, elcount(buffer), "   0.000000 F1 EIS::Config_HU4_AR2::Park_AttenuatMd_Rq_HU = %d\n", intval);
	filePutString (buffer, elcount(buffer), hFile);
	intval = getSignal(CHASSIS::Config_HU4_AR2::Park_BrkMd_Rq_HU);
	snprintf(buffer, elcount(buffer), "   0.000000 F1 EIS::Config_HU4_AR2::Park_BrkMd_Rq_HU = %d\n", intval);
	filePutString (buffer, elcount(buffer), hFile);
	intval = getSignal(CHASSIS::Config_HU4_AR2::Park_CTA_Md_Rq_HU);
	snprintf(buffer, elcount(buffer), "   0.000000 F1 EIS::Config_HU4_AR2::Park_CTA_Md_Rq_HU = %d\n", intval);
	filePutString (buffer, elcount(buffer), hFile);
	intval = getSignal(CHASSIS::Config_HU4_AR2::Park_ObjDtctMd_Rq_HU);
	snprintf(buffer, elcount(buffer), "   0.000000 F1 EIS::Config_HU4_AR2::Park_ObjDtctMd_Rq_HU = %d\n", intval);
	filePutString (buffer, elcount(buffer), hFile);
	intval = getSignal(CHASSIS::Config_HU4_AR2::Park_RevGrMd_Rq_HU);
	snprintf(buffer, elcount(buffer), "   0.000000 F1 EIS::Config_HU4_AR2::Park_RevGrMd_Rq_HU = %d\n", intval);
	filePutString (buffer, elcount(buffer), hFile);
	intval = getSignal(CHASSIS::Config_HU4_AR2::Park_StMd_Rq_HU);
	snprintf(buffer, elcount(buffer), "   0.000000 F1 EIS::Config_HU4_AR2::Park_StMd_Rq_HU = %d\n", intval);
	filePutString (buffer, elcount(buffer), hFile);
	intval = getSignal(CHASSIS::Config_HU4_AR2::Park_StyleMd_Rq_HU);
	snprintf(buffer, elcount(buffer), "   0.000000 F1 EIS::Config_HU4_AR2::Park_StyleMd_Rq_HU = %d\n", intval);
	filePutString (buffer, elcount(buffer), hFile);
	intval = getSignal(CHASSIS::Config_HU4_AR2::Park_FactReset_Rq_HU);
	snprintf(buffer, elcount(buffer), "   0.000000 F1 EIS::Config_HU4_AR2::Park_FactReset_Rq_HU = %d\n", intval);
	filePutString (buffer, elcount(buffer), hFile);
	intval = getSignal(CHASSIS::Config_HU4_AR2::Park_ParkSpaceSelSw_Psd_HU);
	snprintf(buffer, elcount(buffer), "   0.000000 F1 EIS::Config_HU4_AR2::Park_ParkSpaceSelSw_Psd_HU = %d\n", intval);
	filePutString (buffer, elcount(buffer), hFile);
	floatval = getSignal(CHASSIS::Config_HU4_AR2::PNHV_AC_Curr_Max_Lim_Rq_HU);
	snprintf(buffer, elcount(buffer), "   0.000000 F1 EIS::Config_HU4_AR2::PNHV_AC_Curr_Max_Lim_Rq_HU = %f\n", floatval);
	filePutString (buffer, elcount(buffer), hFile);
	floatval = getSignal(CHASSIS::Config_HU4_AR2::HU_AC_Curr_Max_Rq);
	snprintf(buffer, elcount(buffer), "   0.000000 F1 EIS::Config_HU4_AR2::HU_AC_Curr_Max_Rq = %f\n", floatval);
	filePutString (buffer, elcount(buffer), hFile);
	intval = getSignal(CHASSIS::Config_HU4_AR2::CNG_FuelMdChg_Rq_V2);
	snprintf(buffer, elcount(buffer), "   0.000000 F1 EIS::Config_HU4_AR2::CNG_FuelMdChg_Rq_V2 = %d\n", intval);
	filePutString (buffer, elcount(buffer), hFile);
	intval = getSignal(CHASSIS::Config_HU4_AR2::StWhl_OFN_SnstyMd_Rq);
	snprintf(buffer, elcount(buffer), "   0.000000 F1 EIS::Config_HU4_AR2::StWhl_OFN_SnstyMd_Rq = %d\n", intval);
	filePutString (buffer, elcount(buffer), hFile);
	intval = getSignal(CHASSIS::Config_HU4_AR2::HU_TouchAcousticsMd_Stat);
	snprintf(buffer, elcount(buffer), "   0.000000 F1 EIS::Config_HU4_AR2::HU_TouchAcousticsMd_Stat = %d\n", intval);
	filePutString (buffer, elcount(buffer), hFile);
	intval = getSignal(CHASSIS::Config_HU5_AR2::TSA_SpdWarnOffset_Rq_HU);
	snprintf(buffer, elcount(buffer), "   0.000000 F1 EIS::Config_HU5_AR2::TSA_SpdWarnOffset_Rq_HU = %d\n", intval);
	filePutString (buffer, elcount(buffer), hFile);
	intval = getSignal(CHASSIS::Config_HU5_AR2::TSA_SpdWarnMd_Rq_HU);
	snprintf(buffer, elcount(buffer), "   0.000000 F1 EIS::Config_HU5_AR2::TSA_SpdWarnMd_Rq_HU = %d\n", intval);
	filePutString (buffer, elcount(buffer), hFile);
	intval = getSignal(CHASSIS::Config_HU5_AR2::TSA_HU_DispMd_Rq_HU);
	snprintf(buffer, elcount(buffer), "   0.000000 F1 EIS::Config_HU5_AR2::TSA_HU_DispMd_Rq_HU = %d\n", intval);
	filePutString (buffer, elcount(buffer), hFile);
	intval = getSignal(CHASSIS::Config_HU5_AR2::TSA_IC_DispMd_Rq_HU);
	snprintf(buffer, elcount(buffer), "   0.000000 F1 EIS::Config_HU5_AR2::TSA_IC_DispMd_Rq_HU = %d\n", intval);
	filePutString (buffer, elcount(buffer), hFile);
	intval = getSignal(CHASSIS::Config_HU5_AR2::TSA_WarnMd_Rq_HU);
	snprintf(buffer, elcount(buffer), "   0.000000 F1 EIS::Config_HU5_AR2::TSA_WarnMd_Rq_HU = %d\n", intval);
	filePutString (buffer, elcount(buffer), hFile);
	intval = getSignal(CHASSIS::Config_HU5_AR2::BSM_Md_Rq_HU);
	snprintf(buffer, elcount(buffer), "   0.000000 F1 EIS::Config_HU5_AR2::BSM_Md_Rq_HU = %d\n", intval);
	filePutString (buffer, elcount(buffer), hFile);
	intval = getSignal(CHASSIS::Config_HU5_AR2::DTQ_Md_Rq_HU);
	snprintf(buffer, elcount(buffer), "   0.000000 F1 EIS::Config_HU5_AR2::DTQ_Md_Rq_HU = %d\n", intval);
	filePutString (buffer, elcount(buffer), hFile);
	intval = getSignal(CHASSIS::Config_HU5_AR2::LDC_CMS_Md_Rq_HU);
	snprintf(buffer, elcount(buffer), "   0.000000 F1 EIS::Config_HU5_AR2::LDC_CMS_Md_Rq_HU = %d\n", intval);
	filePutString (buffer, elcount(buffer), hFile);
}
/*@@end*/

/*@@caplFunc:saveVars_30(dword):*/
void saveVars_30(dword hFile)
{
	intval = getSignal(CHASSIS::Config_HU5_AR2::LDP_Md_Rq_HU);
	snprintf(buffer, elcount(buffer), "   0.000000 F1 EIS::Config_HU5_AR2::LDP_Md_Rq_HU = %d\n", intval);
	filePutString (buffer, elcount(buffer), hFile);
	intval = getSignal(CHASSIS::Config_HU5_AR2::ESP_Md_Rq_HU);
	snprintf(buffer, elcount(buffer), "   0.000000 F1 EIS::Config_HU5_AR2::ESP_Md_Rq_HU = %d\n", intval);
	filePutString (buffer, elcount(buffer), hFile);
	intval = getSignal(CHASSIS::Config_HU5_AR2::DrowDtct_Md_Rq_HU);
	snprintf(buffer, elcount(buffer), "   0.000000 F1 EIS::Config_HU5_AR2::DrowDtct_Md_Rq_HU = %d\n", intval);
	filePutString (buffer, elcount(buffer), hFile);
	intval = getSignal(CHASSIS::Config_HU5_AR2::CMS_FactReset_Rq_HU);
	snprintf(buffer, elcount(buffer), "   0.000000 F1 EIS::Config_HU5_AR2::CMS_FactReset_Rq_HU = %d\n", intval);
	filePutString (buffer, elcount(buffer), hFile);
	intval = getSignal(CHASSIS::Config_HU5_AR2::LDC_SpdUnit_Rq_HU);
	snprintf(buffer, elcount(buffer), "   0.000000 F1 EIS::Config_HU5_AR2::LDC_SpdUnit_Rq_HU = %d\n", intval);
	filePutString (buffer, elcount(buffer), hFile);
	intval = getSignal(CHASSIS::Config_HU5_AR2::LDC_WTSL_Spd_Max_Rq_HU);
	snprintf(buffer, elcount(buffer), "   0.000000 F1 EIS::Config_HU5_AR2::LDC_WTSL_Spd_Max_Rq_HU = %d\n", intval);
	filePutString (buffer, elcount(buffer), hFile);
	intval = getSignal(CHASSIS::Config_HU5_AR2::LDC_SLA_SpdLmtTkOvr_Md_Rq_HU);
	snprintf(buffer, elcount(buffer), "   0.000000 F1 EIS::Config_HU5_AR2::LDC_SLA_SpdLmtTkOvr_Md_Rq_HU = %d\n", intval);
	filePutString (buffer, elcount(buffer), hFile);
	intval = getSignal(CHASSIS::Config_HU5_AR2::TSA_FactReset_Rq_HU);
	snprintf(buffer, elcount(buffer), "   0.000000 F1 EIS::Config_HU5_AR2::TSA_FactReset_Rq_HU = %d\n", intval);
	filePutString (buffer, elcount(buffer), hFile);
	intval = getSignal(CHASSIS::Config_HU5_AR2::TC_EEBBC_Rq);
	snprintf(buffer, elcount(buffer), "   0.000000 F1 EIS::Config_HU5_AR2::TC_EEBBC_Rq = %d\n", intval);
	filePutString (buffer, elcount(buffer), hFile);
	intval = getSignal(CHASSIS::Config_HU5_AR2::SND_GEN_Md_Rq);
	snprintf(buffer, elcount(buffer), "   0.000000 F1 EIS::Config_HU5_AR2::SND_GEN_Md_Rq = %d\n", intval);
	filePutString (buffer, elcount(buffer), hFile);
	intval = getSignal(CHASSIS::Config_HU5_AR2::Language_Rq_V2);
	snprintf(buffer, elcount(buffer), "   0.000000 F1 EIS::Config_HU5_AR2::Language_Rq_V2 = %d\n", intval);
	filePutString (buffer, elcount(buffer), hFile);
	intval = getSignal(CHASSIS::CRCM_Stat_AR::CT_Stat);
	snprintf(buffer, elcount(buffer), "   0.000000 F1 EIS::CRCM_Stat_AR::CT_Stat = %d\n", intval);
	filePutString (buffer, elcount(buffer), hFile);
	intval = getSignal(CHASSIS::CRCM_Stat_AR::Comf_OpnDrv_44);
	snprintf(buffer, elcount(buffer), "   0.000000 F1 EIS::CRCM_Stat_AR::Comf_OpnDrv_44 = %d\n", intval);
	filePutString (buffer, elcount(buffer), hFile);
	intval = getSignal(CHASSIS::CRCM_Stat_AR::PW_F_Oprtn_Sp_Rq_CTCM);
	snprintf(buffer, elcount(buffer), "   0.000000 F1 EIS::CRCM_Stat_AR::PW_F_Oprtn_Sp_Rq_CTCM = %d\n", intval);
	filePutString (buffer, elcount(buffer), hFile);
	intval = getSignal(CHASSIS::CRCM_Stat_AR::DL_Opn_Dsbl_Rq_CTCM);
	snprintf(buffer, elcount(buffer), "   0.000000 F1 EIS::CRCM_Stat_AR::DL_Opn_Dsbl_Rq_CTCM = %d\n", intval);
	filePutString (buffer, elcount(buffer), hFile);
	intval = getSignal(CHASSIS::CRCM_Stat_AR::SSA_Enbl_Rq_CRCM);
	snprintf(buffer, elcount(buffer), "   0.000000 F1 EIS::CRCM_Stat_AR::SSA_Enbl_Rq_CRCM = %d\n", intval);
	filePutString (buffer, elcount(buffer), hFile);
	intval = getSignal(CHASSIS::CRCM_Stat_AR::BeltHdOvr_Lt_Stat);
	snprintf(buffer, elcount(buffer), "   0.000000 F1 EIS::CRCM_Stat_AR::BeltHdOvr_Lt_Stat = %d\n", intval);
	filePutString (buffer, elcount(buffer), hFile);
	intval = getSignal(CHASSIS::CRCM_Stat_AR::BeltHdOvr_Rt_Stat);
	snprintf(buffer, elcount(buffer), "   0.000000 F1 EIS::CRCM_Stat_AR::BeltHdOvr_Rt_Stat = %d\n", intval);
	filePutString (buffer, elcount(buffer), hFile);
	intval = getSignal(CHASSIS::CRCM_Stat_AR::Win_FL_SS_Rq_CTCM);
	snprintf(buffer, elcount(buffer), "   0.000000 F1 EIS::CRCM_Stat_AR::Win_FL_SS_Rq_CTCM = %d\n", intval);
	filePutString (buffer, elcount(buffer), hFile);
	intval = getSignal(CHASSIS::CRCM_Stat_AR::Win_FR_SS_Rq_CTCM);
	snprintf(buffer, elcount(buffer), "   0.000000 F1 EIS::CRCM_Stat_AR::Win_FR_SS_Rq_CTCM = %d\n", intval);
	filePutString (buffer, elcount(buffer), hFile);
	intval = getSignal(CHASSIS::CRCM_Stat_AR::Win_RL_SS_Rq_CTCM);
	snprintf(buffer, elcount(buffer), "   0.000000 F1 EIS::CRCM_Stat_AR::Win_RL_SS_Rq_CTCM = %d\n", intval);
	filePutString (buffer, elcount(buffer), hFile);
	intval = getSignal(CHASSIS::CRCM_Stat_AR::Win_RR_SS_Rq_CTCM);
	snprintf(buffer, elcount(buffer), "   0.000000 F1 EIS::CRCM_Stat_AR::Win_RR_SS_Rq_CTCM = %d\n", intval);
	filePutString (buffer, elcount(buffer), hFile);
	intval = getSignal(CHASSIS::CRCM_Stat_AR::PN14_SupBatCutSw_Cls_Rq_CRCM);
	snprintf(buffer, elcount(buffer), "   0.000000 F1 EIS::CRCM_Stat_AR::PN14_SupBatCutSw_Cls_Rq_CRCM = %d\n", intval);
	filePutString (buffer, elcount(buffer), hFile);
	intval = getSignal(CHASSIS::CRCM_Stat_AR::KG_Key_Rq_CTCM);
	snprintf(buffer, elcount(buffer), "   0.000000 F1 EIS::CRCM_Stat_AR::KG_Key_Rq_CTCM = %d\n", intval);
	filePutString (buffer, elcount(buffer), hFile);
	intval = getSignal(CHASSIS::CTRL_C_Stat1_AR::OnKey_Psd);
	snprintf(buffer, elcount(buffer), "   0.000000 F1 EIS::CTRL_C_Stat1_AR::OnKey_Psd = %d\n", intval);
	filePutString (buffer, elcount(buffer), hFile);
	intval = @sysvar::CH_Nodes::CH_EISOnKey_PsdCTRL_C_St_UB_AUTO;
	snprintf(buffer, elcount(buffer), "   0.000000    SV: 2 0 0 ::CH_Nodes::CH_EISOnKey_PsdCTRL_C_St_UB_AUTO = %d\n", intval);
	filePutString (buffer, elcount(buffer), hFile);
	intval = @sysvar::CH_Nodes::CH_EISOnKey_PsdCTRL_C_Stat1__UB_;
	snprintf(buffer, elcount(buffer), "   0.000000    SV: 2 0 0 ::CH_Nodes::CH_EISOnKey_PsdCTRL_C_Stat1__UB_ = %d\n", intval);
	filePutString (buffer, elcount(buffer), hFile);
	intval = getSignal(CHASSIS::CTRL_C_Stat1_AR::PhoneKey_Psd);
	snprintf(buffer, elcount(buffer), "   0.000000 F1 EIS::CTRL_C_Stat1_AR::PhoneKey_Psd = %d\n", intval);
	filePutString (buffer, elcount(buffer), hFile);
	intval = @sysvar::CH_Nodes::CH_EISPhoneKey_PsdCTRL_C_UB_AUTO;
	snprintf(buffer, elcount(buffer), "   0.000000    SV: 2 0 0 ::CH_Nodes::CH_EISPhoneKey_PsdCTRL_C_UB_AUTO = %d\n", intval);
	filePutString (buffer, elcount(buffer), hFile);
	intval = @sysvar::CH_Nodes::CH_EISPhoneKey_PsdCTRL_C_Sta_UB_;
	snprintf(buffer, elcount(buffer), "   0.000000    SV: 2 0 0 ::CH_Nodes::CH_EISPhoneKey_PsdCTRL_C_Sta_UB_ = %d\n", intval);
	filePutString (buffer, elcount(buffer), hFile);
	intval = getSignal(CHASSIS::CTRL_C_Stat1_AR::RadioKey_Psd);
	snprintf(buffer, elcount(buffer), "   0.000000 F1 EIS::CTRL_C_Stat1_AR::RadioKey_Psd = %d\n", intval);
	filePutString (buffer, elcount(buffer), hFile);
	intval = @sysvar::CH_Nodes::CH_EISRadioKey_PsdCTRL_C_UB_AUTO;
	snprintf(buffer, elcount(buffer), "   0.000000    SV: 2 0 0 ::CH_Nodes::CH_EISRadioKey_PsdCTRL_C_UB_AUTO = %d\n", intval);
	filePutString (buffer, elcount(buffer), hFile);
	intval = @sysvar::CH_Nodes::CH_EISRadioKey_PsdCTRL_C_Sta_UB_;
	snprintf(buffer, elcount(buffer), "   0.000000    SV: 2 0 0 ::CH_Nodes::CH_EISRadioKey_PsdCTRL_C_Sta_UB_ = %d\n", intval);
	filePutString (buffer, elcount(buffer), hFile);
	intval = getSignal(CHASSIS::CTRL_C_Stat1_AR::SeatKey_Psd);
	snprintf(buffer, elcount(buffer), "   0.000000 F1 EIS::CTRL_C_Stat1_AR::SeatKey_Psd = %d\n", intval);
	filePutString (buffer, elcount(buffer), hFile);
	intval = @sysvar::CH_Nodes::CH_EISSeatKey_PsdCTRL_C__UB_AUTO;
	snprintf(buffer, elcount(buffer), "   0.000000    SV: 2 0 0 ::CH_Nodes::CH_EISSeatKey_PsdCTRL_C__UB_AUTO = %d\n", intval);
	filePutString (buffer, elcount(buffer), hFile);
	intval = @sysvar::CH_Nodes::CH_EISSeatKey_PsdCTRL_C_Stat_UB_;
	snprintf(buffer, elcount(buffer), "   0.000000    SV: 2 0 0 ::CH_Nodes::CH_EISSeatKey_PsdCTRL_C_Stat_UB_ = %d\n", intval);
	filePutString (buffer, elcount(buffer), hFile);
	intval = getSignal(CHASSIS::CTRL_C_Stat1_AR::NaviKey_Psd);
	snprintf(buffer, elcount(buffer), "   0.000000 F1 EIS::CTRL_C_Stat1_AR::NaviKey_Psd = %d\n", intval);
	filePutString (buffer, elcount(buffer), hFile);
	intval = @sysvar::CH_Nodes::CH_EISNaviKey_PsdCTRL_C__UB_AUTO;
	snprintf(buffer, elcount(buffer), "   0.000000    SV: 2 0 0 ::CH_Nodes::CH_EISNaviKey_PsdCTRL_C__UB_AUTO = %d\n", intval);
	filePutString (buffer, elcount(buffer), hFile);
	intval = @sysvar::CH_Nodes::CH_EISNaviKey_PsdCTRL_C_Stat_UB_;
	snprintf(buffer, elcount(buffer), "   0.000000    SV: 2 0 0 ::CH_Nodes::CH_EISNaviKey_PsdCTRL_C_Stat_UB_ = %d\n", intval);
	filePutString (buffer, elcount(buffer), hFile);
	intval = getSignal(CHASSIS::CTRL_C_Stat1_AR::MediaKey_Psd);
	snprintf(buffer, elcount(buffer), "   0.000000 F1 EIS::CTRL_C_Stat1_AR::MediaKey_Psd = %d\n", intval);
	filePutString (buffer, elcount(buffer), hFile);
	intval = @sysvar::CH_Nodes::CH_EISMediaKey_PsdCTRL_C_UB_AUTO;
	snprintf(buffer, elcount(buffer), "   0.000000    SV: 2 0 0 ::CH_Nodes::CH_EISMediaKey_PsdCTRL_C_UB_AUTO = %d\n", intval);
	filePutString (buffer, elcount(buffer), hFile);
	intval = @sysvar::CH_Nodes::CH_EISMediaKey_PsdCTRL_C_Sta_UB_;
	snprintf(buffer, elcount(buffer), "   0.000000    SV: 2 0 0 ::CH_Nodes::CH_EISMediaKey_PsdCTRL_C_Sta_UB_ = %d\n", intval);
	filePutString (buffer, elcount(buffer), hFile);
	intval = getSignal(CHASSIS::CTRL_C_Stat1_AR::CarKey_Psd);
	snprintf(buffer, elcount(buffer), "   0.000000 F1 EIS::CTRL_C_Stat1_AR::CarKey_Psd = %d\n", intval);
	filePutString (buffer, elcount(buffer), hFile);
	intval = @sysvar::CH_Nodes::CH_EISCarKey_PsdCTRL_C_S_UB_AUTO;
	snprintf(buffer, elcount(buffer), "   0.000000    SV: 2 0 0 ::CH_Nodes::CH_EISCarKey_PsdCTRL_C_S_UB_AUTO = %d\n", intval);
	filePutString (buffer, elcount(buffer), hFile);
	intval = @sysvar::CH_Nodes::CH_EISCarKey_PsdCTRL_C_Stat1_UB_;
	snprintf(buffer, elcount(buffer), "   0.000000    SV: 2 0 0 ::CH_Nodes::CH_EISCarKey_PsdCTRL_C_Stat1_UB_ = %d\n", intval);
	filePutString (buffer, elcount(buffer), hFile);
	intval = getSignal(CHASSIS::CTRL_C_Stat1_AR::ReturnKey_Psd);
	snprintf(buffer, elcount(buffer), "   0.000000 F1 EIS::CTRL_C_Stat1_AR::ReturnKey_Psd = %d\n", intval);
	filePutString (buffer, elcount(buffer), hFile);
	intval = @sysvar::CH_Nodes::CH_EISReturnKey_PsdCTRL__UB_AUTO;
	snprintf(buffer, elcount(buffer), "   0.000000    SV: 2 0 0 ::CH_Nodes::CH_EISReturnKey_PsdCTRL__UB_AUTO = %d\n", intval);
	filePutString (buffer, elcount(buffer), hFile);
	intval = @sysvar::CH_Nodes::CH_EISReturnKey_PsdCTRL_C_St_UB_;
	snprintf(buffer, elcount(buffer), "   0.000000    SV: 2 0 0 ::CH_Nodes::CH_EISReturnKey_PsdCTRL_C_St_UB_ = %d\n", intval);
	filePutString (buffer, elcount(buffer), hFile);
	intval = getSignal(CHASSIS::CTRL_C_Stat1_AR::ECO_Sw_Psd);
	snprintf(buffer, elcount(buffer), "   0.000000 F1 EIS::CTRL_C_Stat1_AR::ECO_Sw_Psd = %d\n", intval);
	filePutString (buffer, elcount(buffer), hFile);
	intval = getSignal(CHASSIS::CTRL_C_Stat1_AR::ADC_Sw_Psd_V3);
	snprintf(buffer, elcount(buffer), "   0.000000 F1 EIS::CTRL_C_Stat1_AR::ADC_Sw_Psd_V3 = %d\n", intval);
	filePutString (buffer, elcount(buffer), hFile);
	intval = getSignal(CHASSIS::CTRL_C_Stat1_AR::SuspLvlAdjSw_Psd);
	snprintf(buffer, elcount(buffer), "   0.000000 F1 EIS::CTRL_C_Stat1_AR::SuspLvlAdjSw_Psd = %d\n", intval);
	filePutString (buffer, elcount(buffer), hFile);
	intval = getSignal(CHASSIS::CTRL_C_Stat1_AR::VehDrvProgSw_Psd);
	snprintf(buffer, elcount(buffer), "   0.000000 F1 EIS::CTRL_C_Stat1_AR::VehDrvProgSw_Psd = %d\n", intval);
	filePutString (buffer, elcount(buffer), hFile);
	intval = getSignal(CHASSIS::CTRL_C_Stat1_AR::CTRL_C_C_Psd);
	snprintf(buffer, elcount(buffer), "   0.000000 F1 EIS::CTRL_C_Stat1_AR::CTRL_C_C_Psd = %d\n", intval);
	filePutString (buffer, elcount(buffer), hFile);
	intval = getSignal(CHASSIS::CTRL_C_Stat1_AR::CTRL_C_N_Psd);
	snprintf(buffer, elcount(buffer), "   0.000000 F1 EIS::CTRL_C_Stat1_AR::CTRL_C_N_Psd = %d\n", intval);
	filePutString (buffer, elcount(buffer), hFile);
	intval = getSignal(CHASSIS::CTRL_C_Stat1_AR::CTRL_C_NE_Psd);
	snprintf(buffer, elcount(buffer), "   0.000000 F1 EIS::CTRL_C_Stat1_AR::CTRL_C_NE_Psd = %d\n", intval);
	filePutString (buffer, elcount(buffer), hFile);
	intval = getSignal(CHASSIS::CTRL_C_Stat1_AR::CTRL_C_E_Psd);
	snprintf(buffer, elcount(buffer), "   0.000000 F1 EIS::CTRL_C_Stat1_AR::CTRL_C_E_Psd = %d\n", intval);
	filePutString (buffer, elcount(buffer), hFile);
	intval = getSignal(CHASSIS::CTRL_C_Stat1_AR::CTRL_C_SE_Psd);
	snprintf(buffer, elcount(buffer), "   0.000000 F1 EIS::CTRL_C_Stat1_AR::CTRL_C_SE_Psd = %d\n", intval);
	filePutString (buffer, elcount(buffer), hFile);
	intval = getSignal(CHASSIS::CTRL_C_Stat1_AR::CTRL_C_S_Psd);
	snprintf(buffer, elcount(buffer), "   0.000000 F1 EIS::CTRL_C_Stat1_AR::CTRL_C_S_Psd = %d\n", intval);
	filePutString (buffer, elcount(buffer), hFile);
	intval = getSignal(CHASSIS::CTRL_C_Stat1_AR::CTRL_C_SW_Psd);
	snprintf(buffer, elcount(buffer), "   0.000000 F1 EIS::CTRL_C_Stat1_AR::CTRL_C_SW_Psd = %d\n", intval);
	filePutString (buffer, elcount(buffer), hFile);
}
/*@@end*/

/*@@caplFunc:saveVars_31(dword):*/
void saveVars_31(dword hFile)
{
	intval = getSignal(CHASSIS::CTRL_C_Stat1_AR::CTRL_C_W_Psd);
	snprintf(buffer, elcount(buffer), "   0.000000 F1 EIS::CTRL_C_Stat1_AR::CTRL_C_W_Psd = %d\n", intval);
	filePutString (buffer, elcount(buffer), hFile);
	intval = getSignal(CHASSIS::CTRL_C_Stat1_AR::CTRL_C_NW_Psd);
	snprintf(buffer, elcount(buffer), "   0.000000 F1 EIS::CTRL_C_Stat1_AR::CTRL_C_NW_Psd = %d\n", intval);
	filePutString (buffer, elcount(buffer), hFile);
	intval = getSignal(CHASSIS::CTRL_C_Stat1_AR::Vol_Rq_CTRL_C_V1);
	snprintf(buffer, elcount(buffer), "   0.000000 F1 EIS::CTRL_C_Stat1_AR::Vol_Rq_CTRL_C_V1 = %d\n", intval);
	filePutString (buffer, elcount(buffer), hFile);
	intval = getSignal(CHASSIS::CTRL_C_Stat1_AR::MenuKey_Psd);
	snprintf(buffer, elcount(buffer), "   0.000000 F1 EIS::CTRL_C_Stat1_AR::MenuKey_Psd = %d\n", intval);
	filePutString (buffer, elcount(buffer), hFile);
	intval = @sysvar::CH_Nodes::CH_EISMenuKey_PsdCTRL_C__UB_AUTO;
	snprintf(buffer, elcount(buffer), "   0.000000    SV: 2 0 0 ::CH_Nodes::CH_EISMenuKey_PsdCTRL_C__UB_AUTO = %d\n", intval);
	filePutString (buffer, elcount(buffer), hFile);
	intval = @sysvar::CH_Nodes::CH_EISMenuKey_PsdCTRL_C_Stat_UB_;
	snprintf(buffer, elcount(buffer), "   0.000000    SV: 2 0 0 ::CH_Nodes::CH_EISMenuKey_PsdCTRL_C_Stat_UB_ = %d\n", intval);
	filePutString (buffer, elcount(buffer), hFile);
	intval = getSignal(CHASSIS::CTRL_C_Stat1_AR::MuteKey_Psd);
	snprintf(buffer, elcount(buffer), "   0.000000 F1 EIS::CTRL_C_Stat1_AR::MuteKey_Psd = %d\n", intval);
	filePutString (buffer, elcount(buffer), hFile);
	intval = @sysvar::CH_Nodes::CH_EISMuteKey_PsdCTRL_C__UB_AUTO;
	snprintf(buffer, elcount(buffer), "   0.000000    SV: 2 0 0 ::CH_Nodes::CH_EISMuteKey_PsdCTRL_C__UB_AUTO = %d\n", intval);
	filePutString (buffer, elcount(buffer), hFile);
	intval = @sysvar::CH_Nodes::CH_EISMuteKey_PsdCTRL_C_Stat_UB_;
	snprintf(buffer, elcount(buffer), "   0.000000    SV: 2 0 0 ::CH_Nodes::CH_EISMuteKey_PsdCTRL_C_Stat_UB_ = %d\n", intval);
	filePutString (buffer, elcount(buffer), hFile);
	intval = getSignal(CHASSIS::CTRL_C_Stat1_AR::PlugInHyb_OprtnMdSw_Psd);
	snprintf(buffer, elcount(buffer), "   0.000000 F1 EIS::CTRL_C_Stat1_AR::PlugInHyb_OprtnMdSw_Psd = %d\n", intval);
	filePutString (buffer, elcount(buffer), hFile);
	intval = getSignal(CHASSIS::CTRL_C_Stat1_AR::HdRst_R_Sw_Psd_CTRL_C);
	snprintf(buffer, elcount(buffer), "   0.000000 F1 EIS::CTRL_C_Stat1_AR::HdRst_R_Sw_Psd_CTRL_C = %d\n", intval);
	filePutString (buffer, elcount(buffer), hFile);
	intval = getSignal(CHASSIS::CTRL_C_Stat1_AR::RB_R_Sw_Psd_CTRL_C);
	snprintf(buffer, elcount(buffer), "   0.000000 F1 EIS::CTRL_C_Stat1_AR::RB_R_Sw_Psd_CTRL_C = %d\n", intval);
	filePutString (buffer, elcount(buffer), hFile);
	intval = getSignal(CHASSIS::CTRL_C_Stat1_AR::OffroadScreenSw_Psd);
	snprintf(buffer, elcount(buffer), "   0.000000 F1 EIS::CTRL_C_Stat1_AR::OffroadScreenSw_Psd = %d\n", intval);
	filePutString (buffer, elcount(buffer), hFile);
	intval = getSignal(CHASSIS::CTRL_C_Stat1_AR::BeltHdOvrSw_Psd_CTRL_C);
	snprintf(buffer, elcount(buffer), "   0.000000 F1 EIS::CTRL_C_Stat1_AR::BeltHdOvrSw_Psd_CTRL_C = %d\n", intval);
	filePutString (buffer, elcount(buffer), hFile);
	intval = getSignal(CHASSIS::CTRL_C_Stat1_AR::DSR_Sw_Psd);
	snprintf(buffer, elcount(buffer), "   0.000000 F1 EIS::CTRL_C_Stat1_AR::DSR_Sw_Psd = %d\n", intval);
	filePutString (buffer, elcount(buffer), hFile);
	intval = getSignal(CHASSIS::CTRL_C_Stat1_AR::ESP_Sw_Psd);
	snprintf(buffer, elcount(buffer), "   0.000000 F1 EIS::CTRL_C_Stat1_AR::ESP_Sw_Psd = %d\n", intval);
	filePutString (buffer, elcount(buffer), hFile);
	intval = getSignal(CHASSIS::CTRL_C_Stat1_AR::HU_EjectSw_Psd_CTRL_C);
	snprintf(buffer, elcount(buffer), "   0.000000 F1 EIS::CTRL_C_Stat1_AR::HU_EjectSw_Psd_CTRL_C = %d\n", intval);
	filePutString (buffer, elcount(buffer), hFile);
	intval = getSignal(CHASSIS::CTRL_C_Stat1_AR::ParkSw_Psd_CTRL_C);
	snprintf(buffer, elcount(buffer), "   0.000000 F1 EIS::CTRL_C_Stat1_AR::ParkSw_Psd_CTRL_C = %d\n", intval);
	filePutString (buffer, elcount(buffer), hFile);
	intval = getSignal(CHASSIS::CTRL_C_Stat1_AR::DrvProgSelect_Sw_Psd);
	snprintf(buffer, elcount(buffer), "   0.000000 F1 EIS::CTRL_C_Stat1_AR::DrvProgSelect_Sw_Psd = %d\n", intval);
	filePutString (buffer, elcount(buffer), hFile);
	intval = getSignal(CHASSIS::CTRL_C_Stat1_AR::VehDrvProg_M_Sw_Psd);
	snprintf(buffer, elcount(buffer), "   0.000000 F1 EIS::CTRL_C_Stat1_AR::VehDrvProg_M_Sw_Psd = %d\n", intval);
	filePutString (buffer, elcount(buffer), hFile);
	intval = getSignal(CHASSIS::CTRL_C_Stat1_AR::ExhstFlap_Sw_Psd_AMG);
	snprintf(buffer, elcount(buffer), "   0.000000 F1 EIS::CTRL_C_Stat1_AR::ExhstFlap_Sw_Psd_AMG = %d\n", intval);
	filePutString (buffer, elcount(buffer), hFile);
	intval = getSignal(CHASSIS::DAC4_ECM_AR::DAC_ECM_Data1);
	snprintf(buffer, elcount(buffer), "   0.000000 F1 EIS::DAC4_ECM_AR::DAC_ECM_Data1 = %d\n", intval);
	filePutString (buffer, elcount(buffer), hFile);
	intval = getSignal(CHASSIS::DAC4_ECM_AR::DAC_ECM_Data2);
	snprintf(buffer, elcount(buffer), "   0.000000 F1 EIS::DAC4_ECM_AR::DAC_ECM_Data2 = %d\n", intval);
	filePutString (buffer, elcount(buffer), hFile);
	intval = getSignal(CHASSIS::DAC4_ECM_AR::DAC_ECM_Data3);
	snprintf(buffer, elcount(buffer), "   0.000000 F1 EIS::DAC4_ECM_AR::DAC_ECM_Data3 = %d\n", intval);
	filePutString (buffer, elcount(buffer), hFile);
	intval = getSignal(CHASSIS::DAC4_ECM_AR::DAC_ECM_Data4);
	snprintf(buffer, elcount(buffer), "   0.000000 F1 EIS::DAC4_ECM_AR::DAC_ECM_Data4 = %d\n", intval);
	filePutString (buffer, elcount(buffer), hFile);
	intval = getSignal(CHASSIS::DAC4_ECM_AR::DAC_ECM_Data5);
	snprintf(buffer, elcount(buffer), "   0.000000 F1 EIS::DAC4_ECM_AR::DAC_ECM_Data5 = %d\n", intval);
	filePutString (buffer, elcount(buffer), hFile);
	intval = getSignal(CHASSIS::DAC4_ECM_AR::DAC_ECM_Data6);
	snprintf(buffer, elcount(buffer), "   0.000000 F1 EIS::DAC4_ECM_AR::DAC_ECM_Data6 = %d\n", intval);
	filePutString (buffer, elcount(buffer), hFile);
	intval = getSignal(CHASSIS::DAC4_ECM_AR::DAC_ECM_Data7);
	snprintf(buffer, elcount(buffer), "   0.000000 F1 EIS::DAC4_ECM_AR::DAC_ECM_Data7 = %d\n", intval);
	filePutString (buffer, elcount(buffer), hFile);
	intval = getSignal(CHASSIS::DAC4_ECM_AR::DAC_ECM_Data8);
	snprintf(buffer, elcount(buffer), "   0.000000 F1 EIS::DAC4_ECM_AR::DAC_ECM_Data8 = %d\n", intval);
	filePutString (buffer, elcount(buffer), hFile);
	intval = getSignal(CHASSIS::DAC4_EM2_AR::DAC_EM2_Data1);
	snprintf(buffer, elcount(buffer), "   0.000000 F1 EIS::DAC4_EM2_AR::DAC_EM2_Data1 = %d\n", intval);
	filePutString (buffer, elcount(buffer), hFile);
	intval = getSignal(CHASSIS::DAC4_EM2_AR::DAC_EM2_Data2);
	snprintf(buffer, elcount(buffer), "   0.000000 F1 EIS::DAC4_EM2_AR::DAC_EM2_Data2 = %d\n", intval);
	filePutString (buffer, elcount(buffer), hFile);
	intval = getSignal(CHASSIS::DAC4_EM2_AR::DAC_EM2_Data3);
	snprintf(buffer, elcount(buffer), "   0.000000 F1 EIS::DAC4_EM2_AR::DAC_EM2_Data3 = %d\n", intval);
	filePutString (buffer, elcount(buffer), hFile);
	intval = getSignal(CHASSIS::DAC4_EM2_AR::DAC_EM2_Data4);
	snprintf(buffer, elcount(buffer), "   0.000000 F1 EIS::DAC4_EM2_AR::DAC_EM2_Data4 = %d\n", intval);
	filePutString (buffer, elcount(buffer), hFile);
	intval = getSignal(CHASSIS::DAC4_EM2_AR::DAC_EM2_Data5);
	snprintf(buffer, elcount(buffer), "   0.000000 F1 EIS::DAC4_EM2_AR::DAC_EM2_Data5 = %d\n", intval);
	filePutString (buffer, elcount(buffer), hFile);
	intval = getSignal(CHASSIS::DAC4_EM2_AR::DAC_EM2_Data6);
	snprintf(buffer, elcount(buffer), "   0.000000 F1 EIS::DAC4_EM2_AR::DAC_EM2_Data6 = %d\n", intval);
	filePutString (buffer, elcount(buffer), hFile);
	intval = getSignal(CHASSIS::DAC4_EM2_AR::DAC_EM2_Data7);
	snprintf(buffer, elcount(buffer), "   0.000000 F1 EIS::DAC4_EM2_AR::DAC_EM2_Data7 = %d\n", intval);
	filePutString (buffer, elcount(buffer), hFile);
	intval = getSignal(CHASSIS::DAC4_EM2_AR::DAC_EM2_Data8);
	snprintf(buffer, elcount(buffer), "   0.000000 F1 EIS::DAC4_EM2_AR::DAC_EM2_Data8 = %d\n", intval);
	filePutString (buffer, elcount(buffer), hFile);
	intval = getSignal(CHASSIS::DAC4_ISM_AR::DAC_ISM_Data1);
	snprintf(buffer, elcount(buffer), "   0.000000 F1 EIS::DAC4_ISM_AR::DAC_ISM_Data1 = %d\n", intval);
	filePutString (buffer, elcount(buffer), hFile);
	intval = getSignal(CHASSIS::DAC4_ISM_AR::DAC_ISM_Data2);
	snprintf(buffer, elcount(buffer), "   0.000000 F1 EIS::DAC4_ISM_AR::DAC_ISM_Data2 = %d\n", intval);
	filePutString (buffer, elcount(buffer), hFile);
	intval = getSignal(CHASSIS::DAC4_ISM_AR::DAC_ISM_Data3);
	snprintf(buffer, elcount(buffer), "   0.000000 F1 EIS::DAC4_ISM_AR::DAC_ISM_Data3 = %d\n", intval);
	filePutString (buffer, elcount(buffer), hFile);
	intval = getSignal(CHASSIS::DAC4_ISM_AR::DAC_ISM_Data4);
	snprintf(buffer, elcount(buffer), "   0.000000 F1 EIS::DAC4_ISM_AR::DAC_ISM_Data4 = %d\n", intval);
	filePutString (buffer, elcount(buffer), hFile);
	intval = getSignal(CHASSIS::DAC4_ISM_AR::DAC_ISM_Data5);
	snprintf(buffer, elcount(buffer), "   0.000000 F1 EIS::DAC4_ISM_AR::DAC_ISM_Data5 = %d\n", intval);
	filePutString (buffer, elcount(buffer), hFile);
	intval = getSignal(CHASSIS::DAC4_ISM_AR::DAC_ISM_Data6);
	snprintf(buffer, elcount(buffer), "   0.000000 F1 EIS::DAC4_ISM_AR::DAC_ISM_Data6 = %d\n", intval);
	filePutString (buffer, elcount(buffer), hFile);
	intval = getSignal(CHASSIS::DAC4_ISM_AR::DAC_ISM_Data7);
	snprintf(buffer, elcount(buffer), "   0.000000 F1 EIS::DAC4_ISM_AR::DAC_ISM_Data7 = %d\n", intval);
	filePutString (buffer, elcount(buffer), hFile);
	intval = getSignal(CHASSIS::DAC4_ISM_AR::DAC_ISM_Data8);
	snprintf(buffer, elcount(buffer), "   0.000000 F1 EIS::DAC4_ISM_AR::DAC_ISM_Data8 = %d\n", intval);
	filePutString (buffer, elcount(buffer), hFile);
	intval = getSignal(CHASSIS::DAC4_TCM_AR::DAC_TCM_Data1);
	snprintf(buffer, elcount(buffer), "   0.000000 F1 EIS::DAC4_TCM_AR::DAC_TCM_Data1 = %d\n", intval);
	filePutString (buffer, elcount(buffer), hFile);
	intval = getSignal(CHASSIS::DAC4_TCM_AR::DAC_TCM_Data2);
	snprintf(buffer, elcount(buffer), "   0.000000 F1 EIS::DAC4_TCM_AR::DAC_TCM_Data2 = %d\n", intval);
	filePutString (buffer, elcount(buffer), hFile);
	intval = getSignal(CHASSIS::DAC4_TCM_AR::DAC_TCM_Data3);
	snprintf(buffer, elcount(buffer), "   0.000000 F1 EIS::DAC4_TCM_AR::DAC_TCM_Data3 = %d\n", intval);
	filePutString (buffer, elcount(buffer), hFile);
	intval = getSignal(CHASSIS::DAC4_TCM_AR::DAC_TCM_Data4);
	snprintf(buffer, elcount(buffer), "   0.000000 F1 EIS::DAC4_TCM_AR::DAC_TCM_Data4 = %d\n", intval);
	filePutString (buffer, elcount(buffer), hFile);
	intval = getSignal(CHASSIS::DAC4_TCM_AR::DAC_TCM_Data5);
	snprintf(buffer, elcount(buffer), "   0.000000 F1 EIS::DAC4_TCM_AR::DAC_TCM_Data5 = %d\n", intval);
	filePutString (buffer, elcount(buffer), hFile);
	intval = getSignal(CHASSIS::DAC4_TCM_AR::DAC_TCM_Data6);
	snprintf(buffer, elcount(buffer), "   0.000000 F1 EIS::DAC4_TCM_AR::DAC_TCM_Data6 = %d\n", intval);
	filePutString (buffer, elcount(buffer), hFile);
	intval = getSignal(CHASSIS::DAC4_TCM_AR::DAC_TCM_Data7);
	snprintf(buffer, elcount(buffer), "   0.000000 F1 EIS::DAC4_TCM_AR::DAC_TCM_Data7 = %d\n", intval);
	filePutString (buffer, elcount(buffer), hFile);
	intval = getSignal(CHASSIS::DAC4_TCM_AR::DAC_TCM_Data8);
	snprintf(buffer, elcount(buffer), "   0.000000 F1 EIS::DAC4_TCM_AR::DAC_TCM_Data8 = %d\n", intval);
	filePutString (buffer, elcount(buffer), hFile);
}
/*@@end*/

/*@@caplFunc:saveVars_32(dword):*/
void saveVars_32(dword hFile)
{
	floatval = getSignal(CHASSIS::Dimming_Stat_AR2::IP_Brt_IC);
	snprintf(buffer, elcount(buffer), "   0.000000 F1 EIS::Dimming_Stat_AR2::IP_Brt_IC = %f\n", floatval);
	filePutString (buffer, elcount(buffer), hFile);
	intval = getSignal(CHASSIS::Dimming_Stat_AR2::DispBrt_IC);
	snprintf(buffer, elcount(buffer), "   0.000000 F1 EIS::Dimming_Stat_AR2::DispBrt_IC = %d\n", intval);
	filePutString (buffer, elcount(buffer), hFile);
	intval = getSignal(CHASSIS::Dimming_Stat_AR2::SwIll_NightDay);
	snprintf(buffer, elcount(buffer), "   0.000000 F1 EIS::Dimming_Stat_AR2::SwIll_NightDay = %d\n", intval);
	filePutString (buffer, elcount(buffer), hFile);
	intval = getSignal(CHASSIS::Dimming_Stat_AR2::SwIllLvl_Dim_Md);
	snprintf(buffer, elcount(buffer), "   0.000000 F1 EIS::Dimming_Stat_AR2::SwIllLvl_Dim_Md = %d\n", intval);
	filePutString (buffer, elcount(buffer), hFile);
	intval = getSignal(CHASSIS::Dimming_Stat_AR2::SwIllLvl);
	snprintf(buffer, elcount(buffer), "   0.000000 F1 EIS::Dimming_Stat_AR2::SwIllLvl = %d\n", intval);
	filePutString (buffer, elcount(buffer), hFile);
	floatval = getSignal(CHASSIS::Dimming_Stat_AR2::FctIllLvl);
	snprintf(buffer, elcount(buffer), "   0.000000 F1 EIS::Dimming_Stat_AR2::FctIllLvl = %f\n", floatval);
	filePutString (buffer, elcount(buffer), hFile);
	intval = @sysvar::CH_Nodes::CH_EISCRC_Door_FL_Stat_Pr2D_AUTO;
	snprintf(buffer, elcount(buffer), "   0.000000    SV: 2 0 0 ::CH_Nodes::CH_EISCRC_Door_FL_Stat_Pr2D_AUTO = %d\n", intval);
	filePutString (buffer, elcount(buffer), hFile);
	intval = getSignal(CHASSIS::Door_FL_Stat_AR2::CRC_Door_FL_Stat_Pr2);
	snprintf(buffer, elcount(buffer), "   0.000000 F1 EIS::Door_FL_Stat_AR2::CRC_Door_FL_Stat_Pr2 = %d\n", intval);
	filePutString (buffer, elcount(buffer), hFile);
	intval = @sysvar::CH_Nodes::CH_EISSQC_Door_FL_Stat_Pr2D_AUTO;
	snprintf(buffer, elcount(buffer), "   0.000000    SV: 2 0 0 ::CH_Nodes::CH_EISSQC_Door_FL_Stat_Pr2D_AUTO = %d\n", intval);
	filePutString (buffer, elcount(buffer), hFile);
	intval = getSignal(CHASSIS::Door_FL_Stat_AR2::SQC_Door_FL_Stat_Pr2);
	snprintf(buffer, elcount(buffer), "   0.000000 F1 EIS::Door_FL_Stat_AR2::SQC_Door_FL_Stat_Pr2 = %d\n", intval);
	filePutString (buffer, elcount(buffer), hFile);
	intval = getSignal(CHASSIS::Door_FL_Stat_AR2::DrRLtch_FL_Stat);
	snprintf(buffer, elcount(buffer), "   0.000000 F1 EIS::Door_FL_Stat_AR2::DrRLtch_FL_Stat = %d\n", intval);
	filePutString (buffer, elcount(buffer), hFile);
	intval = getSignal(CHASSIS::Door_FL_Stat_AR2::Rsrv1_Door_FL_Stat_Pr2);
	snprintf(buffer, elcount(buffer), "   0.000000 F1 EIS::Door_FL_Stat_AR2::Rsrv1_Door_FL_Stat_Pr2 = %d\n", intval);
	filePutString (buffer, elcount(buffer), hFile);
	intval = getSignal(CHASSIS::Door_FL_Stat_AR2::DrPreLtch_FL_Engg);
	snprintf(buffer, elcount(buffer), "   0.000000 F1 EIS::Door_FL_Stat_AR2::DrPreLtch_FL_Engg = %d\n", intval);
	filePutString (buffer, elcount(buffer), hFile);
	intval = getSignal(CHASSIS::Door_FL_Stat_AR2::PwrCls_FL_Actv);
	snprintf(buffer, elcount(buffer), "   0.000000 F1 EIS::Door_FL_Stat_AR2::PwrCls_FL_Actv = %d\n", intval);
	filePutString (buffer, elcount(buffer), hFile);
	intval = getSignal(CHASSIS::Door_FL_Stat_AR2::Tweeter_FL_Posn_Stat);
	snprintf(buffer, elcount(buffer), "   0.000000 F1 EIS::Door_FL_Stat_AR2::Tweeter_FL_Posn_Stat = %d\n", intval);
	filePutString (buffer, elcount(buffer), hFile);
	intval = getSignal(CHASSIS::Door_FL_Stat_AR2::SeatAdj_P_LHD_Actv);
	snprintf(buffer, elcount(buffer), "   0.000000 F1 EIS::Door_FL_Stat_AR2::SeatAdj_P_LHD_Actv = %d\n", intval);
	filePutString (buffer, elcount(buffer), hFile);
	intval = getSignal(CHASSIS::Door_FL_Stat_AR2::CLkS_Sw_FL_Psd);
	snprintf(buffer, elcount(buffer), "   0.000000 F1 EIS::Door_FL_Stat_AR2::CLkS_Sw_FL_Psd = %d\n", intval);
	filePutString (buffer, elcount(buffer), hFile);
	intval = getSignal(CHASSIS::Door_FL_Stat_AR2::AutoDrLk_Rq_DM_FL);
	snprintf(buffer, elcount(buffer), "   0.000000 F1 EIS::Door_FL_Stat_AR2::AutoDrLk_Rq_DM_FL = %d\n", intval);
	filePutString (buffer, elcount(buffer), hFile);
	intval = getSignal(CHASSIS::Door_FL_Stat_AR2::DL_RemActn_LHD_Stat);
	snprintf(buffer, elcount(buffer), "   0.000000 F1 EIS::Door_FL_Stat_AR2::DL_RemActn_LHD_Stat = %d\n", intval);
	filePutString (buffer, elcount(buffer), hFile);
	intval = getSignal(CHASSIS::Door_FL_Stat_AR2::RemTank_Unlk_Sw_FL);
	snprintf(buffer, elcount(buffer), "   0.000000 F1 EIS::Door_FL_Stat_AR2::RemTank_Unlk_Sw_FL = %d\n", intval);
	filePutString (buffer, elcount(buffer), hFile);
	intval = getSignal(CHASSIS::Door_FL_Stat_AR2::ElecTrlrHtrch_Sw_Psd_FL);
	snprintf(buffer, elcount(buffer), "   0.000000 F1 EIS::Door_FL_Stat_AR2::ElecTrlrHtrch_Sw_Psd_FL = %d\n", intval);
	filePutString (buffer, elcount(buffer), hFile);
	intval = getSignal(CHASSIS::Door_FL_Stat_AR2::BSM_WarnUnit_Lt_Stat);
	snprintf(buffer, elcount(buffer), "   0.000000 F1 EIS::Door_FL_Stat_AR2::BSM_WarnUnit_Lt_Stat = %d\n", intval);
	filePutString (buffer, elcount(buffer), hFile);
	intval = getSignal(CHASSIS::Door_FL_Stat_AR2::MirrFld_Stat_LHD);
	snprintf(buffer, elcount(buffer), "   0.000000 F1 EIS::Door_FL_Stat_AR2::MirrFld_Stat_LHD = %d\n", intval);
	filePutString (buffer, elcount(buffer), hFile);
	intval = getSignal(CHASSIS::Door_FL_Stat_AR2::MirrFldPk_LHD_Stat);
	snprintf(buffer, elcount(buffer), "   0.000000 F1 EIS::Door_FL_Stat_AR2::MirrFldPk_LHD_Stat = %d\n", intval);
	filePutString (buffer, elcount(buffer), hFile);
	intval = getSignal(CHASSIS::Door_FL_Stat_AR2::MirrAdjSw_Stat_LHD_V2);
	snprintf(buffer, elcount(buffer), "   0.000000 F1 EIS::Door_FL_Stat_AR2::MirrAdjSw_Stat_LHD_V2 = %d\n", intval);
	filePutString (buffer, elcount(buffer), hFile);
	intval = getSignal(CHASSIS::Door_FL_Stat_AR2::Mirr_FL_Bl);
	snprintf(buffer, elcount(buffer), "   0.000000 F1 EIS::Door_FL_Stat_AR2::Mirr_FL_Bl = %d\n", intval);
	filePutString (buffer, elcount(buffer), hFile);
	intval = getSignal(CHASSIS::Door_FL_Stat_AR2::AddTurnLmp_Lt_Flt);
	snprintf(buffer, elcount(buffer), "   0.000000 F1 EIS::Door_FL_Stat_AR2::AddTurnLmp_Lt_Flt = %d\n", intval);
	filePutString (buffer, elcount(buffer), hFile);
	intval = @sysvar::CH_Nodes::CH_EISCRC_Door_FR_Stat_Pr2D_AUTO;
	snprintf(buffer, elcount(buffer), "   0.000000    SV: 2 0 0 ::CH_Nodes::CH_EISCRC_Door_FR_Stat_Pr2D_AUTO = %d\n", intval);
	filePutString (buffer, elcount(buffer), hFile);
	intval = getSignal(CHASSIS::Door_FR_Stat_AR2::CRC_Door_FR_Stat_Pr2);
	snprintf(buffer, elcount(buffer), "   0.000000 F1 EIS::Door_FR_Stat_AR2::CRC_Door_FR_Stat_Pr2 = %d\n", intval);
	filePutString (buffer, elcount(buffer), hFile);
	intval = @sysvar::CH_Nodes::CH_EISSQC_Door_FR_Stat_Pr2D_AUTO;
	snprintf(buffer, elcount(buffer), "   0.000000    SV: 2 0 0 ::CH_Nodes::CH_EISSQC_Door_FR_Stat_Pr2D_AUTO = %d\n", intval);
	filePutString (buffer, elcount(buffer), hFile);
	intval = getSignal(CHASSIS::Door_FR_Stat_AR2::SQC_Door_FR_Stat_Pr2);
	snprintf(buffer, elcount(buffer), "   0.000000 F1 EIS::Door_FR_Stat_AR2::SQC_Door_FR_Stat_Pr2 = %d\n", intval);
	filePutString (buffer, elcount(buffer), hFile);
	intval = getSignal(CHASSIS::Door_FR_Stat_AR2::DrRLtch_FR_Stat);
	snprintf(buffer, elcount(buffer), "   0.000000 F1 EIS::Door_FR_Stat_AR2::DrRLtch_FR_Stat = %d\n", intval);
	filePutString (buffer, elcount(buffer), hFile);
	intval = getSignal(CHASSIS::Door_FR_Stat_AR2::Rsrv1_Door_FR_Stat_Pr2);
	snprintf(buffer, elcount(buffer), "   0.000000 F1 EIS::Door_FR_Stat_AR2::Rsrv1_Door_FR_Stat_Pr2 = %d\n", intval);
	filePutString (buffer, elcount(buffer), hFile);
	intval = getSignal(CHASSIS::Door_FR_Stat_AR2::DrPreLtch_FR_Engg);
	snprintf(buffer, elcount(buffer), "   0.000000 F1 EIS::Door_FR_Stat_AR2::DrPreLtch_FR_Engg = %d\n", intval);
	filePutString (buffer, elcount(buffer), hFile);
	intval = getSignal(CHASSIS::Door_FR_Stat_AR2::PwrCls_FR_Actv);
	snprintf(buffer, elcount(buffer), "   0.000000 F1 EIS::Door_FR_Stat_AR2::PwrCls_FR_Actv = %d\n", intval);
	filePutString (buffer, elcount(buffer), hFile);
	intval = getSignal(CHASSIS::Door_FR_Stat_AR2::Tweeter_FR_Posn_Stat);
	snprintf(buffer, elcount(buffer), "   0.000000 F1 EIS::Door_FR_Stat_AR2::Tweeter_FR_Posn_Stat = %d\n", intval);
	filePutString (buffer, elcount(buffer), hFile);
	intval = getSignal(CHASSIS::Door_FR_Stat_AR2::SeatAdj_P_RHD_Actv);
	snprintf(buffer, elcount(buffer), "   0.000000 F1 EIS::Door_FR_Stat_AR2::SeatAdj_P_RHD_Actv = %d\n", intval);
	filePutString (buffer, elcount(buffer), hFile);
	intval = getSignal(CHASSIS::Door_FR_Stat_AR2::CLkS_Sw_FR_Psd);
	snprintf(buffer, elcount(buffer), "   0.000000 F1 EIS::Door_FR_Stat_AR2::CLkS_Sw_FR_Psd = %d\n", intval);
	filePutString (buffer, elcount(buffer), hFile);
	intval = getSignal(CHASSIS::Door_FR_Stat_AR2::AutoDrLk_Rq_DM_FR);
	snprintf(buffer, elcount(buffer), "   0.000000 F1 EIS::Door_FR_Stat_AR2::AutoDrLk_Rq_DM_FR = %d\n", intval);
	filePutString (buffer, elcount(buffer), hFile);
	intval = getSignal(CHASSIS::Door_FR_Stat_AR2::DL_RemActn_RHD_Stat);
	snprintf(buffer, elcount(buffer), "   0.000000 F1 EIS::Door_FR_Stat_AR2::DL_RemActn_RHD_Stat = %d\n", intval);
	filePutString (buffer, elcount(buffer), hFile);
	intval = getSignal(CHASSIS::Door_FR_Stat_AR2::RemTank_Unlk_Sw_FR);
	snprintf(buffer, elcount(buffer), "   0.000000 F1 EIS::Door_FR_Stat_AR2::RemTank_Unlk_Sw_FR = %d\n", intval);
	filePutString (buffer, elcount(buffer), hFile);
	intval = getSignal(CHASSIS::Door_FR_Stat_AR2::ElecTrlrHtrch_Sw_Psd_FR);
	snprintf(buffer, elcount(buffer), "   0.000000 F1 EIS::Door_FR_Stat_AR2::ElecTrlrHtrch_Sw_Psd_FR = %d\n", intval);
	filePutString (buffer, elcount(buffer), hFile);
	intval = getSignal(CHASSIS::Door_FR_Stat_AR2::BSM_WarnUnit_Rt_Stat);
	snprintf(buffer, elcount(buffer), "   0.000000 F1 EIS::Door_FR_Stat_AR2::BSM_WarnUnit_Rt_Stat = %d\n", intval);
	filePutString (buffer, elcount(buffer), hFile);
	intval = getSignal(CHASSIS::Door_FR_Stat_AR2::MirrFld_Stat_RHD);
	snprintf(buffer, elcount(buffer), "   0.000000 F1 EIS::Door_FR_Stat_AR2::MirrFld_Stat_RHD = %d\n", intval);
	filePutString (buffer, elcount(buffer), hFile);
	intval = getSignal(CHASSIS::Door_FR_Stat_AR2::MirrFldPk_RHD_Stat);
	snprintf(buffer, elcount(buffer), "   0.000000 F1 EIS::Door_FR_Stat_AR2::MirrFldPk_RHD_Stat = %d\n", intval);
	filePutString (buffer, elcount(buffer), hFile);
	intval = getSignal(CHASSIS::Door_FR_Stat_AR2::MirrAdjSw_Stat_RHD_V2);
	snprintf(buffer, elcount(buffer), "   0.000000 F1 EIS::Door_FR_Stat_AR2::MirrAdjSw_Stat_RHD_V2 = %d\n", intval);
	filePutString (buffer, elcount(buffer), hFile);
	intval = getSignal(CHASSIS::Door_FR_Stat_AR2::Mirr_FR_Bl);
	snprintf(buffer, elcount(buffer), "   0.000000 F1 EIS::Door_FR_Stat_AR2::Mirr_FR_Bl = %d\n", intval);
	filePutString (buffer, elcount(buffer), hFile);
	intval = getSignal(CHASSIS::Door_FR_Stat_AR2::AddTurnLmp_Rt_Flt);
	snprintf(buffer, elcount(buffer), "   0.000000 F1 EIS::Door_FR_Stat_AR2::AddTurnLmp_Rt_Flt = %d\n", intval);
	filePutString (buffer, elcount(buffer), hFile);
	intval = @sysvar::CH_Nodes::CH_EISCRC_Door_RL_Stat_Pr2D_AUTO;
	snprintf(buffer, elcount(buffer), "   0.000000    SV: 2 0 0 ::CH_Nodes::CH_EISCRC_Door_RL_Stat_Pr2D_AUTO = %d\n", intval);
	filePutString (buffer, elcount(buffer), hFile);
	intval = getSignal(CHASSIS::Door_RL_Stat_AR2::CRC_Door_RL_Stat_Pr2);
	snprintf(buffer, elcount(buffer), "   0.000000 F1 EIS::Door_RL_Stat_AR2::CRC_Door_RL_Stat_Pr2 = %d\n", intval);
	filePutString (buffer, elcount(buffer), hFile);
	intval = @sysvar::CH_Nodes::CH_EISSQC_Door_RL_Stat_Pr2D_AUTO;
	snprintf(buffer, elcount(buffer), "   0.000000    SV: 2 0 0 ::CH_Nodes::CH_EISSQC_Door_RL_Stat_Pr2D_AUTO = %d\n", intval);
	filePutString (buffer, elcount(buffer), hFile);
	intval = getSignal(CHASSIS::Door_RL_Stat_AR2::SQC_Door_RL_Stat_Pr2);
	snprintf(buffer, elcount(buffer), "   0.000000 F1 EIS::Door_RL_Stat_AR2::SQC_Door_RL_Stat_Pr2 = %d\n", intval);
	filePutString (buffer, elcount(buffer), hFile);
	intval = getSignal(CHASSIS::Door_RL_Stat_AR2::DrRLtch_RL_Stat);
	snprintf(buffer, elcount(buffer), "   0.000000 F1 EIS::Door_RL_Stat_AR2::DrRLtch_RL_Stat = %d\n", intval);
	filePutString (buffer, elcount(buffer), hFile);
	intval = getSignal(CHASSIS::Door_RL_Stat_AR2::Rsrv1_Door_RL_Stat_Pr2);
	snprintf(buffer, elcount(buffer), "   0.000000 F1 EIS::Door_RL_Stat_AR2::Rsrv1_Door_RL_Stat_Pr2 = %d\n", intval);
	filePutString (buffer, elcount(buffer), hFile);
	intval = getSignal(CHASSIS::Door_RL_Stat_AR2::CSL_SeatOprtn_RHD_Actv);
	snprintf(buffer, elcount(buffer), "   0.000000 F1 EIS::Door_RL_Stat_AR2::CSL_SeatOprtn_RHD_Actv = %d\n", intval);
	filePutString (buffer, elcount(buffer), hFile);
	intval = getSignal(CHASSIS::Door_RL_Stat_AR2::DrPreLtch_RL_Engg);
	snprintf(buffer, elcount(buffer), "   0.000000 F1 EIS::Door_RL_Stat_AR2::DrPreLtch_RL_Engg = %d\n", intval);
	filePutString (buffer, elcount(buffer), hFile);
	intval = getSignal(CHASSIS::Door_RL_Stat_AR2::PwrCls_RL_Actv);
	snprintf(buffer, elcount(buffer), "   0.000000 F1 EIS::Door_RL_Stat_AR2::PwrCls_RL_Actv = %d\n", intval);
	filePutString (buffer, elcount(buffer), hFile);
}
/*@@end*/

/*@@caplFunc:saveVars_33(dword):*/
void saveVars_33(dword hFile)
{
	intval = getSignal(CHASSIS::Door_RL_Stat_AR2::Tweeter_RL_Posn_Stat);
	snprintf(buffer, elcount(buffer), "   0.000000 F1 EIS::Door_RL_Stat_AR2::Tweeter_RL_Posn_Stat = %d\n", intval);
	filePutString (buffer, elcount(buffer), hFile);
	intval = getSignal(CHASSIS::Door_RL_Stat_AR2::FtSeatAdj_RL_Actv);
	snprintf(buffer, elcount(buffer), "   0.000000 F1 EIS::Door_RL_Stat_AR2::FtSeatAdj_RL_Actv = %d\n", intval);
	filePutString (buffer, elcount(buffer), hFile);
	intval = @sysvar::CH_Nodes::CH_EISCRC_Door_RR_Stat_Pr2D_AUTO;
	snprintf(buffer, elcount(buffer), "   0.000000    SV: 2 0 0 ::CH_Nodes::CH_EISCRC_Door_RR_Stat_Pr2D_AUTO = %d\n", intval);
	filePutString (buffer, elcount(buffer), hFile);
	intval = getSignal(CHASSIS::Door_RR_Stat_AR2::CRC_Door_RR_Stat_Pr2);
	snprintf(buffer, elcount(buffer), "   0.000000 F1 EIS::Door_RR_Stat_AR2::CRC_Door_RR_Stat_Pr2 = %d\n", intval);
	filePutString (buffer, elcount(buffer), hFile);
	intval = @sysvar::CH_Nodes::CH_EISSQC_Door_RR_Stat_Pr2D_AUTO;
	snprintf(buffer, elcount(buffer), "   0.000000    SV: 2 0 0 ::CH_Nodes::CH_EISSQC_Door_RR_Stat_Pr2D_AUTO = %d\n", intval);
	filePutString (buffer, elcount(buffer), hFile);
	intval = getSignal(CHASSIS::Door_RR_Stat_AR2::SQC_Door_RR_Stat_Pr2);
	snprintf(buffer, elcount(buffer), "   0.000000 F1 EIS::Door_RR_Stat_AR2::SQC_Door_RR_Stat_Pr2 = %d\n", intval);
	filePutString (buffer, elcount(buffer), hFile);
	intval = getSignal(CHASSIS::Door_RR_Stat_AR2::DrRLtch_RR_Stat);
	snprintf(buffer, elcount(buffer), "   0.000000 F1 EIS::Door_RR_Stat_AR2::DrRLtch_RR_Stat = %d\n", intval);
	filePutString (buffer, elcount(buffer), hFile);
	intval = getSignal(CHASSIS::Door_RR_Stat_AR2::Rsrv1_Door_RR_Stat_Pr2);
	snprintf(buffer, elcount(buffer), "   0.000000 F1 EIS::Door_RR_Stat_AR2::Rsrv1_Door_RR_Stat_Pr2 = %d\n", intval);
	filePutString (buffer, elcount(buffer), hFile);
	intval = getSignal(CHASSIS::Door_RR_Stat_AR2::CSL_SeatOprtn_LHD_Actv);
	snprintf(buffer, elcount(buffer), "   0.000000 F1 EIS::Door_RR_Stat_AR2::CSL_SeatOprtn_LHD_Actv = %d\n", intval);
	filePutString (buffer, elcount(buffer), hFile);
	intval = getSignal(CHASSIS::Door_RR_Stat_AR2::DrPreLtch_RR_Engg);
	snprintf(buffer, elcount(buffer), "   0.000000 F1 EIS::Door_RR_Stat_AR2::DrPreLtch_RR_Engg = %d\n", intval);
	filePutString (buffer, elcount(buffer), hFile);
	intval = getSignal(CHASSIS::Door_RR_Stat_AR2::PwrCls_RR_Actv);
	snprintf(buffer, elcount(buffer), "   0.000000 F1 EIS::Door_RR_Stat_AR2::PwrCls_RR_Actv = %d\n", intval);
	filePutString (buffer, elcount(buffer), hFile);
	intval = getSignal(CHASSIS::Door_RR_Stat_AR2::Tweeter_RR_Posn_Stat);
	snprintf(buffer, elcount(buffer), "   0.000000 F1 EIS::Door_RR_Stat_AR2::Tweeter_RR_Posn_Stat = %d\n", intval);
	filePutString (buffer, elcount(buffer), hFile);
	intval = getSignal(CHASSIS::Door_RR_Stat_AR2::FtSeatAdj_RR_Actv);
	snprintf(buffer, elcount(buffer), "   0.000000 F1 EIS::Door_RR_Stat_AR2::FtSeatAdj_RR_Actv = %d\n", intval);
	filePutString (buffer, elcount(buffer), hFile);
	intval = getSignal(CHASSIS::DPC_IndMd_Rq_AR::DPC_IndMd_PT_Rq);
	snprintf(buffer, elcount(buffer), "   0.000000 F1 EIS::DPC_IndMd_Rq_AR::DPC_IndMd_PT_Rq = %d\n", intval);
	filePutString (buffer, elcount(buffer), hFile);
	intval = getSignal(CHASSIS::DPC_IndMd_Rq_AR::DPC_IndMd_St_Rq);
	snprintf(buffer, elcount(buffer), "   0.000000 F1 EIS::DPC_IndMd_Rq_AR::DPC_IndMd_St_Rq = %d\n", intval);
	filePutString (buffer, elcount(buffer), hFile);
	intval = getSignal(CHASSIS::DPC_IndMd_Rq_AR::DPC_IndMd_Susp_Rq);
	snprintf(buffer, elcount(buffer), "   0.000000 F1 EIS::DPC_IndMd_Rq_AR::DPC_IndMd_Susp_Rq = %d\n", intval);
	filePutString (buffer, elcount(buffer), hFile);
	intval = getSignal(CHASSIS::DPC_IndMd_Rq_AR::DPC_IndMd_SSA_Rq);
	snprintf(buffer, elcount(buffer), "   0.000000 F1 EIS::DPC_IndMd_Rq_AR::DPC_IndMd_SSA_Rq = %d\n", intval);
	filePutString (buffer, elcount(buffer), hFile);
	intval = getSignal(CHASSIS::DPC_IndMd_Rq_AR::DPC_OffroadMd_Rq);
	snprintf(buffer, elcount(buffer), "   0.000000 F1 EIS::DPC_IndMd_Rq_AR::DPC_OffroadMd_Rq = %d\n", intval);
	filePutString (buffer, elcount(buffer), hFile);
	intval = getSignal(CHASSIS::DPC_IndMd_Rq_AR::DPC_IndMd_eDrv_Rq);
	snprintf(buffer, elcount(buffer), "   0.000000 F1 EIS::DPC_IndMd_Rq_AR::DPC_IndMd_eDrv_Rq = %d\n", intval);
	filePutString (buffer, elcount(buffer), hFile);
	intval = getSignal(CHASSIS::DPC_IndMd_Rq_AR::DPC_IndMd_PwrFreeD_Plus_Rq);
	snprintf(buffer, elcount(buffer), "   0.000000 F1 EIS::DPC_IndMd_Rq_AR::DPC_IndMd_PwrFreeD_Plus_Rq = %d\n", intval);
	filePutString (buffer, elcount(buffer), hFile);
	intval = getSignal(CHASSIS::DPC_IndMd_Rq_AR::DPC_IndMd_ECO_Assist_Rq);
	snprintf(buffer, elcount(buffer), "   0.000000 F1 EIS::DPC_IndMd_Rq_AR::DPC_IndMd_ECO_Assist_Rq = %d\n", intval);
	filePutString (buffer, elcount(buffer), hFile);
	intval = getSignal(CHASSIS::DPC_IndMd_Rq_AR::DPC_IndMd_AC_Rq);
	snprintf(buffer, elcount(buffer), "   0.000000 F1 EIS::DPC_IndMd_Rq_AR::DPC_IndMd_AC_Rq = %d\n", intval);
	filePutString (buffer, elcount(buffer), hFile);
	intval = getSignal(CHASSIS::DPC_IndMd_Rq_AR::DPC_IndMd_Ht_Rq);
	snprintf(buffer, elcount(buffer), "   0.000000 F1 EIS::DPC_IndMd_Rq_AR::DPC_IndMd_Ht_Rq = %d\n", intval);
	filePutString (buffer, elcount(buffer), hFile);
	intval = getSignal(CHASSIS::DPC_IndMd_Rq_AR::DPC_IndMd_Tx_Rq);
	snprintf(buffer, elcount(buffer), "   0.000000 F1 EIS::DPC_IndMd_Rq_AR::DPC_IndMd_Tx_Rq = %d\n", intval);
	filePutString (buffer, elcount(buffer), hFile);
	intval = getSignal(CHASSIS::DPC_IndMd_Rq_AR::DPC_IndMd_ESP_Rq);
	snprintf(buffer, elcount(buffer), "   0.000000 F1 EIS::DPC_IndMd_Rq_AR::DPC_IndMd_ESP_Rq = %d\n", intval);
	filePutString (buffer, elcount(buffer), hFile);
	intval = getSignal(CHASSIS::DPC_IndMd_Rq_AR::DPC_IndMd_ExhstFlap_Rq);
	snprintf(buffer, elcount(buffer), "   0.000000 F1 EIS::DPC_IndMd_Rq_AR::DPC_IndMd_ExhstFlap_Rq = %d\n", intval);
	filePutString (buffer, elcount(buffer), hFile);
	intval = getSignal(CHASSIS::DPC_IndMd_Rq_AR::DPC_IndMd_AS_Rq);
	snprintf(buffer, elcount(buffer), "   0.000000 F1 EIS::DPC_IndMd_Rq_AR::DPC_IndMd_AS_Rq = %d\n", intval);
	filePutString (buffer, elcount(buffer), hFile);
	intval = getSignal(CHASSIS::DPC_IndMd_Rq_AR::DPC_IndMd_ABC_Rq);
	snprintf(buffer, elcount(buffer), "   0.000000 F1 EIS::DPC_IndMd_Rq_AR::DPC_IndMd_ABC_Rq = %d\n", intval);
	filePutString (buffer, elcount(buffer), hFile);
	floatval = getSignal(CHASSIS::EAC_Stat_AR::CompSpd_V2);
	snprintf(buffer, elcount(buffer), "   0.000000 F1 EIS::EAC_Stat_AR::CompSpd_V2 = %f\n", floatval);
	filePutString (buffer, elcount(buffer), hFile);
	floatval = getSignal(CHASSIS::EAC_Stat_AR::EAC_Volt_V2);
	snprintf(buffer, elcount(buffer), "   0.000000 F1 EIS::EAC_Stat_AR::EAC_Volt_V2 = %f\n", floatval);
	filePutString (buffer, elcount(buffer), hFile);
	intval = getSignal(CHASSIS::EAC_Stat_AR::Comp_Oprtn_Stat_V2);
	snprintf(buffer, elcount(buffer), "   0.000000 F1 EIS::EAC_Stat_AR::Comp_Oprtn_Stat_V2 = %d\n", intval);
	filePutString (buffer, elcount(buffer), hFile);
	floatval = getSignal(CHASSIS::EAC_Stat_AR::EAC_Curr);
	snprintf(buffer, elcount(buffer), "   0.000000 F1 EIS::EAC_Stat_AR::EAC_Curr = %f\n", floatval);
	filePutString (buffer, elcount(buffer), hFile);
	intval = getSignal(CHASSIS::EAC_Stat_AR::EAC_Off_ShrtCurr);
	snprintf(buffer, elcount(buffer), "   0.000000 F1 EIS::EAC_Stat_AR::EAC_Off_ShrtCurr = %d\n", intval);
	filePutString (buffer, elcount(buffer), hFile);
	intval = getSignal(CHASSIS::EAC_Stat_AR::EAC_Off_Stall);
	snprintf(buffer, elcount(buffer), "   0.000000 F1 EIS::EAC_Stat_AR::EAC_Off_Stall = %d\n", intval);
	filePutString (buffer, elcount(buffer), hFile);
	intval = getSignal(CHASSIS::EAC_Stat_AR::EAC_Sp_ExtPwrSup_Flt);
	snprintf(buffer, elcount(buffer), "   0.000000 F1 EIS::EAC_Stat_AR::EAC_Sp_ExtPwrSup_Flt = %d\n", intval);
	filePutString (buffer, elcount(buffer), hFile);
	intval = getSignal(CHASSIS::EAC_Stat_AR::EAC_Sp_Temp_Excess);
	snprintf(buffer, elcount(buffer), "   0.000000 F1 EIS::EAC_Stat_AR::EAC_Sp_Temp_Excess = %d\n", intval);
	filePutString (buffer, elcount(buffer), hFile);
	intval = getSignal(CHASSIS::EAC_Stat_AR::EAC_Sp_Trq_Excess);
	snprintf(buffer, elcount(buffer), "   0.000000 F1 EIS::EAC_Stat_AR::EAC_Sp_Trq_Excess = %d\n", intval);
	filePutString (buffer, elcount(buffer), hFile);
	intval = getSignal(CHASSIS::EAC_Stat_AR::EAC_CurrLmt);
	snprintf(buffer, elcount(buffer), "   0.000000 F1 EIS::EAC_Stat_AR::EAC_CurrLmt = %d\n", intval);
	filePutString (buffer, elcount(buffer), hFile);
	intval = @sysvar::CH_Nodes::CH_EISCRC_ExtLgt_Lmp_On_Rq__AUTO;
	snprintf(buffer, elcount(buffer), "   0.000000    SV: 2 0 0 ::CH_Nodes::CH_EISCRC_ExtLgt_Lmp_On_Rq__AUTO = %d\n", intval);
	filePutString (buffer, elcount(buffer), hFile);
	intval = getSignal(CHASSIS::EL_Stat_AR2::CRC_ExtLgt_Lmp_On_Rq_Pr2);
	snprintf(buffer, elcount(buffer), "   0.000000 F1 EIS::EL_Stat_AR2::CRC_ExtLgt_Lmp_On_Rq_Pr2 = %d\n", intval);
	filePutString (buffer, elcount(buffer), hFile);
	intval = @sysvar::CH_Nodes::CH_EISSQC_ExtLgt_Lmp_On_Rq__AUTO;
	snprintf(buffer, elcount(buffer), "   0.000000    SV: 2 0 0 ::CH_Nodes::CH_EISSQC_ExtLgt_Lmp_On_Rq__AUTO = %d\n", intval);
	filePutString (buffer, elcount(buffer), hFile);
	intval = getSignal(CHASSIS::EL_Stat_AR2::SQC_ExtLgt_Lmp_On_Rq_Pr2);
	snprintf(buffer, elcount(buffer), "   0.000000 F1 EIS::EL_Stat_AR2::SQC_ExtLgt_Lmp_On_Rq_Pr2 = %d\n", intval);
	filePutString (buffer, elcount(buffer), hFile);
	intval = getSignal(CHASSIS::EL_Stat_AR2::PosnLmp_On_Rq);
	snprintf(buffer, elcount(buffer), "   0.000000 F1 EIS::EL_Stat_AR2::PosnLmp_On_Rq = %d\n", intval);
	filePutString (buffer, elcount(buffer), hFile);
	intval = getSignal(CHASSIS::EL_Stat_AR2::PosnLmp_IndLmp_On_Rq);
	snprintf(buffer, elcount(buffer), "   0.000000 F1 EIS::EL_Stat_AR2::PosnLmp_IndLmp_On_Rq = %d\n", intval);
	filePutString (buffer, elcount(buffer), hFile);
	intval = getSignal(CHASSIS::EL_Stat_AR2::LoBm_On_Rq);
	snprintf(buffer, elcount(buffer), "   0.000000 F1 EIS::EL_Stat_AR2::LoBm_On_Rq = %d\n", intval);
	filePutString (buffer, elcount(buffer), hFile);
	intval = getSignal(CHASSIS::EL_Stat_AR2::LoBm_IndLmp_On_Rq);
	snprintf(buffer, elcount(buffer), "   0.000000 F1 EIS::EL_Stat_AR2::LoBm_IndLmp_On_Rq = %d\n", intval);
	filePutString (buffer, elcount(buffer), hFile);
	intval = getSignal(CHASSIS::EL_Stat_AR2::TlLmp_Lt_On_Rq);
	snprintf(buffer, elcount(buffer), "   0.000000 F1 EIS::EL_Stat_AR2::TlLmp_Lt_On_Rq = %d\n", intval);
	filePutString (buffer, elcount(buffer), hFile);
	intval = getSignal(CHASSIS::EL_Stat_AR2::TlLmp_Rt_On_Rq);
	snprintf(buffer, elcount(buffer), "   0.000000 F1 EIS::EL_Stat_AR2::TlLmp_Rt_On_Rq = %d\n", intval);
	filePutString (buffer, elcount(buffer), hFile);
	intval = getSignal(CHASSIS::EL_Stat_AR2::SM_RL_On_Rq);
	snprintf(buffer, elcount(buffer), "   0.000000 F1 EIS::EL_Stat_AR2::SM_RL_On_Rq = %d\n", intval);
	filePutString (buffer, elcount(buffer), hFile);
	intval = getSignal(CHASSIS::EL_Stat_AR2::SM_RR_On_Rq);
	snprintf(buffer, elcount(buffer), "   0.000000 F1 EIS::EL_Stat_AR2::SM_RR_On_Rq = %d\n", intval);
	filePutString (buffer, elcount(buffer), hFile);
	intval = getSignal(CHASSIS::EL_Stat_AR2::LP_Lmp_Lt_On_Rq);
	snprintf(buffer, elcount(buffer), "   0.000000 F1 EIS::EL_Stat_AR2::LP_Lmp_Lt_On_Rq = %d\n", intval);
	filePutString (buffer, elcount(buffer), hFile);
	intval = getSignal(CHASSIS::EL_Stat_AR2::NS_Ill_Actv);
	snprintf(buffer, elcount(buffer), "   0.000000 F1 EIS::EL_Stat_AR2::NS_Ill_Actv = %d\n", intval);
	filePutString (buffer, elcount(buffer), hFile);
	intval = getSignal(CHASSIS::EL_Stat_AR2::SurrIll_Stat);
	snprintf(buffer, elcount(buffer), "   0.000000 F1 EIS::EL_Stat_AR2::SurrIll_Stat = %d\n", intval);
	filePutString (buffer, elcount(buffer), hFile);
	intval = getSignal(CHASSIS::EL_Stat_AR2::EntrLmp_Front_LT_On_Rq);
	snprintf(buffer, elcount(buffer), "   0.000000 F1 EIS::EL_Stat_AR2::EntrLmp_Front_LT_On_Rq = %d\n", intval);
	filePutString (buffer, elcount(buffer), hFile);
	intval = getSignal(CHASSIS::EL_Stat_AR2::EntrLmp_Front_RT_On_Rq);
	snprintf(buffer, elcount(buffer), "   0.000000 F1 EIS::EL_Stat_AR2::EntrLmp_Front_RT_On_Rq = %d\n", intval);
	filePutString (buffer, elcount(buffer), hFile);
}
/*@@end*/

/*@@caplFunc:saveVars_34(dword):*/
void saveVars_34(dword hFile)
{
	intval = getSignal(CHASSIS::EL_Stat_AR2::EntrLmp_Rear_Lt_On_Rq);
	snprintf(buffer, elcount(buffer), "   0.000000 F1 EIS::EL_Stat_AR2::EntrLmp_Rear_Lt_On_Rq = %d\n", intval);
	filePutString (buffer, elcount(buffer), hFile);
	intval = getSignal(CHASSIS::EL_Stat_AR2::EntrLmp_Rear_Rt_On_Rq);
	snprintf(buffer, elcount(buffer), "   0.000000 F1 EIS::EL_Stat_AR2::EntrLmp_Rear_Rt_On_Rq = %d\n", intval);
	filePutString (buffer, elcount(buffer), hFile);
	intval = getSignal(CHASSIS::EL_Stat_AR2::Rsrv1_ExtLgt_Lmp_On_Rq_Pr2);
	snprintf(buffer, elcount(buffer), "   0.000000 F1 EIS::EL_Stat_AR2::Rsrv1_ExtLgt_Lmp_On_Rq_Pr2 = %d\n", intval);
	filePutString (buffer, elcount(buffer), hFile);
	intval = getSignal(CHASSIS::EL_Stat_AR2::HiBm_On);
	snprintf(buffer, elcount(buffer), "   0.000000 F1 EIS::EL_Stat_AR2::HiBm_On = %d\n", intval);
	filePutString (buffer, elcount(buffer), hFile);
	intval = getSignal(CHASSIS::EL_Stat_AR2::HiBm_IndLmp_On_Rq);
	snprintf(buffer, elcount(buffer), "   0.000000 F1 EIS::EL_Stat_AR2::HiBm_IndLmp_On_Rq = %d\n", intval);
	filePutString (buffer, elcount(buffer), hFile);
	intval = getSignal(CHASSIS::EL_Stat_AR2::FogLmp_Ft_On_Rq);
	snprintf(buffer, elcount(buffer), "   0.000000 F1 EIS::EL_Stat_AR2::FogLmp_Ft_On_Rq = %d\n", intval);
	filePutString (buffer, elcount(buffer), hFile);
	intval = getSignal(CHASSIS::EL_Stat_AR2::FogLmp_Ft_IndLmp_On_Rq);
	snprintf(buffer, elcount(buffer), "   0.000000 F1 EIS::EL_Stat_AR2::FogLmp_Ft_IndLmp_On_Rq = %d\n", intval);
	filePutString (buffer, elcount(buffer), hFile);
	intval = getSignal(CHASSIS::EL_Stat_AR2::FogLmp_R_On_Rq);
	snprintf(buffer, elcount(buffer), "   0.000000 F1 EIS::EL_Stat_AR2::FogLmp_R_On_Rq = %d\n", intval);
	filePutString (buffer, elcount(buffer), hFile);
	intval = getSignal(CHASSIS::EL_Stat_AR2::FogLmp_R_IndLmp_On_Rq);
	snprintf(buffer, elcount(buffer), "   0.000000 F1 EIS::EL_Stat_AR2::FogLmp_R_IndLmp_On_Rq = %d\n", intval);
	filePutString (buffer, elcount(buffer), hFile);
	intval = getSignal(CHASSIS::EL_Stat_AR2::PkLmp_Lt_On_Rq);
	snprintf(buffer, elcount(buffer), "   0.000000 F1 EIS::EL_Stat_AR2::PkLmp_Lt_On_Rq = %d\n", intval);
	filePutString (buffer, elcount(buffer), hFile);
	intval = getSignal(CHASSIS::EL_Stat_AR2::PkLmp_Rt_On_Rq);
	snprintf(buffer, elcount(buffer), "   0.000000 F1 EIS::EL_Stat_AR2::PkLmp_Rt_On_Rq = %d\n", intval);
	filePutString (buffer, elcount(buffer), hFile);
	intval = getSignal(CHASSIS::EL_Stat_AR2::FogLmp_RL_On_Rq);
	snprintf(buffer, elcount(buffer), "   0.000000 F1 EIS::EL_Stat_AR2::FogLmp_RL_On_Rq = %d\n", intval);
	filePutString (buffer, elcount(buffer), hFile);
	intval = getSignal(CHASSIS::EL_Stat_AR2::FogLmp_RR_On_Rq);
	snprintf(buffer, elcount(buffer), "   0.000000 F1 EIS::EL_Stat_AR2::FogLmp_RR_On_Rq = %d\n", intval);
	filePutString (buffer, elcount(buffer), hFile);
	intval = getSignal(CHASSIS::EL_Stat_AR2::DRL_Dim_Actv);
	snprintf(buffer, elcount(buffer), "   0.000000 F1 EIS::EL_Stat_AR2::DRL_Dim_Actv = %d\n", intval);
	filePutString (buffer, elcount(buffer), hFile);
	intval = getSignal(CHASSIS::EL_Stat_AR2::DRL_LT_On_Rq);
	snprintf(buffer, elcount(buffer), "   0.000000 F1 EIS::EL_Stat_AR2::DRL_LT_On_Rq = %d\n", intval);
	filePutString (buffer, elcount(buffer), hFile);
	intval = getSignal(CHASSIS::EL_Stat_AR2::DRL_RT_On_Rq);
	snprintf(buffer, elcount(buffer), "   0.000000 F1 EIS::EL_Stat_AR2::DRL_RT_On_Rq = %d\n", intval);
	filePutString (buffer, elcount(buffer), hFile);
	intval = getSignal(CHASSIS::EL_Stat_AR2::IrLmp_Stat);
	snprintf(buffer, elcount(buffer), "   0.000000 F1 EIS::EL_Stat_AR2::IrLmp_Stat = %d\n", intval);
	filePutString (buffer, elcount(buffer), hFile);
	intval = getSignal(CHASSIS::EL_Stat_AR2::BuLmp_Lt_On_Rq);
	snprintf(buffer, elcount(buffer), "   0.000000 F1 EIS::EL_Stat_AR2::BuLmp_Lt_On_Rq = %d\n", intval);
	filePutString (buffer, elcount(buffer), hFile);
	intval = getSignal(CHASSIS::EL_Stat_AR2::BuLmp_Rt_On_Rq);
	snprintf(buffer, elcount(buffer), "   0.000000 F1 EIS::EL_Stat_AR2::BuLmp_Rt_On_Rq = %d\n", intval);
	filePutString (buffer, elcount(buffer), hFile);
	intval = getSignal(CHASSIS::EL_Stat_AR2::SVS_ExtLmp_Actv_V2);
	snprintf(buffer, elcount(buffer), "   0.000000 F1 EIS::EL_Stat_AR2::SVS_ExtLmp_Actv_V2 = %d\n", intval);
	filePutString (buffer, elcount(buffer), hFile);
	intval = getSignal(CHASSIS::EL_Stat_AR2::ElecPwr_Inc_Rq);
	snprintf(buffer, elcount(buffer), "   0.000000 F1 EIS::EL_Stat_AR2::ElecPwr_Inc_Rq = %d\n", intval);
	filePutString (buffer, elcount(buffer), hFile);
	intval = getSignal(CHASSIS::EL_Stat_AR2::IHC_Sys_Stat);
	snprintf(buffer, elcount(buffer), "   0.000000 F1 EIS::EL_Stat_AR2::IHC_Sys_Stat = %d\n", intval);
	filePutString (buffer, elcount(buffer), hFile);
	intval = getSignal(CHASSIS::EL_Stat_AR2::ExtLmp_AcustWarn_On_Rq);
	snprintf(buffer, elcount(buffer), "   0.000000 F1 EIS::EL_Stat_AR2::ExtLmp_AcustWarn_On_Rq = %d\n", intval);
	filePutString (buffer, elcount(buffer), hFile);
	intval = getSignal(CHASSIS::EL_Stat_AR2::DrHdlRecLgt_On_Rq);
	snprintf(buffer, elcount(buffer), "   0.000000 F1 EIS::EL_Stat_AR2::DrHdlRecLgt_On_Rq = %d\n", intval);
	filePutString (buffer, elcount(buffer), hFile);
	intval = getSignal(CHASSIS::EL_Stat_AR2::HiBm_Md_On_Rq);
	snprintf(buffer, elcount(buffer), "   0.000000 F1 EIS::EL_Stat_AR2::HiBm_Md_On_Rq = %d\n", intval);
	filePutString (buffer, elcount(buffer), hFile);
	intval = getSignal(CHASSIS::EL_Stat_AR2::DRLt_On_Stat);
	snprintf(buffer, elcount(buffer), "   0.000000 F1 EIS::EL_Stat_AR2::DRLt_On_Stat = %d\n", intval);
	filePutString (buffer, elcount(buffer), hFile);
	intval = @sysvar::CH_Nodes::CH_EISCRC_EL_TurnInd_On_Rq__AUTO;
	snprintf(buffer, elcount(buffer), "   0.000000    SV: 2 0 0 ::CH_Nodes::CH_EISCRC_EL_TurnInd_On_Rq__AUTO = %d\n", intval);
	filePutString (buffer, elcount(buffer), hFile);
	intval = getSignal(CHASSIS::EL_TurnInd_Rq_AR2::CRC_EL_TurnInd_On_Rq_Pr2);
	snprintf(buffer, elcount(buffer), "   0.000000 F1 EIS::EL_TurnInd_Rq_AR2::CRC_EL_TurnInd_On_Rq_Pr2 = %d\n", intval);
	filePutString (buffer, elcount(buffer), hFile);
	intval = @sysvar::CH_Nodes::CH_EISSQC_EL_TurnInd_On_Rq__AUTO;
	snprintf(buffer, elcount(buffer), "   0.000000    SV: 2 0 0 ::CH_Nodes::CH_EISSQC_EL_TurnInd_On_Rq__AUTO = %d\n", intval);
	filePutString (buffer, elcount(buffer), hFile);
	intval = getSignal(CHASSIS::EL_TurnInd_Rq_AR2::SQC_EL_TurnInd_On_Rq_Pr2);
	snprintf(buffer, elcount(buffer), "   0.000000 F1 EIS::EL_TurnInd_Rq_AR2::SQC_EL_TurnInd_On_Rq_Pr2 = %d\n", intval);
	filePutString (buffer, elcount(buffer), hFile);
	intval = getSignal(CHASSIS::EL_TurnInd_Rq_AR2::TurnInd_FL_On_Rq);
	snprintf(buffer, elcount(buffer), "   0.000000 F1 EIS::EL_TurnInd_Rq_AR2::TurnInd_FL_On_Rq = %d\n", intval);
	filePutString (buffer, elcount(buffer), hFile);
	intval = getSignal(CHASSIS::EL_TurnInd_Rq_AR2::TurnInd_FR_On_Rq);
	snprintf(buffer, elcount(buffer), "   0.000000 F1 EIS::EL_TurnInd_Rq_AR2::TurnInd_FR_On_Rq = %d\n", intval);
	filePutString (buffer, elcount(buffer), hFile);
	intval = getSignal(CHASSIS::EL_TurnInd_Rq_AR2::TurnInd_RL_On_Rq);
	snprintf(buffer, elcount(buffer), "   0.000000 F1 EIS::EL_TurnInd_Rq_AR2::TurnInd_RL_On_Rq = %d\n", intval);
	filePutString (buffer, elcount(buffer), hFile);
	intval = getSignal(CHASSIS::EL_TurnInd_Rq_AR2::TurnInd_RR_On_Rq);
	snprintf(buffer, elcount(buffer), "   0.000000 F1 EIS::EL_TurnInd_Rq_AR2::TurnInd_RR_On_Rq = %d\n", intval);
	filePutString (buffer, elcount(buffer), hFile);
	intval = getSignal(CHASSIS::EL_TurnInd_Rq_AR2::TurnLmpOnDur);
	snprintf(buffer, elcount(buffer), "   0.000000 F1 EIS::EL_TurnInd_Rq_AR2::TurnLmpOnDur = %d\n", intval);
	filePutString (buffer, elcount(buffer), hFile);
	intval = getSignal(CHASSIS::EL_TurnInd_Rq_AR2::TurnInd_Lt_On);
	snprintf(buffer, elcount(buffer), "   0.000000 F1 EIS::EL_TurnInd_Rq_AR2::TurnInd_Lt_On = %d\n", intval);
	filePutString (buffer, elcount(buffer), hFile);
	intval = getSignal(CHASSIS::EL_TurnInd_Rq_AR2::TurnInd_Rt_On);
	snprintf(buffer, elcount(buffer), "   0.000000 F1 EIS::EL_TurnInd_Rq_AR2::TurnInd_Rt_On = %d\n", intval);
	filePutString (buffer, elcount(buffer), hFile);
	intval = getSignal(CHASSIS::EL_TurnInd_Rq_AR2::EF_Actv);
	snprintf(buffer, elcount(buffer), "   0.000000 F1 EIS::EL_TurnInd_Rq_AR2::EF_Actv = %d\n", intval);
	filePutString (buffer, elcount(buffer), hFile);
	intval = getSignal(CHASSIS::EL_TurnInd_Rq_AR2::Rsrv1_EL_TurnInd_On_Rq_Pr2);
	snprintf(buffer, elcount(buffer), "   0.000000 F1 EIS::EL_TurnInd_Rq_AR2::Rsrv1_EL_TurnInd_On_Rq_Pr2 = %d\n", intval);
	filePutString (buffer, elcount(buffer), hFile);
	intval = @sysvar::CH_Nodes::CH_EISCRC_EPKB_Stat_Pr2EPKB_AUTO;
	snprintf(buffer, elcount(buffer), "   0.000000    SV: 2 0 0 ::CH_Nodes::CH_EISCRC_EPKB_Stat_Pr2EPKB_AUTO = %d\n", intval);
	filePutString (buffer, elcount(buffer), hFile);
	intval = getSignal(CHASSIS::EPKB_Stat_AR2::CRC_EPKB_Stat_Pr2);
	snprintf(buffer, elcount(buffer), "   0.000000 F1 EIS::EPKB_Stat_AR2::CRC_EPKB_Stat_Pr2 = %d\n", intval);
	filePutString (buffer, elcount(buffer), hFile);
	intval = @sysvar::CH_Nodes::CH_EISSQC_EPKB_Stat_Pr2EPKB_AUTO;
	snprintf(buffer, elcount(buffer), "   0.000000    SV: 2 0 0 ::CH_Nodes::CH_EISSQC_EPKB_Stat_Pr2EPKB_AUTO = %d\n", intval);
	filePutString (buffer, elcount(buffer), hFile);
	intval = getSignal(CHASSIS::EPKB_Stat_AR2::SQC_EPKB_Stat_Pr2);
	snprintf(buffer, elcount(buffer), "   0.000000 F1 EIS::EPKB_Stat_AR2::SQC_EPKB_Stat_Pr2 = %d\n", intval);
	filePutString (buffer, elcount(buffer), hFile);
	intval = getSignal(CHASSIS::EPKB_Stat_AR2::BatCplSw_Rq_EPKB);
	snprintf(buffer, elcount(buffer), "   0.000000 F1 EIS::EPKB_Stat_AR2::BatCplSw_Rq_EPKB = %d\n", intval);
	filePutString (buffer, elcount(buffer), hFile);
	intval = getSignal(CHASSIS::EPKB_Stat_AR2::TxPkPosn_Rq_EPKB);
	snprintf(buffer, elcount(buffer), "   0.000000 F1 EIS::EPKB_Stat_AR2::TxPkPosn_Rq_EPKB = %d\n", intval);
	filePutString (buffer, elcount(buffer), hFile);
	intval = getSignal(CHASSIS::EPKB_Stat_AR2::PkBrk_Stat);
	snprintf(buffer, elcount(buffer), "   0.000000 F1 EIS::EPKB_Stat_AR2::PkBrk_Stat = %d\n", intval);
	filePutString (buffer, elcount(buffer), hFile);
	intval = getSignal(CHASSIS::EPKB_Stat_AR2::PkBrkSw_Stat);
	snprintf(buffer, elcount(buffer), "   0.000000 F1 EIS::EPKB_Stat_AR2::PkBrkSw_Stat = %d\n", intval);
	filePutString (buffer, elcount(buffer), hFile);
	intval = getSignal(CHASSIS::EPKB_Stat_AR2::EPkBrk_Stat);
	snprintf(buffer, elcount(buffer), "   0.000000 F1 EIS::EPKB_Stat_AR2::EPkBrk_Stat = %d\n", intval);
	filePutString (buffer, elcount(buffer), hFile);
	intval = getSignal(CHASSIS::EPKB_Stat_AR2::Rsrv4_EPKB_Stat_Pr2);
	snprintf(buffer, elcount(buffer), "   0.000000 F1 EIS::EPKB_Stat_AR2::Rsrv4_EPKB_Stat_Pr2 = %d\n", intval);
	filePutString (buffer, elcount(buffer), hFile);
	intval = getSignal(CHASSIS::EPKB_Stat_AR2::DynBrkMd);
	snprintf(buffer, elcount(buffer), "   0.000000 F1 EIS::EPKB_Stat_AR2::DynBrkMd = %d\n", intval);
	filePutString (buffer, elcount(buffer), hFile);
	intval = getSignal(CHASSIS::EPKB_Stat_AR2::BrkLgt_On_Rq);
	snprintf(buffer, elcount(buffer), "   0.000000 F1 EIS::EPKB_Stat_AR2::BrkLgt_On_Rq = %d\n", intval);
	filePutString (buffer, elcount(buffer), hFile);
	intval = getSignal(CHASSIS::EPKB_Stat_AR2::Rsrv1_EPKB_Stat_Pr2);
	snprintf(buffer, elcount(buffer), "   0.000000 F1 EIS::EPKB_Stat_AR2::Rsrv1_EPKB_Stat_Pr2 = %d\n", intval);
	filePutString (buffer, elcount(buffer), hFile);
	intval = getSignal(CHASSIS::EPKB_Stat_AR2::ESP_Enbl_Rq_EPKB);
	snprintf(buffer, elcount(buffer), "   0.000000 F1 EIS::EPKB_Stat_AR2::ESP_Enbl_Rq_EPKB = %d\n", intval);
	filePutString (buffer, elcount(buffer), hFile);
	intval = getSignal(CHASSIS::EPKB_Stat_AR2::Rsrv2_EPKB_Stat_Pr2);
	snprintf(buffer, elcount(buffer), "   0.000000 F1 EIS::EPKB_Stat_AR2::Rsrv2_EPKB_Stat_Pr2 = %d\n", intval);
	filePutString (buffer, elcount(buffer), hFile);
	intval = getSignal(CHASSIS::EPKB_Stat_AR2::Rsrv3_EPKB_Stat_Pr2);
	snprintf(buffer, elcount(buffer), "   0.000000 F1 EIS::EPKB_Stat_AR2::Rsrv3_EPKB_Stat_Pr2 = %d\n", intval);
	filePutString (buffer, elcount(buffer), hFile);
}
/*@@end*/

/*@@caplFunc:saveVars_35(dword):*/
void saveVars_35(dword hFile)
{
	intval = @sysvar::CH_Nodes::CH_EISCRC_EVC_CfgBit_01_32__AUTO;
	snprintf(buffer, elcount(buffer), "   0.000000    SV: 2 0 0 ::CH_Nodes::CH_EISCRC_EVC_CfgBit_01_32__AUTO = %d\n", intval);
	filePutString (buffer, elcount(buffer), hFile);
	intval = getSignal(CHASSIS::EVC_CfgBit_01_32_AR2::CRC_EVC_CfgBit_01_32_Pr2);
	snprintf(buffer, elcount(buffer), "   0.000000 F1 EIS::EVC_CfgBit_01_32_AR2::CRC_EVC_CfgBit_01_32_Pr2 = %d\n", intval);
	filePutString (buffer, elcount(buffer), hFile);
	intval = @sysvar::CH_Nodes::CH_EISSQC_EVC_CfgBit_01_32__AUTO;
	snprintf(buffer, elcount(buffer), "   0.000000    SV: 2 0 0 ::CH_Nodes::CH_EISSQC_EVC_CfgBit_01_32__AUTO = %d\n", intval);
	filePutString (buffer, elcount(buffer), hFile);
	intval = getSignal(CHASSIS::EVC_CfgBit_01_32_AR2::SQC_EVC_CfgBit_01_32_Pr2);
	snprintf(buffer, elcount(buffer), "   0.000000 F1 EIS::EVC_CfgBit_01_32_AR2::SQC_EVC_CfgBit_01_32_Pr2 = %d\n", intval);
	filePutString (buffer, elcount(buffer), hFile);
	intval = getSignal(CHASSIS::EVC_CfgBit_01_32_AR2::EVC_CfgBit_01_32_Stat);
	snprintf(buffer, elcount(buffer), "   0.000000 F1 EIS::EVC_CfgBit_01_32_AR2::EVC_CfgBit_01_32_Stat = %d\n", intval);
	filePutString (buffer, elcount(buffer), hFile);
	intval = getSignal(CHASSIS::EVC_CfgBit_01_32_AR2::EVC_01_Ver_USA_Avl);
	snprintf(buffer, elcount(buffer), "   0.000000 F1 EIS::EVC_CfgBit_01_32_AR2::EVC_01_Ver_USA_Avl = %d\n", intval);
	filePutString (buffer, elcount(buffer), hFile);
	intval = getSignal(CHASSIS::EVC_CfgBit_01_32_AR2::EVC_02_Ver_Mexico_Avl);
	snprintf(buffer, elcount(buffer), "   0.000000 F1 EIS::EVC_CfgBit_01_32_AR2::EVC_02_Ver_Mexico_Avl = %d\n", intval);
	filePutString (buffer, elcount(buffer), hFile);
	intval = getSignal(CHASSIS::EVC_CfgBit_01_32_AR2::EVC_03_Ver_Japan_Avl);
	snprintf(buffer, elcount(buffer), "   0.000000 F1 EIS::EVC_CfgBit_01_32_AR2::EVC_03_Ver_Japan_Avl = %d\n", intval);
	filePutString (buffer, elcount(buffer), hFile);
	intval = getSignal(CHASSIS::EVC_CfgBit_01_32_AR2::EVC_04_Ver_GulfStates_Avl);
	snprintf(buffer, elcount(buffer), "   0.000000 F1 EIS::EVC_CfgBit_01_32_AR2::EVC_04_Ver_GulfStates_Avl = %d\n", intval);
	filePutString (buffer, elcount(buffer), hFile);
	intval = getSignal(CHASSIS::EVC_CfgBit_01_32_AR2::EVC_05_Ver_Australia_Avl);
	snprintf(buffer, elcount(buffer), "   0.000000 F1 EIS::EVC_CfgBit_01_32_AR2::EVC_05_Ver_Australia_Avl = %d\n", intval);
	filePutString (buffer, elcount(buffer), hFile);
	intval = getSignal(CHASSIS::EVC_CfgBit_01_32_AR2::EVC_06_Ver_China_Avl);
	snprintf(buffer, elcount(buffer), "   0.000000 F1 EIS::EVC_CfgBit_01_32_AR2::EVC_06_Ver_China_Avl = %d\n", intval);
	filePutString (buffer, elcount(buffer), hFile);
	intval = getSignal(CHASSIS::EVC_CfgBit_01_32_AR2::EVC_07_Ver_S_Korea_Avl);
	snprintf(buffer, elcount(buffer), "   0.000000 F1 EIS::EVC_CfgBit_01_32_AR2::EVC_07_Ver_S_Korea_Avl = %d\n", intval);
	filePutString (buffer, elcount(buffer), hFile);
	intval = getSignal(CHASSIS::EVC_CfgBit_01_32_AR2::EVC_08_Ver_Canada_Avl);
	snprintf(buffer, elcount(buffer), "   0.000000 F1 EIS::EVC_CfgBit_01_32_AR2::EVC_08_Ver_Canada_Avl = %d\n", intval);
	filePutString (buffer, elcount(buffer), hFile);
	intval = getSignal(CHASSIS::EVC_CfgBit_01_32_AR2::EVC_09_FullHyb_Avl);
	snprintf(buffer, elcount(buffer), "   0.000000 F1 EIS::EVC_CfgBit_01_32_AR2::EVC_09_FullHyb_Avl = %d\n", intval);
	filePutString (buffer, elcount(buffer), hFile);
	intval = getSignal(CHASSIS::EVC_CfgBit_01_32_AR2::EVC_0A_Hyb_20kW_Avl);
	snprintf(buffer, elcount(buffer), "   0.000000 F1 EIS::EVC_CfgBit_01_32_AR2::EVC_0A_Hyb_20kW_Avl = %d\n", intval);
	filePutString (buffer, elcount(buffer), hFile);
	intval = getSignal(CHASSIS::EVC_CfgBit_01_32_AR2::EVC_0B_PlugInHyb_80kW_Avl);
	snprintf(buffer, elcount(buffer), "   0.000000 F1 EIS::EVC_CfgBit_01_32_AR2::EVC_0B_PlugInHyb_80kW_Avl = %d\n", intval);
	filePutString (buffer, elcount(buffer), hFile);
	intval = getSignal(CHASSIS::EVC_CfgBit_01_32_AR2::EVC_0C_AllWheelDr_Avl);
	snprintf(buffer, elcount(buffer), "   0.000000 F1 EIS::EVC_CfgBit_01_32_AR2::EVC_0C_AllWheelDr_Avl = %d\n", intval);
	filePutString (buffer, elcount(buffer), hFile);
	intval = getSignal(CHASSIS::EVC_CfgBit_01_32_AR2::EVC_0D_4x2Drive_Avl);
	snprintf(buffer, elcount(buffer), "   0.000000 F1 EIS::EVC_CfgBit_01_32_AR2::EVC_0D_4x2Drive_Avl = %d\n", intval);
	filePutString (buffer, elcount(buffer), hFile);
	intval = getSignal(CHASSIS::EVC_CfgBit_01_32_AR2::EVC_0E_Presf_Avl);
	snprintf(buffer, elcount(buffer), "   0.000000 F1 EIS::EVC_CfgBit_01_32_AR2::EVC_0E_Presf_Avl = %d\n", intval);
	filePutString (buffer, elcount(buffer), hFile);
	intval = getSignal(CHASSIS::EVC_CfgBit_01_32_AR2::EVC_0F_TrlrHtch_Avl);
	snprintf(buffer, elcount(buffer), "   0.000000 F1 EIS::EVC_CfgBit_01_32_AR2::EVC_0F_TrlrHtch_Avl = %d\n", intval);
	filePutString (buffer, elcount(buffer), hFile);
	intval = getSignal(CHASSIS::EVC_CfgBit_01_32_AR2::EVC_10_KG_Avl);
	snprintf(buffer, elcount(buffer), "   0.000000 F1 EIS::EVC_CfgBit_01_32_AR2::EVC_10_KG_Avl = %d\n", intval);
	filePutString (buffer, elcount(buffer), hFile);
	intval = getSignal(CHASSIS::EVC_CfgBit_01_32_AR2::EVC_11_AutTrunkLid_Avl);
	snprintf(buffer, elcount(buffer), "   0.000000 F1 EIS::EVC_CfgBit_01_32_AR2::EVC_11_AutTrunkLid_Avl = %d\n", intval);
	filePutString (buffer, elcount(buffer), hFile);
	intval = getSignal(CHASSIS::EVC_CfgBit_01_32_AR2::EVC_12_AutRearDr_Avl);
	snprintf(buffer, elcount(buffer), "   0.000000 F1 EIS::EVC_CfgBit_01_32_AR2::EVC_12_AutRearDr_Avl = %d\n", intval);
	filePutString (buffer, elcount(buffer), hFile);
	intval = getSignal(CHASSIS::EVC_CfgBit_01_32_AR2::EVC_13_PwrCls_Avl);
	snprintf(buffer, elcount(buffer), "   0.000000 F1 EIS::EVC_CfgBit_01_32_AR2::EVC_13_PwrCls_Avl = %d\n", intval);
	filePutString (buffer, elcount(buffer), hFile);
	intval = getSignal(CHASSIS::EVC_CfgBit_01_32_AR2::EVC_14_RainSens_Avl);
	snprintf(buffer, elcount(buffer), "   0.000000 F1 EIS::EVC_CfgBit_01_32_AR2::EVC_14_RainSens_Avl = %d\n", intval);
	filePutString (buffer, elcount(buffer), hFile);
	intval = getSignal(CHASSIS::EVC_CfgBit_01_32_AR2::EVC_15_DRLt_Avl);
	snprintf(buffer, elcount(buffer), "   0.000000 F1 EIS::EVC_CfgBit_01_32_AR2::EVC_15_DRLt_Avl = %d\n", intval);
	filePutString (buffer, elcount(buffer), hFile);
	intval = getSignal(CHASSIS::EVC_CfgBit_01_32_AR2::EVC_16_FogLmp_Avl);
	snprintf(buffer, elcount(buffer), "   0.000000 F1 EIS::EVC_CfgBit_01_32_AR2::EVC_16_FogLmp_Avl = %d\n", intval);
	filePutString (buffer, elcount(buffer), hFile);
	intval = getSignal(CHASSIS::EVC_CfgBit_01_32_AR2::EVC_17_IL_Pk_Avl);
	snprintf(buffer, elcount(buffer), "   0.000000 F1 EIS::EVC_CfgBit_01_32_AR2::EVC_17_IL_Pk_Avl = %d\n", intval);
	filePutString (buffer, elcount(buffer), hFile);
	intval = getSignal(CHASSIS::EVC_CfgBit_01_32_AR2::EVC_18_AmbLgt_Avl);
	snprintf(buffer, elcount(buffer), "   0.000000 F1 EIS::EVC_CfgBit_01_32_AR2::EVC_18_AmbLgt_Avl = %d\n", intval);
	filePutString (buffer, elcount(buffer), hFile);
	intval = getSignal(CHASSIS::EVC_CfgBit_01_32_AR2::EVC_19_ElDrPosnSel_Avl);
	snprintf(buffer, elcount(buffer), "   0.000000 F1 EIS::EVC_CfgBit_01_32_AR2::EVC_19_ElDrPosnSel_Avl = %d\n", intval);
	filePutString (buffer, elcount(buffer), hFile);
	intval = getSignal(CHASSIS::EVC_CfgBit_01_32_AR2::EVC_1A_IntSfProt_Avl);
	snprintf(buffer, elcount(buffer), "   0.000000 F1 EIS::EVC_CfgBit_01_32_AR2::EVC_1A_IntSfProt_Avl = %d\n", intval);
	filePutString (buffer, elcount(buffer), hFile);
	intval = getSignal(CHASSIS::EVC_CfgBit_01_32_AR2::EVC_1B_VTA_Avl);
	snprintf(buffer, elcount(buffer), "   0.000000 F1 EIS::EVC_CfgBit_01_32_AR2::EVC_1B_VTA_Avl = %d\n", intval);
	filePutString (buffer, elcount(buffer), hFile);
	intval = getSignal(CHASSIS::EVC_CfgBit_01_32_AR2::EVC_1C_HghVTP_Avl);
	snprintf(buffer, elcount(buffer), "   0.000000 F1 EIS::EVC_CfgBit_01_32_AR2::EVC_1C_HghVTP_Avl = %d\n", intval);
	filePutString (buffer, elcount(buffer), hFile);
	intval = getSignal(CHASSIS::EVC_CfgBit_01_32_AR2::EVC_1D_SecurityVer_Avl);
	snprintf(buffer, elcount(buffer), "   0.000000 F1 EIS::EVC_CfgBit_01_32_AR2::EVC_1D_SecurityVer_Avl = %d\n", intval);
	filePutString (buffer, elcount(buffer), hFile);
	intval = getSignal(CHASSIS::EVC_CfgBit_01_32_AR2::EVC_1E_GuardLvl_B4_Avl);
	snprintf(buffer, elcount(buffer), "   0.000000 F1 EIS::EVC_CfgBit_01_32_AR2::EVC_1E_GuardLvl_B4_Avl = %d\n", intval);
	filePutString (buffer, elcount(buffer), hFile);
	intval = getSignal(CHASSIS::EVC_CfgBit_01_32_AR2::EVC_1F_GuardLvl_B6_Avl);
	snprintf(buffer, elcount(buffer), "   0.000000 F1 EIS::EVC_CfgBit_01_32_AR2::EVC_1F_GuardLvl_B6_Avl = %d\n", intval);
	filePutString (buffer, elcount(buffer), hFile);
	intval = getSignal(CHASSIS::EVC_CfgBit_01_32_AR2::EVC_20_GuardLvl_B7_Avl);
	snprintf(buffer, elcount(buffer), "   0.000000 F1 EIS::EVC_CfgBit_01_32_AR2::EVC_20_GuardLvl_B7_Avl = %d\n", intval);
	filePutString (buffer, elcount(buffer), hFile);
	intval = getSignal(CHASSIS::EVC_CfgBit_01_32_AR2::EVC_21_Pullman_Avl);
	snprintf(buffer, elcount(buffer), "   0.000000 F1 EIS::EVC_CfgBit_01_32_AR2::EVC_21_Pullman_Avl = %d\n", intval);
	filePutString (buffer, elcount(buffer), hFile);
	intval = getSignal(CHASSIS::EVC_CfgBit_01_32_AR2::EVC_22_SpecClos_Avl);
	snprintf(buffer, elcount(buffer), "   0.000000 F1 EIS::EVC_CfgBit_01_32_AR2::EVC_22_SpecClos_Avl = %d\n", intval);
	filePutString (buffer, elcount(buffer), hFile);
	intval = getSignal(CHASSIS::EVC_CfgBit_01_32_AR2::EVC_23_PASS_Avl);
	snprintf(buffer, elcount(buffer), "   0.000000 F1 EIS::EVC_CfgBit_01_32_AR2::EVC_23_PASS_Avl = %d\n", intval);
	filePutString (buffer, elcount(buffer), hFile);
	intval = getSignal(CHASSIS::EVC_CfgBit_01_32_AR2::EVC_24_ICH_Avl);
	snprintf(buffer, elcount(buffer), "   0.000000 F1 EIS::EVC_CfgBit_01_32_AR2::EVC_24_ICH_Avl = %d\n", intval);
	filePutString (buffer, elcount(buffer), hFile);
	intval = getSignal(CHASSIS::EVC_CfgBit_01_32_AR2::EVC_25_HVAC_R_Avl);
	snprintf(buffer, elcount(buffer), "   0.000000 F1 EIS::EVC_CfgBit_01_32_AR2::EVC_25_HVAC_R_Avl = %d\n", intval);
	filePutString (buffer, elcount(buffer), hFile);
	intval = getSignal(CHASSIS::EVC_CfgBit_01_32_AR2::EVC_26_SSA_Avl);
	snprintf(buffer, elcount(buffer), "   0.000000 F1 EIS::EVC_CfgBit_01_32_AR2::EVC_26_SSA_Avl = %d\n", intval);
	filePutString (buffer, elcount(buffer), hFile);
	intval = getSignal(CHASSIS::EVC_CfgBit_01_32_AR2::EVC_27_HandsFreeAcc_Avl);
	snprintf(buffer, elcount(buffer), "   0.000000 F1 EIS::EVC_CfgBit_01_32_AR2::EVC_27_HandsFreeAcc_Avl = %d\n", intval);
	filePutString (buffer, elcount(buffer), hFile);
	intval = getSignal(CHASSIS::EVC_CfgBit_01_32_AR2::EVC_28_PlugInHyb_50kW_Avl);
	snprintf(buffer, elcount(buffer), "   0.000000 F1 EIS::EVC_CfgBit_01_32_AR2::EVC_28_PlugInHyb_50kW_Avl = %d\n", intval);
	filePutString (buffer, elcount(buffer), hFile);
	intval = getSignal(CHASSIS::EVC_CfgBit_01_32_AR2::EVC_29_Hyb_30kW_Avl);
	snprintf(buffer, elcount(buffer), "   0.000000 F1 EIS::EVC_CfgBit_01_32_AR2::EVC_29_Hyb_30kW_Avl = %d\n", intval);
	filePutString (buffer, elcount(buffer), hFile);
	intval = getSignal(CHASSIS::EVC_CfgBit_01_32_AR2::EVC_2A_SeatElAdj_F_OprtnR_Avl);
	snprintf(buffer, elcount(buffer), "   0.000000 F1 EIS::EVC_CfgBit_01_32_AR2::EVC_2A_SeatElAdj_F_OprtnR_Avl = %d\n", intval);
	filePutString (buffer, elcount(buffer), hFile);
	intval = getSignal(CHASSIS::EVC_CfgBit_01_32_AR2::EVC_2B_DSI_Sel_Avl);
	snprintf(buffer, elcount(buffer), "   0.000000 F1 EIS::EVC_CfgBit_01_32_AR2::EVC_2B_DSI_Sel_Avl = %d\n", intval);
	filePutString (buffer, elcount(buffer), hFile);
	intval = getSignal(CHASSIS::EVC_CfgBit_01_32_AR2::EVC_2C_WC_VEDA_Avl);
	snprintf(buffer, elcount(buffer), "   0.000000 F1 EIS::EVC_CfgBit_01_32_AR2::EVC_2C_WC_VEDA_Avl = %d\n", intval);
	filePutString (buffer, elcount(buffer), hFile);
	intval = getSignal(CHASSIS::EVC_CfgBit_01_32_AR2::EVC_2D_AutoSpdCtrl_Avl);
	snprintf(buffer, elcount(buffer), "   0.000000 F1 EIS::EVC_CfgBit_01_32_AR2::EVC_2D_AutoSpdCtrl_Avl = %d\n", intval);
	filePutString (buffer, elcount(buffer), hFile);
	intval = getSignal(CHASSIS::EVC_CfgBit_01_32_AR2::EVC_2E_AddEquip_Avl);
	snprintf(buffer, elcount(buffer), "   0.000000 F1 EIS::EVC_CfgBit_01_32_AR2::EVC_2E_AddEquip_Avl = %d\n", intval);
	filePutString (buffer, elcount(buffer), hFile);
	intval = getSignal(CHASSIS::EVC_CfgBit_01_32_AR2::EVC_2F_AddEquip_Avl);
	snprintf(buffer, elcount(buffer), "   0.000000 F1 EIS::EVC_CfgBit_01_32_AR2::EVC_2F_AddEquip_Avl = %d\n", intval);
	filePutString (buffer, elcount(buffer), hFile);
	intval = getSignal(CHASSIS::EVC_CfgBit_01_32_AR2::EVC_30_AddEquip_Avl);
	snprintf(buffer, elcount(buffer), "   0.000000 F1 EIS::EVC_CfgBit_01_32_AR2::EVC_30_AddEquip_Avl = %d\n", intval);
	filePutString (buffer, elcount(buffer), hFile);
}
/*@@end*/

/*@@caplFunc:saveVars_36(dword):*/
void saveVars_36(dword hFile)
{
	intval = getSignal(CHASSIS::EVC_CfgBit_01_32_AR2::EVC_31_AddEquip_Avl);
	snprintf(buffer, elcount(buffer), "   0.000000 F1 EIS::EVC_CfgBit_01_32_AR2::EVC_31_AddEquip_Avl = %d\n", intval);
	filePutString (buffer, elcount(buffer), hFile);
	intval = getSignal(CHASSIS::EVC_CfgBit_01_32_AR2::EVC_32_AddEquip_Avl);
	snprintf(buffer, elcount(buffer), "   0.000000 F1 EIS::EVC_CfgBit_01_32_AR2::EVC_32_AddEquip_Avl = %d\n", intval);
	filePutString (buffer, elcount(buffer), hFile);
	intval = @sysvar::CH_Nodes::CH_EISCRC_EVC_CfgBit_33_64__AUTO;
	snprintf(buffer, elcount(buffer), "   0.000000    SV: 2 0 0 ::CH_Nodes::CH_EISCRC_EVC_CfgBit_33_64__AUTO = %d\n", intval);
	filePutString (buffer, elcount(buffer), hFile);
	intval = getSignal(CHASSIS::EVC_CfgBit_33_64_AR2::CRC_EVC_CfgBit_33_64_Pr2);
	snprintf(buffer, elcount(buffer), "   0.000000 F1 EIS::EVC_CfgBit_33_64_AR2::CRC_EVC_CfgBit_33_64_Pr2 = %d\n", intval);
	filePutString (buffer, elcount(buffer), hFile);
	intval = @sysvar::CH_Nodes::CH_EISSQC_EVC_CfgBit_33_64__AUTO;
	snprintf(buffer, elcount(buffer), "   0.000000    SV: 2 0 0 ::CH_Nodes::CH_EISSQC_EVC_CfgBit_33_64__AUTO = %d\n", intval);
	filePutString (buffer, elcount(buffer), hFile);
	intval = getSignal(CHASSIS::EVC_CfgBit_33_64_AR2::SQC_EVC_CfgBit_33_64_Pr2);
	snprintf(buffer, elcount(buffer), "   0.000000 F1 EIS::EVC_CfgBit_33_64_AR2::SQC_EVC_CfgBit_33_64_Pr2 = %d\n", intval);
	filePutString (buffer, elcount(buffer), hFile);
	intval = getSignal(CHASSIS::EVC_CfgBit_33_64_AR2::EVC_CfgBit_33_64_Stat);
	snprintf(buffer, elcount(buffer), "   0.000000 F1 EIS::EVC_CfgBit_33_64_AR2::EVC_CfgBit_33_64_Stat = %d\n", intval);
	filePutString (buffer, elcount(buffer), hFile);
	intval = getSignal(CHASSIS::EVC_CfgBit_33_64_AR2::EVC_33_EmgOpn_F_Avl);
	snprintf(buffer, elcount(buffer), "   0.000000 F1 EIS::EVC_CfgBit_33_64_AR2::EVC_33_EmgOpn_F_Avl = %d\n", intval);
	filePutString (buffer, elcount(buffer), hFile);
	intval = getSignal(CHASSIS::EVC_CfgBit_33_64_AR2::EVC_34_Curtain_F_Avl);
	snprintf(buffer, elcount(buffer), "   0.000000 F1 EIS::EVC_CfgBit_33_64_AR2::EVC_34_Curtain_F_Avl = %d\n", intval);
	filePutString (buffer, elcount(buffer), hFile);
	intval = getSignal(CHASSIS::EVC_CfgBit_33_64_AR2::EVC_35_EmgOpn_Inact);
	snprintf(buffer, elcount(buffer), "   0.000000 F1 EIS::EVC_CfgBit_33_64_AR2::EVC_35_EmgOpn_Inact = %d\n", intval);
	filePutString (buffer, elcount(buffer), hFile);
	intval = getSignal(CHASSIS::EVC_CfgBit_33_64_AR2::EVC_36_SpecVehPW_FL_Avl);
	snprintf(buffer, elcount(buffer), "   0.000000 F1 EIS::EVC_CfgBit_33_64_AR2::EVC_36_SpecVehPW_FL_Avl = %d\n", intval);
	filePutString (buffer, elcount(buffer), hFile);
	intval = getSignal(CHASSIS::EVC_CfgBit_33_64_AR2::EVC_37_SpecVehPW_FR_Avl);
	snprintf(buffer, elcount(buffer), "   0.000000 F1 EIS::EVC_CfgBit_33_64_AR2::EVC_37_SpecVehPW_FR_Avl = %d\n", intval);
	filePutString (buffer, elcount(buffer), hFile);
	intval = getSignal(CHASSIS::EVC_CfgBit_33_64_AR2::EVC_38_SpecVehPW_RL_Avl);
	snprintf(buffer, elcount(buffer), "   0.000000 F1 EIS::EVC_CfgBit_33_64_AR2::EVC_38_SpecVehPW_RL_Avl = %d\n", intval);
	filePutString (buffer, elcount(buffer), hFile);
	intval = getSignal(CHASSIS::EVC_CfgBit_33_64_AR2::EVC_39_SpecVehPW_RR_Avl);
	snprintf(buffer, elcount(buffer), "   0.000000 F1 EIS::EVC_CfgBit_33_64_AR2::EVC_39_SpecVehPW_RR_Avl = %d\n", intval);
	filePutString (buffer, elcount(buffer), hFile);
	intval = getSignal(CHASSIS::EVC_CfgBit_33_64_AR2::EVC_3A_RB_F_Avl);
	snprintf(buffer, elcount(buffer), "   0.000000 F1 EIS::EVC_CfgBit_33_64_AR2::EVC_3A_RB_F_Avl = %d\n", intval);
	filePutString (buffer, elcount(buffer), hFile);
	intval = getSignal(CHASSIS::EVC_CfgBit_33_64_AR2::EVC_3B_RB_R_Avl);
	snprintf(buffer, elcount(buffer), "   0.000000 F1 EIS::EVC_CfgBit_33_64_AR2::EVC_3B_RB_R_Avl = %d\n", intval);
	filePutString (buffer, elcount(buffer), hFile);
	intval = getSignal(CHASSIS::EVC_CfgBit_33_64_AR2::EVC_3C_SeatDrvDyn_Ft_Avl);
	snprintf(buffer, elcount(buffer), "   0.000000 F1 EIS::EVC_CfgBit_33_64_AR2::EVC_3C_SeatDrvDyn_Ft_Avl = %d\n", intval);
	filePutString (buffer, elcount(buffer), hFile);
	intval = getSignal(CHASSIS::EVC_CfgBit_33_64_AR2::EVC_3D_ComfHdRst_Ft_Avl);
	snprintf(buffer, elcount(buffer), "   0.000000 F1 EIS::EVC_CfgBit_33_64_AR2::EVC_3D_ComfHdRst_Ft_Avl = %d\n", intval);
	filePutString (buffer, elcount(buffer), hFile);
	intval = getSignal(CHASSIS::EVC_CfgBit_33_64_AR2::EVC_3E_SeatMultiCont_Ft_Avl);
	snprintf(buffer, elcount(buffer), "   0.000000 F1 EIS::EVC_CfgBit_33_64_AR2::EVC_3E_SeatMultiCont_Ft_Avl = %d\n", intval);
	filePutString (buffer, elcount(buffer), hFile);
	intval = getSignal(CHASSIS::EVC_CfgBit_33_64_AR2::EVC_3F_SeatHt_Ft_Avl);
	snprintf(buffer, elcount(buffer), "   0.000000 F1 EIS::EVC_CfgBit_33_64_AR2::EVC_3F_SeatHt_Ft_Avl = %d\n", intval);
	filePutString (buffer, elcount(buffer), hFile);
	intval = getSignal(CHASSIS::EVC_CfgBit_33_64_AR2::EVC_40_SeatClim_Ft_Avl);
	snprintf(buffer, elcount(buffer), "   0.000000 F1 EIS::EVC_CfgBit_33_64_AR2::EVC_40_SeatClim_Ft_Avl = %d\n", intval);
	filePutString (buffer, elcount(buffer), hFile);
	intval = getSignal(CHASSIS::EVC_CfgBit_33_64_AR2::EVC_41_SeatMem_LHD_Avl);
	snprintf(buffer, elcount(buffer), "   0.000000 F1 EIS::EVC_CfgBit_33_64_AR2::EVC_41_SeatMem_LHD_Avl = %d\n", intval);
	filePutString (buffer, elcount(buffer), hFile);
	intval = getSignal(CHASSIS::EVC_CfgBit_33_64_AR2::EVC_42_SeatMem_RHD_Avl);
	snprintf(buffer, elcount(buffer), "   0.000000 F1 EIS::EVC_CfgBit_33_64_AR2::EVC_42_SeatMem_RHD_Avl = %d\n", intval);
	filePutString (buffer, elcount(buffer), hFile);
	intval = getSignal(CHASSIS::EVC_CfgBit_33_64_AR2::EVC_43_SeatMemPk_Avl);
	snprintf(buffer, elcount(buffer), "   0.000000 F1 EIS::EVC_CfgBit_33_64_AR2::EVC_43_SeatMemPk_Avl = %d\n", intval);
	filePutString (buffer, elcount(buffer), hFile);
	intval = getSignal(CHASSIS::EVC_CfgBit_33_64_AR2::EVC_44_ReclSeat_Avl);
	snprintf(buffer, elcount(buffer), "   0.000000 F1 EIS::EVC_CfgBit_33_64_AR2::EVC_44_ReclSeat_Avl = %d\n", intval);
	filePutString (buffer, elcount(buffer), hFile);
	intval = getSignal(CHASSIS::EVC_CfgBit_33_64_AR2::EVC_45_SeatMultiCont_R_Avl);
	snprintf(buffer, elcount(buffer), "   0.000000 F1 EIS::EVC_CfgBit_33_64_AR2::EVC_45_SeatMultiCont_R_Avl = %d\n", intval);
	filePutString (buffer, elcount(buffer), hFile);
	intval = getSignal(CHASSIS::EVC_CfgBit_33_64_AR2::EVC_46_SeatBkRstAdj_R_Avl);
	snprintf(buffer, elcount(buffer), "   0.000000 F1 EIS::EVC_CfgBit_33_64_AR2::EVC_46_SeatBkRstAdj_R_Avl = %d\n", intval);
	filePutString (buffer, elcount(buffer), hFile);
	intval = getSignal(CHASSIS::EVC_CfgBit_33_64_AR2::EVC_47_SeatHt_R_Avl);
	snprintf(buffer, elcount(buffer), "   0.000000 F1 EIS::EVC_CfgBit_33_64_AR2::EVC_47_SeatHt_R_Avl = %d\n", intval);
	filePutString (buffer, elcount(buffer), hFile);
	intval = getSignal(CHASSIS::EVC_CfgBit_33_64_AR2::EVC_48_SeatClim_R_Avl);
	snprintf(buffer, elcount(buffer), "   0.000000 F1 EIS::EVC_CfgBit_33_64_AR2::EVC_48_SeatClim_R_Avl = %d\n", intval);
	filePutString (buffer, elcount(buffer), hFile);
	intval = getSignal(CHASSIS::EVC_CfgBit_33_64_AR2::EVC_49_WShWashHt_Avl);
	snprintf(buffer, elcount(buffer), "   0.000000 F1 EIS::EVC_CfgBit_33_64_AR2::EVC_49_WShWashHt_Avl = %d\n", intval);
	filePutString (buffer, elcount(buffer), hFile);
	intval = getSignal(CHASSIS::EVC_CfgBit_33_64_AR2::EVC_4A_TaxiPwrSup_Avl);
	snprintf(buffer, elcount(buffer), "   0.000000 F1 EIS::EVC_CfgBit_33_64_AR2::EVC_4A_TaxiPwrSup_Avl = %d\n", intval);
	filePutString (buffer, elcount(buffer), hFile);
	intval = getSignal(CHASSIS::EVC_CfgBit_33_64_AR2::EVC_4B_TaxiRoofLmpCon_Avl);
	snprintf(buffer, elcount(buffer), "   0.000000 F1 EIS::EVC_CfgBit_33_64_AR2::EVC_4B_TaxiRoofLmpCon_Avl = %d\n", intval);
	filePutString (buffer, elcount(buffer), hFile);
	intval = getSignal(CHASSIS::EVC_CfgBit_33_64_AR2::EVC_4C_TaxiEmgAlm_Avl);
	snprintf(buffer, elcount(buffer), "   0.000000 F1 EIS::EVC_CfgBit_33_64_AR2::EVC_4C_TaxiEmgAlm_Avl = %d\n", intval);
	filePutString (buffer, elcount(buffer), hFile);
	intval = getSignal(CHASSIS::EVC_CfgBit_33_64_AR2::EVC_4D_RadioHdFree_Avl);
	snprintf(buffer, elcount(buffer), "   0.000000 F1 EIS::EVC_CfgBit_33_64_AR2::EVC_4D_RadioHdFree_Avl = %d\n", intval);
	filePutString (buffer, elcount(buffer), hFile);
	intval = getSignal(CHASSIS::EVC_CfgBit_33_64_AR2::EVC_4E_GAS_Avl);
	snprintf(buffer, elcount(buffer), "   0.000000 F1 EIS::EVC_CfgBit_33_64_AR2::EVC_4E_GAS_Avl = %d\n", intval);
	filePutString (buffer, elcount(buffer), hFile);
	intval = getSignal(CHASSIS::EVC_CfgBit_33_64_AR2::EVC_4F_CtrlU_MultiFunc_Avl);
	snprintf(buffer, elcount(buffer), "   0.000000 F1 EIS::EVC_CfgBit_33_64_AR2::EVC_4F_CtrlU_MultiFunc_Avl = %d\n", intval);
	filePutString (buffer, elcount(buffer), hFile);
	intval = getSignal(CHASSIS::EVC_CfgBit_33_64_AR2::EVC_50_TaxInMirr_Avl);
	snprintf(buffer, elcount(buffer), "   0.000000 F1 EIS::EVC_CfgBit_33_64_AR2::EVC_50_TaxInMirr_Avl = %d\n", intval);
	filePutString (buffer, elcount(buffer), hFile);
	intval = getSignal(CHASSIS::EVC_CfgBit_33_64_AR2::EVC_51_DistRecInMirr_Avl);
	snprintf(buffer, elcount(buffer), "   0.000000 F1 EIS::EVC_CfgBit_33_64_AR2::EVC_51_DistRecInMirr_Avl = %d\n", intval);
	filePutString (buffer, elcount(buffer), hFile);
	intval = getSignal(CHASSIS::EVC_CfgBit_33_64_AR2::EVC_52_PreInstRad_Avl);
	snprintf(buffer, elcount(buffer), "   0.000000 F1 EIS::EVC_CfgBit_33_64_AR2::EVC_52_PreInstRad_Avl = %d\n", intval);
	filePutString (buffer, elcount(buffer), hFile);
	intval = getSignal(CHASSIS::EVC_CfgBit_33_64_AR2::EVC_53_VehHandi_Avl);
	snprintf(buffer, elcount(buffer), "   0.000000 F1 EIS::EVC_CfgBit_33_64_AR2::EVC_53_VehHandi_Avl = %d\n", intval);
	filePutString (buffer, elcount(buffer), hFile);
	intval = getSignal(CHASSIS::EVC_CfgBit_33_64_AR2::EVC_54_PanelHt_Ft_Avl);
	snprintf(buffer, elcount(buffer), "   0.000000 F1 EIS::EVC_CfgBit_33_64_AR2::EVC_54_PanelHt_Ft_Avl = %d\n", intval);
	filePutString (buffer, elcount(buffer), hFile);
	intval = getSignal(CHASSIS::EVC_CfgBit_33_64_AR2::EVC_55_SeatComfHt_Ft_Avl);
	snprintf(buffer, elcount(buffer), "   0.000000 F1 EIS::EVC_CfgBit_33_64_AR2::EVC_55_SeatComfHt_Ft_Avl = %d\n", intval);
	filePutString (buffer, elcount(buffer), hFile);
	intval = getSignal(CHASSIS::EVC_CfgBit_33_64_AR2::EVC_56_SeatComfHt_R_Avl);
	snprintf(buffer, elcount(buffer), "   0.000000 F1 EIS::EVC_CfgBit_33_64_AR2::EVC_56_SeatComfHt_R_Avl = %d\n", intval);
	filePutString (buffer, elcount(buffer), hFile);
	intval = getSignal(CHASSIS::EVC_CfgBit_33_64_AR2::EVC_57_IntFoldHdRst_Ft_Avl);
	snprintf(buffer, elcount(buffer), "   0.000000 F1 EIS::EVC_CfgBit_33_64_AR2::EVC_57_IntFoldHdRst_Ft_Avl = %d\n", intval);
	filePutString (buffer, elcount(buffer), hFile);
	intval = getSignal(CHASSIS::EVC_CfgBit_33_64_AR2::EVC_58_SeatInd_R_Avl);
	snprintf(buffer, elcount(buffer), "   0.000000 F1 EIS::EVC_CfgBit_33_64_AR2::EVC_58_SeatInd_R_Avl = %d\n", intval);
	filePutString (buffer, elcount(buffer), hFile);
	intval = getSignal(CHASSIS::EVC_CfgBit_33_64_AR2::EVC_59_SeatChauffPos_P_Avl);
	snprintf(buffer, elcount(buffer), "   0.000000 F1 EIS::EVC_CfgBit_33_64_AR2::EVC_59_SeatChauffPos_P_Avl = %d\n", intval);
	filePutString (buffer, elcount(buffer), hFile);
	intval = getSignal(CHASSIS::EVC_CfgBit_33_64_AR2::EVC_5A_SeatMContMass_Ft_Avl);
	snprintf(buffer, elcount(buffer), "   0.000000 F1 EIS::EVC_CfgBit_33_64_AR2::EVC_5A_SeatMContMass_Ft_Avl = %d\n", intval);
	filePutString (buffer, elcount(buffer), hFile);
	intval = getSignal(CHASSIS::EVC_CfgBit_33_64_AR2::EVC_5B_PanelHt_R_Avl);
	snprintf(buffer, elcount(buffer), "   0.000000 F1 EIS::EVC_CfgBit_33_64_AR2::EVC_5B_PanelHt_R_Avl = %d\n", intval);
	filePutString (buffer, elcount(buffer), hFile);
	intval = getSignal(CHASSIS::EVC_CfgBit_33_64_AR2::EVC_5C_Airscarf_Ft_Avl);
	snprintf(buffer, elcount(buffer), "   0.000000 F1 EIS::EVC_CfgBit_33_64_AR2::EVC_5C_Airscarf_Ft_Avl = %d\n", intval);
	filePutString (buffer, elcount(buffer), hFile);
	intval = getSignal(CHASSIS::EVC_CfgBit_33_64_AR2::EVC_5D_SeatLimit_P_Avl);
	snprintf(buffer, elcount(buffer), "   0.000000 F1 EIS::EVC_CfgBit_33_64_AR2::EVC_5D_SeatLimit_P_Avl = %d\n", intval);
	filePutString (buffer, elcount(buffer), hFile);
	intval = getSignal(CHASSIS::EVC_CfgBit_33_64_AR2::EVC_5E_TaxiRoofLmp_Avl);
	snprintf(buffer, elcount(buffer), "   0.000000 F1 EIS::EVC_CfgBit_33_64_AR2::EVC_5E_TaxiRoofLmp_Avl = %d\n", intval);
	filePutString (buffer, elcount(buffer), hFile);
	intval = getSignal(CHASSIS::EVC_CfgBit_33_64_AR2::EVC_5F_SeatElAdj_LHD_Avl);
	snprintf(buffer, elcount(buffer), "   0.000000 F1 EIS::EVC_CfgBit_33_64_AR2::EVC_5F_SeatElAdj_LHD_Avl = %d\n", intval);
	filePutString (buffer, elcount(buffer), hFile);
	intval = getSignal(CHASSIS::EVC_CfgBit_33_64_AR2::EVC_60_SeatElAdj_RHD_Avl);
	snprintf(buffer, elcount(buffer), "   0.000000 F1 EIS::EVC_CfgBit_33_64_AR2::EVC_60_SeatElAdj_RHD_Avl = %d\n", intval);
	filePutString (buffer, elcount(buffer), hFile);
}
/*@@end*/

/*@@caplFunc:saveVars_37(dword):*/
void saveVars_37(dword hFile)
{
	intval = getSignal(CHASSIS::EVC_CfgBit_33_64_AR2::EVC_61_AMGPerfSusp_Avl);
	snprintf(buffer, elcount(buffer), "   0.000000 F1 EIS::EVC_CfgBit_33_64_AR2::EVC_61_AMGPerfSusp_Avl = %d\n", intval);
	filePutString (buffer, elcount(buffer), hFile);
	intval = getSignal(CHASSIS::EVC_CfgBit_33_64_AR2::EVC_62_ShiftExhstSys_Avl);
	snprintf(buffer, elcount(buffer), "   0.000000 F1 EIS::EVC_CfgBit_33_64_AR2::EVC_62_ShiftExhstSys_Avl = %d\n", intval);
	filePutString (buffer, elcount(buffer), hFile);
	intval = getSignal(CHASSIS::EVC_CfgBit_33_64_AR2::EVC_63_ActvLDA_MPC_Avl);
	snprintf(buffer, elcount(buffer), "   0.000000 F1 EIS::EVC_CfgBit_33_64_AR2::EVC_63_ActvLDA_MPC_Avl = %d\n", intval);
	filePutString (buffer, elcount(buffer), hFile);
	intval = getSignal(CHASSIS::EVC_CfgBit_33_64_AR2::EVC_64_EAS_Avl);
	snprintf(buffer, elcount(buffer), "   0.000000 F1 EIS::EVC_CfgBit_33_64_AR2::EVC_64_EAS_Avl = %d\n", intval);
	filePutString (buffer, elcount(buffer), hFile);
	intval = @sysvar::CH_Nodes::CH_EISCRC_EVC_CfgBit_65_96__AUTO;
	snprintf(buffer, elcount(buffer), "   0.000000    SV: 2 0 0 ::CH_Nodes::CH_EISCRC_EVC_CfgBit_65_96__AUTO = %d\n", intval);
	filePutString (buffer, elcount(buffer), hFile);
	intval = getSignal(CHASSIS::EVC_CfgBit_65_96_AR2::CRC_EVC_CfgBit_65_96_Pr2);
	snprintf(buffer, elcount(buffer), "   0.000000 F1 EIS::EVC_CfgBit_65_96_AR2::CRC_EVC_CfgBit_65_96_Pr2 = %d\n", intval);
	filePutString (buffer, elcount(buffer), hFile);
	intval = @sysvar::CH_Nodes::CH_EISSQC_EVC_CfgBit_65_96__AUTO;
	snprintf(buffer, elcount(buffer), "   0.000000    SV: 2 0 0 ::CH_Nodes::CH_EISSQC_EVC_CfgBit_65_96__AUTO = %d\n", intval);
	filePutString (buffer, elcount(buffer), hFile);
	intval = getSignal(CHASSIS::EVC_CfgBit_65_96_AR2::SQC_EVC_CfgBit_65_96_Pr2);
	snprintf(buffer, elcount(buffer), "   0.000000 F1 EIS::EVC_CfgBit_65_96_AR2::SQC_EVC_CfgBit_65_96_Pr2 = %d\n", intval);
	filePutString (buffer, elcount(buffer), hFile);
	intval = getSignal(CHASSIS::EVC_CfgBit_65_96_AR2::EVC_CfgBit_65_96_Stat);
	snprintf(buffer, elcount(buffer), "   0.000000 F1 EIS::EVC_CfgBit_65_96_AR2::EVC_CfgBit_65_96_Stat = %d\n", intval);
	filePutString (buffer, elcount(buffer), hFile);
	intval = getSignal(CHASSIS::EVC_CfgBit_65_96_AR2::EVC_65_CruiseCtrl_Avl);
	snprintf(buffer, elcount(buffer), "   0.000000 F1 EIS::EVC_CfgBit_65_96_AR2::EVC_65_CruiseCtrl_Avl = %d\n", intval);
	filePutString (buffer, elcount(buffer), hFile);
	intval = getSignal(CHASSIS::EVC_CfgBit_65_96_AR2::EVC_66_OffRoadPk_Avl);
	snprintf(buffer, elcount(buffer), "   0.000000 F1 EIS::EVC_CfgBit_65_96_AR2::EVC_66_OffRoadPk_Avl = %d\n", intval);
	filePutString (buffer, elcount(buffer), hFile);
	intval = getSignal(CHASSIS::EVC_CfgBit_65_96_AR2::EVC_67_CMS_Avl);
	snprintf(buffer, elcount(buffer), "   0.000000 F1 EIS::EVC_CfgBit_65_96_AR2::EVC_67_CMS_Avl = %d\n", intval);
	filePutString (buffer, elcount(buffer), hFile);
	intval = getSignal(CHASSIS::EVC_CfgBit_65_96_AR2::EVC_68_CMS_R_Avl);
	snprintf(buffer, elcount(buffer), "   0.000000 F1 EIS::EVC_CfgBit_65_96_AR2::EVC_68_CMS_R_Avl = %d\n", intval);
	filePutString (buffer, elcount(buffer), hFile);
	intval = getSignal(CHASSIS::EVC_CfgBit_65_96_AR2::EVC_69_BrkEngg_PP_Avl);
	snprintf(buffer, elcount(buffer), "   0.000000 F1 EIS::EVC_CfgBit_65_96_AR2::EVC_69_BrkEngg_PP_Avl = %d\n", intval);
	filePutString (buffer, elcount(buffer), hFile);
	intval = getSignal(CHASSIS::EVC_CfgBit_65_96_AR2::EVC_6A_BasExtd_Avl);
	snprintf(buffer, elcount(buffer), "   0.000000 F1 EIS::EVC_CfgBit_65_96_AR2::EVC_6A_BasExtd_Avl = %d\n", intval);
	filePutString (buffer, elcount(buffer), hFile);
	intval = getSignal(CHASSIS::EVC_CfgBit_65_96_AR2::EVC_6B_MirrFld_Avl);
	snprintf(buffer, elcount(buffer), "   0.000000 F1 EIS::EVC_CfgBit_65_96_AR2::EVC_6B_MirrFld_Avl = %d\n", intval);
	filePutString (buffer, elcount(buffer), hFile);
	intval = getSignal(CHASSIS::EVC_CfgBit_65_96_AR2::EVC_6C_BSM_Avl);
	snprintf(buffer, elcount(buffer), "   0.000000 F1 EIS::EVC_CfgBit_65_96_AR2::EVC_6C_BSM_Avl = %d\n", intval);
	filePutString (buffer, elcount(buffer), hFile);
	intval = getSignal(CHASSIS::EVC_CfgBit_65_96_AR2::EVC_6D_ActvBSM_Avl);
	snprintf(buffer, elcount(buffer), "   0.000000 F1 EIS::EVC_CfgBit_65_96_AR2::EVC_6D_ActvBSM_Avl = %d\n", intval);
	filePutString (buffer, elcount(buffer), hFile);
	intval = getSignal(CHASSIS::EVC_CfgBit_65_96_AR2::EVC_6E_TurnAss_Avl);
	snprintf(buffer, elcount(buffer), "   0.000000 F1 EIS::EVC_CfgBit_65_96_AR2::EVC_6E_TurnAss_Avl = %d\n", intval);
	filePutString (buffer, elcount(buffer), hFile);
	intval = getSignal(CHASSIS::EVC_CfgBit_65_96_AR2::EVC_6F_ADTR_Avl);
	snprintf(buffer, elcount(buffer), "   0.000000 F1 EIS::EVC_CfgBit_65_96_AR2::EVC_6F_ADTR_Avl = %d\n", intval);
	filePutString (buffer, elcount(buffer), hFile);
	intval = getSignal(CHASSIS::EVC_CfgBit_65_96_AR2::EVC_70_DTR_Pro_Avl);
	snprintf(buffer, elcount(buffer), "   0.000000 F1 EIS::EVC_CfgBit_65_96_AR2::EVC_70_DTR_Pro_Avl = %d\n", intval);
	filePutString (buffer, elcount(buffer), hFile);
	intval = getSignal(CHASSIS::EVC_CfgBit_65_96_AR2::EVC_71_ALS_Avl);
	snprintf(buffer, elcount(buffer), "   0.000000 F1 EIS::EVC_CfgBit_65_96_AR2::EVC_71_ALS_Avl = %d\n", intval);
	filePutString (buffer, elcount(buffer), hFile);
	intval = getSignal(CHASSIS::EVC_CfgBit_65_96_AR2::EVC_72_ActvLDA_Avl);
	snprintf(buffer, elcount(buffer), "   0.000000 F1 EIS::EVC_CfgBit_65_96_AR2::EVC_72_ActvLDA_Avl = %d\n", intval);
	filePutString (buffer, elcount(buffer), hFile);
	intval = getSignal(CHASSIS::EVC_CfgBit_65_96_AR2::EVC_73_FCW_Avl);
	snprintf(buffer, elcount(buffer), "   0.000000 F1 EIS::EVC_CfgBit_65_96_AR2::EVC_73_FCW_Avl = %d\n", intval);
	filePutString (buffer, elcount(buffer), hFile);
	intval = getSignal(CHASSIS::EVC_CfgBit_65_96_AR2::EVC_74_LaneRec_Avl);
	snprintf(buffer, elcount(buffer), "   0.000000 F1 EIS::EVC_CfgBit_65_96_AR2::EVC_74_LaneRec_Avl = %d\n", intval);
	filePutString (buffer, elcount(buffer), hFile);
	intval = getSignal(CHASSIS::EVC_CfgBit_65_96_AR2::EVC_75_NV_Avl);
	snprintf(buffer, elcount(buffer), "   0.000000 F1 EIS::EVC_CfgBit_65_96_AR2::EVC_75_NV_Avl = %d\n", intval);
	filePutString (buffer, elcount(buffer), hFile);
	intval = getSignal(CHASSIS::EVC_CfgBit_65_96_AR2::EVC_76_RoadSignDtct_Avl);
	snprintf(buffer, elcount(buffer), "   0.000000 F1 EIS::EVC_CfgBit_65_96_AR2::EVC_76_RoadSignDtct_Avl = %d\n", intval);
	filePutString (buffer, elcount(buffer), hFile);
	intval = getSignal(CHASSIS::EVC_CfgBit_65_96_AR2::EVC_77_RVC_Avl);
	snprintf(buffer, elcount(buffer), "   0.000000 F1 EIS::EVC_CfgBit_65_96_AR2::EVC_77_RVC_Avl = %d\n", intval);
	filePutString (buffer, elcount(buffer), hFile);
	intval = getSignal(CHASSIS::EVC_CfgBit_65_96_AR2::EVC_78_SurrView_Avl);
	snprintf(buffer, elcount(buffer), "   0.000000 F1 EIS::EVC_CfgBit_65_96_AR2::EVC_78_SurrView_Avl = %d\n", intval);
	filePutString (buffer, elcount(buffer), hFile);
	intval = getSignal(CHASSIS::EVC_CfgBit_65_96_AR2::EVC_79_PTS_Avl);
	snprintf(buffer, elcount(buffer), "   0.000000 F1 EIS::EVC_CfgBit_65_96_AR2::EVC_79_PTS_Avl = %d\n", intval);
	filePutString (buffer, elcount(buffer), hFile);
	intval = getSignal(CHASSIS::EVC_CfgBit_65_96_AR2::EVC_7A_APG_Avl);
	snprintf(buffer, elcount(buffer), "   0.000000 F1 EIS::EVC_CfgBit_65_96_AR2::EVC_7A_APG_Avl = %d\n", intval);
	filePutString (buffer, elcount(buffer), hFile);
	intval = getSignal(CHASSIS::EVC_CfgBit_65_96_AR2::EVC_7B_ActPKAS_Avl);
	snprintf(buffer, elcount(buffer), "   0.000000 F1 EIS::EVC_CfgBit_65_96_AR2::EVC_7B_ActPKAS_Avl = %d\n", intval);
	filePutString (buffer, elcount(buffer), hFile);
	intval = getSignal(CHASSIS::EVC_CfgBit_65_96_AR2::EVC_7C_IHC_Avl);
	snprintf(buffer, elcount(buffer), "   0.000000 F1 EIS::EVC_CfgBit_65_96_AR2::EVC_7C_IHC_Avl = %d\n", intval);
	filePutString (buffer, elcount(buffer), hFile);
	intval = getSignal(CHASSIS::EVC_CfgBit_65_96_AR2::EVC_7D_IHC_Plus_Avl);
	snprintf(buffer, elcount(buffer), "   0.000000 F1 EIS::EVC_CfgBit_65_96_AR2::EVC_7D_IHC_Plus_Avl = %d\n", intval);
	filePutString (buffer, elcount(buffer), hFile);
	intval = getSignal(CHASSIS::EVC_CfgBit_65_96_AR2::EVC_7E_BasPlusQ_Avl);
	snprintf(buffer, elcount(buffer), "   0.000000 F1 EIS::EVC_CfgBit_65_96_AR2::EVC_7E_BasPlusQ_Avl = %d\n", intval);
	filePutString (buffer, elcount(buffer), hFile);
	intval = getSignal(CHASSIS::EVC_CfgBit_65_96_AR2::EVC_7F_ECO_St_Avl);
	snprintf(buffer, elcount(buffer), "   0.000000 F1 EIS::EVC_CfgBit_65_96_AR2::EVC_7F_ECO_St_Avl = %d\n", intval);
	filePutString (buffer, elcount(buffer), hFile);
	intval = getSignal(CHASSIS::EVC_CfgBit_65_96_AR2::EVC_80_PSTS_Avl);
	snprintf(buffer, elcount(buffer), "   0.000000 F1 EIS::EVC_CfgBit_65_96_AR2::EVC_80_PSTS_Avl = %d\n", intval);
	filePutString (buffer, elcount(buffer), hFile);
	intval = getSignal(CHASSIS::EVC_CfgBit_65_96_AR2::EVC_81_ABC_Avl);
	snprintf(buffer, elcount(buffer), "   0.000000 F1 EIS::EVC_CfgBit_65_96_AR2::EVC_81_ABC_Avl = %d\n", intval);
	filePutString (buffer, elcount(buffer), hFile);
	intval = getSignal(CHASSIS::EVC_CfgBit_65_96_AR2::EVC_82_SteelAirSusp_Avl);
	snprintf(buffer, elcount(buffer), "   0.000000 F1 EIS::EVC_CfgBit_65_96_AR2::EVC_82_SteelAirSusp_Avl = %d\n", intval);
	filePutString (buffer, elcount(buffer), hFile);
	intval = getSignal(CHASSIS::EVC_CfgBit_65_96_AR2::EVC_83_AirSemiActv_Susp_Avl);
	snprintf(buffer, elcount(buffer), "   0.000000 F1 EIS::EVC_CfgBit_65_96_AR2::EVC_83_AirSemiActv_Susp_Avl = %d\n", intval);
	filePutString (buffer, elcount(buffer), hFile);
	intval = getSignal(CHASSIS::EVC_CfgBit_65_96_AR2::EVC_84_SportSusp_Avl);
	snprintf(buffer, elcount(buffer), "   0.000000 F1 EIS::EVC_CfgBit_65_96_AR2::EVC_84_SportSusp_Avl = %d\n", intval);
	filePutString (buffer, elcount(buffer), hFile);
	intval = getSignal(CHASSIS::EVC_CfgBit_65_96_AR2::EVC_85_SportPk_AMG_Avl);
	snprintf(buffer, elcount(buffer), "   0.000000 F1 EIS::EVC_CfgBit_65_96_AR2::EVC_85_SportPk_AMG_Avl = %d\n", intval);
	filePutString (buffer, elcount(buffer), hFile);
	intval = getSignal(CHASSIS::EVC_CfgBit_65_96_AR2::EVC_86_SportPk_Avl);
	snprintf(buffer, elcount(buffer), "   0.000000 F1 EIS::EVC_CfgBit_65_96_AR2::EVC_86_SportPk_Avl = %d\n", intval);
	filePutString (buffer, elcount(buffer), hFile);
	intval = getSignal(CHASSIS::EVC_CfgBit_65_96_AR2::EVC_87_SportPk_Ext_Avl);
	snprintf(buffer, elcount(buffer), "   0.000000 F1 EIS::EVC_CfgBit_65_96_AR2::EVC_87_SportPk_Ext_Avl = %d\n", intval);
	filePutString (buffer, elcount(buffer), hFile);
	intval = getSignal(CHASSIS::EVC_CfgBit_65_96_AR2::EVC_88_DualView_Avl);
	snprintf(buffer, elcount(buffer), "   0.000000 F1 EIS::EVC_CfgBit_65_96_AR2::EVC_88_DualView_Avl = %d\n", intval);
	filePutString (buffer, elcount(buffer), hFile);
	intval = getSignal(CHASSIS::EVC_CfgBit_65_96_AR2::EVC_89_Entertain_R_Avl);
	snprintf(buffer, elcount(buffer), "   0.000000 F1 EIS::EVC_CfgBit_65_96_AR2::EVC_89_Entertain_R_Avl = %d\n", intval);
	filePutString (buffer, elcount(buffer), hFile);
	intval = getSignal(CHASSIS::EVC_CfgBit_65_96_AR2::EVC_8A_DigTV_Avl);
	snprintf(buffer, elcount(buffer), "   0.000000 F1 EIS::EVC_CfgBit_65_96_AR2::EVC_8A_DigTV_Avl = %d\n", intval);
	filePutString (buffer, elcount(buffer), hFile);
	intval = getSignal(CHASSIS::EVC_CfgBit_65_96_AR2::EVC_8B_DAB_Tun_Avl);
	snprintf(buffer, elcount(buffer), "   0.000000 F1 EIS::EVC_CfgBit_65_96_AR2::EVC_8B_DAB_Tun_Avl = %d\n", intval);
	filePutString (buffer, elcount(buffer), hFile);
	intval = getSignal(CHASSIS::EVC_CfgBit_65_96_AR2::EVC_8C_MTUS_Avl);
	snprintf(buffer, elcount(buffer), "   0.000000 F1 EIS::EVC_CfgBit_65_96_AR2::EVC_8C_MTUS_Avl = %d\n", intval);
	filePutString (buffer, elcount(buffer), hFile);
	intval = getSignal(CHASSIS::EVC_CfgBit_65_96_AR2::EVC_8D_UCI_Avl);
	snprintf(buffer, elcount(buffer), "   0.000000 F1 EIS::EVC_CfgBit_65_96_AR2::EVC_8D_UCI_Avl = %d\n", intval);
	filePutString (buffer, elcount(buffer), hFile);
	intval = getSignal(CHASSIS::EVC_CfgBit_65_96_AR2::EVC_8E_SndSys_Avl);
	snprintf(buffer, elcount(buffer), "   0.000000 F1 EIS::EVC_CfgBit_65_96_AR2::EVC_8E_SndSys_Avl = %d\n", intval);
	filePutString (buffer, elcount(buffer), hFile);
	intval = getSignal(CHASSIS::EVC_CfgBit_65_96_AR2::EVC_8F_WShViewWin_Avl);
	snprintf(buffer, elcount(buffer), "   0.000000 F1 EIS::EVC_CfgBit_65_96_AR2::EVC_8F_WShViewWin_Avl = %d\n", intval);
	filePutString (buffer, elcount(buffer), hFile);
	intval = getSignal(CHASSIS::EVC_CfgBit_65_96_AR2::EVC_90_WSh_Clr_Avl);
	snprintf(buffer, elcount(buffer), "   0.000000 F1 EIS::EVC_CfgBit_65_96_AR2::EVC_90_WSh_Clr_Avl = %d\n", intval);
	filePutString (buffer, elcount(buffer), hFile);
}
/*@@end*/

/*@@caplFunc:saveVars_38(dword):*/
void saveVars_38(dword hFile)
{
	intval = getSignal(CHASSIS::EVC_CfgBit_65_96_AR2::EVC_91_WSh_Ht_Avl);
	snprintf(buffer, elcount(buffer), "   0.000000 F1 EIS::EVC_CfgBit_65_96_AR2::EVC_91_WSh_Ht_Avl = %d\n", intval);
	filePutString (buffer, elcount(buffer), hFile);
	intval = getSignal(CHASSIS::EVC_CfgBit_65_96_AR2::EVC_92_WShBL_Prot_Avl);
	snprintf(buffer, elcount(buffer), "   0.000000 F1 EIS::EVC_CfgBit_65_96_AR2::EVC_92_WShBL_Prot_Avl = %d\n", intval);
	filePutString (buffer, elcount(buffer), hFile);
	intval = getSignal(CHASSIS::EVC_CfgBit_65_96_AR2::EVC_93_WSh_Ht_Lcut_Avl);
	snprintf(buffer, elcount(buffer), "   0.000000 F1 EIS::EVC_CfgBit_65_96_AR2::EVC_93_WSh_Ht_Lcut_Avl = %d\n", intval);
	filePutString (buffer, elcount(buffer), hFile);
	intval = getSignal(CHASSIS::EVC_CfgBit_65_96_AR2::EVC_94_OptPack_Clas_Avl);
	snprintf(buffer, elcount(buffer), "   0.000000 F1 EIS::EVC_CfgBit_65_96_AR2::EVC_94_OptPack_Clas_Avl = %d\n", intval);
	filePutString (buffer, elcount(buffer), hFile);
	intval = getSignal(CHASSIS::EVC_CfgBit_65_96_AR2::EVC_95_OptPack_Avan_Avl);
	snprintf(buffer, elcount(buffer), "   0.000000 F1 EIS::EVC_CfgBit_65_96_AR2::EVC_95_OptPack_Avan_Avl = %d\n", intval);
	filePutString (buffer, elcount(buffer), hFile);
	intval = getSignal(CHASSIS::EVC_CfgBit_65_96_AR2::EVC_96_OptPack_Eleg_Avl);
	snprintf(buffer, elcount(buffer), "   0.000000 F1 EIS::EVC_CfgBit_65_96_AR2::EVC_96_OptPack_Eleg_Avl = %d\n", intval);
	filePutString (buffer, elcount(buffer), hFile);
	intval = @sysvar::CH_Nodes::CH_EISCRC_EVC_CfgBit_97_C8__AUTO;
	snprintf(buffer, elcount(buffer), "   0.000000    SV: 2 0 0 ::CH_Nodes::CH_EISCRC_EVC_CfgBit_97_C8__AUTO = %d\n", intval);
	filePutString (buffer, elcount(buffer), hFile);
	intval = getSignal(CHASSIS::EVC_CfgBit_97_C8_AR2::CRC_EVC_CfgBit_97_C8_Pr2);
	snprintf(buffer, elcount(buffer), "   0.000000 F1 EIS::EVC_CfgBit_97_C8_AR2::CRC_EVC_CfgBit_97_C8_Pr2 = %d\n", intval);
	filePutString (buffer, elcount(buffer), hFile);
	intval = @sysvar::CH_Nodes::CH_EISSQC_EVC_CfgBit_97_C8__AUTO;
	snprintf(buffer, elcount(buffer), "   0.000000    SV: 2 0 0 ::CH_Nodes::CH_EISSQC_EVC_CfgBit_97_C8__AUTO = %d\n", intval);
	filePutString (buffer, elcount(buffer), hFile);
	intval = getSignal(CHASSIS::EVC_CfgBit_97_C8_AR2::SQC_EVC_CfgBit_97_C8_Pr2);
	snprintf(buffer, elcount(buffer), "   0.000000 F1 EIS::EVC_CfgBit_97_C8_AR2::SQC_EVC_CfgBit_97_C8_Pr2 = %d\n", intval);
	filePutString (buffer, elcount(buffer), hFile);
	intval = getSignal(CHASSIS::EVC_CfgBit_97_C8_AR2::EVC_CfgBit_97_C8_Stat);
	snprintf(buffer, elcount(buffer), "   0.000000 F1 EIS::EVC_CfgBit_97_C8_AR2::EVC_CfgBit_97_C8_Stat = %d\n", intval);
	filePutString (buffer, elcount(buffer), hFile);
	intval = getSignal(CHASSIS::EVC_CfgBit_97_C8_AR2::EVC_97_ConvStWhlOp_AssSys_Avl);
	snprintf(buffer, elcount(buffer), "   0.000000 F1 EIS::EVC_CfgBit_97_C8_AR2::EVC_97_ConvStWhlOp_AssSys_Avl = %d\n", intval);
	filePutString (buffer, elcount(buffer), hFile);
	intval = getSignal(CHASSIS::EVC_CfgBit_97_C8_AR2::EVC_98_AMG_PerfSeat_Avl);
	snprintf(buffer, elcount(buffer), "   0.000000 F1 EIS::EVC_CfgBit_97_C8_AR2::EVC_98_AMG_PerfSeat_Avl = %d\n", intval);
	filePutString (buffer, elcount(buffer), hFile);
	intval = getSignal(CHASSIS::EVC_CfgBit_97_C8_AR2::EVC_99_RemPark_Avl);
	snprintf(buffer, elcount(buffer), "   0.000000 F1 EIS::EVC_CfgBit_97_C8_AR2::EVC_99_RemPark_Avl = %d\n", intval);
	filePutString (buffer, elcount(buffer), hFile);
	intval = getSignal(CHASSIS::EVC_CfgBit_97_C8_AR2::EVC_9A_PresfImpls_Sd_Avl);
	snprintf(buffer, elcount(buffer), "   0.000000 F1 EIS::EVC_CfgBit_97_C8_AR2::EVC_9A_PresfImpls_Sd_Avl = %d\n", intval);
	filePutString (buffer, elcount(buffer), hFile);
	intval = getSignal(CHASSIS::EVC_CfgBit_97_C8_AR2::EVC_9B_ADSPlus_Avl);
	snprintf(buffer, elcount(buffer), "   0.000000 F1 EIS::EVC_CfgBit_97_C8_AR2::EVC_9B_ADSPlus_Avl = %d\n", intval);
	filePutString (buffer, elcount(buffer), hFile);
	intval = getSignal(CHASSIS::EVC_CfgBit_97_C8_AR2::EVC_9C_PullmanGuard_Avl);
	snprintf(buffer, elcount(buffer), "   0.000000 F1 EIS::EVC_CfgBit_97_C8_AR2::EVC_9C_PullmanGuard_Avl = %d\n", intval);
	filePutString (buffer, elcount(buffer), hFile);
	intval = getSignal(CHASSIS::EVC_CfgBit_97_C8_AR2::EVC_9D_Allroad_Avl);
	snprintf(buffer, elcount(buffer), "   0.000000 F1 EIS::EVC_CfgBit_97_C8_AR2::EVC_9D_Allroad_Avl = %d\n", intval);
	filePutString (buffer, elcount(buffer), hFile);
	intval = getSignal(CHASSIS::EVC_CfgBit_97_C8_AR2::EVC_9E_AddEquip_Avl);
	snprintf(buffer, elcount(buffer), "   0.000000 F1 EIS::EVC_CfgBit_97_C8_AR2::EVC_9E_AddEquip_Avl = %d\n", intval);
	filePutString (buffer, elcount(buffer), hFile);
	intval = getSignal(CHASSIS::EVC_CfgBit_97_C8_AR2::EVC_9F_AddEquip_Avl);
	snprintf(buffer, elcount(buffer), "   0.000000 F1 EIS::EVC_CfgBit_97_C8_AR2::EVC_9F_AddEquip_Avl = %d\n", intval);
	filePutString (buffer, elcount(buffer), hFile);
	intval = getSignal(CHASSIS::EVC_CfgBit_97_C8_AR2::EVC_A0_AddEquip_Avl);
	snprintf(buffer, elcount(buffer), "   0.000000 F1 EIS::EVC_CfgBit_97_C8_AR2::EVC_A0_AddEquip_Avl = %d\n", intval);
	filePutString (buffer, elcount(buffer), hFile);
	intval = getSignal(CHASSIS::EVC_CfgBit_97_C8_AR2::EVC_A1_AddEquip_Avl);
	snprintf(buffer, elcount(buffer), "   0.000000 F1 EIS::EVC_CfgBit_97_C8_AR2::EVC_A1_AddEquip_Avl = %d\n", intval);
	filePutString (buffer, elcount(buffer), hFile);
	intval = getSignal(CHASSIS::EVC_CfgBit_97_C8_AR2::EVC_A2_AddEquip_Avl);
	snprintf(buffer, elcount(buffer), "   0.000000 F1 EIS::EVC_CfgBit_97_C8_AR2::EVC_A2_AddEquip_Avl = %d\n", intval);
	filePutString (buffer, elcount(buffer), hFile);
	intval = getSignal(CHASSIS::EVC_CfgBit_97_C8_AR2::EVC_A3_AddEquip_Avl);
	snprintf(buffer, elcount(buffer), "   0.000000 F1 EIS::EVC_CfgBit_97_C8_AR2::EVC_A3_AddEquip_Avl = %d\n", intval);
	filePutString (buffer, elcount(buffer), hFile);
	intval = getSignal(CHASSIS::EVC_CfgBit_97_C8_AR2::EVC_A4_AddEquip_Avl);
	snprintf(buffer, elcount(buffer), "   0.000000 F1 EIS::EVC_CfgBit_97_C8_AR2::EVC_A4_AddEquip_Avl = %d\n", intval);
	filePutString (buffer, elcount(buffer), hFile);
	intval = getSignal(CHASSIS::EVC_CfgBit_97_C8_AR2::EVC_A5_AddEquip_Avl);
	snprintf(buffer, elcount(buffer), "   0.000000 F1 EIS::EVC_CfgBit_97_C8_AR2::EVC_A5_AddEquip_Avl = %d\n", intval);
	filePutString (buffer, elcount(buffer), hFile);
	intval = getSignal(CHASSIS::EVC_CfgBit_97_C8_AR2::EVC_A6_AddEquip_Avl);
	snprintf(buffer, elcount(buffer), "   0.000000 F1 EIS::EVC_CfgBit_97_C8_AR2::EVC_A6_AddEquip_Avl = %d\n", intval);
	filePutString (buffer, elcount(buffer), hFile);
	intval = getSignal(CHASSIS::EVC_CfgBit_97_C8_AR2::EVC_A7_AddEquip_Avl);
	snprintf(buffer, elcount(buffer), "   0.000000 F1 EIS::EVC_CfgBit_97_C8_AR2::EVC_A7_AddEquip_Avl = %d\n", intval);
	filePutString (buffer, elcount(buffer), hFile);
	intval = getSignal(CHASSIS::EVC_CfgBit_97_C8_AR2::EVC_A8_AddEquip_Avl);
	snprintf(buffer, elcount(buffer), "   0.000000 F1 EIS::EVC_CfgBit_97_C8_AR2::EVC_A8_AddEquip_Avl = %d\n", intval);
	filePutString (buffer, elcount(buffer), hFile);
	intval = getSignal(CHASSIS::EVC_CfgBit_97_C8_AR2::EVC_A9_AddEquip_Avl);
	snprintf(buffer, elcount(buffer), "   0.000000 F1 EIS::EVC_CfgBit_97_C8_AR2::EVC_A9_AddEquip_Avl = %d\n", intval);
	filePutString (buffer, elcount(buffer), hFile);
	intval = getSignal(CHASSIS::EVC_CfgBit_97_C8_AR2::EVC_AA_AddEquip_Avl);
	snprintf(buffer, elcount(buffer), "   0.000000 F1 EIS::EVC_CfgBit_97_C8_AR2::EVC_AA_AddEquip_Avl = %d\n", intval);
	filePutString (buffer, elcount(buffer), hFile);
	intval = getSignal(CHASSIS::EVC_CfgBit_97_C8_AR2::EVC_AB_AddEquip_Avl);
	snprintf(buffer, elcount(buffer), "   0.000000 F1 EIS::EVC_CfgBit_97_C8_AR2::EVC_AB_AddEquip_Avl = %d\n", intval);
	filePutString (buffer, elcount(buffer), hFile);
	intval = getSignal(CHASSIS::EVC_CfgBit_97_C8_AR2::EVC_AC_AddEquip_Avl);
	snprintf(buffer, elcount(buffer), "   0.000000 F1 EIS::EVC_CfgBit_97_C8_AR2::EVC_AC_AddEquip_Avl = %d\n", intval);
	filePutString (buffer, elcount(buffer), hFile);
	intval = getSignal(CHASSIS::EVC_CfgBit_97_C8_AR2::EVC_AD_AddEquip_Avl);
	snprintf(buffer, elcount(buffer), "   0.000000 F1 EIS::EVC_CfgBit_97_C8_AR2::EVC_AD_AddEquip_Avl = %d\n", intval);
	filePutString (buffer, elcount(buffer), hFile);
	intval = getSignal(CHASSIS::EVC_CfgBit_97_C8_AR2::EVC_AE_AddEquip_Avl);
	snprintf(buffer, elcount(buffer), "   0.000000 F1 EIS::EVC_CfgBit_97_C8_AR2::EVC_AE_AddEquip_Avl = %d\n", intval);
	filePutString (buffer, elcount(buffer), hFile);
	intval = getSignal(CHASSIS::EVC_CfgBit_97_C8_AR2::EVC_AF_AddEquip_Avl);
	snprintf(buffer, elcount(buffer), "   0.000000 F1 EIS::EVC_CfgBit_97_C8_AR2::EVC_AF_AddEquip_Avl = %d\n", intval);
	filePutString (buffer, elcount(buffer), hFile);
	intval = getSignal(CHASSIS::EVC_CfgBit_97_C8_AR2::EVC_B0_AddEquip_Avl);
	snprintf(buffer, elcount(buffer), "   0.000000 F1 EIS::EVC_CfgBit_97_C8_AR2::EVC_B0_AddEquip_Avl = %d\n", intval);
	filePutString (buffer, elcount(buffer), hFile);
	intval = getSignal(CHASSIS::EVC_CfgBit_97_C8_AR2::EVC_B1_AddEquip_Avl);
	snprintf(buffer, elcount(buffer), "   0.000000 F1 EIS::EVC_CfgBit_97_C8_AR2::EVC_B1_AddEquip_Avl = %d\n", intval);
	filePutString (buffer, elcount(buffer), hFile);
	intval = getSignal(CHASSIS::EVC_CfgBit_97_C8_AR2::EVC_B2_AddEquip_Avl);
	snprintf(buffer, elcount(buffer), "   0.000000 F1 EIS::EVC_CfgBit_97_C8_AR2::EVC_B2_AddEquip_Avl = %d\n", intval);
	filePutString (buffer, elcount(buffer), hFile);
	intval = getSignal(CHASSIS::EVC_CfgBit_97_C8_AR2::EVC_B3_AddEquip_Avl);
	snprintf(buffer, elcount(buffer), "   0.000000 F1 EIS::EVC_CfgBit_97_C8_AR2::EVC_B3_AddEquip_Avl = %d\n", intval);
	filePutString (buffer, elcount(buffer), hFile);
	intval = getSignal(CHASSIS::EVC_CfgBit_97_C8_AR2::EVC_B4_AddEquip_Avl);
	snprintf(buffer, elcount(buffer), "   0.000000 F1 EIS::EVC_CfgBit_97_C8_AR2::EVC_B4_AddEquip_Avl = %d\n", intval);
	filePutString (buffer, elcount(buffer), hFile);
	intval = getSignal(CHASSIS::EVC_CfgBit_97_C8_AR2::EVC_B5_AddEquip_Avl);
	snprintf(buffer, elcount(buffer), "   0.000000 F1 EIS::EVC_CfgBit_97_C8_AR2::EVC_B5_AddEquip_Avl = %d\n", intval);
	filePutString (buffer, elcount(buffer), hFile);
	intval = getSignal(CHASSIS::EVC_CfgBit_97_C8_AR2::EVC_B6_AddEquip_Avl);
	snprintf(buffer, elcount(buffer), "   0.000000 F1 EIS::EVC_CfgBit_97_C8_AR2::EVC_B6_AddEquip_Avl = %d\n", intval);
	filePutString (buffer, elcount(buffer), hFile);
	intval = getSignal(CHASSIS::EVC_CfgBit_97_C8_AR2::EVC_B7_AddEquip_Avl);
	snprintf(buffer, elcount(buffer), "   0.000000 F1 EIS::EVC_CfgBit_97_C8_AR2::EVC_B7_AddEquip_Avl = %d\n", intval);
	filePutString (buffer, elcount(buffer), hFile);
	intval = getSignal(CHASSIS::EVC_CfgBit_97_C8_AR2::EVC_B8_AddEquip_Avl);
	snprintf(buffer, elcount(buffer), "   0.000000 F1 EIS::EVC_CfgBit_97_C8_AR2::EVC_B8_AddEquip_Avl = %d\n", intval);
	filePutString (buffer, elcount(buffer), hFile);
	intval = getSignal(CHASSIS::EVC_CfgBit_97_C8_AR2::EVC_B9_AddEquip_Avl);
	snprintf(buffer, elcount(buffer), "   0.000000 F1 EIS::EVC_CfgBit_97_C8_AR2::EVC_B9_AddEquip_Avl = %d\n", intval);
	filePutString (buffer, elcount(buffer), hFile);
	intval = getSignal(CHASSIS::EVC_CfgBit_97_C8_AR2::EVC_BA_AddEquip_Avl);
	snprintf(buffer, elcount(buffer), "   0.000000 F1 EIS::EVC_CfgBit_97_C8_AR2::EVC_BA_AddEquip_Avl = %d\n", intval);
	filePutString (buffer, elcount(buffer), hFile);
	intval = getSignal(CHASSIS::EVC_CfgBit_97_C8_AR2::EVC_BB_AddEquip_Avl);
	snprintf(buffer, elcount(buffer), "   0.000000 F1 EIS::EVC_CfgBit_97_C8_AR2::EVC_BB_AddEquip_Avl = %d\n", intval);
	filePutString (buffer, elcount(buffer), hFile);
	intval = getSignal(CHASSIS::EVC_CfgBit_97_C8_AR2::EVC_BC_AddEquip_Avl);
	snprintf(buffer, elcount(buffer), "   0.000000 F1 EIS::EVC_CfgBit_97_C8_AR2::EVC_BC_AddEquip_Avl = %d\n", intval);
	filePutString (buffer, elcount(buffer), hFile);
	intval = getSignal(CHASSIS::EVC_CfgBit_97_C8_AR2::EVC_BD_AddEquip_Avl);
	snprintf(buffer, elcount(buffer), "   0.000000 F1 EIS::EVC_CfgBit_97_C8_AR2::EVC_BD_AddEquip_Avl = %d\n", intval);
	filePutString (buffer, elcount(buffer), hFile);
	intval = getSignal(CHASSIS::EVC_CfgBit_97_C8_AR2::EVC_BE_AddEquip_Avl);
	snprintf(buffer, elcount(buffer), "   0.000000 F1 EIS::EVC_CfgBit_97_C8_AR2::EVC_BE_AddEquip_Avl = %d\n", intval);
	filePutString (buffer, elcount(buffer), hFile);
	intval = getSignal(CHASSIS::EVC_CfgBit_97_C8_AR2::EVC_BF_AEJx0_2_Avl);
	snprintf(buffer, elcount(buffer), "   0.000000 F1 EIS::EVC_CfgBit_97_C8_AR2::EVC_BF_AEJx0_2_Avl = %d\n", intval);
	filePutString (buffer, elcount(buffer), hFile);
	intval = getSignal(CHASSIS::EVC_CfgBit_97_C8_AR2::EVC_C0_AEJx1_2_Avl);
	snprintf(buffer, elcount(buffer), "   0.000000 F1 EIS::EVC_CfgBit_97_C8_AR2::EVC_C0_AEJx1_2_Avl = %d\n", intval);
	filePutString (buffer, elcount(buffer), hFile);
}
/*@@end*/

/*@@caplFunc:saveVars_39(dword):*/
void saveVars_39(dword hFile)
{
	intval = getSignal(CHASSIS::EVC_CfgBit_97_C8_AR2::EVC_C1_AEJx2_2_Avl);
	snprintf(buffer, elcount(buffer), "   0.000000 F1 EIS::EVC_CfgBit_97_C8_AR2::EVC_C1_AEJx2_2_Avl = %d\n", intval);
	filePutString (buffer, elcount(buffer), hFile);
	intval = getSignal(CHASSIS::EVC_CfgBit_97_C8_AR2::EVC_C2_AEJx3_2_Avl);
	snprintf(buffer, elcount(buffer), "   0.000000 F1 EIS::EVC_CfgBit_97_C8_AR2::EVC_C2_AEJx3_2_Avl = %d\n", intval);
	filePutString (buffer, elcount(buffer), hFile);
	intval = getSignal(CHASSIS::EVC_CfgBit_97_C8_AR2::EVC_C3_AEJx4_2_Avl);
	snprintf(buffer, elcount(buffer), "   0.000000 F1 EIS::EVC_CfgBit_97_C8_AR2::EVC_C3_AEJx4_2_Avl = %d\n", intval);
	filePutString (buffer, elcount(buffer), hFile);
	intval = getSignal(CHASSIS::EVC_CfgBit_97_C8_AR2::EVC_C4_AEJx5_2_Avl);
	snprintf(buffer, elcount(buffer), "   0.000000 F1 EIS::EVC_CfgBit_97_C8_AR2::EVC_C4_AEJx5_2_Avl = %d\n", intval);
	filePutString (buffer, elcount(buffer), hFile);
	intval = getSignal(CHASSIS::EVC_CfgBit_97_C8_AR2::EVC_C5_AEJx6_2_Avl);
	snprintf(buffer, elcount(buffer), "   0.000000 F1 EIS::EVC_CfgBit_97_C8_AR2::EVC_C5_AEJx6_2_Avl = %d\n", intval);
	filePutString (buffer, elcount(buffer), hFile);
	intval = getSignal(CHASSIS::EVC_CfgBit_97_C8_AR2::EVC_C6_AEJx7_2_Avl);
	snprintf(buffer, elcount(buffer), "   0.000000 F1 EIS::EVC_CfgBit_97_C8_AR2::EVC_C6_AEJx7_2_Avl = %d\n", intval);
	filePutString (buffer, elcount(buffer), hFile);
	intval = getSignal(CHASSIS::EVC_CfgBit_97_C8_AR2::EVC_C7_AEJx8_2_Avl);
	snprintf(buffer, elcount(buffer), "   0.000000 F1 EIS::EVC_CfgBit_97_C8_AR2::EVC_C7_AEJx8_2_Avl = %d\n", intval);
	filePutString (buffer, elcount(buffer), hFile);
	intval = getSignal(CHASSIS::EVC_CfgBit_97_C8_AR2::EVC_C8_AEJx9_2_Avl);
	snprintf(buffer, elcount(buffer), "   0.000000 F1 EIS::EVC_CfgBit_97_C8_AR2::EVC_C8_AEJx9_2_Avl = %d\n", intval);
	filePutString (buffer, elcount(buffer), hFile);
	intval = @sysvar::CH_Nodes::CH_EISCRC_EVC_CfgList_01_0C_AUTO;
	snprintf(buffer, elcount(buffer), "   0.000000    SV: 2 0 0 ::CH_Nodes::CH_EISCRC_EVC_CfgList_01_0C_AUTO = %d\n", intval);
	filePutString (buffer, elcount(buffer), hFile);
	intval = getSignal(CHASSIS::EVC_CfgList_01_0C_AR2::CRC_EVC_CfgList_01_0C_Pr2);
	snprintf(buffer, elcount(buffer), "   0.000000 F1 EIS::EVC_CfgList_01_0C_AR2::CRC_EVC_CfgList_01_0C_Pr2 = %d\n", intval);
	filePutString (buffer, elcount(buffer), hFile);
	intval = @sysvar::CH_Nodes::CH_EISSQC_EVC_CfgList_01_0C_AUTO;
	snprintf(buffer, elcount(buffer), "   0.000000    SV: 2 0 0 ::CH_Nodes::CH_EISSQC_EVC_CfgList_01_0C_AUTO = %d\n", intval);
	filePutString (buffer, elcount(buffer), hFile);
	intval = getSignal(CHASSIS::EVC_CfgList_01_0C_AR2::SQC_EVC_CfgList_01_0C_Pr2);
	snprintf(buffer, elcount(buffer), "   0.000000 F1 EIS::EVC_CfgList_01_0C_AR2::SQC_EVC_CfgList_01_0C_Pr2 = %d\n", intval);
	filePutString (buffer, elcount(buffer), hFile);
	intval = getSignal(CHASSIS::EVC_CfgList_01_0C_AR2::EVC_CfgList_01_0C_Stat);
	snprintf(buffer, elcount(buffer), "   0.000000 F1 EIS::EVC_CfgList_01_0C_AR2::EVC_CfgList_01_0C_Stat = %d\n", intval);
	filePutString (buffer, elcount(buffer), hFile);
	intval = getSignal(CHASSIS::EVC_CfgList_01_0C_AR2::EVC_List01_StStyle);
	snprintf(buffer, elcount(buffer), "   0.000000 F1 EIS::EVC_CfgList_01_0C_AR2::EVC_List01_StStyle = %d\n", intval);
	filePutString (buffer, elcount(buffer), hFile);
	intval = getSignal(CHASSIS::EVC_CfgList_01_0C_AR2::EVC_List02_BodyStyle);
	snprintf(buffer, elcount(buffer), "   0.000000 F1 EIS::EVC_CfgList_01_0C_AR2::EVC_List02_BodyStyle = %d\n", intval);
	filePutString (buffer, elcount(buffer), hFile);
	intval = getSignal(CHASSIS::EVC_CfgList_01_0C_AR2::EVC_List03_RoofStyle);
	snprintf(buffer, elcount(buffer), "   0.000000 F1 EIS::EVC_CfgList_01_0C_AR2::EVC_List03_RoofStyle = %d\n", intval);
	filePutString (buffer, elcount(buffer), hFile);
	intval = getSignal(CHASSIS::EVC_CfgList_01_0C_AR2::EVC_List04_HL_Style);
	snprintf(buffer, elcount(buffer), "   0.000000 F1 EIS::EVC_CfgList_01_0C_AR2::EVC_List04_HL_Style = %d\n", intval);
	filePutString (buffer, elcount(buffer), hFile);
	intval = getSignal(CHASSIS::EVC_CfgList_01_0C_AR2::EVC_List05_TxStyle);
	snprintf(buffer, elcount(buffer), "   0.000000 F1 EIS::EVC_CfgList_01_0C_AR2::EVC_List05_TxStyle = %d\n", intval);
	filePutString (buffer, elcount(buffer), hFile);
	intval = getSignal(CHASSIS::EVC_CfgList_01_0C_AR2::EVC_List06_VehLineYear);
	snprintf(buffer, elcount(buffer), "   0.000000 F1 EIS::EVC_CfgList_01_0C_AR2::EVC_List06_VehLineYear = %d\n", intval);
	filePutString (buffer, elcount(buffer), hFile);
	intval = getSignal(CHASSIS::EVC_CfgList_01_0C_AR2::EVC_List07_HVAC_Style);
	snprintf(buffer, elcount(buffer), "   0.000000 F1 EIS::EVC_CfgList_01_0C_AR2::EVC_List07_HVAC_Style = %d\n", intval);
	filePutString (buffer, elcount(buffer), hFile);
	intval = getSignal(CHASSIS::EVC_CfgList_01_0C_AR2::EVC_List08_Country);
	snprintf(buffer, elcount(buffer), "   0.000000 F1 EIS::EVC_CfgList_01_0C_AR2::EVC_List08_Country = %d\n", intval);
	filePutString (buffer, elcount(buffer), hFile);
	intval = getSignal(CHASSIS::EVC_CfgList_01_0C_AR2::EVC_List09_HU_Style);
	snprintf(buffer, elcount(buffer), "   0.000000 F1 EIS::EVC_CfgList_01_0C_AR2::EVC_List09_HU_Style = %d\n", intval);
	filePutString (buffer, elcount(buffer), hFile);
	intval = getSignal(CHASSIS::EVC_CfgList_01_0C_AR2::EVC_List0A_TPM_Style);
	snprintf(buffer, elcount(buffer), "   0.000000 F1 EIS::EVC_CfgList_01_0C_AR2::EVC_List0A_TPM_Style = %d\n", intval);
	filePutString (buffer, elcount(buffer), hFile);
	intval = getSignal(CHASSIS::EVC_CfgList_01_0C_AR2::EVC_List0B_AddEquip);
	snprintf(buffer, elcount(buffer), "   0.000000 F1 EIS::EVC_CfgList_01_0C_AR2::EVC_List0B_AddEquip = %d\n", intval);
	filePutString (buffer, elcount(buffer), hFile);
	intval = getSignal(CHASSIS::EVC_CfgList_01_0C_AR2::EVC_List0C_VehLine);
	snprintf(buffer, elcount(buffer), "   0.000000 F1 EIS::EVC_CfgList_01_0C_AR2::EVC_List0C_VehLine = %d\n", intval);
	filePutString (buffer, elcount(buffer), hFile);
	intval = getSignal(CHASSIS::FCW_Disp_Rq_AR::FCW_IndLmp_On_Rq);
	snprintf(buffer, elcount(buffer), "   0.000000 F1 EIS::FCW_Disp_Rq_AR::FCW_IndLmp_On_Rq = %d\n", intval);
	filePutString (buffer, elcount(buffer), hFile);
	intval = getSignal(CHASSIS::FCW_Disp_Rq_AR::FCW_AcustWarn_Rq);
	snprintf(buffer, elcount(buffer), "   0.000000 F1 EIS::FCW_Disp_Rq_AR::FCW_AcustWarn_Rq = %d\n", intval);
	filePutString (buffer, elcount(buffer), hFile);
	intval = getSignal(CHASSIS::FCW_Disp_Rq_AR::FCW_Stat);
	snprintf(buffer, elcount(buffer), "   0.000000 F1 EIS::FCW_Disp_Rq_AR::FCW_Stat = %d\n", intval);
	filePutString (buffer, elcount(buffer), hFile);
	intval = getSignal(CHASSIS::FCW_Disp_Rq_AR::FCW_ObjIntrstDist);
	snprintf(buffer, elcount(buffer), "   0.000000 F1 EIS::FCW_Disp_Rq_AR::FCW_ObjIntrstDist = %d\n", intval);
	filePutString (buffer, elcount(buffer), hFile);
	intval = getSignal(CHASSIS::FCW_Disp_Rq_AR::FCW_ObjIntrstDist_SPEEDO1);
	snprintf(buffer, elcount(buffer), "   0.000000 F1 EIS::FCW_Disp_Rq_AR::FCW_ObjIntrstDist_SPEEDO1 = %d\n", intval);
	filePutString (buffer, elcount(buffer), hFile);
	intval = getSignal(CHASSIS::FCW_Disp_Rq_AR::FCW_ObjIntrstDist_SPEEDO2);
	snprintf(buffer, elcount(buffer), "   0.000000 F1 EIS::FCW_Disp_Rq_AR::FCW_ObjIntrstDist_SPEEDO2 = %d\n", intval);
	filePutString (buffer, elcount(buffer), hFile);
	intval = getSignal(CHASSIS::FCW_Disp_Rq_AR::FCW_MsgDisp_Rq);
	snprintf(buffer, elcount(buffer), "   0.000000 F1 EIS::FCW_Disp_Rq_AR::FCW_MsgDisp_Rq = %d\n", intval);
	filePutString (buffer, elcount(buffer), hFile);
	intval = getSignal(CHASSIS::FCW_Disp_Rq_AR::PN14_ElecPwr_Rq_AS);
	snprintf(buffer, elcount(buffer), "   0.000000 F1 EIS::FCW_Disp_Rq_AR::PN14_ElecPwr_Rq_AS = %d\n", intval);
	filePutString (buffer, elcount(buffer), hFile);
	intval = getSignal(CHASSIS::HMI_CHASSIS_R1_AR2::Park_Disp_Stat);
	snprintf(buffer, elcount(buffer), "   0.000000 F1 EIS::HMI_CHASSIS_R1_AR2::Park_Disp_Stat = %d\n", intval);
	filePutString (buffer, elcount(buffer), hFile);
	intval = @sysvar::CH_Nodes::CH_EISPark_Disp_StatHMI__UB_AUTO;
	snprintf(buffer, elcount(buffer), "   0.000000    SV: 2 0 0 ::CH_Nodes::CH_EISPark_Disp_StatHMI__UB_AUTO = %d\n", intval);
	filePutString (buffer, elcount(buffer), hFile);
	intval = @sysvar::CH_Nodes::CH_EISPark_Disp_StatHMI_CHAS_UB_;
	snprintf(buffer, elcount(buffer), "   0.000000    SV: 2 0 0 ::CH_Nodes::CH_EISPark_Disp_StatHMI_CHAS_UB_ = %d\n", intval);
	filePutString (buffer, elcount(buffer), hFile);
	intval = @sysvar::CH_Nodes::CH_EISCRC_CTRL_L_Stat_Pr2HM_AUTO;
	snprintf(buffer, elcount(buffer), "   0.000000    SV: 2 0 0 ::CH_Nodes::CH_EISCRC_CTRL_L_Stat_Pr2HM_AUTO = %d\n", intval);
	filePutString (buffer, elcount(buffer), hFile);
	intval = getSignal(CHASSIS::HMI_CHASSIS_R1_AR2::CRC_CTRL_L_Stat_Pr2);
	snprintf(buffer, elcount(buffer), "   0.000000 F1 EIS::HMI_CHASSIS_R1_AR2::CRC_CTRL_L_Stat_Pr2 = %d\n", intval);
	filePutString (buffer, elcount(buffer), hFile);
	intval = @sysvar::CH_Nodes::CH_EISSQC_CTRL_L_Stat_Pr2HM_AUTO;
	snprintf(buffer, elcount(buffer), "   0.000000    SV: 2 0 0 ::CH_Nodes::CH_EISSQC_CTRL_L_Stat_Pr2HM_AUTO = %d\n", intval);
	filePutString (buffer, elcount(buffer), hFile);
	intval = getSignal(CHASSIS::HMI_CHASSIS_R1_AR2::SQC_CTRL_L_Stat_Pr2);
	snprintf(buffer, elcount(buffer), "   0.000000 F1 EIS::HMI_CHASSIS_R1_AR2::SQC_CTRL_L_Stat_Pr2 = %d\n", intval);
	filePutString (buffer, elcount(buffer), hFile);
	intval = getSignal(CHASSIS::HMI_CHASSIS_R1_AR2::Park_APC_Sw_Psd_CTRL_L);
	snprintf(buffer, elcount(buffer), "   0.000000 F1 EIS::HMI_CHASSIS_R1_AR2::Park_APC_Sw_Psd_CTRL_L = %d\n", intval);
	filePutString (buffer, elcount(buffer), hFile);
	intval = getSignal(CHASSIS::HMI_CHASSIS_R1_AR2::Rsrv1_CTRL_L_Stat_Pr2);
	snprintf(buffer, elcount(buffer), "   0.000000 F1 EIS::HMI_CHASSIS_R1_AR2::Rsrv1_CTRL_L_Stat_Pr2 = %d\n", intval);
	filePutString (buffer, elcount(buffer), hFile);
	intval = @sysvar::CH_Nodes::CH_EISCRC_CTRL_L2_Stat_Pr2H_AUTO;
	snprintf(buffer, elcount(buffer), "   0.000000    SV: 2 0 0 ::CH_Nodes::CH_EISCRC_CTRL_L2_Stat_Pr2H_AUTO = %d\n", intval);
	filePutString (buffer, elcount(buffer), hFile);
	intval = getSignal(CHASSIS::HMI_CHASSIS_R1_AR2::CRC_CTRL_L2_Stat_Pr2);
	snprintf(buffer, elcount(buffer), "   0.000000 F1 EIS::HMI_CHASSIS_R1_AR2::CRC_CTRL_L2_Stat_Pr2 = %d\n", intval);
	filePutString (buffer, elcount(buffer), hFile);
	intval = @sysvar::CH_Nodes::CH_EISSQC_CTRL_L2_Stat_Pr2H_AUTO;
	snprintf(buffer, elcount(buffer), "   0.000000    SV: 2 0 0 ::CH_Nodes::CH_EISSQC_CTRL_L2_Stat_Pr2H_AUTO = %d\n", intval);
	filePutString (buffer, elcount(buffer), hFile);
	intval = getSignal(CHASSIS::HMI_CHASSIS_R1_AR2::SQC_CTRL_L2_Stat_Pr2);
	snprintf(buffer, elcount(buffer), "   0.000000 F1 EIS::HMI_CHASSIS_R1_AR2::SQC_CTRL_L2_Stat_Pr2 = %d\n", intval);
	filePutString (buffer, elcount(buffer), hFile);
	intval = getSignal(CHASSIS::HMI_CHASSIS_R1_AR2::Park_APC_Sw_Psd_CTRL_L2);
	snprintf(buffer, elcount(buffer), "   0.000000 F1 EIS::HMI_CHASSIS_R1_AR2::Park_APC_Sw_Psd_CTRL_L2 = %d\n", intval);
	filePutString (buffer, elcount(buffer), hFile);
	intval = getSignal(CHASSIS::HMI_CHASSIS_R1_AR2::Rsrv1_CTRL_L2_Stat_Pr2);
	snprintf(buffer, elcount(buffer), "   0.000000 F1 EIS::HMI_CHASSIS_R1_AR2::Rsrv1_CTRL_L2_Stat_Pr2 = %d\n", intval);
	filePutString (buffer, elcount(buffer), hFile);
	intval = getSignal(CHASSIS::HU_Comf_Rq_AR2::StWhl_Cond_Rq_HU);
	snprintf(buffer, elcount(buffer), "   0.000000 F1 EIS::HU_Comf_Rq_AR2::StWhl_Cond_Rq_HU = %d\n", intval);
	filePutString (buffer, elcount(buffer), hFile);
	intval = getSignal(CHASSIS::HU_State_AR::HU_MPM_Msg_Stat);
	snprintf(buffer, elcount(buffer), "   0.000000 F1 EIS::HU_State_AR::HU_MPM_Msg_Stat = %d\n", intval);
	filePutString (buffer, elcount(buffer), hFile);
	intval = getSignal(CHASSIS::HU_State_AR::Radio_NumPad_Stat);
	snprintf(buffer, elcount(buffer), "   0.000000 F1 EIS::HU_State_AR::Radio_NumPad_Stat = %d\n", intval);
	filePutString (buffer, elcount(buffer), hFile);
	intval = getSignal(CHASSIS::HU_State_AR::FBAS_Video_Stat);
	snprintf(buffer, elcount(buffer), "   0.000000 F1 EIS::HU_State_AR::FBAS_Video_Stat = %d\n", intval);
	filePutString (buffer, elcount(buffer), hFile);
	intval = getSignal(CHASSIS::HU_State_AR::HU_On_Stat);
	snprintf(buffer, elcount(buffer), "   0.000000 F1 EIS::HU_State_AR::HU_On_Stat = %d\n", intval);
	filePutString (buffer, elcount(buffer), hFile);
	intval = getSignal(CHASSIS::HU_State_AR::HU_DayNightMd_Stat);
	snprintf(buffer, elcount(buffer), "   0.000000 F1 EIS::HU_State_AR::HU_DayNightMd_Stat = %d\n", intval);
	filePutString (buffer, elcount(buffer), hFile);
	intval = getSignal(CHASSIS::HU_State_AR::SDS_Actv);
	snprintf(buffer, elcount(buffer), "   0.000000 F1 EIS::HU_State_AR::SDS_Actv = %d\n", intval);
	filePutString (buffer, elcount(buffer), hFile);
	intval = getSignal(CHASSIS::HU_State_AR::CI_DI_Actv);
	snprintf(buffer, elcount(buffer), "   0.000000 F1 EIS::HU_State_AR::CI_DI_Actv = %d\n", intval);
	filePutString (buffer, elcount(buffer), hFile);
	intval = getSignal(CHASSIS::HU_State_AR::TGW_TP_Alive);
	snprintf(buffer, elcount(buffer), "   0.000000 F1 EIS::HU_State_AR::TGW_TP_Alive = %d\n", intval);
	filePutString (buffer, elcount(buffer), hFile);
	intval = getSignal(CHASSIS::HU_State_AR::PT_DispLrnMax_Rq);
	snprintf(buffer, elcount(buffer), "   0.000000 F1 EIS::HU_State_AR::PT_DispLrnMax_Rq = %d\n", intval);
	filePutString (buffer, elcount(buffer), hFile);
}
/*@@end*/

/*@@caplFunc:saveVars_40(dword):*/
void saveVars_40(dword hFile)
{
	intval = getSignal(CHASSIS::HU_State_AR::Phonecall_SDS_Actv);
	snprintf(buffer, elcount(buffer), "   0.000000 F1 EIS::HU_State_AR::Phonecall_SDS_Actv = %d\n", intval);
	filePutString (buffer, elcount(buffer), hFile);
	intval = getSignal(CHASSIS::HU_State_AR::Tlm_Sw_Psd);
	snprintf(buffer, elcount(buffer), "   0.000000 F1 EIS::HU_State_AR::Tlm_Sw_Psd = %d\n", intval);
	filePutString (buffer, elcount(buffer), hFile);
	intval = getSignal(CHASSIS::HU_State_AR::ServiceCall_Call_Stat);
	snprintf(buffer, elcount(buffer), "   0.000000 F1 EIS::HU_State_AR::ServiceCall_Call_Stat = %d\n", intval);
	filePutString (buffer, elcount(buffer), hFile);
	intval = getSignal(CHASSIS::HU_State_AR::InfoCall_Call_Stat);
	snprintf(buffer, elcount(buffer), "   0.000000 F1 EIS::HU_State_AR::InfoCall_Call_Stat = %d\n", intval);
	filePutString (buffer, elcount(buffer), hFile);
	intval = getSignal(CHASSIS::HU_State_AR::Disp_R_Adj_Up_Rq);
	snprintf(buffer, elcount(buffer), "   0.000000 F1 EIS::HU_State_AR::Disp_R_Adj_Up_Rq = %d\n", intval);
	filePutString (buffer, elcount(buffer), hFile);
	intval = getSignal(CHASSIS::HU_State_AR::Disp_R_Adj_Dn_Rq);
	snprintf(buffer, elcount(buffer), "   0.000000 F1 EIS::HU_State_AR::Disp_R_Adj_Dn_Rq = %d\n", intval);
	filePutString (buffer, elcount(buffer), hFile);
	intval = getSignal(CHASSIS::HU_State_AR::SPV_Rem_UI_Stat);
	snprintf(buffer, elcount(buffer), "   0.000000 F1 EIS::HU_State_AR::SPV_Rem_UI_Stat = %d\n", intval);
	filePutString (buffer, elcount(buffer), hFile);
	intval = getSignal(CHASSIS::HU_State_AR::RemDev_CtrlEv);
	snprintf(buffer, elcount(buffer), "   0.000000 F1 EIS::HU_State_AR::RemDev_CtrlEv = %d\n", intval);
	filePutString (buffer, elcount(buffer), hFile);
	intval = getSignal(CHASSIS::HU_State_AR::RemDev_CtrlEv_Type);
	snprintf(buffer, elcount(buffer), "   0.000000 F1 EIS::HU_State_AR::RemDev_CtrlEv_Type = %d\n", intval);
	filePutString (buffer, elcount(buffer), hFile);
	intval = getSignal(CHASSIS::HU_State_AR::Tweeter_Ft_Posn_Rq);
	snprintf(buffer, elcount(buffer), "   0.000000 F1 EIS::HU_State_AR::Tweeter_Ft_Posn_Rq = %d\n", intval);
	filePutString (buffer, elcount(buffer), hFile);
	intval = getSignal(CHASSIS::HU_State_AR::Tweeter_R_Posn_Rq);
	snprintf(buffer, elcount(buffer), "   0.000000 F1 EIS::HU_State_AR::Tweeter_R_Posn_Rq = %d\n", intval);
	filePutString (buffer, elcount(buffer), hFile);
	intval = getSignal(CHASSIS::HU_State_AR::Audio_TwoCabSrc_Stat);
	snprintf(buffer, elcount(buffer), "   0.000000 F1 EIS::HU_State_AR::Audio_TwoCabSrc_Stat = %d\n", intval);
	filePutString (buffer, elcount(buffer), hFile);
	intval = getSignal(CHASSIS::HU_State_AR::VTA_Park_Event_Disp_Ack);
	snprintf(buffer, elcount(buffer), "   0.000000 F1 EIS::HU_State_AR::VTA_Park_Event_Disp_Ack = %d\n", intval);
	filePutString (buffer, elcount(buffer), hFile);
	intval = getSignal(CHASSIS::HU_State_AR::PhoneCall_Actv);
	snprintf(buffer, elcount(buffer), "   0.000000 F1 EIS::HU_State_AR::PhoneCall_Actv = %d\n", intval);
	filePutString (buffer, elcount(buffer), hFile);
	intval = getSignal(CHASSIS::HVAC_Disp_Stat1_AR::HVAC_CO2_Warn_Rq);
	snprintf(buffer, elcount(buffer), "   0.000000 F1 EIS::HVAC_Disp_Stat1_AR::HVAC_CO2_Warn_Rq = %d\n", intval);
	filePutString (buffer, elcount(buffer), hFile);
	intval = getSignal(CHASSIS::HVAC_Disp_Stat1_AR::HVAC_Recirc_Stat);
	snprintf(buffer, elcount(buffer), "   0.000000 F1 EIS::HVAC_Disp_Stat1_AR::HVAC_Recirc_Stat = %d\n", intval);
	filePutString (buffer, elcount(buffer), hFile);
	intval = getSignal(CHASSIS::HVAC_Disp_Stat1_AR::HVAC_AC_Z1Z2_Actv);
	snprintf(buffer, elcount(buffer), "   0.000000 F1 EIS::HVAC_Disp_Stat1_AR::HVAC_AC_Z1Z2_Actv = %d\n", intval);
	filePutString (buffer, elcount(buffer), hFile);
	intval = getSignal(CHASSIS::HVAC_Disp_Stat1_AR::HVAC_Off_Z1Z2_Actv);
	snprintf(buffer, elcount(buffer), "   0.000000 F1 EIS::HVAC_Disp_Stat1_AR::HVAC_Off_Z1Z2_Actv = %d\n", intval);
	filePutString (buffer, elcount(buffer), hFile);
	intval = getSignal(CHASSIS::HVAC_Disp_Stat1_AR::HVAC_RHU_Z1Z2_Actv);
	snprintf(buffer, elcount(buffer), "   0.000000 F1 EIS::HVAC_Disp_Stat1_AR::HVAC_RHU_Z1Z2_Actv = %d\n", intval);
	filePutString (buffer, elcount(buffer), hFile);
	intval = getSignal(CHASSIS::HVAC_Disp_Stat1_AR::HVAC_Dfrst_Z1Z2_Actv);
	snprintf(buffer, elcount(buffer), "   0.000000 F1 EIS::HVAC_Disp_Stat1_AR::HVAC_Dfrst_Z1Z2_Actv = %d\n", intval);
	filePutString (buffer, elcount(buffer), hFile);
	intval = getSignal(CHASSIS::HVAC_Disp_Stat1_AR::HVAC_CO2_Sens_Flt);
	snprintf(buffer, elcount(buffer), "   0.000000 F1 EIS::HVAC_Disp_Stat1_AR::HVAC_CO2_Sens_Flt = %d\n", intval);
	filePutString (buffer, elcount(buffer), hFile);
	intval = getSignal(CHASSIS::HVAC_Disp_Stat1_AR::HVAC_eHeV_Stat);
	snprintf(buffer, elcount(buffer), "   0.000000 F1 EIS::HVAC_Disp_Stat1_AR::HVAC_eHeV_Stat = %d\n", intval);
	filePutString (buffer, elcount(buffer), hFile);
	intval = getSignal(CHASSIS::HVAC_Disp_Stat1_AR::HVAC_eHeV_Disp_Rq);
	snprintf(buffer, elcount(buffer), "   0.000000 F1 EIS::HVAC_Disp_Stat1_AR::HVAC_eHeV_Disp_Rq = %d\n", intval);
	filePutString (buffer, elcount(buffer), hFile);
	intval = getSignal(CHASSIS::HVAC_Disp_Stat1_AR::HVAC_ICH1_2_LED_On_Rq);
	snprintf(buffer, elcount(buffer), "   0.000000 F1 EIS::HVAC_Disp_Stat1_AR::HVAC_ICH1_2_LED_On_Rq = %d\n", intval);
	filePutString (buffer, elcount(buffer), hFile);
	intval = getSignal(CHASSIS::HVAC_Disp_Stat1_AR::HVAC_Auto_Zone1_Stat);
	snprintf(buffer, elcount(buffer), "   0.000000 F1 EIS::HVAC_Disp_Stat1_AR::HVAC_Auto_Zone1_Stat = %d\n", intval);
	filePutString (buffer, elcount(buffer), hFile);
	intval = getSignal(CHASSIS::HVAC_Disp_Stat1_AR::HVAC_Auto_Zone2_Stat);
	snprintf(buffer, elcount(buffer), "   0.000000 F1 EIS::HVAC_Disp_Stat1_AR::HVAC_Auto_Zone2_Stat = %d\n", intval);
	filePutString (buffer, elcount(buffer), hFile);
	intval = getSignal(CHASSIS::HVAC_Disp_Stat1_AR::HVAC_FtwInc_Zone1_Stat);
	snprintf(buffer, elcount(buffer), "   0.000000 F1 EIS::HVAC_Disp_Stat1_AR::HVAC_FtwInc_Zone1_Stat = %d\n", intval);
	filePutString (buffer, elcount(buffer), hFile);
	intval = getSignal(CHASSIS::HVAC_Disp_Stat1_AR::HVAC_FtwInc_Zone2_Stat);
	snprintf(buffer, elcount(buffer), "   0.000000 F1 EIS::HVAC_Disp_Stat1_AR::HVAC_FtwInc_Zone2_Stat = %d\n", intval);
	filePutString (buffer, elcount(buffer), hFile);
	floatval = getSignal(CHASSIS::HVAC_Disp_Stat1_AR::HVAC_Temp_Zone1_Stat);
	snprintf(buffer, elcount(buffer), "   0.000000 F1 EIS::HVAC_Disp_Stat1_AR::HVAC_Temp_Zone1_Stat = %f\n", floatval);
	filePutString (buffer, elcount(buffer), hFile);
	intval = getSignal(CHASSIS::HVAC_Disp_Stat1_AR::HVAC_Airflow_Zone1_Stat);
	snprintf(buffer, elcount(buffer), "   0.000000 F1 EIS::HVAC_Disp_Stat1_AR::HVAC_Airflow_Zone1_Stat = %d\n", intval);
	filePutString (buffer, elcount(buffer), hFile);
	floatval = getSignal(CHASSIS::HVAC_Disp_Stat1_AR::HVAC_Temp_Zone2_Stat);
	snprintf(buffer, elcount(buffer), "   0.000000 F1 EIS::HVAC_Disp_Stat1_AR::HVAC_Temp_Zone2_Stat = %f\n", floatval);
	filePutString (buffer, elcount(buffer), hFile);
	intval = getSignal(CHASSIS::HVAC_Disp_Stat1_AR::HVAC_Airflow_Zone2_Stat);
	snprintf(buffer, elcount(buffer), "   0.000000 F1 EIS::HVAC_Disp_Stat1_AR::HVAC_Airflow_Zone2_Stat = %d\n", intval);
	filePutString (buffer, elcount(buffer), hFile);
	intval = getSignal(CHASSIS::HVAC_Disp_Stat1_AR::HVAC_AirDist_Zone1_Stat);
	snprintf(buffer, elcount(buffer), "   0.000000 F1 EIS::HVAC_Disp_Stat1_AR::HVAC_AirDist_Zone1_Stat = %d\n", intval);
	filePutString (buffer, elcount(buffer), hFile);
	intval = getSignal(CHASSIS::HVAC_Disp_Stat1_AR::HVAC_AirDist_Zone2_Stat);
	snprintf(buffer, elcount(buffer), "   0.000000 F1 EIS::HVAC_Disp_Stat1_AR::HVAC_AirDist_Zone2_Stat = %d\n", intval);
	filePutString (buffer, elcount(buffer), hFile);
	intval = getSignal(CHASSIS::HVAC_Disp_Stat1_AR::HVAC_Fan_Zone1_Stat);
	snprintf(buffer, elcount(buffer), "   0.000000 F1 EIS::HVAC_Disp_Stat1_AR::HVAC_Fan_Zone1_Stat = %d\n", intval);
	filePutString (buffer, elcount(buffer), hFile);
	intval = getSignal(CHASSIS::HVAC_Disp_Stat1_AR::HVAC_Fan_Zone2_Stat);
	snprintf(buffer, elcount(buffer), "   0.000000 F1 EIS::HVAC_Disp_Stat1_AR::HVAC_Fan_Zone2_Stat = %d\n", intval);
	filePutString (buffer, elcount(buffer), hFile);
	intval = getSignal(CHASSIS::HVAC_OBD_DTC_AR::HVAC_CALID_CVN_ErrNum);
	snprintf(buffer, elcount(buffer), "   0.000000 F1 EIS::HVAC_OBD_DTC_AR::HVAC_CALID_CVN_ErrNum = %d\n", intval);
	filePutString (buffer, elcount(buffer), hFile);
	intval = getSignal(CHASSIS::HVAC_OBD_DTC_AR::HVAC_Data);
	snprintf(buffer, elcount(buffer), "   0.000000 F1 EIS::HVAC_OBD_DTC_AR::HVAC_Data = %d\n", intval);
	filePutString (buffer, elcount(buffer), hFile);
	intval = getSignal(CHASSIS::HVAC_OBD_DTC_AR::HVAC_DTC1_Idx);
	snprintf(buffer, elcount(buffer), "   0.000000 F1 EIS::HVAC_OBD_DTC_AR::HVAC_DTC1_Idx = %d\n", intval);
	filePutString (buffer, elcount(buffer), hFile);
	intval = getSignal(CHASSIS::HVAC_OBD_DTC_AR::HVAC_DTC1_Stat);
	snprintf(buffer, elcount(buffer), "   0.000000 F1 EIS::HVAC_OBD_DTC_AR::HVAC_DTC1_Stat = %d\n", intval);
	filePutString (buffer, elcount(buffer), hFile);
	intval = getSignal(CHASSIS::HVAC_OBD_DTC_AR::HVAC_DTC2_Idx);
	snprintf(buffer, elcount(buffer), "   0.000000 F1 EIS::HVAC_OBD_DTC_AR::HVAC_DTC2_Idx = %d\n", intval);
	filePutString (buffer, elcount(buffer), hFile);
	intval = getSignal(CHASSIS::HVAC_OBD_DTC_AR::HVAC_DTC2_Stat);
	snprintf(buffer, elcount(buffer), "   0.000000 F1 EIS::HVAC_OBD_DTC_AR::HVAC_DTC2_Stat = %d\n", intval);
	filePutString (buffer, elcount(buffer), hFile);
	floatval = getSignal(CHASSIS::HVAC_Rs2_AR::PTC_HV_Curr);
	snprintf(buffer, elcount(buffer), "   0.000000 F1 EIS::HVAC_Rs2_AR::PTC_HV_Curr = %f\n", floatval);
	filePutString (buffer, elcount(buffer), hFile);
	intval = getSignal(CHASSIS::HVAC_Rs2_AR::PTC_Oprtn_Stat);
	snprintf(buffer, elcount(buffer), "   0.000000 F1 EIS::HVAC_Rs2_AR::PTC_Oprtn_Stat = %d\n", intval);
	filePutString (buffer, elcount(buffer), hFile);
	floatval = getSignal(CHASSIS::HVAC_Rs2_AR::PTC_HV_Volt);
	snprintf(buffer, elcount(buffer), "   0.000000 F1 EIS::HVAC_Rs2_AR::PTC_HV_Volt = %f\n", floatval);
	filePutString (buffer, elcount(buffer), hFile);
	intval = getSignal(CHASSIS::HVAC_Rs2_AR::HVAC_PwrBoost_Rq);
	snprintf(buffer, elcount(buffer), "   0.000000 F1 EIS::HVAC_Rs2_AR::HVAC_PwrBoost_Rq = %d\n", intval);
	filePutString (buffer, elcount(buffer), hFile);
	intval = getSignal(CHASSIS::HVAC_Rs2_AR::PNHV_PTC_PwrOut_Stat);
	snprintf(buffer, elcount(buffer), "   0.000000 F1 EIS::HVAC_Rs2_AR::PNHV_PTC_PwrOut_Stat = %d\n", intval);
	filePutString (buffer, elcount(buffer), hFile);
	intval = getSignal(CHASSIS::HVAC_Rs2_AR::ECP_4_Pwr_Rq);
	snprintf(buffer, elcount(buffer), "   0.000000 F1 EIS::HVAC_Rs2_AR::ECP_4_Pwr_Rq = %d\n", intval);
	filePutString (buffer, elcount(buffer), hFile);
	intval = getSignal(CHASSIS::HVAC_Rs2_AR::ECP_4_On_Rq);
	snprintf(buffer, elcount(buffer), "   0.000000 F1 EIS::HVAC_Rs2_AR::ECP_4_On_Rq = %d\n", intval);
	filePutString (buffer, elcount(buffer), hFile);
	intval = getSignal(CHASSIS::HVAC_Rs2_AR::PNHV_PTC_PredPwr);
	snprintf(buffer, elcount(buffer), "   0.000000 F1 EIS::HVAC_Rs2_AR::PNHV_PTC_PredPwr = %d\n", intval);
	filePutString (buffer, elcount(buffer), hFile);
	intval = getSignal(CHASSIS::HVAC_Rs2_AR::HVAC_PredPwr);
	snprintf(buffer, elcount(buffer), "   0.000000 F1 EIS::HVAC_Rs2_AR::HVAC_PredPwr = %d\n", intval);
	filePutString (buffer, elcount(buffer), hFile);
}
/*@@end*/

/*@@caplFunc:saveVars_41(dword):*/
void saveVars_41(dword hFile)
{
	intval = getSignal(CHASSIS::HVAC_Rs2_AR::HV_PTC_InternalWaterTemp);
	snprintf(buffer, elcount(buffer), "   0.000000 F1 EIS::HVAC_Rs2_AR::HV_PTC_InternalWaterTemp = %d\n", intval);
	filePutString (buffer, elcount(buffer), hFile);
	floatval = getSignal(CHASSIS::HVAC_Rs3_AR2::HVAC_Chiller_PwrConv);
	snprintf(buffer, elcount(buffer), "   0.000000 F1 EIS::HVAC_Rs3_AR2::HVAC_Chiller_PwrConv = %f\n", floatval);
	filePutString (buffer, elcount(buffer), hFile);
	floatval = getSignal(CHASSIS::HVAC_Rs3_AR2::HVAC_Condens_PwrConv);
	snprintf(buffer, elcount(buffer), "   0.000000 F1 EIS::HVAC_Rs3_AR2::HVAC_Condens_PwrConv = %f\n", floatval);
	filePutString (buffer, elcount(buffer), hFile);
	floatval = getSignal(CHASSIS::HVAC_Rs3_AR2::HVAC_HtPwr);
	snprintf(buffer, elcount(buffer), "   0.000000 F1 EIS::HVAC_Rs3_AR2::HVAC_HtPwr = %f\n", floatval);
	filePutString (buffer, elcount(buffer), hFile);
	intval = getSignal(CHASSIS::HVAC_Rs3_AR2::HVAC_CoolCirc_Cls);
	snprintf(buffer, elcount(buffer), "   0.000000 F1 EIS::HVAC_Rs3_AR2::HVAC_CoolCirc_Cls = %d\n", intval);
	filePutString (buffer, elcount(buffer), hFile);
	floatval = getSignal(CHASSIS::HVAC_Rs3_AR2::HVAC_Chiller_EXV_Posn_Rq);
	snprintf(buffer, elcount(buffer), "   0.000000 F1 EIS::HVAC_Rs3_AR2::HVAC_Chiller_EXV_Posn_Rq = %f\n", floatval);
	filePutString (buffer, elcount(buffer), hFile);
	intval = @sysvar::CH_Nodes::CH_EISCRC_HVAC_CompTrq_Pr2H_AUTO;
	snprintf(buffer, elcount(buffer), "   0.000000    SV: 2 0 0 ::CH_Nodes::CH_EISCRC_HVAC_CompTrq_Pr2H_AUTO = %d\n", intval);
	filePutString (buffer, elcount(buffer), hFile);
	intval = getSignal(CHASSIS::HVAC_Rs_AR2::CRC_HVAC_CompTrq_Pr2);
	snprintf(buffer, elcount(buffer), "   0.000000 F1 EIS::HVAC_Rs_AR2::CRC_HVAC_CompTrq_Pr2 = %d\n", intval);
	filePutString (buffer, elcount(buffer), hFile);
	intval = @sysvar::CH_Nodes::CH_EISSQC_HVAC_CompTrq_Pr2H_AUTO;
	snprintf(buffer, elcount(buffer), "   0.000000    SV: 2 0 0 ::CH_Nodes::CH_EISSQC_HVAC_CompTrq_Pr2H_AUTO = %d\n", intval);
	filePutString (buffer, elcount(buffer), hFile);
	intval = getSignal(CHASSIS::HVAC_Rs_AR2::SQC_HVAC_CompTrq_Pr2);
	snprintf(buffer, elcount(buffer), "   0.000000 F1 EIS::HVAC_Rs_AR2::SQC_HVAC_CompTrq_Pr2 = %d\n", intval);
	filePutString (buffer, elcount(buffer), hFile);
	intval = getSignal(CHASSIS::HVAC_Rs_AR2::Rsrv1_HVAC_Comp_Trq_Pr2);
	snprintf(buffer, elcount(buffer), "   0.000000 F1 EIS::HVAC_Rs_AR2::Rsrv1_HVAC_Comp_Trq_Pr2 = %d\n", intval);
	filePutString (buffer, elcount(buffer), hFile);
	floatval = getSignal(CHASSIS::HVAC_Rs_AR2::HVAC_CompTrq_Ft);
	snprintf(buffer, elcount(buffer), "   0.000000 F1 EIS::HVAC_Rs_AR2::HVAC_CompTrq_Ft = %f\n", floatval);
	filePutString (buffer, elcount(buffer), hFile);
	intval = getSignal(CHASSIS::HVAC_Rs_AR2::HVAC_TxShftPoint_Inc_Rq);
	snprintf(buffer, elcount(buffer), "   0.000000 F1 EIS::HVAC_Rs_AR2::HVAC_TxShftPoint_Inc_Rq = %d\n", intval);
	filePutString (buffer, elcount(buffer), hFile);
	intval = getSignal(CHASSIS::HVAC_Rs_AR2::HVAC_TxShftPointHt_Inc_Rq);
	snprintf(buffer, elcount(buffer), "   0.000000 F1 EIS::HVAC_Rs_AR2::HVAC_TxShftPointHt_Inc_Rq = %d\n", intval);
	filePutString (buffer, elcount(buffer), hFile);
	intval = getSignal(CHASSIS::HVAC_Rs_AR2::SSA_Enbl_Rq_HVAC);
	snprintf(buffer, elcount(buffer), "   0.000000 F1 EIS::HVAC_Rs_AR2::SSA_Enbl_Rq_HVAC = %d\n", intval);
	filePutString (buffer, elcount(buffer), hFile);
	intval = getSignal(CHASSIS::HVAC_Rs_AR2::HVAC_EngIdleRPM_Inc_Rq);
	snprintf(buffer, elcount(buffer), "   0.000000 F1 EIS::HVAC_Rs_AR2::HVAC_EngIdleRPM_Inc_Rq = %d\n", intval);
	filePutString (buffer, elcount(buffer), hFile);
	intval = getSignal(CHASSIS::HVAC_Rs_AR2::HVAC_Comp_Ft_On);
	snprintf(buffer, elcount(buffer), "   0.000000 F1 EIS::HVAC_Rs_AR2::HVAC_Comp_Ft_On = %d\n", intval);
	filePutString (buffer, elcount(buffer), hFile);
	intval = getSignal(CHASSIS::HVAC_Rs_AR2::FrntGrllBlnd_Opn_Rq);
	snprintf(buffer, elcount(buffer), "   0.000000 F1 EIS::HVAC_Rs_AR2::FrntGrllBlnd_Opn_Rq = %d\n", intval);
	filePutString (buffer, elcount(buffer), hFile);
	intval = getSignal(CHASSIS::HVAC_Rs_AR2::HVAC_Ref_Circ_NA);
	snprintf(buffer, elcount(buffer), "   0.000000 F1 EIS::HVAC_Rs_AR2::HVAC_Ref_Circ_NA = %d\n", intval);
	filePutString (buffer, elcount(buffer), hFile);
	intval = getSignal(CHASSIS::HVAC_Rs_AR2::HVAC_CoolFan_Rq);
	snprintf(buffer, elcount(buffer), "   0.000000 F1 EIS::HVAC_Rs_AR2::HVAC_CoolFan_Rq = %d\n", intval);
	filePutString (buffer, elcount(buffer), hFile);
	intval = getSignal(CHASSIS::HVAC_Rs_AR2::HVAC_CoolVlv_Rq);
	snprintf(buffer, elcount(buffer), "   0.000000 F1 EIS::HVAC_Rs_AR2::HVAC_CoolVlv_Rq = %d\n", intval);
	filePutString (buffer, elcount(buffer), hFile);
	intval = getSignal(CHASSIS::HVAC_Rs_AR2::HVAC_MaxCool_Rq);
	snprintf(buffer, elcount(buffer), "   0.000000 F1 EIS::HVAC_Rs_AR2::HVAC_MaxCool_Rq = %d\n", intval);
	filePutString (buffer, elcount(buffer), hFile);
	intval = getSignal(CHASSIS::HVAC_Rs_AR2::HVAC_CoolCirc_Actv);
	snprintf(buffer, elcount(buffer), "   0.000000 F1 EIS::HVAC_Rs_AR2::HVAC_CoolCirc_Actv = %d\n", intval);
	filePutString (buffer, elcount(buffer), hFile);
	intval = getSignal(CHASSIS::HVAC_Rs_AR2::AddWtrPmp_Actv);
	snprintf(buffer, elcount(buffer), "   0.000000 F1 EIS::HVAC_Rs_AR2::AddWtrPmp_Actv = %d\n", intval);
	filePutString (buffer, elcount(buffer), hFile);
	intval = getSignal(CHASSIS::HVAC_Rs_AR2::AddWtrPmp_Err);
	snprintf(buffer, elcount(buffer), "   0.000000 F1 EIS::HVAC_Rs_AR2::AddWtrPmp_Err = %d\n", intval);
	filePutString (buffer, elcount(buffer), hFile);
	intval = getSignal(CHASSIS::HVAC_Rs_AR2::HtPwr_Ft_Rq);
	snprintf(buffer, elcount(buffer), "   0.000000 F1 EIS::HVAC_Rs_AR2::HtPwr_Ft_Rq = %d\n", intval);
	filePutString (buffer, elcount(buffer), hFile);
	intval = getSignal(CHASSIS::HVAC_Rs_AR2::EngFanRPM_Rq_HVAC);
	snprintf(buffer, elcount(buffer), "   0.000000 F1 EIS::HVAC_Rs_AR2::EngFanRPM_Rq_HVAC = %d\n", intval);
	filePutString (buffer, elcount(buffer), hFile);
	intval = getSignal(CHASSIS::HVAC_State1_AR::HVAC_AC_Off);
	snprintf(buffer, elcount(buffer), "   0.000000 F1 EIS::HVAC_State1_AR::HVAC_AC_Off = %d\n", intval);
	filePutString (buffer, elcount(buffer), hFile);
	intval = getSignal(CHASSIS::HVAC_State1_AR::HVAC_Off_Ft_Actv);
	snprintf(buffer, elcount(buffer), "   0.000000 F1 EIS::HVAC_State1_AR::HVAC_Off_Ft_Actv = %d\n", intval);
	filePutString (buffer, elcount(buffer), hFile);
	intval = getSignal(CHASSIS::HVAC_State1_AR::HVAC_RHU_Ft_Actv);
	snprintf(buffer, elcount(buffer), "   0.000000 F1 EIS::HVAC_State1_AR::HVAC_RHU_Ft_Actv = %d\n", intval);
	filePutString (buffer, elcount(buffer), hFile);
	intval = getSignal(CHASSIS::HVAC_State1_AR::HVAC_RHU_R_Actv);
	snprintf(buffer, elcount(buffer), "   0.000000 F1 EIS::HVAC_State1_AR::HVAC_RHU_R_Actv = %d\n", intval);
	filePutString (buffer, elcount(buffer), hFile);
	intval = getSignal(CHASSIS::HVAC_State1_AR::EBL_Sw_Psd);
	snprintf(buffer, elcount(buffer), "   0.000000 F1 EIS::HVAC_State1_AR::EBL_Sw_Psd = %d\n", intval);
	filePutString (buffer, elcount(buffer), hFile);
	intval = getSignal(CHASSIS::HVAC_State1_AR::HVAC_Vprzr_DryVn_Actv);
	snprintf(buffer, elcount(buffer), "   0.000000 F1 EIS::HVAC_State1_AR::HVAC_Vprzr_DryVn_Actv = %d\n", intval);
	filePutString (buffer, elcount(buffer), hFile);
	intval = getSignal(CHASSIS::HVAC_State1_AR::HVAC_Vprzr_DryVnTmr_On_Rq);
	snprintf(buffer, elcount(buffer), "   0.000000 F1 EIS::HVAC_State1_AR::HVAC_Vprzr_DryVnTmr_On_Rq = %d\n", intval);
	filePutString (buffer, elcount(buffer), hFile);
	intval = getSignal(CHASSIS::HVAC_State1_AR::ICH_Rq);
	snprintf(buffer, elcount(buffer), "   0.000000 F1 EIS::HVAC_State1_AR::ICH_Rq = %d\n", intval);
	filePutString (buffer, elcount(buffer), hFile);
	intval = getSignal(CHASSIS::HVAC_State1_AR::ICH_HtVnSw_Psd);
	snprintf(buffer, elcount(buffer), "   0.000000 F1 EIS::HVAC_State1_AR::ICH_HtVnSw_Psd = %d\n", intval);
	filePutString (buffer, elcount(buffer), hFile);
	intval = getSignal(CHASSIS::HVAC_State1_AR::ICH_LED_Rd_Flt);
	snprintf(buffer, elcount(buffer), "   0.000000 F1 EIS::HVAC_State1_AR::ICH_LED_Rd_Flt = %d\n", intval);
	filePutString (buffer, elcount(buffer), hFile);
	intval = getSignal(CHASSIS::HVAC_State1_AR::ICH_LED_Ye_Flt);
	snprintf(buffer, elcount(buffer), "   0.000000 F1 EIS::HVAC_State1_AR::ICH_LED_Ye_Flt = %d\n", intval);
	filePutString (buffer, elcount(buffer), hFile);
	intval = getSignal(CHASSIS::HVAC_State1_AR::ICH_WtrPmp_On_Rq_HVAC);
	snprintf(buffer, elcount(buffer), "   0.000000 F1 EIS::HVAC_State1_AR::ICH_WtrPmp_On_Rq_HVAC = %d\n", intval);
	filePutString (buffer, elcount(buffer), hFile);
	intval = getSignal(CHASSIS::HVAC_State1_AR::HVAC_AuxHt_Enbl);
	snprintf(buffer, elcount(buffer), "   0.000000 F1 EIS::HVAC_State1_AR::HVAC_AuxHt_Enbl = %d\n", intval);
	filePutString (buffer, elcount(buffer), hFile);
	intval = getSignal(CHASSIS::HVAC_State1_AR::HVAC_RecircAirSw_F_Psd_HVAC_F);
	snprintf(buffer, elcount(buffer), "   0.000000 F1 EIS::HVAC_State1_AR::HVAC_RecircAirSw_F_Psd_HVAC_F = %d\n", intval);
	filePutString (buffer, elcount(buffer), hFile);
	intval = getSignal(CHASSIS::HVAC_State1_AR::HVAC_Pulsation_Stat);
	snprintf(buffer, elcount(buffer), "   0.000000 F1 EIS::HVAC_State1_AR::HVAC_Pulsation_Stat = %d\n", intval);
	filePutString (buffer, elcount(buffer), hFile);
	intval = getSignal(CHASSIS::HVAC_State1_AR::DPC_Md_AC_Rs);
	snprintf(buffer, elcount(buffer), "   0.000000 F1 EIS::HVAC_State1_AR::DPC_Md_AC_Rs = %d\n", intval);
	filePutString (buffer, elcount(buffer), hFile);
	intval = getSignal(CHASSIS::HVAC_State1_AR::DPC_Md_Ht_Rs);
	snprintf(buffer, elcount(buffer), "   0.000000 F1 EIS::HVAC_State1_AR::DPC_Md_Ht_Rs = %d\n", intval);
	filePutString (buffer, elcount(buffer), hFile);
	floatval = getSignal(CHASSIS::HVAC_State1_AR::AirTemp_Insd_V2);
	snprintf(buffer, elcount(buffer), "   0.000000 F1 EIS::HVAC_State1_AR::AirTemp_Insd_V2 = %f\n", floatval);
	filePutString (buffer, elcount(buffer), hFile);
	intval = getSignal(CHASSIS::HVAC_State1_AR::AirTemp_InsdSens_OHCM_FanOnRq);
	snprintf(buffer, elcount(buffer), "   0.000000 F1 EIS::HVAC_State1_AR::AirTemp_InsdSens_OHCM_FanOnRq = %d\n", intval);
	filePutString (buffer, elcount(buffer), hFile);
	intval = getSignal(CHASSIS::HVAC_State1_AR::HVAC_Fan_Actv_IgnOff);
	snprintf(buffer, elcount(buffer), "   0.000000 F1 EIS::HVAC_State1_AR::HVAC_Fan_Actv_IgnOff = %d\n", intval);
	filePutString (buffer, elcount(buffer), hFile);
	intval = getSignal(CHASSIS::HVAC_State1_AR::HVAC_RecircAir_Actv);
	snprintf(buffer, elcount(buffer), "   0.000000 F1 EIS::HVAC_State1_AR::HVAC_RecircAir_Actv = %d\n", intval);
	filePutString (buffer, elcount(buffer), hFile);
	intval = getSignal(CHASSIS::HVAC_State1_AR::HVAC_Dfrst_Actv);
	snprintf(buffer, elcount(buffer), "   0.000000 F1 EIS::HVAC_State1_AR::HVAC_Dfrst_Actv = %d\n", intval);
	filePutString (buffer, elcount(buffer), hFile);
	intval = getSignal(CHASSIS::HVAC_State1_AR::PN14_GM1_Off_Rq_HVAC);
	snprintf(buffer, elcount(buffer), "   0.000000 F1 EIS::HVAC_State1_AR::PN14_GM1_Off_Rq_HVAC = %d\n", intval);
	filePutString (buffer, elcount(buffer), hFile);
	floatval = getSignal(CHASSIS::HVAC_State1_AR::HVAC_Fan_F);
	snprintf(buffer, elcount(buffer), "   0.000000 F1 EIS::HVAC_State1_AR::HVAC_Fan_F = %f\n", floatval);
	filePutString (buffer, elcount(buffer), hFile);
	intval = getSignal(CHASSIS::HVAC_State1_AR::ICH_Dur_Stat);
	snprintf(buffer, elcount(buffer), "   0.000000 F1 EIS::HVAC_State1_AR::ICH_Dur_Stat = %d\n", intval);
	filePutString (buffer, elcount(buffer), hFile);
	floatval = getSignal(CHASSIS::HVAC_State1_AR::DewTemp);
	snprintf(buffer, elcount(buffer), "   0.000000 F1 EIS::HVAC_State1_AR::DewTemp = %f\n", floatval);
	filePutString (buffer, elcount(buffer), hFile);
}
/*@@end*/

/*@@caplFunc:saveVars_42(dword):*/
void saveVars_42(dword hFile)
{
	floatval = getSignal(CHASSIS::IC_BasicInfo_AR2::Odo);
	snprintf(buffer, elcount(buffer), "   0.000000 F1 EIS::IC_BasicInfo_AR2::Odo = %f\n", floatval);
	filePutString (buffer, elcount(buffer), hFile);
	floatval = getSignal(CHASSIS::IC_BasicInfo_AR2::AirTemp_Outsd_Disp);
	snprintf(buffer, elcount(buffer), "   0.000000 F1 EIS::IC_BasicInfo_AR2::AirTemp_Outsd_Disp = %f\n", floatval);
	filePutString (buffer, elcount(buffer), hFile);
	floatval = getSignal(CHASSIS::IC_BasicInfo_AR2::VehSpd_Disp);
	snprintf(buffer, elcount(buffer), "   0.000000 F1 EIS::IC_BasicInfo_AR2::VehSpd_Disp = %f\n", floatval);
	filePutString (buffer, elcount(buffer), hFile);
	intval = getSignal(CHASSIS::IC_BasicInfo_AR2::UnitVehSpd);
	snprintf(buffer, elcount(buffer), "   0.000000 F1 EIS::IC_BasicInfo_AR2::UnitVehSpd = %d\n", intval);
	filePutString (buffer, elcount(buffer), hFile);
	intval = getSignal(CHASSIS::IC_BasicInfo_AR2::IC_TP_Alive);
	snprintf(buffer, elcount(buffer), "   0.000000 F1 EIS::IC_BasicInfo_AR2::IC_TP_Alive = %d\n", intval);
	filePutString (buffer, elcount(buffer), hFile);
	intval = getSignal(CHASSIS::IC_DriveAssistSys_AR2::RollTestMd_Rq);
	snprintf(buffer, elcount(buffer), "   0.000000 F1 EIS::IC_DriveAssistSys_AR2::RollTestMd_Rq = %d\n", intval);
	filePutString (buffer, elcount(buffer), hFile);
	intval = getSignal(CHASSIS::IC_DriveAssistSys_AR2::SPCR_Conf_IC);
	snprintf(buffer, elcount(buffer), "   0.000000 F1 EIS::IC_DriveAssistSys_AR2::SPCR_Conf_IC = %d\n", intval);
	filePutString (buffer, elcount(buffer), hFile);
	intval = getSignal(CHASSIS::IC_DriveAssistSys_AR2::SPCR_Flt_IC);
	snprintf(buffer, elcount(buffer), "   0.000000 F1 EIS::IC_DriveAssistSys_AR2::SPCR_Flt_IC = %d\n", intval);
	filePutString (buffer, elcount(buffer), hFile);
	intval = getSignal(CHASSIS::IC_DriveAssistSys_AR2::DrowWarnDisp_Stat);
	snprintf(buffer, elcount(buffer), "   0.000000 F1 EIS::IC_DriveAssistSys_AR2::DrowWarnDisp_Stat = %d\n", intval);
	filePutString (buffer, elcount(buffer), hFile);
	intval = getSignal(CHASSIS::IC_DriveAssistSys_AR2::PTS_Disp_Stat_IC);
	snprintf(buffer, elcount(buffer), "   0.000000 F1 EIS::IC_DriveAssistSys_AR2::PTS_Disp_Stat_IC = %d\n", intval);
	filePutString (buffer, elcount(buffer), hFile);
	intval = getSignal(CHASSIS::IC_DriveAssistSys_AR2::PreHtIndLmp_Flt);
	snprintf(buffer, elcount(buffer), "   0.000000 F1 EIS::IC_DriveAssistSys_AR2::PreHtIndLmp_Flt = %d\n", intval);
	filePutString (buffer, elcount(buffer), hFile);
	intval = getSignal(CHASSIS::IC_DriveAssistSys_AR2::RoofLuggMd_Rq);
	snprintf(buffer, elcount(buffer), "   0.000000 F1 EIS::IC_DriveAssistSys_AR2::RoofLuggMd_Rq = %d\n", intval);
	filePutString (buffer, elcount(buffer), hFile);
	intval = getSignal(CHASSIS::IC_DriveAssistSys_AR2::APM_RaceMd_Rq);
	snprintf(buffer, elcount(buffer), "   0.000000 F1 EIS::IC_DriveAssistSys_AR2::APM_RaceMd_Rq = %d\n", intval);
	filePutString (buffer, elcount(buffer), hFile);
	intval = getSignal(CHASSIS::IC_Settings_AR2::FTW_On_Rq);
	snprintf(buffer, elcount(buffer), "   0.000000 F1 EIS::IC_Settings_AR2::FTW_On_Rq = %d\n", intval);
	filePutString (buffer, elcount(buffer), hFile);
	intval = getSignal(CHASSIS::IC_Settings_AR2::TPM_Actv_Rq_V2);
	snprintf(buffer, elcount(buffer), "   0.000000 F1 EIS::IC_Settings_AR2::TPM_Actv_Rq_V2 = %d\n", intval);
	filePutString (buffer, elcount(buffer), hFile);
	intval = getSignal(CHASSIS::IC_Settings_AR2::UnitPress_Rq);
	snprintf(buffer, elcount(buffer), "   0.000000 F1 EIS::IC_Settings_AR2::UnitPress_Rq = %d\n", intval);
	filePutString (buffer, elcount(buffer), hFile);
	intval = getSignal(CHASSIS::IC_Settings_AR2::UnitTemp_Rq);
	snprintf(buffer, elcount(buffer), "   0.000000 F1 EIS::IC_Settings_AR2::UnitTemp_Rq = %d\n", intval);
	filePutString (buffer, elcount(buffer), hFile);
	intval = getSignal(CHASSIS::IC_Settings_AR2::IHC_Md_Rq);
	snprintf(buffer, elcount(buffer), "   0.000000 F1 EIS::IC_Settings_AR2::IHC_Md_Rq = %d\n", intval);
	filePutString (buffer, elcount(buffer), hFile);
	intval = getSignal(CHASSIS::IC_Settings_AR2::Preview_Md_Rq);
	snprintf(buffer, elcount(buffer), "   0.000000 F1 EIS::IC_Settings_AR2::Preview_Md_Rq = %d\n", intval);
	filePutString (buffer, elcount(buffer), hFile);
	intval = getSignal(CHASSIS::IC_Settings_AR2::SLA_SpdOffset_Rq_D_Val);
	snprintf(buffer, elcount(buffer), "   0.000000 F1 EIS::IC_Settings_AR2::SLA_SpdOffset_Rq_D_Val = %d\n", intval);
	filePutString (buffer, elcount(buffer), hFile);
	intval = getSignal(CHASSIS::IC_Settings_AR2::SLA_SpdOffset_Rq_D_Unit);
	snprintf(buffer, elcount(buffer), "   0.000000 F1 EIS::IC_Settings_AR2::SLA_SpdOffset_Rq_D_Unit = %d\n", intval);
	filePutString (buffer, elcount(buffer), hFile);
	intval = getSignal(CHASSIS::IC_Settings_AR2::ExtFanTempIC_State);
	snprintf(buffer, elcount(buffer), "   0.000000 F1 EIS::IC_Settings_AR2::ExtFanTempIC_State = %d\n", intval);
	filePutString (buffer, elcount(buffer), hFile);
	intval = getSignal(CHASSIS::ICH_Stat_AR::ICH_Ht_Test);
	snprintf(buffer, elcount(buffer), "   0.000000 F1 EIS::ICH_Stat_AR::ICH_Ht_Test = %d\n", intval);
	filePutString (buffer, elcount(buffer), hFile);
	intval = getSignal(CHASSIS::ICH_Stat_AR::ICH_AuxHt_LED_On_Rq);
	snprintf(buffer, elcount(buffer), "   0.000000 F1 EIS::ICH_Stat_AR::ICH_AuxHt_LED_On_Rq = %d\n", intval);
	filePutString (buffer, elcount(buffer), hFile);
	intval = getSignal(CHASSIS::ICH_Stat_AR::TxmtSync_Actv);
	snprintf(buffer, elcount(buffer), "   0.000000 F1 EIS::ICH_Stat_AR::TxmtSync_Actv = %d\n", intval);
	filePutString (buffer, elcount(buffer), hFile);
	intval = getSignal(CHASSIS::ICH_Stat_AR::HU_Disp_On_Rq);
	snprintf(buffer, elcount(buffer), "   0.000000 F1 EIS::ICH_Stat_AR::HU_Disp_On_Rq = %d\n", intval);
	filePutString (buffer, elcount(buffer), hFile);
	intval = getSignal(CHASSIS::ICH_Stat_AR::ICH_SwitchVlv_Stat);
	snprintf(buffer, elcount(buffer), "   0.000000 F1 EIS::ICH_Stat_AR::ICH_SwitchVlv_Stat = %d\n", intval);
	filePutString (buffer, elcount(buffer), hFile);
	intval = getSignal(CHASSIS::ICH_Stat_AR::ICH_HtVn_Actv_V2);
	snprintf(buffer, elcount(buffer), "   0.000000 F1 EIS::ICH_Stat_AR::ICH_HtVn_Actv_V2 = %d\n", intval);
	filePutString (buffer, elcount(buffer), hFile);
	intval = getSignal(CHASSIS::ICH_Stat_AR::ICH_Pwr_Stat);
	snprintf(buffer, elcount(buffer), "   0.000000 F1 EIS::ICH_Stat_AR::ICH_Pwr_Stat = %d\n", intval);
	filePutString (buffer, elcount(buffer), hFile);
	intval = getSignal(CHASSIS::ICH_Stat_AR::ICH_TankLvl_Min_Occ);
	snprintf(buffer, elcount(buffer), "   0.000000 F1 EIS::ICH_Stat_AR::ICH_TankLvl_Min_Occ = %d\n", intval);
	filePutString (buffer, elcount(buffer), hFile);
	intval = getSignal(CHASSIS::ICH_Stat_AR::ICH_TankLvl_Min);
	snprintf(buffer, elcount(buffer), "   0.000000 F1 EIS::ICH_Stat_AR::ICH_TankLvl_Min = %d\n", intval);
	filePutString (buffer, elcount(buffer), hFile);
	intval = getSignal(CHASSIS::ICH_Stat_AR::ICH_SupVolt_Lo_Occ);
	snprintf(buffer, elcount(buffer), "   0.000000 F1 EIS::ICH_Stat_AR::ICH_SupVolt_Lo_Occ = %d\n", intval);
	filePutString (buffer, elcount(buffer), hFile);
	intval = getSignal(CHASSIS::ICH_Stat_AR::ICH_SupVolt_Lo);
	snprintf(buffer, elcount(buffer), "   0.000000 F1 EIS::ICH_Stat_AR::ICH_SupVolt_Lo = %d\n", intval);
	filePutString (buffer, elcount(buffer), hFile);
	intval = getSignal(CHASSIS::ICH_Stat_AR::ICH_Flt_Occ);
	snprintf(buffer, elcount(buffer), "   0.000000 F1 EIS::ICH_Stat_AR::ICH_Flt_Occ = %d\n", intval);
	filePutString (buffer, elcount(buffer), hFile);
	intval = getSignal(CHASSIS::ICH_Stat_AR::ICH_Flt);
	snprintf(buffer, elcount(buffer), "   0.000000 F1 EIS::ICH_Stat_AR::ICH_Flt = %d\n", intval);
	filePutString (buffer, elcount(buffer), hFile);
	intval = getSignal(CHASSIS::ICH_Stat_AR::ICH_WtrTemp_V2);
	snprintf(buffer, elcount(buffer), "   0.000000 F1 EIS::ICH_Stat_AR::ICH_WtrTemp_V2 = %d\n", intval);
	filePutString (buffer, elcount(buffer), hFile);
	intval = getSignal(CHASSIS::ICH_Stat_AR::ICH_PreTm_Hour);
	snprintf(buffer, elcount(buffer), "   0.000000 F1 EIS::ICH_Stat_AR::ICH_PreTm_Hour = %d\n", intval);
	filePutString (buffer, elcount(buffer), hFile);
	intval = getSignal(CHASSIS::ICH_Stat_AR::ICH_PreTm_Minute);
	snprintf(buffer, elcount(buffer), "   0.000000 F1 EIS::ICH_Stat_AR::ICH_PreTm_Minute = %d\n", intval);
	filePutString (buffer, elcount(buffer), hFile);
	intval = getSignal(CHASSIS::ICH_Stat_AR::ICH_WtrPmp_Stat);
	snprintf(buffer, elcount(buffer), "   0.000000 F1 EIS::ICH_Stat_AR::ICH_WtrPmp_Stat = %d\n", intval);
	filePutString (buffer, elcount(buffer), hFile);
	intval = getSignal(CHASSIS::ICH_Stat_AR::ICH_Bdgt_Empty_Occ);
	snprintf(buffer, elcount(buffer), "   0.000000 F1 EIS::ICH_Stat_AR::ICH_Bdgt_Empty_Occ = %d\n", intval);
	filePutString (buffer, elcount(buffer), hFile);
	intval = getSignal(CHASSIS::ICH_Stat_AR::ICH_Bdgt_Empty);
	snprintf(buffer, elcount(buffer), "   0.000000 F1 EIS::ICH_Stat_AR::ICH_Bdgt_Empty = %d\n", intval);
	filePutString (buffer, elcount(buffer), hFile);
	intval = getSignal(CHASSIS::ICH_Stat_AR::ICH_PreTm_Actv_V2);
	snprintf(buffer, elcount(buffer), "   0.000000 F1 EIS::ICH_Stat_AR::ICH_PreTm_Actv_V2 = %d\n", intval);
	filePutString (buffer, elcount(buffer), hFile);
	intval = getSignal(CHASSIS::ICH_Stat_AR::HVAC_Fan_On_Rq);
	snprintf(buffer, elcount(buffer), "   0.000000 F1 EIS::ICH_Stat_AR::HVAC_Fan_On_Rq = %d\n", intval);
	filePutString (buffer, elcount(buffer), hFile);
	intval = getSignal(CHASSIS::ICH_Stat_AR::ICH_ResRunTm);
	snprintf(buffer, elcount(buffer), "   0.000000 F1 EIS::ICH_Stat_AR::ICH_ResRunTm = %d\n", intval);
	filePutString (buffer, elcount(buffer), hFile);
	intval = getSignal(CHASSIS::ICH_Stat_AR::ICH_TankLvl_Min_ErrDisp);
	snprintf(buffer, elcount(buffer), "   0.000000 F1 EIS::ICH_Stat_AR::ICH_TankLvl_Min_ErrDisp = %d\n", intval);
	filePutString (buffer, elcount(buffer), hFile);
	intval = getSignal(CHASSIS::ICH_Stat_AR::ICH_TankLvl_Min_Stat);
	snprintf(buffer, elcount(buffer), "   0.000000 F1 EIS::ICH_Stat_AR::ICH_TankLvl_Min_Stat = %d\n", intval);
	filePutString (buffer, elcount(buffer), hFile);
	intval = getSignal(CHASSIS::ICH_Stat_AR::ICH_SupVolt_Lo_ErrDisp);
	snprintf(buffer, elcount(buffer), "   0.000000 F1 EIS::ICH_Stat_AR::ICH_SupVolt_Lo_ErrDisp = %d\n", intval);
	filePutString (buffer, elcount(buffer), hFile);
	intval = getSignal(CHASSIS::ICH_Stat_AR::ICH_SupVolt_Lo_Stat);
	snprintf(buffer, elcount(buffer), "   0.000000 F1 EIS::ICH_Stat_AR::ICH_SupVolt_Lo_Stat = %d\n", intval);
	filePutString (buffer, elcount(buffer), hFile);
	intval = getSignal(CHASSIS::ICH_Stat_AR::ICH_Flt_ErrDisp);
	snprintf(buffer, elcount(buffer), "   0.000000 F1 EIS::ICH_Stat_AR::ICH_Flt_ErrDisp = %d\n", intval);
	filePutString (buffer, elcount(buffer), hFile);
	intval = getSignal(CHASSIS::ICH_Stat_AR::ICH_Flt_Stat);
	snprintf(buffer, elcount(buffer), "   0.000000 F1 EIS::ICH_Stat_AR::ICH_Flt_Stat = %d\n", intval);
	filePutString (buffer, elcount(buffer), hFile);
	intval = getSignal(CHASSIS::ICH_Stat_AR::ICH_Bdgt_Empty_ErrDisp);
	snprintf(buffer, elcount(buffer), "   0.000000 F1 EIS::ICH_Stat_AR::ICH_Bdgt_Empty_ErrDisp = %d\n", intval);
	filePutString (buffer, elcount(buffer), hFile);
}
/*@@end*/

/*@@caplFunc:saveVars_43(dword):*/
void saveVars_43(dword hFile)
{
	intval = getSignal(CHASSIS::ICH_Stat_AR::ICH_Bdgt_Empty_Stat);
	snprintf(buffer, elcount(buffer), "   0.000000 F1 EIS::ICH_Stat_AR::ICH_Bdgt_Empty_Stat = %d\n", intval);
	filePutString (buffer, elcount(buffer), hFile);
	intval = @sysvar::CH_Nodes::CH_EISCRC_Ign_Stat_Pr2Ign_V_AUTO;
	snprintf(buffer, elcount(buffer), "   0.000000    SV: 2 0 0 ::CH_Nodes::CH_EISCRC_Ign_Stat_Pr2Ign_V_AUTO = %d\n", intval);
	filePutString (buffer, elcount(buffer), hFile);
	intval = getSignal(CHASSIS::Ign_Veh_Stat_AR2::CRC_Ign_Stat_Pr2);
	snprintf(buffer, elcount(buffer), "   0.000000 F1 EIS::Ign_Veh_Stat_AR2::CRC_Ign_Stat_Pr2 = %d\n", intval);
	filePutString (buffer, elcount(buffer), hFile);
	intval = @sysvar::CH_Nodes::CH_EISSQC_Ign_Stat_Pr2Ign_V_AUTO;
	snprintf(buffer, elcount(buffer), "   0.000000    SV: 2 0 0 ::CH_Nodes::CH_EISSQC_Ign_Stat_Pr2Ign_V_AUTO = %d\n", intval);
	filePutString (buffer, elcount(buffer), hFile);
	intval = getSignal(CHASSIS::Ign_Veh_Stat_AR2::SQC_Ign_Stat_Pr2);
	snprintf(buffer, elcount(buffer), "   0.000000 F1 EIS::Ign_Veh_Stat_AR2::SQC_Ign_Stat_Pr2 = %d\n", intval);
	filePutString (buffer, elcount(buffer), hFile);
	intval = @sysvar::CH_Nodes::CH__EIS_ISw_Stat;
	snprintf(buffer, elcount(buffer), "   0.000000    SV: 2 0 0 ::CH_Nodes::CH__EIS_ISw_Stat = %d\n", intval);
	filePutString (buffer, elcount(buffer), hFile);
	intval = getSignal(CHASSIS::Ign_Veh_Stat_AR2::Ign_On_StartProc_Inact);
	snprintf(buffer, elcount(buffer), "   0.000000 F1 EIS::Ign_Veh_Stat_AR2::Ign_On_StartProc_Inact = %d\n", intval);
	filePutString (buffer, elcount(buffer), hFile);
	intval = getSignal(CHASSIS::Ign_Veh_Stat_AR2::KG_IgnCtrl_Actv);
	snprintf(buffer, elcount(buffer), "   0.000000 F1 EIS::Ign_Veh_Stat_AR2::KG_IgnCtrl_Actv = %d\n", intval);
	filePutString (buffer, elcount(buffer), hFile);
	intval = getSignal(CHASSIS::Ign_Veh_Stat_AR2::KG_StartSw_Psd);
	snprintf(buffer, elcount(buffer), "   0.000000 F1 EIS::Ign_Veh_Stat_AR2::KG_StartSw_Psd = %d\n", intval);
	filePutString (buffer, elcount(buffer), hFile);
	intval = getSignal(CHASSIS::Ign_Veh_Stat_AR2::ESL_Lk_Rq);
	snprintf(buffer, elcount(buffer), "   0.000000 F1 EIS::Ign_Veh_Stat_AR2::ESL_Lk_Rq = %d\n", intval);
	filePutString (buffer, elcount(buffer), hFile);
	intval = getSignal(CHASSIS::Ign_Veh_Stat_AR2::SPCR_Flt_EIS);
	snprintf(buffer, elcount(buffer), "   0.000000 F1 EIS::Ign_Veh_Stat_AR2::SPCR_Flt_EIS = %d\n", intval);
	filePutString (buffer, elcount(buffer), hFile);
	intval = getSignal(CHASSIS::Ign_Veh_Stat_AR2::SPCR_Conf_EIS);
	snprintf(buffer, elcount(buffer), "   0.000000 F1 EIS::Ign_Veh_Stat_AR2::SPCR_Conf_EIS = %d\n", intval);
	filePutString (buffer, elcount(buffer), hFile);
	intval = getSignal(CHASSIS::Ign_Veh_Stat_AR2::SPCR_AcustWarn_Rq_EIS);
	snprintf(buffer, elcount(buffer), "   0.000000 F1 EIS::Ign_Veh_Stat_AR2::SPCR_AcustWarn_Rq_EIS = %d\n", intval);
	filePutString (buffer, elcount(buffer), hFile);
	intval = getSignal(CHASSIS::Ign_Veh_Stat_AR2::TxPkPosn_Rq);
	snprintf(buffer, elcount(buffer), "   0.000000 F1 EIS::Ign_Veh_Stat_AR2::TxPkPosn_Rq = %d\n", intval);
	filePutString (buffer, elcount(buffer), hFile);
	intval = getSignal(CHASSIS::Ign_Veh_Stat_AR2::TxPkPosn_Emg_Rq);
	snprintf(buffer, elcount(buffer), "   0.000000 F1 EIS::Ign_Veh_Stat_AR2::TxPkPosn_Emg_Rq = %d\n", intval);
	filePutString (buffer, elcount(buffer), hFile);
	intval = getSignal(CHASSIS::Ign_Veh_Stat_AR2::TxPkPosnAuto_Enbl);
	snprintf(buffer, elcount(buffer), "   0.000000 F1 EIS::Ign_Veh_Stat_AR2::TxPkPosnAuto_Enbl = %d\n", intval);
	filePutString (buffer, elcount(buffer), hFile);
	intval = getSignal(CHASSIS::Ign_Veh_Stat_AR2::TxPkPosn_Rq_SPCR_Enbl);
	snprintf(buffer, elcount(buffer), "   0.000000 F1 EIS::Ign_Veh_Stat_AR2::TxPkPosn_Rq_SPCR_Enbl = %d\n", intval);
	filePutString (buffer, elcount(buffer), hFile);
	intval = getSignal(CHASSIS::Ign_Veh_Stat_AR2::EngSt_Enbl_Rq_KG);
	snprintf(buffer, elcount(buffer), "   0.000000 F1 EIS::Ign_Veh_Stat_AR2::EngSt_Enbl_Rq_KG = %d\n", intval);
	filePutString (buffer, elcount(buffer), hFile);
	intval = getSignal(CHASSIS::Ign_Veh_Stat_AR2::RemSt_IgnCtrl_Actv);
	snprintf(buffer, elcount(buffer), "   0.000000 F1 EIS::Ign_Veh_Stat_AR2::RemSt_IgnCtrl_Actv = %d\n", intval);
	filePutString (buffer, elcount(buffer), hFile);
	intval = getSignal(CHASSIS::Ign_Veh_Stat_AR2::RemSt_IgnCtrl_Info);
	snprintf(buffer, elcount(buffer), "   0.000000 F1 EIS::Ign_Veh_Stat_AR2::RemSt_IgnCtrl_Info = %d\n", intval);
	filePutString (buffer, elcount(buffer), hFile);
	intval = getSignal(CHASSIS::Ign_Veh_Stat_AR2::DidA_ExtTest_Pres);
	snprintf(buffer, elcount(buffer), "   0.000000 F1 EIS::Ign_Veh_Stat_AR2::DidA_ExtTest_Pres = %d\n", intval);
	filePutString (buffer, elcount(buffer), hFile);
	intval = getSignal(CHASSIS::Ign_Veh_Stat_AR2::RevGr_Engg);
	snprintf(buffer, elcount(buffer), "   0.000000 F1 EIS::Ign_Veh_Stat_AR2::RevGr_Engg = %d\n", intval);
	filePutString (buffer, elcount(buffer), hFile);
	intval = getSignal(CHASSIS::Ign_Veh_Stat_AR2::BusFlt_PrmntActv);
	snprintf(buffer, elcount(buffer), "   0.000000 F1 EIS::Ign_Veh_Stat_AR2::BusFlt_PrmntActv = %d\n", intval);
	filePutString (buffer, elcount(buffer), hFile);
	intval = getSignal(CHASSIS::Ign_Veh_Stat_AR2::ContEngRun_Stat);
	snprintf(buffer, elcount(buffer), "   0.000000 F1 EIS::Ign_Veh_Stat_AR2::ContEngRun_Stat = %d\n", intval);
	filePutString (buffer, elcount(buffer), hFile);
	intval = getSignal(CHASSIS::Ign_Veh_Stat_AR2::Mobile_Chrg_Rq_EIS);
	snprintf(buffer, elcount(buffer), "   0.000000 F1 EIS::Ign_Veh_Stat_AR2::Mobile_Chrg_Rq_EIS = %d\n", intval);
	filePutString (buffer, elcount(buffer), hFile);
	floatval = getSignal(CHASSIS::IHC_Lgt_Stat_HLI_2_AR2::IHC_HL_LgtOut);
	snprintf(buffer, elcount(buffer), "   0.000000 F1 EIS::IHC_Lgt_Stat_HLI_2_AR2::IHC_HL_LgtOut = %f\n", floatval);
	filePutString (buffer, elcount(buffer), hFile);
	intval = getSignal(CHASSIS::IHC_Lgt_Stat_HLI_2_AR2::IHC_GlareRdc_Stat);
	snprintf(buffer, elcount(buffer), "   0.000000 F1 EIS::IHC_Lgt_Stat_HLI_2_AR2::IHC_GlareRdc_Stat = %d\n", intval);
	filePutString (buffer, elcount(buffer), hFile);
	intval = getSignal(CHASSIS::IHC_Lgt_Stat_HLI_2_AR2::IHC_HL_LgtOut_Gradient_Lt);
	snprintf(buffer, elcount(buffer), "   0.000000 F1 EIS::IHC_Lgt_Stat_HLI_2_AR2::IHC_HL_LgtOut_Gradient_Lt = %d\n", intval);
	filePutString (buffer, elcount(buffer), hFile);
	intval = getSignal(CHASSIS::IHC_Lgt_Stat_HLI_2_AR2::IHC_HL_LgtOut_Gradient_Rt);
	snprintf(buffer, elcount(buffer), "   0.000000 F1 EIS::IHC_Lgt_Stat_HLI_2_AR2::IHC_HL_LgtOut_Gradient_Rt = %d\n", intval);
	filePutString (buffer, elcount(buffer), hFile);
	intval = getSignal(CHASSIS::IHC_Lgt_Stat_HLI_2_AR2::IHC_HL_LgtOut_IntensMax);
	snprintf(buffer, elcount(buffer), "   0.000000 F1 EIS::IHC_Lgt_Stat_HLI_2_AR2::IHC_HL_LgtOut_IntensMax = %d\n", intval);
	filePutString (buffer, elcount(buffer), hFile);
	intval = getSignal(CHASSIS::IHC_Lgt_Stat_HLI_2_AR2::VehLvl_R_HLM);
	snprintf(buffer, elcount(buffer), "   0.000000 F1 EIS::IHC_Lgt_Stat_HLI_2_AR2::VehLvl_R_HLM = %d\n", intval);
	filePutString (buffer, elcount(buffer), hFile);
	intval = getSignal(CHASSIS::IHC_Lgt_Stat_HLI_2_AR2::VehLvl_Ft_HLM);
	snprintf(buffer, elcount(buffer), "   0.000000 F1 EIS::IHC_Lgt_Stat_HLI_2_AR2::VehLvl_Ft_HLM = %d\n", intval);
	filePutString (buffer, elcount(buffer), hFile);
	intval = @sysvar::CH_Nodes::CH_EISCRC_IHC_Lgt_Stat_HLI__AUTO;
	snprintf(buffer, elcount(buffer), "   0.000000    SV: 2 0 0 ::CH_Nodes::CH_EISCRC_IHC_Lgt_Stat_HLI__AUTO = %d\n", intval);
	filePutString (buffer, elcount(buffer), hFile);
	intval = getSignal(CHASSIS::IHC_Lgt_Stat_HLI_AR2::CRC_IHC_Lgt_Stat_HLI_Pr2);
	snprintf(buffer, elcount(buffer), "   0.000000 F1 EIS::IHC_Lgt_Stat_HLI_AR2::CRC_IHC_Lgt_Stat_HLI_Pr2 = %d\n", intval);
	filePutString (buffer, elcount(buffer), hFile);
	intval = @sysvar::CH_Nodes::CH_EISSQC_IHC_Lgt_Stat_HLI__AUTO;
	snprintf(buffer, elcount(buffer), "   0.000000    SV: 2 0 0 ::CH_Nodes::CH_EISSQC_IHC_Lgt_Stat_HLI__AUTO = %d\n", intval);
	filePutString (buffer, elcount(buffer), hFile);
	intval = getSignal(CHASSIS::IHC_Lgt_Stat_HLI_AR2::SQC_IHC_Lgt_Stat_HLI_Pr2);
	snprintf(buffer, elcount(buffer), "   0.000000 F1 EIS::IHC_Lgt_Stat_HLI_AR2::SQC_IHC_Lgt_Stat_HLI_Pr2 = %d\n", intval);
	filePutString (buffer, elcount(buffer), hFile);
	intval = getSignal(CHASSIS::IHC_Lgt_Stat_HLI_AR2::IHC_Plus_LgtStyle_Rt);
	snprintf(buffer, elcount(buffer), "   0.000000 F1 EIS::IHC_Lgt_Stat_HLI_AR2::IHC_Plus_LgtStyle_Rt = %d\n", intval);
	filePutString (buffer, elcount(buffer), hFile);
	intval = getSignal(CHASSIS::IHC_Lgt_Stat_HLI_AR2::Rsrv1_IHC_Lgt_Stat_HLI_Pr2);
	snprintf(buffer, elcount(buffer), "   0.000000 F1 EIS::IHC_Lgt_Stat_HLI_AR2::Rsrv1_IHC_Lgt_Stat_HLI_Pr2 = %d\n", intval);
	filePutString (buffer, elcount(buffer), hFile);
	floatval = getSignal(CHASSIS::IHC_Lgt_Stat_HLI_AR2::IHC_Plus_CrvLgt_Lt_RotAngl);
	snprintf(buffer, elcount(buffer), "   0.000000 F1 EIS::IHC_Lgt_Stat_HLI_AR2::IHC_Plus_CrvLgt_Lt_RotAngl = %f\n", floatval);
	filePutString (buffer, elcount(buffer), hFile);
	floatval = getSignal(CHASSIS::IHC_Lgt_Stat_HLI_AR2::IHC_Plus_Rt_RotAngl_Cutoff);
	snprintf(buffer, elcount(buffer), "   0.000000 F1 EIS::IHC_Lgt_Stat_HLI_AR2::IHC_Plus_Rt_RotAngl_Cutoff = %f\n", floatval);
	filePutString (buffer, elcount(buffer), hFile);
	floatval = getSignal(CHASSIS::IHC_Lgt_Stat_HLI_AR2::IHC_Plus_CrvLgt_Rt_RotAngl);
	snprintf(buffer, elcount(buffer), "   0.000000 F1 EIS::IHC_Lgt_Stat_HLI_AR2::IHC_Plus_CrvLgt_Rt_RotAngl = %f\n", floatval);
	filePutString (buffer, elcount(buffer), hFile);
	floatval = getSignal(CHASSIS::IHC_Lgt_Stat_HLI_AR2::IHC_Plus_Lt_RotAngl_Cutoff);
	snprintf(buffer, elcount(buffer), "   0.000000 F1 EIS::IHC_Lgt_Stat_HLI_AR2::IHC_Plus_Lt_RotAngl_Cutoff = %f\n", floatval);
	filePutString (buffer, elcount(buffer), hFile);
	intval = getSignal(CHASSIS::IHC_Lgt_Stat_HLI_AR2::IHC_Plus_LgtStyle_Lt);
	snprintf(buffer, elcount(buffer), "   0.000000 F1 EIS::IHC_Lgt_Stat_HLI_AR2::IHC_Plus_LgtStyle_Lt = %d\n", intval);
	filePutString (buffer, elcount(buffer), hFile);
	intval = getSignal(CHASSIS::IHC_Lgt_Stat_HLI_AR2::IHC_HiBm_Stat_HLM_LT);
	snprintf(buffer, elcount(buffer), "   0.000000 F1 EIS::IHC_Lgt_Stat_HLI_AR2::IHC_HiBm_Stat_HLM_LT = %d\n", intval);
	filePutString (buffer, elcount(buffer), hFile);
	intval = getSignal(CHASSIS::IHC_Lgt_Stat_HLI_AR2::IHC_Stat_HLM_LT);
	snprintf(buffer, elcount(buffer), "   0.000000 F1 EIS::IHC_Lgt_Stat_HLI_AR2::IHC_Stat_HLM_LT = %d\n", intval);
	filePutString (buffer, elcount(buffer), hFile);
	intval = getSignal(CHASSIS::IHC_Lgt_Stat_HLI_AR2::Rsrv2_IHC_Lgt_Stat_HLI_Pr2);
	snprintf(buffer, elcount(buffer), "   0.000000 F1 EIS::IHC_Lgt_Stat_HLI_AR2::Rsrv2_IHC_Lgt_Stat_HLI_Pr2 = %d\n", intval);
	filePutString (buffer, elcount(buffer), hFile);
	floatval = getSignal(CHASSIS::IHC_Lgt_Stat_HLI_AR2::IHC_LgtDist);
	snprintf(buffer, elcount(buffer), "   0.000000 F1 EIS::IHC_Lgt_Stat_HLI_AR2::IHC_LgtDist = %f\n", floatval);
	filePutString (buffer, elcount(buffer), hFile);
	intval = getSignal(CHASSIS::KG_State_AR2::KG_Key_Rs);
	snprintf(buffer, elcount(buffer), "   0.000000 F1 EIS::KG_State_AR2::KG_Key_Rs = %d\n", intval);
	filePutString (buffer, elcount(buffer), hFile);
	intval = getSignal(CHASSIS::KG_State_AR2::KG_KeySrch_Actv);
	snprintf(buffer, elcount(buffer), "   0.000000 F1 EIS::KG_State_AR2::KG_KeySrch_Actv = %d\n", intval);
	filePutString (buffer, elcount(buffer), hFile);
	intval = getSignal(CHASSIS::KG_State_AR2::LockImposbl_InvPreCond);
	snprintf(buffer, elcount(buffer), "   0.000000 F1 EIS::KG_State_AR2::LockImposbl_InvPreCond = %d\n", intval);
	filePutString (buffer, elcount(buffer), hFile);
	intval = getSignal(CHASSIS::KG_State_AR2::HFA_DL_Rq_KG);
	snprintf(buffer, elcount(buffer), "   0.000000 F1 EIS::KG_State_AR2::HFA_DL_Rq_KG = %d\n", intval);
	filePutString (buffer, elcount(buffer), hFile);
	intval = getSignal(CHASSIS::KG_State_AR2::KG_Dr_FL_Dr_Hndl_pulled);
	snprintf(buffer, elcount(buffer), "   0.000000 F1 EIS::KG_State_AR2::KG_Dr_FL_Dr_Hndl_pulled = %d\n", intval);
	filePutString (buffer, elcount(buffer), hFile);
	intval = getSignal(CHASSIS::KG_State_AR2::KG_Dr_FR_Dr_Hndl_pulled);
	snprintf(buffer, elcount(buffer), "   0.000000 F1 EIS::KG_State_AR2::KG_Dr_FR_Dr_Hndl_pulled = %d\n", intval);
	filePutString (buffer, elcount(buffer), hFile);
	intval = getSignal(CHASSIS::KG_State_AR2::KG_Dr_RL_Dr_Hndl_pulled);
	snprintf(buffer, elcount(buffer), "   0.000000 F1 EIS::KG_State_AR2::KG_Dr_RL_Dr_Hndl_pulled = %d\n", intval);
	filePutString (buffer, elcount(buffer), hFile);
	intval = getSignal(CHASSIS::KG_State_AR2::KG_Dr_RR_Dr_Hndl_pulled);
	snprintf(buffer, elcount(buffer), "   0.000000 F1 EIS::KG_State_AR2::KG_Dr_RR_Dr_Hndl_pulled = %d\n", intval);
	filePutString (buffer, elcount(buffer), hFile);
}
/*@@end*/

/*@@caplFunc:saveVars_44(dword):*/
void saveVars_44(dword hFile)
{
	intval = getSignal(CHASSIS::KG_State_AR2::KG_TrSrch_Actv);
	snprintf(buffer, elcount(buffer), "   0.000000 F1 EIS::KG_State_AR2::KG_TrSrch_Actv = %d\n", intval);
	filePutString (buffer, elcount(buffer), hFile);
	intval = @sysvar::CH_Nodes::CH_EISCRC_RemPark_Stat_KG_P_AUTO;
	snprintf(buffer, elcount(buffer), "   0.000000    SV: 2 0 0 ::CH_Nodes::CH_EISCRC_RemPark_Stat_KG_P_AUTO = %d\n", intval);
	filePutString (buffer, elcount(buffer), hFile);
	intval = getSignal(CHASSIS::KG_State_AR2::CRC_RemPark_Stat_KG_Pr2);
	snprintf(buffer, elcount(buffer), "   0.000000 F1 EIS::KG_State_AR2::CRC_RemPark_Stat_KG_Pr2 = %d\n", intval);
	filePutString (buffer, elcount(buffer), hFile);
	intval = @sysvar::CH_Nodes::CH_EISSQC_RemPark_Stat_KG_P_AUTO;
	snprintf(buffer, elcount(buffer), "   0.000000    SV: 2 0 0 ::CH_Nodes::CH_EISSQC_RemPark_Stat_KG_P_AUTO = %d\n", intval);
	filePutString (buffer, elcount(buffer), hFile);
	intval = getSignal(CHASSIS::KG_State_AR2::SQC_RemPark_Stat_KG_Pr2);
	snprintf(buffer, elcount(buffer), "   0.000000 F1 EIS::KG_State_AR2::SQC_RemPark_Stat_KG_Pr2 = %d\n", intval);
	filePutString (buffer, elcount(buffer), hFile);
	intval = getSignal(CHASSIS::KG_State_AR2::RemPark_Stat_KG);
	snprintf(buffer, elcount(buffer), "   0.000000 F1 EIS::KG_State_AR2::RemPark_Stat_KG = %d\n", intval);
	filePutString (buffer, elcount(buffer), hFile);
	intval = getSignal(CHASSIS::KG_State_AR2::RemPark_Cancel_Stat);
	snprintf(buffer, elcount(buffer), "   0.000000 F1 EIS::KG_State_AR2::RemPark_Cancel_Stat = %d\n", intval);
	filePutString (buffer, elcount(buffer), hFile);
	intval = getSignal(CHASSIS::KG_State_AR2::Rsrv1_RemPark_Stat_KG_Pr2);
	snprintf(buffer, elcount(buffer), "   0.000000 F1 EIS::KG_State_AR2::Rsrv1_RemPark_Stat_KG_Pr2 = %d\n", intval);
	filePutString (buffer, elcount(buffer), hFile);
	intval = getSignal(CHASSIS::LDC_Disp_Stat_IC_AR2::Rsrv2_LDC_Disp_Stat_IC);
	snprintf(buffer, elcount(buffer), "   0.000000 F1 EIS::LDC_Disp_Stat_IC_AR2::Rsrv2_LDC_Disp_Stat_IC = %d\n", intval);
	filePutString (buffer, elcount(buffer), hFile);
	intval = getSignal(CHASSIS::LDC_Disp_Stat_IC_AR2::Rsrv5_LDC_Disp_Stat_IC);
	snprintf(buffer, elcount(buffer), "   0.000000 F1 EIS::LDC_Disp_Stat_IC_AR2::Rsrv5_LDC_Disp_Stat_IC = %d\n", intval);
	filePutString (buffer, elcount(buffer), hFile);
	intval = getSignal(CHASSIS::LDC_Disp_Stat_IC_AR2::LDC_Ifc_ok_ESP);
	snprintf(buffer, elcount(buffer), "   0.000000 F1 EIS::LDC_Disp_Stat_IC_AR2::LDC_Ifc_ok_ESP = %d\n", intval);
	filePutString (buffer, elcount(buffer), hFile);
	intval = getSignal(CHASSIS::LDC_Disp_Stat_IC_AR2::LDC_SpdUnit_Rq);
	snprintf(buffer, elcount(buffer), "   0.000000 F1 EIS::LDC_Disp_Stat_IC_AR2::LDC_SpdUnit_Rq = %d\n", intval);
	filePutString (buffer, elcount(buffer), hFile);
	intval = getSignal(CHASSIS::LDC_Disp_Stat_IC_AR2::Rsrv4_LDC_Disp_Stat_IC);
	snprintf(buffer, elcount(buffer), "   0.000000 F1 EIS::LDC_Disp_Stat_IC_AR2::Rsrv4_LDC_Disp_Stat_IC = %d\n", intval);
	filePutString (buffer, elcount(buffer), hFile);
	intval = getSignal(CHASSIS::LDC_Disp_Stat_IC_AR2::Rsrv3_LDC_Disp_Stat_IC);
	snprintf(buffer, elcount(buffer), "   0.000000 F1 EIS::LDC_Disp_Stat_IC_AR2::Rsrv3_LDC_Disp_Stat_IC = %d\n", intval);
	filePutString (buffer, elcount(buffer), hFile);
	intval = getSignal(CHASSIS::LDC_Disp_Stat_IC_AR2::LDC_SPEEDO_Cal);
	snprintf(buffer, elcount(buffer), "   0.000000 F1 EIS::LDC_Disp_Stat_IC_AR2::LDC_SPEEDO_Cal = %d\n", intval);
	filePutString (buffer, elcount(buffer), hFile);
	intval = getSignal(CHASSIS::LDC_Disp_Stat_IC_AR2::LDC_SPEEDO_SegRing_Avl);
	snprintf(buffer, elcount(buffer), "   0.000000 F1 EIS::LDC_Disp_Stat_IC_AR2::LDC_SPEEDO_SegRing_Avl = %d\n", intval);
	filePutString (buffer, elcount(buffer), hFile);
	intval = getSignal(CHASSIS::LDC_Disp_Stat_IC_AR2::Rsrv1_LDC_Disp_Stat_IC);
	snprintf(buffer, elcount(buffer), "   0.000000 F1 EIS::LDC_Disp_Stat_IC_AR2::Rsrv1_LDC_Disp_Stat_IC = %d\n", intval);
	filePutString (buffer, elcount(buffer), hFile);
	intval = getSignal(CHASSIS::LDC_Disp_Stat_IC_AR2::LDC_Ifc_ok_RDU);
	snprintf(buffer, elcount(buffer), "   0.000000 F1 EIS::LDC_Disp_Stat_IC_AR2::LDC_Ifc_ok_RDU = %d\n", intval);
	filePutString (buffer, elcount(buffer), hFile);
	intval = getSignal(CHASSIS::LDC_Disp_Stat_IC_AR2::DTQ_DispIfc_ok);
	snprintf(buffer, elcount(buffer), "   0.000000 F1 EIS::LDC_Disp_Stat_IC_AR2::DTQ_DispIfc_ok = %d\n", intval);
	filePutString (buffer, elcount(buffer), hFile);
	intval = getSignal(CHASSIS::LDC_Disp_Stat_IC_AR2::BSM_DispIfc_ok);
	snprintf(buffer, elcount(buffer), "   0.000000 F1 EIS::LDC_Disp_Stat_IC_AR2::BSM_DispIfc_ok = %d\n", intval);
	filePutString (buffer, elcount(buffer), hFile);
	intval = getSignal(CHASSIS::LDC_Disp_Stat_IC_AR2::LDP_Ifc_Ok);
	snprintf(buffer, elcount(buffer), "   0.000000 F1 EIS::LDC_Disp_Stat_IC_AR2::LDP_Ifc_Ok = %d\n", intval);
	filePutString (buffer, elcount(buffer), hFile);
	intval = getSignal(CHASSIS::LDC_Disp_Stat_IC_AR2::FCW_Ifc_ok);
	snprintf(buffer, elcount(buffer), "   0.000000 F1 EIS::LDC_Disp_Stat_IC_AR2::FCW_Ifc_ok = %d\n", intval);
	filePutString (buffer, elcount(buffer), hFile);
	intval = getSignal(CHASSIS::LgtSens_State_AR::LgtSens_Twlgt);
	snprintf(buffer, elcount(buffer), "   0.000000 F1 EIS::LgtSens_State_AR::LgtSens_Twlgt = %d\n", intval);
	filePutString (buffer, elcount(buffer), hFile);
	intval = getSignal(CHASSIS::LgtSens_State_AR::LgtSens_Night);
	snprintf(buffer, elcount(buffer), "   0.000000 F1 EIS::LgtSens_State_AR::LgtSens_Night = %d\n", intval);
	filePutString (buffer, elcount(buffer), hFile);
	intval = getSignal(CHASSIS::LgtSens_State_AR::LgtSens_Night2);
	snprintf(buffer, elcount(buffer), "   0.000000 F1 EIS::LgtSens_State_AR::LgtSens_Night2 = %d\n", intval);
	filePutString (buffer, elcount(buffer), hFile);
	intval = getSignal(CHASSIS::LgtSens_State_AR::LgtSens_Tunnel);
	snprintf(buffer, elcount(buffer), "   0.000000 F1 EIS::LgtSens_State_AR::LgtSens_Tunnel = %d\n", intval);
	filePutString (buffer, elcount(buffer), hFile);
	intval = getSignal(CHASSIS::LgtSens_State_AR::LgtSens_SNA);
	snprintf(buffer, elcount(buffer), "   0.000000 F1 EIS::LgtSens_State_AR::LgtSens_SNA = %d\n", intval);
	filePutString (buffer, elcount(buffer), hFile);
	intval = getSignal(CHASSIS::LgtSens_State_AR::LgtSens_Flt);
	snprintf(buffer, elcount(buffer), "   0.000000 F1 EIS::LgtSens_State_AR::LgtSens_Flt = %d\n", intval);
	filePutString (buffer, elcount(buffer), hFile);
	intval = getSignal(CHASSIS::LgtSens_State_AR::LgtSens_LoBm_On_Rq);
	snprintf(buffer, elcount(buffer), "   0.000000 F1 EIS::LgtSens_State_AR::LgtSens_LoBm_On_Rq = %d\n", intval);
	filePutString (buffer, elcount(buffer), hFile);
	intval = getSignal(CHASSIS::LgtSens_State_AR::LgtSens_Night3);
	snprintf(buffer, elcount(buffer), "   0.000000 F1 EIS::LgtSens_State_AR::LgtSens_Night3 = %d\n", intval);
	filePutString (buffer, elcount(buffer), hFile);
	intval = getSignal(CHASSIS::LgtSens_State_AR::HUD_Sens_Init);
	snprintf(buffer, elcount(buffer), "   0.000000 F1 EIS::LgtSens_State_AR::HUD_Sens_Init = %d\n", intval);
	filePutString (buffer, elcount(buffer), hFile);
	intval = getSignal(CHASSIS::LgtSens_State_AR::HUD_Sens_Actv);
	snprintf(buffer, elcount(buffer), "   0.000000 F1 EIS::LgtSens_State_AR::HUD_Sens_Actv = %d\n", intval);
	filePutString (buffer, elcount(buffer), hFile);
	intval = getSignal(CHASSIS::LgtSens_State_AR::SunInsty_Actv);
	snprintf(buffer, elcount(buffer), "   0.000000 F1 EIS::LgtSens_State_AR::SunInsty_Actv = %d\n", intval);
	filePutString (buffer, elcount(buffer), hFile);
	intval = getSignal(CHASSIS::LgtSens_State_AR::SunInsty_Flt);
	snprintf(buffer, elcount(buffer), "   0.000000 F1 EIS::LgtSens_State_AR::SunInsty_Flt = %d\n", intval);
	filePutString (buffer, elcount(buffer), hFile);
	floatval = getSignal(CHASSIS::LgtSens_State_AR::SunInsty_FL);
	snprintf(buffer, elcount(buffer), "   0.000000 F1 EIS::LgtSens_State_AR::SunInsty_FL = %f\n", floatval);
	filePutString (buffer, elcount(buffer), hFile);
	floatval = getSignal(CHASSIS::LgtSens_State_AR::SunInsty_FR);
	snprintf(buffer, elcount(buffer), "   0.000000 F1 EIS::LgtSens_State_AR::SunInsty_FR = %f\n", floatval);
	filePutString (buffer, elcount(buffer), hFile);
	intval = getSignal(CHASSIS::LgtSens_State_AR::HUD_Sens_Value);
	snprintf(buffer, elcount(buffer), "   0.000000 F1 EIS::LgtSens_State_AR::HUD_Sens_Value = %d\n", intval);
	filePutString (buffer, elcount(buffer), hFile);
	intval = getSignal(CHASSIS::LgtSens_State_AR::HUD_Sens_Variant);
	snprintf(buffer, elcount(buffer), "   0.000000 F1 EIS::LgtSens_State_AR::HUD_Sens_Variant = %d\n", intval);
	filePutString (buffer, elcount(buffer), hFile);
	intval = getSignal(CHASSIS::LgtSens_State_AR::HUD_SensInt_Flt);
	snprintf(buffer, elcount(buffer), "   0.000000 F1 EIS::LgtSens_State_AR::HUD_SensInt_Flt = %d\n", intval);
	filePutString (buffer, elcount(buffer), hFile);
	intval = getSignal(CHASSIS::LgtSens_State_AR::HUD_SensCode_Flt);
	snprintf(buffer, elcount(buffer), "   0.000000 F1 EIS::LgtSens_State_AR::HUD_SensCode_Flt = %d\n", intval);
	filePutString (buffer, elcount(buffer), hFile);
	intval = getSignal(CHASSIS::Mirr_Adj_Lt_Rq_AR::MirrAdj_Lt_Lt);
	snprintf(buffer, elcount(buffer), "   0.000000 F1 EIS::Mirr_Adj_Lt_Rq_AR::MirrAdj_Lt_Lt = %d\n", intval);
	filePutString (buffer, elcount(buffer), hFile);
	intval = getSignal(CHASSIS::Mirr_Adj_Lt_Rq_AR::MirrAdj_Lt_Rt);
	snprintf(buffer, elcount(buffer), "   0.000000 F1 EIS::Mirr_Adj_Lt_Rq_AR::MirrAdj_Lt_Rt = %d\n", intval);
	filePutString (buffer, elcount(buffer), hFile);
	intval = getSignal(CHASSIS::Mirr_Adj_Lt_Rq_AR::MirrAdj_Lt_Up);
	snprintf(buffer, elcount(buffer), "   0.000000 F1 EIS::Mirr_Adj_Lt_Rq_AR::MirrAdj_Lt_Up = %d\n", intval);
	filePutString (buffer, elcount(buffer), hFile);
	intval = getSignal(CHASSIS::Mirr_Adj_Lt_Rq_AR::MirrAdj_Lt_Down);
	snprintf(buffer, elcount(buffer), "   0.000000 F1 EIS::Mirr_Adj_Lt_Rq_AR::MirrAdj_Lt_Down = %d\n", intval);
	filePutString (buffer, elcount(buffer), hFile);
	intval = getSignal(CHASSIS::Mirr_Adj_Lt_Rq_AR::MirrFld_Lt_Rq);
	snprintf(buffer, elcount(buffer), "   0.000000 F1 EIS::Mirr_Adj_Lt_Rq_AR::MirrFld_Lt_Rq = %d\n", intval);
	filePutString (buffer, elcount(buffer), hFile);
	intval = getSignal(CHASSIS::Mirr_Adj_Lt_Rq_AR::MirrPkPosn_Lt_Sv_Rq);
	snprintf(buffer, elcount(buffer), "   0.000000 F1 EIS::Mirr_Adj_Lt_Rq_AR::MirrPkPosn_Lt_Sv_Rq = %d\n", intval);
	filePutString (buffer, elcount(buffer), hFile);
	intval = getSignal(CHASSIS::Mirr_Adj_Rt_Rq_AR::MirrAdj_Rt_Lt);
	snprintf(buffer, elcount(buffer), "   0.000000 F1 EIS::Mirr_Adj_Rt_Rq_AR::MirrAdj_Rt_Lt = %d\n", intval);
	filePutString (buffer, elcount(buffer), hFile);
	intval = getSignal(CHASSIS::Mirr_Adj_Rt_Rq_AR::MirrAdj_Rt_Rt);
	snprintf(buffer, elcount(buffer), "   0.000000 F1 EIS::Mirr_Adj_Rt_Rq_AR::MirrAdj_Rt_Rt = %d\n", intval);
	filePutString (buffer, elcount(buffer), hFile);
	intval = getSignal(CHASSIS::Mirr_Adj_Rt_Rq_AR::MirrAdj_Rt_Up);
	snprintf(buffer, elcount(buffer), "   0.000000 F1 EIS::Mirr_Adj_Rt_Rq_AR::MirrAdj_Rt_Up = %d\n", intval);
	filePutString (buffer, elcount(buffer), hFile);
	intval = getSignal(CHASSIS::Mirr_Adj_Rt_Rq_AR::MirrAdj_Rt_Down);
	snprintf(buffer, elcount(buffer), "   0.000000 F1 EIS::Mirr_Adj_Rt_Rq_AR::MirrAdj_Rt_Down = %d\n", intval);
	filePutString (buffer, elcount(buffer), hFile);
	intval = getSignal(CHASSIS::Mirr_Adj_Rt_Rq_AR::MirrFld_Rt_Rq);
	snprintf(buffer, elcount(buffer), "   0.000000 F1 EIS::Mirr_Adj_Rt_Rq_AR::MirrFld_Rt_Rq = %d\n", intval);
	filePutString (buffer, elcount(buffer), hFile);
	intval = getSignal(CHASSIS::Mirr_Adj_Rt_Rq_AR::MirrPkPosn_Rt_Sv_Rq);
	snprintf(buffer, elcount(buffer), "   0.000000 F1 EIS::Mirr_Adj_Rt_Rq_AR::MirrPkPosn_Rt_Sv_Rq = %d\n", intval);
	filePutString (buffer, elcount(buffer), hFile);
	intval = getSignal(CHASSIS::NAVI_Pos1_AR::GPS_Lat);
	snprintf(buffer, elcount(buffer), "   0.000000 F1 EIS::NAVI_Pos1_AR::GPS_Lat = %d\n", intval);
	filePutString (buffer, elcount(buffer), hFile);
}
/*@@end*/

/*@@caplFunc:saveVars_45(dword):*/
void saveVars_45(dword hFile)
{
	intval = getSignal(CHASSIS::NAVI_Pos1_AR::GPS_Long);
	snprintf(buffer, elcount(buffer), "   0.000000 F1 EIS::NAVI_Pos1_AR::GPS_Long = %d\n", intval);
	filePutString (buffer, elcount(buffer), hFile);
	intval = getSignal(CHASSIS::NAVI_Pos2_AR::GPS_Vel);
	snprintf(buffer, elcount(buffer), "   0.000000 F1 EIS::NAVI_Pos2_AR::GPS_Vel = %d\n", intval);
	filePutString (buffer, elcount(buffer), hFile);
	floatval = getSignal(CHASSIS::NAVI_Pos2_AR::GPS_Head);
	snprintf(buffer, elcount(buffer), "   0.000000 F1 EIS::NAVI_Pos2_AR::GPS_Head = %f\n", floatval);
	filePutString (buffer, elcount(buffer), hFile);
	floatval = getSignal(CHASSIS::NAVI_Pos2_AR::GPS_Ellip);
	snprintf(buffer, elcount(buffer), "   0.000000 F1 EIS::NAVI_Pos2_AR::GPS_Ellip = %f\n", floatval);
	filePutString (buffer, elcount(buffer), hFile);
	floatval = getSignal(CHASSIS::NAVI_Pos2_AR::GPS_Alt);
	snprintf(buffer, elcount(buffer), "   0.000000 F1 EIS::NAVI_Pos2_AR::GPS_Alt = %f\n", floatval);
	filePutString (buffer, elcount(buffer), hFile);
	intval = getSignal(CHASSIS::NAVI_Pos3_AR::GPS_Date_Year);
	snprintf(buffer, elcount(buffer), "   0.000000 F1 EIS::NAVI_Pos3_AR::GPS_Date_Year = %d\n", intval);
	filePutString (buffer, elcount(buffer), hFile);
	intval = getSignal(CHASSIS::NAVI_Pos3_AR::GPS_Date_Month);
	snprintf(buffer, elcount(buffer), "   0.000000 F1 EIS::NAVI_Pos3_AR::GPS_Date_Month = %d\n", intval);
	filePutString (buffer, elcount(buffer), hFile);
	intval = getSignal(CHASSIS::NAVI_Pos3_AR::GPS_Date_Day);
	snprintf(buffer, elcount(buffer), "   0.000000 F1 EIS::NAVI_Pos3_AR::GPS_Date_Day = %d\n", intval);
	filePutString (buffer, elcount(buffer), hFile);
	intval = getSignal(CHASSIS::NAVI_Pos3_AR::GPS_UTC_Hour);
	snprintf(buffer, elcount(buffer), "   0.000000 F1 EIS::NAVI_Pos3_AR::GPS_UTC_Hour = %d\n", intval);
	filePutString (buffer, elcount(buffer), hFile);
	intval = getSignal(CHASSIS::NAVI_Pos3_AR::GPS_UTC_Minute);
	snprintf(buffer, elcount(buffer), "   0.000000 F1 EIS::NAVI_Pos3_AR::GPS_UTC_Minute = %d\n", intval);
	filePutString (buffer, elcount(buffer), hFile);
	floatval = getSignal(CHASSIS::NAVI_Pos3_AR::GPS_UTC_Second);
	snprintf(buffer, elcount(buffer), "   0.000000 F1 EIS::NAVI_Pos3_AR::GPS_UTC_Second = %f\n", floatval);
	filePutString (buffer, elcount(buffer), hFile);
	intval = getSignal(CHASSIS::NAVI_Pos4_AR::DR_MM_Lat);
	snprintf(buffer, elcount(buffer), "   0.000000 F1 EIS::NAVI_Pos4_AR::DR_MM_Lat = %d\n", intval);
	filePutString (buffer, elcount(buffer), hFile);
	intval = getSignal(CHASSIS::NAVI_Pos4_AR::DR_MM_Long);
	snprintf(buffer, elcount(buffer), "   0.000000 F1 EIS::NAVI_Pos4_AR::DR_MM_Long = %d\n", intval);
	filePutString (buffer, elcount(buffer), hFile);
	intval = getSignal(CHASSIS::NAVI_Pos5_AR::GPS_Vsbl_Sat);
	snprintf(buffer, elcount(buffer), "   0.000000 F1 EIS::NAVI_Pos5_AR::GPS_Vsbl_Sat = %d\n", intval);
	filePutString (buffer, elcount(buffer), hFile);
	intval = getSignal(CHASSIS::NAVI_Pos5_AR::GPS_Trck_Sat);
	snprintf(buffer, elcount(buffer), "   0.000000 F1 EIS::NAVI_Pos5_AR::GPS_Trck_Sat = %d\n", intval);
	filePutString (buffer, elcount(buffer), hFile);
	floatval = getSignal(CHASSIS::NAVI_Pos5_AR::GPS_Vdop);
	snprintf(buffer, elcount(buffer), "   0.000000 F1 EIS::NAVI_Pos5_AR::GPS_Vdop = %f\n", floatval);
	filePutString (buffer, elcount(buffer), hFile);
	floatval = getSignal(CHASSIS::NAVI_Pos5_AR::GPS_Hdop);
	snprintf(buffer, elcount(buffer), "   0.000000 F1 EIS::NAVI_Pos5_AR::GPS_Hdop = %f\n", floatval);
	filePutString (buffer, elcount(buffer), hFile);
	floatval = getSignal(CHASSIS::NAVI_Pos5_AR::GPS_Pdop);
	snprintf(buffer, elcount(buffer), "   0.000000 F1 EIS::NAVI_Pos5_AR::GPS_Pdop = %f\n", floatval);
	filePutString (buffer, elcount(buffer), hFile);
	intval = getSignal(CHASSIS::NAVI_Pos5_AR::GPS_Fix);
	snprintf(buffer, elcount(buffer), "   0.000000 F1 EIS::NAVI_Pos5_AR::GPS_Fix = %d\n", intval);
	filePutString (buffer, elcount(buffer), hFile);
	intval = @sysvar::CH_Nodes::CH_EISCRC_NVP_Stat1_Pr2NVP__AUTO;
	snprintf(buffer, elcount(buffer), "   0.000000    SV: 2 0 0 ::CH_Nodes::CH_EISCRC_NVP_Stat1_Pr2NVP__AUTO = %d\n", intval);
	filePutString (buffer, elcount(buffer), hFile);
	intval = getSignal(CHASSIS::NVP_Stat1_AR2::CRC_NVP_Stat1_Pr2);
	snprintf(buffer, elcount(buffer), "   0.000000 F1 EIS::NVP_Stat1_AR2::CRC_NVP_Stat1_Pr2 = %d\n", intval);
	filePutString (buffer, elcount(buffer), hFile);
	intval = @sysvar::CH_Nodes::CH_EISSQC_NVP_Stat1_Pr2NVP__AUTO;
	snprintf(buffer, elcount(buffer), "   0.000000    SV: 2 0 0 ::CH_Nodes::CH_EISSQC_NVP_Stat1_Pr2NVP__AUTO = %d\n", intval);
	filePutString (buffer, elcount(buffer), hFile);
	intval = getSignal(CHASSIS::NVP_Stat1_AR2::SQC_NVP_Stat1_Pr2);
	snprintf(buffer, elcount(buffer), "   0.000000 F1 EIS::NVP_Stat1_AR2::SQC_NVP_Stat1_Pr2 = %d\n", intval);
	filePutString (buffer, elcount(buffer), hFile);
	intval = getSignal(CHASSIS::NVP_Stat1_AR2::NVP_Sys_Stat);
	snprintf(buffer, elcount(buffer), "   0.000000 F1 EIS::NVP_Stat1_AR2::NVP_Sys_Stat = %d\n", intval);
	filePutString (buffer, elcount(buffer), hFile);
	intval = getSignal(CHASSIS::NVP_Stat1_AR2::NVP_Disp_Rq);
	snprintf(buffer, elcount(buffer), "   0.000000 F1 EIS::NVP_Stat1_AR2::NVP_Disp_Rq = %d\n", intval);
	filePutString (buffer, elcount(buffer), hFile);
	intval = getSignal(CHASSIS::NVP_Stat1_AR2::NVP_Icon_Stat);
	snprintf(buffer, elcount(buffer), "   0.000000 F1 EIS::NVP_Stat1_AR2::NVP_Icon_Stat = %d\n", intval);
	filePutString (buffer, elcount(buffer), hFile);
	intval = getSignal(CHASSIS::NVP_Stat1_AR2::NVP_WshHt_Rq);
	snprintf(buffer, elcount(buffer), "   0.000000 F1 EIS::NVP_Stat1_AR2::NVP_WshHt_Rq = %d\n", intval);
	filePutString (buffer, elcount(buffer), hFile);
	intval = getSignal(CHASSIS::NVP_Stat1_AR2::NVP_Warn_Stat);
	snprintf(buffer, elcount(buffer), "   0.000000 F1 EIS::NVP_Stat1_AR2::NVP_Warn_Stat = %d\n", intval);
	filePutString (buffer, elcount(buffer), hFile);
	intval = getSignal(CHASSIS::NVP_Stat1_AR2::NVP_IrLmp_On_Rq);
	snprintf(buffer, elcount(buffer), "   0.000000 F1 EIS::NVP_Stat1_AR2::NVP_IrLmp_On_Rq = %d\n", intval);
	filePutString (buffer, elcount(buffer), hFile);
	intval = getSignal(CHASSIS::NVP_Stat1_AR2::SPL_MenuSubs_Rq);
	snprintf(buffer, elcount(buffer), "   0.000000 F1 EIS::NVP_Stat1_AR2::SPL_MenuSubs_Rq = %d\n", intval);
	filePutString (buffer, elcount(buffer), hFile);
	intval = getSignal(CHASSIS::NVP_Stat1_AR2::NVP_MenuSubs_Rq);
	snprintf(buffer, elcount(buffer), "   0.000000 F1 EIS::NVP_Stat1_AR2::NVP_MenuSubs_Rq = %d\n", intval);
	filePutString (buffer, elcount(buffer), hFile);
	intval = getSignal(CHASSIS::NVP_Stat1_AR2::NVP_Wpr_Rq);
	snprintf(buffer, elcount(buffer), "   0.000000 F1 EIS::NVP_Stat1_AR2::NVP_Wpr_Rq = %d\n", intval);
	filePutString (buffer, elcount(buffer), hFile);
	intval = getSignal(CHASSIS::NVP_Stat1_AR2::NVP_SPL_Warn_Stat);
	snprintf(buffer, elcount(buffer), "   0.000000 F1 EIS::NVP_Stat1_AR2::NVP_SPL_Warn_Stat = %d\n", intval);
	filePutString (buffer, elcount(buffer), hFile);
	intval = getSignal(CHASSIS::NVP_Stat1_AR2::NVP_SPL_Icon_Stat);
	snprintf(buffer, elcount(buffer), "   0.000000 F1 EIS::NVP_Stat1_AR2::NVP_SPL_Icon_Stat = %d\n", intval);
	filePutString (buffer, elcount(buffer), hFile);
	intval = getSignal(CHASSIS::NVP_Stat1_AR2::NVP_DispMd_Stat);
	snprintf(buffer, elcount(buffer), "   0.000000 F1 EIS::NVP_Stat1_AR2::NVP_DispMd_Stat = %d\n", intval);
	filePutString (buffer, elcount(buffer), hFile);
	intval = getSignal(CHASSIS::NVP_Stat1_AR2::NVP_SPL_Md_Stat);
	snprintf(buffer, elcount(buffer), "   0.000000 F1 EIS::NVP_Stat1_AR2::NVP_SPL_Md_Stat = %d\n", intval);
	filePutString (buffer, elcount(buffer), hFile);
	intval = getSignal(CHASSIS::NVP_Stat1_AR2::NVP_Warn_TrgrRq);
	snprintf(buffer, elcount(buffer), "   0.000000 F1 EIS::NVP_Stat1_AR2::NVP_Warn_TrgrRq = %d\n", intval);
	filePutString (buffer, elcount(buffer), hFile);
	intval = getSignal(CHASSIS::OHCM_Stat_AR2::IL_F_Man_Psd);
	snprintf(buffer, elcount(buffer), "   0.000000 F1 EIS::OHCM_Stat_AR2::IL_F_Man_Psd = %d\n", intval);
	filePutString (buffer, elcount(buffer), hFile);
	intval = getSignal(CHASSIS::OHCM_Stat_AR2::IL_R_Man_Psd);
	snprintf(buffer, elcount(buffer), "   0.000000 F1 EIS::OHCM_Stat_AR2::IL_R_Man_Psd = %d\n", intval);
	filePutString (buffer, elcount(buffer), hFile);
	intval = getSignal(CHASSIS::OHCM_Stat_AR2::IL_RL_Man_Psd);
	snprintf(buffer, elcount(buffer), "   0.000000 F1 EIS::OHCM_Stat_AR2::IL_RL_Man_Psd = %d\n", intval);
	filePutString (buffer, elcount(buffer), hFile);
	intval = getSignal(CHASSIS::OHCM_Stat_AR2::IL_RR_Man_Psd);
	snprintf(buffer, elcount(buffer), "   0.000000 F1 EIS::OHCM_Stat_AR2::IL_RR_Man_Psd = %d\n", intval);
	filePutString (buffer, elcount(buffer), hFile);
	intval = getSignal(CHASSIS::OHCM_Stat_AR2::RdLgtSw_FL_Psd);
	snprintf(buffer, elcount(buffer), "   0.000000 F1 EIS::OHCM_Stat_AR2::RdLgtSw_FL_Psd = %d\n", intval);
	filePutString (buffer, elcount(buffer), hFile);
	intval = getSignal(CHASSIS::OHCM_Stat_AR2::RdLgtSw_FR_Psd);
	snprintf(buffer, elcount(buffer), "   0.000000 F1 EIS::OHCM_Stat_AR2::RdLgtSw_FR_Psd = %d\n", intval);
	filePutString (buffer, elcount(buffer), hFile);
	intval = getSignal(CHASSIS::OHCM_Stat_AR2::RdLgtSw_RL_Psd);
	snprintf(buffer, elcount(buffer), "   0.000000 F1 EIS::OHCM_Stat_AR2::RdLgtSw_RL_Psd = %d\n", intval);
	filePutString (buffer, elcount(buffer), hFile);
	intval = getSignal(CHASSIS::OHCM_Stat_AR2::RdLgtSw_RR_Psd);
	snprintf(buffer, elcount(buffer), "   0.000000 F1 EIS::OHCM_Stat_AR2::RdLgtSw_RR_Psd = %d\n", intval);
	filePutString (buffer, elcount(buffer), hFile);
	intval = getSignal(CHASSIS::OHCM_Stat_AR2::IL_FL_Actv);
	snprintf(buffer, elcount(buffer), "   0.000000 F1 EIS::OHCM_Stat_AR2::IL_FL_Actv = %d\n", intval);
	filePutString (buffer, elcount(buffer), hFile);
	intval = getSignal(CHASSIS::OHCM_Stat_AR2::IL_FM_Actv);
	snprintf(buffer, elcount(buffer), "   0.000000 F1 EIS::OHCM_Stat_AR2::IL_FM_Actv = %d\n", intval);
	filePutString (buffer, elcount(buffer), hFile);
	intval = getSignal(CHASSIS::OHCM_Stat_AR2::IL_FR_Actv);
	snprintf(buffer, elcount(buffer), "   0.000000 F1 EIS::OHCM_Stat_AR2::IL_FR_Actv = %d\n", intval);
	filePutString (buffer, elcount(buffer), hFile);
	intval = getSignal(CHASSIS::OHCM_Stat_AR2::IL_RL_Actv);
	snprintf(buffer, elcount(buffer), "   0.000000 F1 EIS::OHCM_Stat_AR2::IL_RL_Actv = %d\n", intval);
	filePutString (buffer, elcount(buffer), hFile);
	intval = getSignal(CHASSIS::OHCM_Stat_AR2::IL_RM_Actv);
	snprintf(buffer, elcount(buffer), "   0.000000 F1 EIS::OHCM_Stat_AR2::IL_RM_Actv = %d\n", intval);
	filePutString (buffer, elcount(buffer), hFile);
	intval = getSignal(CHASSIS::OHCM_Stat_AR2::IL_RR_Actv);
	snprintf(buffer, elcount(buffer), "   0.000000 F1 EIS::OHCM_Stat_AR2::IL_RR_Actv = %d\n", intval);
	filePutString (buffer, elcount(buffer), hFile);
	intval = getSignal(CHASSIS::OHCM_Stat_AR2::DrSwOff_Man_Psd);
	snprintf(buffer, elcount(buffer), "   0.000000 F1 EIS::OHCM_Stat_AR2::DrSwOff_Man_Psd = %d\n", intval);
	filePutString (buffer, elcount(buffer), hFile);
	intval = getSignal(CHASSIS::OHCM_Stat_AR2::IL_F_Actv);
	snprintf(buffer, elcount(buffer), "   0.000000 F1 EIS::OHCM_Stat_AR2::IL_F_Actv = %d\n", intval);
	filePutString (buffer, elcount(buffer), hFile);
}
/*@@end*/

/*@@caplFunc:saveVars_46(dword):*/
void saveVars_46(dword hFile)
{
	intval = getSignal(CHASSIS::OHCM_Stat_AR2::IL_R_Actv);
	snprintf(buffer, elcount(buffer), "   0.000000 F1 EIS::OHCM_Stat_AR2::IL_R_Actv = %d\n", intval);
	filePutString (buffer, elcount(buffer), hFile);
	intval = getSignal(CHASSIS::OHCM_Stat_AR2::RdLmp_FL_Actv);
	snprintf(buffer, elcount(buffer), "   0.000000 F1 EIS::OHCM_Stat_AR2::RdLmp_FL_Actv = %d\n", intval);
	filePutString (buffer, elcount(buffer), hFile);
	intval = getSignal(CHASSIS::OHCM_Stat_AR2::RdLmp_FR_Actv);
	snprintf(buffer, elcount(buffer), "   0.000000 F1 EIS::OHCM_Stat_AR2::RdLmp_FR_Actv = %d\n", intval);
	filePutString (buffer, elcount(buffer), hFile);
	intval = getSignal(CHASSIS::OHCM_Stat_AR2::Mirr_Privacy_Stat);
	snprintf(buffer, elcount(buffer), "   0.000000 F1 EIS::OHCM_Stat_AR2::Mirr_Privacy_Stat = %d\n", intval);
	filePutString (buffer, elcount(buffer), hFile);
	intval = getSignal(CHASSIS::OHCM_Stat_AR2::Mirr_Adzzl);
	snprintf(buffer, elcount(buffer), "   0.000000 F1 EIS::OHCM_Stat_AR2::Mirr_Adzzl = %d\n", intval);
	filePutString (buffer, elcount(buffer), hFile);
	intval = getSignal(CHASSIS::OHCM_Stat_AR2::EnvLgtLvl);
	snprintf(buffer, elcount(buffer), "   0.000000 F1 EIS::OHCM_Stat_AR2::EnvLgtLvl = %d\n", intval);
	filePutString (buffer, elcount(buffer), hFile);
	floatval = getSignal(CHASSIS::OHCM_Stat_AR2::AirTemp_Insd_OHCM_V2);
	snprintf(buffer, elcount(buffer), "   0.000000 F1 EIS::OHCM_Stat_AR2::AirTemp_Insd_OHCM_V2 = %f\n", floatval);
	filePutString (buffer, elcount(buffer), hFile);
	intval = getSignal(CHASSIS::OHCM_Stat_AR2::AirTemp_InsdSens_Fan_Actv);
	snprintf(buffer, elcount(buffer), "   0.000000 F1 EIS::OHCM_Stat_AR2::AirTemp_InsdSens_Fan_Actv = %d\n", intval);
	filePutString (buffer, elcount(buffer), hFile);
	intval = getSignal(CHASSIS::OHCM_Stat_AR2::TSSR_Sw_Stat_OHCM);
	snprintf(buffer, elcount(buffer), "   0.000000 F1 EIS::OHCM_Stat_AR2::TSSR_Sw_Stat_OHCM = %d\n", intval);
	filePutString (buffer, elcount(buffer), hFile);
	intval = getSignal(CHASSIS::OHCM_Stat_AR2::TSSR_RB_Sw_Psd_OHCM);
	snprintf(buffer, elcount(buffer), "   0.000000 F1 EIS::OHCM_Stat_AR2::TSSR_RB_Sw_Psd_OHCM = %d\n", intval);
	filePutString (buffer, elcount(buffer), hFile);
	intval = getSignal(CHASSIS::OHCM_Stat_AR2::SOS_CallSw_Stat);
	snprintf(buffer, elcount(buffer), "   0.000000 F1 EIS::OHCM_Stat_AR2::SOS_CallSw_Stat = %d\n", intval);
	filePutString (buffer, elcount(buffer), hFile);
	intval = getSignal(CHASSIS::OHCM_Stat_AR2::RoadsdCallSw_Stat);
	snprintf(buffer, elcount(buffer), "   0.000000 F1 EIS::OHCM_Stat_AR2::RoadsdCallSw_Stat = %d\n", intval);
	filePutString (buffer, elcount(buffer), hFile);
	intval = getSignal(CHASSIS::OHCM_Stat_AR2::ServCallSw_Stat);
	snprintf(buffer, elcount(buffer), "   0.000000 F1 EIS::OHCM_Stat_AR2::ServCallSw_Stat = %d\n", intval);
	filePutString (buffer, elcount(buffer), hFile);
	intval = getSignal(CHASSIS::ORC_Disp_Stat_AR2::SRS_DtlMsg01_Disp_Rq);
	snprintf(buffer, elcount(buffer), "   0.000000 F1 EIS::ORC_Disp_Stat_AR2::SRS_DtlMsg01_Disp_Rq = %d\n", intval);
	filePutString (buffer, elcount(buffer), hFile);
	intval = getSignal(CHASSIS::ORC_Disp_Stat_AR2::SRS_DtlMsg02_Disp_Rq);
	snprintf(buffer, elcount(buffer), "   0.000000 F1 EIS::ORC_Disp_Stat_AR2::SRS_DtlMsg02_Disp_Rq = %d\n", intval);
	filePutString (buffer, elcount(buffer), hFile);
	intval = getSignal(CHASSIS::ORC_Disp_Stat_AR2::SRS_DtlMsg03_Disp_Rq);
	snprintf(buffer, elcount(buffer), "   0.000000 F1 EIS::ORC_Disp_Stat_AR2::SRS_DtlMsg03_Disp_Rq = %d\n", intval);
	filePutString (buffer, elcount(buffer), hFile);
	intval = getSignal(CHASSIS::ORC_Disp_Stat_AR2::SRS_DtlMsg04_Disp_Rq);
	snprintf(buffer, elcount(buffer), "   0.000000 F1 EIS::ORC_Disp_Stat_AR2::SRS_DtlMsg04_Disp_Rq = %d\n", intval);
	filePutString (buffer, elcount(buffer), hFile);
	intval = getSignal(CHASSIS::ORC_Disp_Stat_AR2::SRS_DtlMsg05_Disp_Rq);
	snprintf(buffer, elcount(buffer), "   0.000000 F1 EIS::ORC_Disp_Stat_AR2::SRS_DtlMsg05_Disp_Rq = %d\n", intval);
	filePutString (buffer, elcount(buffer), hFile);
	intval = getSignal(CHASSIS::ORC_Disp_Stat_AR2::SRS_DtlMsg06_Disp_Rq);
	snprintf(buffer, elcount(buffer), "   0.000000 F1 EIS::ORC_Disp_Stat_AR2::SRS_DtlMsg06_Disp_Rq = %d\n", intval);
	filePutString (buffer, elcount(buffer), hFile);
	intval = getSignal(CHASSIS::ORC_Disp_Stat_AR2::SRS_DtlMsg07_Disp_Rq);
	snprintf(buffer, elcount(buffer), "   0.000000 F1 EIS::ORC_Disp_Stat_AR2::SRS_DtlMsg07_Disp_Rq = %d\n", intval);
	filePutString (buffer, elcount(buffer), hFile);
	intval = getSignal(CHASSIS::ORC_Disp_Stat_AR2::SRS_DtlMsg08_Disp_Rq);
	snprintf(buffer, elcount(buffer), "   0.000000 F1 EIS::ORC_Disp_Stat_AR2::SRS_DtlMsg08_Disp_Rq = %d\n", intval);
	filePutString (buffer, elcount(buffer), hFile);
	intval = getSignal(CHASSIS::ORC_Disp_Stat_AR2::SRS_DtlMsg09_Disp_Rq);
	snprintf(buffer, elcount(buffer), "   0.000000 F1 EIS::ORC_Disp_Stat_AR2::SRS_DtlMsg09_Disp_Rq = %d\n", intval);
	filePutString (buffer, elcount(buffer), hFile);
	intval = getSignal(CHASSIS::ORC_Disp_Stat_AR2::SRS_DtlMsg10_Disp_Rq);
	snprintf(buffer, elcount(buffer), "   0.000000 F1 EIS::ORC_Disp_Stat_AR2::SRS_DtlMsg10_Disp_Rq = %d\n", intval);
	filePutString (buffer, elcount(buffer), hFile);
	intval = getSignal(CHASSIS::ORC_Disp_Stat_AR2::SRS_DtlMsg11_Disp_Rq);
	snprintf(buffer, elcount(buffer), "   0.000000 F1 EIS::ORC_Disp_Stat_AR2::SRS_DtlMsg11_Disp_Rq = %d\n", intval);
	filePutString (buffer, elcount(buffer), hFile);
	intval = getSignal(CHASSIS::ORC_Disp_Stat_AR2::SRS_DtlMsg12_Disp_Rq);
	snprintf(buffer, elcount(buffer), "   0.000000 F1 EIS::ORC_Disp_Stat_AR2::SRS_DtlMsg12_Disp_Rq = %d\n", intval);
	filePutString (buffer, elcount(buffer), hFile);
	intval = getSignal(CHASSIS::ORC_Disp_Stat_AR2::SRS_DtlMsg13_Disp_Rq);
	snprintf(buffer, elcount(buffer), "   0.000000 F1 EIS::ORC_Disp_Stat_AR2::SRS_DtlMsg13_Disp_Rq = %d\n", intval);
	filePutString (buffer, elcount(buffer), hFile);
	intval = getSignal(CHASSIS::ORC_Disp_Stat_AR2::SRS_DtlMsg14_Disp_Rq);
	snprintf(buffer, elcount(buffer), "   0.000000 F1 EIS::ORC_Disp_Stat_AR2::SRS_DtlMsg14_Disp_Rq = %d\n", intval);
	filePutString (buffer, elcount(buffer), hFile);
	intval = getSignal(CHASSIS::ORC_Disp_Stat_AR2::SRS_DtlMsg15_Disp_Rq);
	snprintf(buffer, elcount(buffer), "   0.000000 F1 EIS::ORC_Disp_Stat_AR2::SRS_DtlMsg15_Disp_Rq = %d\n", intval);
	filePutString (buffer, elcount(buffer), hFile);
	intval = getSignal(CHASSIS::ORC_Disp_Stat_AR2::SRS_DtlMsg16_Disp_Rq);
	snprintf(buffer, elcount(buffer), "   0.000000 F1 EIS::ORC_Disp_Stat_AR2::SRS_DtlMsg16_Disp_Rq = %d\n", intval);
	filePutString (buffer, elcount(buffer), hFile);
	intval = getSignal(CHASSIS::ORC_Disp_Stat_AR2::OC_P_Flt_ORC);
	snprintf(buffer, elcount(buffer), "   0.000000 F1 EIS::ORC_Disp_Stat_AR2::OC_P_Flt_ORC = %d\n", intval);
	filePutString (buffer, elcount(buffer), hFile);
	intval = getSignal(CHASSIS::ORC_Disp_Stat_AR2::OC_P_ORC);
	snprintf(buffer, elcount(buffer), "   0.000000 F1 EIS::ORC_Disp_Stat_AR2::OC_P_ORC = %d\n", intval);
	filePutString (buffer, elcount(buffer), hFile);
	intval = getSignal(CHASSIS::ORC_Disp_Stat_AR2::OC_PM_Fast_ORC);
	snprintf(buffer, elcount(buffer), "   0.000000 F1 EIS::ORC_Disp_Stat_AR2::OC_PM_Fast_ORC = %d\n", intval);
	filePutString (buffer, elcount(buffer), hFile);
	intval = getSignal(CHASSIS::ORC_Disp_Stat_AR2::PP_Msg1_Disp_Rq);
	snprintf(buffer, elcount(buffer), "   0.000000 F1 EIS::ORC_Disp_Stat_AR2::PP_Msg1_Disp_Rq = %d\n", intval);
	filePutString (buffer, elcount(buffer), hFile);
	intval = getSignal(CHASSIS::ORC_Disp_Stat_AR2::Bckl_Sw_FPM_Stat);
	snprintf(buffer, elcount(buffer), "   0.000000 F1 EIS::ORC_Disp_Stat_AR2::Bckl_Sw_FPM_Stat = %d\n", intval);
	filePutString (buffer, elcount(buffer), hFile);
	intval = getSignal(CHASSIS::ORC_Disp_Stat_AR2::ESL_Lk_Appl_ORC);
	snprintf(buffer, elcount(buffer), "   0.000000 F1 EIS::ORC_Disp_Stat_AR2::ESL_Lk_Appl_ORC = %d\n", intval);
	filePutString (buffer, elcount(buffer), hFile);
	intval = getSignal(CHASSIS::ORC_Disp_Stat_AR2::OC_P_Fast_ORC);
	snprintf(buffer, elcount(buffer), "   0.000000 F1 EIS::ORC_Disp_Stat_AR2::OC_P_Fast_ORC = %d\n", intval);
	filePutString (buffer, elcount(buffer), hFile);
	intval = getSignal(CHASSIS::ORC_Disp_Stat_AR2::ORC_CrashDet_Flt);
	snprintf(buffer, elcount(buffer), "   0.000000 F1 EIS::ORC_Disp_Stat_AR2::ORC_CrashDet_Flt = %d\n", intval);
	filePutString (buffer, elcount(buffer), hFile);
	intval = getSignal(CHASSIS::ORC_Disp_Stat_AR2::HV_Pyrofuse_Flt);
	snprintf(buffer, elcount(buffer), "   0.000000 F1 EIS::ORC_Disp_Stat_AR2::HV_Pyrofuse_Flt = %d\n", intval);
	filePutString (buffer, elcount(buffer), hFile);
	intval = getSignal(CHASSIS::ORC_Disp_Stat_AR2::OCM_MsgDisp_Rq);
	snprintf(buffer, elcount(buffer), "   0.000000 F1 EIS::ORC_Disp_Stat_AR2::OCM_MsgDisp_Rq = %d\n", intval);
	filePutString (buffer, elcount(buffer), hFile);
	intval = @sysvar::CH_Nodes::CH_EISCRC_Bckl_Sw_Ft_Stat_P_AUTO;
	snprintf(buffer, elcount(buffer), "   0.000000    SV: 2 0 0 ::CH_Nodes::CH_EISCRC_Bckl_Sw_Ft_Stat_P_AUTO = %d\n", intval);
	filePutString (buffer, elcount(buffer), hFile);
	intval = getSignal(CHASSIS::ORC_Disp_Stat_AR2::CRC_Bckl_Sw_Ft_Stat_Pr2);
	snprintf(buffer, elcount(buffer), "   0.000000 F1 EIS::ORC_Disp_Stat_AR2::CRC_Bckl_Sw_Ft_Stat_Pr2 = %d\n", intval);
	filePutString (buffer, elcount(buffer), hFile);
	intval = @sysvar::CH_Nodes::CH_EISSQC_Bckl_Sw_Ft_Stat_P_AUTO;
	snprintf(buffer, elcount(buffer), "   0.000000    SV: 2 0 0 ::CH_Nodes::CH_EISSQC_Bckl_Sw_Ft_Stat_P_AUTO = %d\n", intval);
	filePutString (buffer, elcount(buffer), hFile);
	intval = getSignal(CHASSIS::ORC_Disp_Stat_AR2::SQC_Bckl_Sw_Ft_Stat_Pr2);
	snprintf(buffer, elcount(buffer), "   0.000000 F1 EIS::ORC_Disp_Stat_AR2::SQC_Bckl_Sw_Ft_Stat_Pr2 = %d\n", intval);
	filePutString (buffer, elcount(buffer), hFile);
	intval = getSignal(CHASSIS::ORC_Disp_Stat_AR2::Airbag_P_LED_On_Rq);
	snprintf(buffer, elcount(buffer), "   0.000000 F1 EIS::ORC_Disp_Stat_AR2::Airbag_P_LED_On_Rq = %d\n", intval);
	filePutString (buffer, elcount(buffer), hFile);
	intval = getSignal(CHASSIS::ORC_Disp_Stat_AR2::COD_Ind_LED_Rq);
	snprintf(buffer, elcount(buffer), "   0.000000 F1 EIS::ORC_Disp_Stat_AR2::COD_Ind_LED_Rq = %d\n", intval);
	filePutString (buffer, elcount(buffer), hFile);
	intval = getSignal(CHASSIS::ORC_Disp_Stat_AR2::SRS_IndLmp_Rq);
	snprintf(buffer, elcount(buffer), "   0.000000 F1 EIS::ORC_Disp_Stat_AR2::SRS_IndLmp_Rq = %d\n", intval);
	filePutString (buffer, elcount(buffer), hFile);
	intval = getSignal(CHASSIS::ORC_Disp_Stat_AR2::OC_D_Fast_ORC);
	snprintf(buffer, elcount(buffer), "   0.000000 F1 EIS::ORC_Disp_Stat_AR2::OC_D_Fast_ORC = %d\n", intval);
	filePutString (buffer, elcount(buffer), hFile);
	intval = getSignal(CHASSIS::ORC_Disp_Stat_AR2::Bckl_Sw_D_Stat);
	snprintf(buffer, elcount(buffer), "   0.000000 F1 EIS::ORC_Disp_Stat_AR2::Bckl_Sw_D_Stat = %d\n", intval);
	filePutString (buffer, elcount(buffer), hFile);
	intval = getSignal(CHASSIS::ORC_Disp_Stat_AR2::Bckl_Sw_FP_Stat);
	snprintf(buffer, elcount(buffer), "   0.000000 F1 EIS::ORC_Disp_Stat_AR2::Bckl_Sw_FP_Stat = %d\n", intval);
	filePutString (buffer, elcount(buffer), hFile);
	intval = @sysvar::CH_Nodes::CH_EISCRC_Impact_Pr2ORC_Imp_AUTO;
	snprintf(buffer, elcount(buffer), "   0.000000    SV: 2 0 0 ::CH_Nodes::CH_EISCRC_Impact_Pr2ORC_Imp_AUTO = %d\n", intval);
	filePutString (buffer, elcount(buffer), hFile);
	intval = getSignal(CHASSIS::ORC_Impact_AR2::CRC_Impact_Pr2);
	snprintf(buffer, elcount(buffer), "   0.000000 F1 EIS::ORC_Impact_AR2::CRC_Impact_Pr2 = %d\n", intval);
	filePutString (buffer, elcount(buffer), hFile);
	intval = @sysvar::CH_Nodes::CH_EISSQC_Impact_Pr2ORC_Imp_AUTO;
	snprintf(buffer, elcount(buffer), "   0.000000    SV: 2 0 0 ::CH_Nodes::CH_EISSQC_Impact_Pr2ORC_Imp_AUTO = %d\n", intval);
	filePutString (buffer, elcount(buffer), hFile);
	intval = getSignal(CHASSIS::ORC_Impact_AR2::SQC_Impact_Pr2);
	snprintf(buffer, elcount(buffer), "   0.000000 F1 EIS::ORC_Impact_AR2::SQC_Impact_Pr2 = %d\n", intval);
	filePutString (buffer, elcount(buffer), hFile);
	intval = getSignal(CHASSIS::ORC_Impact_AR2::Impact_N);
	snprintf(buffer, elcount(buffer), "   0.000000 F1 EIS::ORC_Impact_AR2::Impact_N = %d\n", intval);
	filePutString (buffer, elcount(buffer), hFile);
	intval = getSignal(CHASSIS::ORC_Impact_AR2::Impact_O);
	snprintf(buffer, elcount(buffer), "   0.000000 F1 EIS::ORC_Impact_AR2::Impact_O = %d\n", intval);
	filePutString (buffer, elcount(buffer), hFile);
}
/*@@end*/

/*@@caplFunc:saveVars_47(dword):*/
void saveVars_47(dword hFile)
{
	intval = @sysvar::CH_Nodes::CH_EISImpact_TglORC_Impact__AUTO;
	snprintf(buffer, elcount(buffer), "   0.000000    SV: 2 0 0 ::CH_Nodes::CH_EISImpact_TglORC_Impact__AUTO = %d\n", intval);
	filePutString (buffer, elcount(buffer), hFile);
	intval = getSignal(CHASSIS::ORC_Impact_AR2::Impact_Tgl);
	snprintf(buffer, elcount(buffer), "   0.000000 F1 EIS::ORC_Impact_AR2::Impact_Tgl = %d\n", intval);
	filePutString (buffer, elcount(buffer), hFile);
	intval = getSignal(CHASSIS::ORC_Impact_AR2::Impact_X);
	snprintf(buffer, elcount(buffer), "   0.000000 F1 EIS::ORC_Impact_AR2::Impact_X = %d\n", intval);
	filePutString (buffer, elcount(buffer), hFile);
	intval = getSignal(CHASSIS::ORC_Impact_AR2::Impact_P);
	snprintf(buffer, elcount(buffer), "   0.000000 F1 EIS::ORC_Impact_AR2::Impact_P = %d\n", intval);
	filePutString (buffer, elcount(buffer), hFile);
	intval = getSignal(CHASSIS::ORC_Impact_AR2::Impact_Q);
	snprintf(buffer, elcount(buffer), "   0.000000 F1 EIS::ORC_Impact_AR2::Impact_Q = %d\n", intval);
	filePutString (buffer, elcount(buffer), hFile);
	intval = getSignal(CHASSIS::ORC_Impact_AR2::Impact_R);
	snprintf(buffer, elcount(buffer), "   0.000000 F1 EIS::ORC_Impact_AR2::Impact_R = %d\n", intval);
	filePutString (buffer, elcount(buffer), hFile);
	intval = getSignal(CHASSIS::ORC_Impact_AR2::Impact_S);
	snprintf(buffer, elcount(buffer), "   0.000000 F1 EIS::ORC_Impact_AR2::Impact_S = %d\n", intval);
	filePutString (buffer, elcount(buffer), hFile);
	intval = getSignal(CHASSIS::ORC_Impact_AR2::Impact_A);
	snprintf(buffer, elcount(buffer), "   0.000000 F1 EIS::ORC_Impact_AR2::Impact_A = %d\n", intval);
	filePutString (buffer, elcount(buffer), hFile);
	intval = getSignal(CHASSIS::ORC_Impact_AR2::Impact_B);
	snprintf(buffer, elcount(buffer), "   0.000000 F1 EIS::ORC_Impact_AR2::Impact_B = %d\n", intval);
	filePutString (buffer, elcount(buffer), hFile);
	intval = getSignal(CHASSIS::ORC_Impact_AR2::Impact_C);
	snprintf(buffer, elcount(buffer), "   0.000000 F1 EIS::ORC_Impact_AR2::Impact_C = %d\n", intval);
	filePutString (buffer, elcount(buffer), hFile);
	intval = getSignal(CHASSIS::ORC_Impact_AR2::Impact_D);
	snprintf(buffer, elcount(buffer), "   0.000000 F1 EIS::ORC_Impact_AR2::Impact_D = %d\n", intval);
	filePutString (buffer, elcount(buffer), hFile);
	intval = getSignal(CHASSIS::ORC_Impact_AR2::Impact_E);
	snprintf(buffer, elcount(buffer), "   0.000000 F1 EIS::ORC_Impact_AR2::Impact_E = %d\n", intval);
	filePutString (buffer, elcount(buffer), hFile);
	intval = getSignal(CHASSIS::ORC_Impact_AR2::Impact_F);
	snprintf(buffer, elcount(buffer), "   0.000000 F1 EIS::ORC_Impact_AR2::Impact_F = %d\n", intval);
	filePutString (buffer, elcount(buffer), hFile);
	intval = getSignal(CHASSIS::ORC_Impact_AR2::Impact_G);
	snprintf(buffer, elcount(buffer), "   0.000000 F1 EIS::ORC_Impact_AR2::Impact_G = %d\n", intval);
	filePutString (buffer, elcount(buffer), hFile);
	intval = getSignal(CHASSIS::ORC_Impact_AR2::Impact_H);
	snprintf(buffer, elcount(buffer), "   0.000000 F1 EIS::ORC_Impact_AR2::Impact_H = %d\n", intval);
	filePutString (buffer, elcount(buffer), hFile);
	intval = getSignal(CHASSIS::ORC_Impact_AR2::Impact_I);
	snprintf(buffer, elcount(buffer), "   0.000000 F1 EIS::ORC_Impact_AR2::Impact_I = %d\n", intval);
	filePutString (buffer, elcount(buffer), hFile);
	intval = getSignal(CHASSIS::ORC_Impact_AR2::Impact_K);
	snprintf(buffer, elcount(buffer), "   0.000000 F1 EIS::ORC_Impact_AR2::Impact_K = %d\n", intval);
	filePutString (buffer, elcount(buffer), hFile);
	intval = getSignal(CHASSIS::ORC_Impact_AR2::Impact_L);
	snprintf(buffer, elcount(buffer), "   0.000000 F1 EIS::ORC_Impact_AR2::Impact_L = %d\n", intval);
	filePutString (buffer, elcount(buffer), hFile);
	intval = getSignal(CHASSIS::ORC_Impact_AR2::Impact_M);
	snprintf(buffer, elcount(buffer), "   0.000000 F1 EIS::ORC_Impact_AR2::Impact_M = %d\n", intval);
	filePutString (buffer, elcount(buffer), hFile);
	intval = getSignal(CHASSIS::ORC_Impact_AR2::Impact_T);
	snprintf(buffer, elcount(buffer), "   0.000000 F1 EIS::ORC_Impact_AR2::Impact_T = %d\n", intval);
	filePutString (buffer, elcount(buffer), hFile);
	intval = getSignal(CHASSIS::ORC_Impact_AR2::Impact_U);
	snprintf(buffer, elcount(buffer), "   0.000000 F1 EIS::ORC_Impact_AR2::Impact_U = %d\n", intval);
	filePutString (buffer, elcount(buffer), hFile);
	intval = getSignal(CHASSIS::ORC_Impact_AR2::Rsrv1_Impact_Pr2);
	snprintf(buffer, elcount(buffer), "   0.000000 F1 EIS::ORC_Impact_AR2::Rsrv1_Impact_Pr2 = %d\n", intval);
	filePutString (buffer, elcount(buffer), hFile);
	intval = getSignal(CHASSIS::ORC_Impact_AR2::Rsrv2_Impact_Pr2);
	snprintf(buffer, elcount(buffer), "   0.000000 F1 EIS::ORC_Impact_AR2::Rsrv2_Impact_Pr2 = %d\n", intval);
	filePutString (buffer, elcount(buffer), hFile);
	intval = getSignal(CHASSIS::ORC_Impact_AR2::SADR_TrgrTm_ORC);
	snprintf(buffer, elcount(buffer), "   0.000000 F1 EIS::ORC_Impact_AR2::SADR_TrgrTm_ORC = %d\n", intval);
	filePutString (buffer, elcount(buffer), hFile);
	intval = getSignal(CHASSIS::ORC_Impact_AR2::Rsrv3_Impact_Pr2);
	snprintf(buffer, elcount(buffer), "   0.000000 F1 EIS::ORC_Impact_AR2::Rsrv3_Impact_Pr2 = %d\n", intval);
	filePutString (buffer, elcount(buffer), hFile);
	intval = getSignal(CHASSIS::ORC_Impact_AR2::SADR_TrgrPrio_ORC);
	snprintf(buffer, elcount(buffer), "   0.000000 F1 EIS::ORC_Impact_AR2::SADR_TrgrPrio_ORC = %d\n", intval);
	filePutString (buffer, elcount(buffer), hFile);
	intval = getSignal(CHASSIS::ORC_Impact_AR2::Rsrv4_Impact_Pr2);
	snprintf(buffer, elcount(buffer), "   0.000000 F1 EIS::ORC_Impact_AR2::Rsrv4_Impact_Pr2 = %d\n", intval);
	filePutString (buffer, elcount(buffer), hFile);
	intval = getSignal(CHASSIS::Park_Disp_Rs_AR2::Park_IconDisp_Rs);
	snprintf(buffer, elcount(buffer), "   0.000000 F1 EIS::Park_Disp_Rs_AR2::Park_IconDisp_Rs = %d\n", intval);
	filePutString (buffer, elcount(buffer), hFile);
	intval = getSignal(CHASSIS::Park_Disp_Rs_AR2::Park_IconDisp_Stat_IC);
	snprintf(buffer, elcount(buffer), "   0.000000 F1 EIS::Park_Disp_Rs_AR2::Park_IconDisp_Stat_IC = %d\n", intval);
	filePutString (buffer, elcount(buffer), hFile);
	intval = getSignal(CHASSIS::Park_Disp_Rs_AR2::Park_Warn1_Disp_Rs);
	snprintf(buffer, elcount(buffer), "   0.000000 F1 EIS::Park_Disp_Rs_AR2::Park_Warn1_Disp_Rs = %d\n", intval);
	filePutString (buffer, elcount(buffer), hFile);
	intval = getSignal(CHASSIS::Park_Disp_Rs_AR2::Park_Warn1_Disp_Stat_IC);
	snprintf(buffer, elcount(buffer), "   0.000000 F1 EIS::Park_Disp_Rs_AR2::Park_Warn1_Disp_Stat_IC = %d\n", intval);
	filePutString (buffer, elcount(buffer), hFile);
	intval = getSignal(CHASSIS::Park_Disp_Rs_AR2::IC_Err_Stat);
	snprintf(buffer, elcount(buffer), "   0.000000 F1 EIS::Park_Disp_Rs_AR2::IC_Err_Stat = %d\n", intval);
	filePutString (buffer, elcount(buffer), hFile);
	intval = getSignal(CHASSIS::Park_Disp_Rs_AR2::IC_Func_Stat);
	snprintf(buffer, elcount(buffer), "   0.000000 F1 EIS::Park_Disp_Rs_AR2::IC_Func_Stat = %d\n", intval);
	filePutString (buffer, elcount(buffer), hFile);
	intval = @sysvar::CH_Nodes::CH_EISCRC_PHB_IHC_Plus_Tunn_AUTO;
	snprintf(buffer, elcount(buffer), "   0.000000    SV: 2 0 0 ::CH_Nodes::CH_EISCRC_PHB_IHC_Plus_Tunn_AUTO = %d\n", intval);
	filePutString (buffer, elcount(buffer), hFile);
	intval = getSignal(CHASSIS::PHB_IHC_Plus_Tunnel_3_4_AR2::CRC_PHB_IHC_Plus_Tunnel_3_4_Pr2);
	snprintf(buffer, elcount(buffer), "   0.000000 F1 EIS::PHB_IHC_Plus_Tunnel_3_4_AR2::CRC_PHB_IHC_Plus_Tunnel_3_4_Pr2 = %d\n", intval);
	filePutString (buffer, elcount(buffer), hFile);
	intval = @sysvar::CH_Nodes::CH_EISSQC_PHB_IHC_Plus_Tunn_AUTO;
	snprintf(buffer, elcount(buffer), "   0.000000    SV: 2 0 0 ::CH_Nodes::CH_EISSQC_PHB_IHC_Plus_Tunn_AUTO = %d\n", intval);
	filePutString (buffer, elcount(buffer), hFile);
	intval = getSignal(CHASSIS::PHB_IHC_Plus_Tunnel_3_4_AR2::SQC_PHB_IHC_Plus_Tunnel_3_4_Pr2);
	snprintf(buffer, elcount(buffer), "   0.000000 F1 EIS::PHB_IHC_Plus_Tunnel_3_4_AR2::SQC_PHB_IHC_Plus_Tunnel_3_4_Pr2 = %d\n", intval);
	filePutString (buffer, elcount(buffer), hFile);
	intval = getSignal(CHASSIS::PHB_IHC_Plus_Tunnel_3_4_AR2::PHB_IHC_Tunnel3_Stat);
	snprintf(buffer, elcount(buffer), "   0.000000 F1 EIS::PHB_IHC_Plus_Tunnel_3_4_AR2::PHB_IHC_Tunnel3_Stat = %d\n", intval);
	filePutString (buffer, elcount(buffer), hFile);
	intval = getSignal(CHASSIS::PHB_IHC_Plus_Tunnel_3_4_AR2::PHB_IHC_Tunnel4_Stat);
	snprintf(buffer, elcount(buffer), "   0.000000 F1 EIS::PHB_IHC_Plus_Tunnel_3_4_AR2::PHB_IHC_Tunnel4_Stat = %d\n", intval);
	filePutString (buffer, elcount(buffer), hFile);
	floatval = getSignal(CHASSIS::PHB_IHC_Plus_Tunnel_3_4_AR2::PHB_IHC_Tunnel3_AnglLmt_Lt);
	snprintf(buffer, elcount(buffer), "   0.000000 F1 EIS::PHB_IHC_Plus_Tunnel_3_4_AR2::PHB_IHC_Tunnel3_AnglLmt_Lt = %f\n", floatval);
	filePutString (buffer, elcount(buffer), hFile);
	intval = getSignal(CHASSIS::PHB_IHC_Plus_Tunnel_3_4_AR2::PHB_IHC_Tunnel3_AnglLmt_Vert);
	snprintf(buffer, elcount(buffer), "   0.000000 F1 EIS::PHB_IHC_Plus_Tunnel_3_4_AR2::PHB_IHC_Tunnel3_AnglLmt_Vert = %d\n", intval);
	filePutString (buffer, elcount(buffer), hFile);
	intval = getSignal(CHASSIS::PHB_IHC_Plus_Tunnel_3_4_AR2::PHB_IHC_Tunnel3_ChgovrSpd);
	snprintf(buffer, elcount(buffer), "   0.000000 F1 EIS::PHB_IHC_Plus_Tunnel_3_4_AR2::PHB_IHC_Tunnel3_ChgovrSpd = %d\n", intval);
	filePutString (buffer, elcount(buffer), hFile);
	floatval = getSignal(CHASSIS::PHB_IHC_Plus_Tunnel_3_4_AR2::PHB_IHC_Tunnel3_AnglLmt_Rt);
	snprintf(buffer, elcount(buffer), "   0.000000 F1 EIS::PHB_IHC_Plus_Tunnel_3_4_AR2::PHB_IHC_Tunnel3_AnglLmt_Rt = %f\n", floatval);
	filePutString (buffer, elcount(buffer), hFile);
	floatval = getSignal(CHASSIS::PHB_IHC_Plus_Tunnel_3_4_AR2::PHB_IHC_Tunnel4_AnglLmt_Lt);
	snprintf(buffer, elcount(buffer), "   0.000000 F1 EIS::PHB_IHC_Plus_Tunnel_3_4_AR2::PHB_IHC_Tunnel4_AnglLmt_Lt = %f\n", floatval);
	filePutString (buffer, elcount(buffer), hFile);
	intval = getSignal(CHASSIS::PHB_IHC_Plus_Tunnel_3_4_AR2::PHB_IHC_Tunnel4_AnglLmt_Vert);
	snprintf(buffer, elcount(buffer), "   0.000000 F1 EIS::PHB_IHC_Plus_Tunnel_3_4_AR2::PHB_IHC_Tunnel4_AnglLmt_Vert = %d\n", intval);
	filePutString (buffer, elcount(buffer), hFile);
	intval = getSignal(CHASSIS::PHB_IHC_Plus_Tunnel_3_4_AR2::PHB_IHC_Tunnel4_ChgovrSpd);
	snprintf(buffer, elcount(buffer), "   0.000000 F1 EIS::PHB_IHC_Plus_Tunnel_3_4_AR2::PHB_IHC_Tunnel4_ChgovrSpd = %d\n", intval);
	filePutString (buffer, elcount(buffer), hFile);
	floatval = getSignal(CHASSIS::PHB_IHC_Plus_Tunnel_3_4_AR2::PHB_IHC_Tunnel4_AnglLmt_Rt);
	snprintf(buffer, elcount(buffer), "   0.000000 F1 EIS::PHB_IHC_Plus_Tunnel_3_4_AR2::PHB_IHC_Tunnel4_AnglLmt_Rt = %f\n", floatval);
	filePutString (buffer, elcount(buffer), hFile);
	intval = @sysvar::CH_Nodes::CH_EISCRC_PHB_IHC_Plus_Tunn_A_01;
	snprintf(buffer, elcount(buffer), "   0.000000    SV: 2 0 0 ::CH_Nodes::CH_EISCRC_PHB_IHC_Plus_Tunn_A_01 = %d\n", intval);
	filePutString (buffer, elcount(buffer), hFile);
	intval = getSignal(CHASSIS::PHB_IHC_Plus_Tunnel_AR2::CRC_PHB_IHC_Plus_Tunnel_Pr2);
	snprintf(buffer, elcount(buffer), "   0.000000 F1 EIS::PHB_IHC_Plus_Tunnel_AR2::CRC_PHB_IHC_Plus_Tunnel_Pr2 = %d\n", intval);
	filePutString (buffer, elcount(buffer), hFile);
	intval = @sysvar::CH_Nodes::CH_EISSQC_PHB_IHC_Plus_Tunn_A_01;
	snprintf(buffer, elcount(buffer), "   0.000000    SV: 2 0 0 ::CH_Nodes::CH_EISSQC_PHB_IHC_Plus_Tunn_A_01 = %d\n", intval);
	filePutString (buffer, elcount(buffer), hFile);
	intval = getSignal(CHASSIS::PHB_IHC_Plus_Tunnel_AR2::SQC_PHB_IHC_Plus_Tunnel_Pr2);
	snprintf(buffer, elcount(buffer), "   0.000000 F1 EIS::PHB_IHC_Plus_Tunnel_AR2::SQC_PHB_IHC_Plus_Tunnel_Pr2 = %d\n", intval);
	filePutString (buffer, elcount(buffer), hFile);
	intval = getSignal(CHASSIS::PHB_IHC_Plus_Tunnel_AR2::PHB_IHC_Tunnel1_Stat);
	snprintf(buffer, elcount(buffer), "   0.000000 F1 EIS::PHB_IHC_Plus_Tunnel_AR2::PHB_IHC_Tunnel1_Stat = %d\n", intval);
	filePutString (buffer, elcount(buffer), hFile);
	intval = getSignal(CHASSIS::PHB_IHC_Plus_Tunnel_AR2::PHB_IHC_Tunnel2_Stat);
	snprintf(buffer, elcount(buffer), "   0.000000 F1 EIS::PHB_IHC_Plus_Tunnel_AR2::PHB_IHC_Tunnel2_Stat = %d\n", intval);
	filePutString (buffer, elcount(buffer), hFile);
	floatval = getSignal(CHASSIS::PHB_IHC_Plus_Tunnel_AR2::PHB_IHC_Tunnel1_AnglLmt_Lt);
	snprintf(buffer, elcount(buffer), "   0.000000 F1 EIS::PHB_IHC_Plus_Tunnel_AR2::PHB_IHC_Tunnel1_AnglLmt_Lt = %f\n", floatval);
	filePutString (buffer, elcount(buffer), hFile);
	intval = getSignal(CHASSIS::PHB_IHC_Plus_Tunnel_AR2::PHB_IHC_Tunnel1_AnglLmt_Vert);
	snprintf(buffer, elcount(buffer), "   0.000000 F1 EIS::PHB_IHC_Plus_Tunnel_AR2::PHB_IHC_Tunnel1_AnglLmt_Vert = %d\n", intval);
	filePutString (buffer, elcount(buffer), hFile);
	intval = getSignal(CHASSIS::PHB_IHC_Plus_Tunnel_AR2::PHB_IHC_Tunnel1_ChgovrSpd);
	snprintf(buffer, elcount(buffer), "   0.000000 F1 EIS::PHB_IHC_Plus_Tunnel_AR2::PHB_IHC_Tunnel1_ChgovrSpd = %d\n", intval);
	filePutString (buffer, elcount(buffer), hFile);
}
/*@@end*/

/*@@caplFunc:saveVars_48(dword):*/
void saveVars_48(dword hFile)
{
	floatval = getSignal(CHASSIS::PHB_IHC_Plus_Tunnel_AR2::PHB_IHC_Tunnel1_AnglLmt_Rt);
	snprintf(buffer, elcount(buffer), "   0.000000 F1 EIS::PHB_IHC_Plus_Tunnel_AR2::PHB_IHC_Tunnel1_AnglLmt_Rt = %f\n", floatval);
	filePutString (buffer, elcount(buffer), hFile);
	floatval = getSignal(CHASSIS::PHB_IHC_Plus_Tunnel_AR2::PHB_IHC_Tunnel2_AnglLmt_Lt);
	snprintf(buffer, elcount(buffer), "   0.000000 F1 EIS::PHB_IHC_Plus_Tunnel_AR2::PHB_IHC_Tunnel2_AnglLmt_Lt = %f\n", floatval);
	filePutString (buffer, elcount(buffer), hFile);
	intval = getSignal(CHASSIS::PHB_IHC_Plus_Tunnel_AR2::PHB_IHC_Tunnel2_AnglLmt_Vert);
	snprintf(buffer, elcount(buffer), "   0.000000 F1 EIS::PHB_IHC_Plus_Tunnel_AR2::PHB_IHC_Tunnel2_AnglLmt_Vert = %d\n", intval);
	filePutString (buffer, elcount(buffer), hFile);
	intval = getSignal(CHASSIS::PHB_IHC_Plus_Tunnel_AR2::PHB_IHC_Tunnel2_ChgovrSpd);
	snprintf(buffer, elcount(buffer), "   0.000000 F1 EIS::PHB_IHC_Plus_Tunnel_AR2::PHB_IHC_Tunnel2_ChgovrSpd = %d\n", intval);
	filePutString (buffer, elcount(buffer), hFile);
	floatval = getSignal(CHASSIS::PHB_IHC_Plus_Tunnel_AR2::PHB_IHC_Tunnel2_AnglLmt_Rt);
	snprintf(buffer, elcount(buffer), "   0.000000 F1 EIS::PHB_IHC_Plus_Tunnel_AR2::PHB_IHC_Tunnel2_AnglLmt_Rt = %f\n", floatval);
	filePutString (buffer, elcount(buffer), hFile);
	intval = getSignal(CHASSIS::PN14_Disp_Rq_AR::PN14_Msg1_Disp_Rq);
	snprintf(buffer, elcount(buffer), "   0.000000 F1 EIS::PN14_Disp_Rq_AR::PN14_Msg1_Disp_Rq = %d\n", intval);
	filePutString (buffer, elcount(buffer), hFile);
	intval = getSignal(CHASSIS::PN14_Disp_Rq_AR::PN14_Msg2_Disp_Rq);
	snprintf(buffer, elcount(buffer), "   0.000000 F1 EIS::PN14_Disp_Rq_AR::PN14_Msg2_Disp_Rq = %d\n", intval);
	filePutString (buffer, elcount(buffer), hFile);
	intval = getSignal(CHASSIS::PN14_Disp_Rq_AR::PN14_Msg6_Disp_Rq);
	snprintf(buffer, elcount(buffer), "   0.000000 F1 EIS::PN14_Disp_Rq_AR::PN14_Msg6_Disp_Rq = %d\n", intval);
	filePutString (buffer, elcount(buffer), hFile);
	intval = getSignal(CHASSIS::PN14_Disp_Rq_AR::PN14_Msg7_Disp_Rq);
	snprintf(buffer, elcount(buffer), "   0.000000 F1 EIS::PN14_Disp_Rq_AR::PN14_Msg7_Disp_Rq = %d\n", intval);
	filePutString (buffer, elcount(buffer), hFile);
	intval = getSignal(CHASSIS::PN14_Disp_Rq_AR::PN14_Msg8_Disp_Rq);
	snprintf(buffer, elcount(buffer), "   0.000000 F1 EIS::PN14_Disp_Rq_AR::PN14_Msg8_Disp_Rq = %d\n", intval);
	filePutString (buffer, elcount(buffer), hFile);
	intval = getSignal(CHASSIS::PN14_Disp_Rq_AR::PN14_ProdMdDisp_Rq);
	snprintf(buffer, elcount(buffer), "   0.000000 F1 EIS::PN14_Disp_Rq_AR::PN14_ProdMdDisp_Rq = %d\n", intval);
	filePutString (buffer, elcount(buffer), hFile);
	intval = getSignal(CHASSIS::PN14_Disp_Rq_AR::PN14_EOL_Disp_Rq);
	snprintf(buffer, elcount(buffer), "   0.000000 F1 EIS::PN14_Disp_Rq_AR::PN14_EOL_Disp_Rq = %d\n", intval);
	filePutString (buffer, elcount(buffer), hFile);
	intval = getSignal(CHASSIS::PN14_Disp_Rq_AR::PN14_TransMdDisp_Rq);
	snprintf(buffer, elcount(buffer), "   0.000000 F1 EIS::PN14_Disp_Rq_AR::PN14_TransMdDisp_Rq = %d\n", intval);
	filePutString (buffer, elcount(buffer), hFile);
	intval = getSignal(CHASSIS::PN14_Disp_Rq_AR::PN14_TransMd_RemTm);
	snprintf(buffer, elcount(buffer), "   0.000000 F1 EIS::PN14_Disp_Rq_AR::PN14_TransMd_RemTm = %d\n", intval);
	filePutString (buffer, elcount(buffer), hFile);
	floatval = getSignal(CHASSIS::PN14_Disp_Rq_AR::PN14_SupBat_Curr_Extd);
	snprintf(buffer, elcount(buffer), "   0.000000 F1 EIS::PN14_Disp_Rq_AR::PN14_SupBat_Curr_Extd = %f\n", floatval);
	filePutString (buffer, elcount(buffer), hFile);
	floatval = getSignal(CHASSIS::PN14_Disp_Rq_AR::PN14_SupBat_Temp);
	snprintf(buffer, elcount(buffer), "   0.000000 F1 EIS::PN14_Disp_Rq_AR::PN14_SupBat_Temp = %f\n", floatval);
	filePutString (buffer, elcount(buffer), hFile);
	intval = getSignal(CHASSIS::PN14_Disp_Rq_AR::PN14_SupBat_State);
	snprintf(buffer, elcount(buffer), "   0.000000 F1 EIS::PN14_Disp_Rq_AR::PN14_SupBat_State = %d\n", intval);
	filePutString (buffer, elcount(buffer), hFile);
	intval = @sysvar::CH_Nodes::CH_EISCRC_PN14_Rs1_Pr2PN14__AUTO;
	snprintf(buffer, elcount(buffer), "   0.000000    SV: 2 0 0 ::CH_Nodes::CH_EISCRC_PN14_Rs1_Pr2PN14__AUTO = %d\n", intval);
	filePutString (buffer, elcount(buffer), hFile);
	intval = getSignal(CHASSIS::PN14_Rs1_AR2::CRC_PN14_Rs1_Pr2);
	snprintf(buffer, elcount(buffer), "   0.000000 F1 EIS::PN14_Rs1_AR2::CRC_PN14_Rs1_Pr2 = %d\n", intval);
	filePutString (buffer, elcount(buffer), hFile);
	intval = @sysvar::CH_Nodes::CH_EISSQC_PN14_Rs1_Pr2PN14__AUTO;
	snprintf(buffer, elcount(buffer), "   0.000000    SV: 2 0 0 ::CH_Nodes::CH_EISSQC_PN14_Rs1_Pr2PN14__AUTO = %d\n", intval);
	filePutString (buffer, elcount(buffer), hFile);
	intval = getSignal(CHASSIS::PN14_Rs1_AR2::SQC_PN14_Rs1_Pr2);
	snprintf(buffer, elcount(buffer), "   0.000000 F1 EIS::PN14_Rs1_AR2::SQC_PN14_Rs1_Pr2 = %d\n", intval);
	filePutString (buffer, elcount(buffer), hFile);
	intval = getSignal(CHASSIS::PN14_Rs1_AR2::PN14_GM1_Avl);
	snprintf(buffer, elcount(buffer), "   0.000000 F1 EIS::PN14_Rs1_AR2::PN14_GM1_Avl = %d\n", intval);
	filePutString (buffer, elcount(buffer), hFile);
	intval = getSignal(CHASSIS::PN14_Rs1_AR2::PN14_GM1_Actv);
	snprintf(buffer, elcount(buffer), "   0.000000 F1 EIS::PN14_Rs1_AR2::PN14_GM1_Actv = %d\n", intval);
	filePutString (buffer, elcount(buffer), hFile);
	intval = getSignal(CHASSIS::PN14_Rs1_AR2::PN14_GenLoadMin_Rq);
	snprintf(buffer, elcount(buffer), "   0.000000 F1 EIS::PN14_Rs1_AR2::PN14_GenLoadMin_Rq = %d\n", intval);
	filePutString (buffer, elcount(buffer), hFile);
	intval = getSignal(CHASSIS::PN14_Rs1_AR2::PN14_PrioLmt_Rch);
	snprintf(buffer, elcount(buffer), "   0.000000 F1 EIS::PN14_Rs1_AR2::PN14_PrioLmt_Rch = %d\n", intval);
	filePutString (buffer, elcount(buffer), hFile);
	floatval = getSignal(CHASSIS::PN14_Rs1_AR2::PN14_ChrgVolt_Rq);
	snprintf(buffer, elcount(buffer), "   0.000000 F1 EIS::PN14_Rs1_AR2::PN14_ChrgVolt_Rq = %f\n", floatval);
	filePutString (buffer, elcount(buffer), hFile);
	intval = getSignal(CHASSIS::PN14_Rs1_AR2::PN14_EngIdleRPM_Lvl_Rq);
	snprintf(buffer, elcount(buffer), "   0.000000 F1 EIS::PN14_Rs1_AR2::PN14_EngIdleRPM_Lvl_Rq = %d\n", intval);
	filePutString (buffer, elcount(buffer), hFile);
	intval = getSignal(CHASSIS::PN14_Rs1_AR2::SSA_Dsabl_Rq_PN14);
	snprintf(buffer, elcount(buffer), "   0.000000 F1 EIS::PN14_Rs1_AR2::SSA_Dsabl_Rq_PN14 = %d\n", intval);
	filePutString (buffer, elcount(buffer), hFile);
	intval = getSignal(CHASSIS::PN14_Rs1_AR2::Rsrv1_PN14_Rs1_Pr2);
	snprintf(buffer, elcount(buffer), "   0.000000 F1 EIS::PN14_Rs1_AR2::Rsrv1_PN14_Rs1_Pr2 = %d\n", intval);
	filePutString (buffer, elcount(buffer), hFile);
	floatval = getSignal(CHASSIS::PN14_Rs1_AR2::PN14_StartVolt_Min);
	snprintf(buffer, elcount(buffer), "   0.000000 F1 EIS::PN14_Rs1_AR2::PN14_StartVolt_Min = %f\n", floatval);
	filePutString (buffer, elcount(buffer), hFile);
	intval = getSignal(CHASSIS::PN14_Rs1_AR2::Rsrv2_PN14_Rs1_Pr2);
	snprintf(buffer, elcount(buffer), "   0.000000 F1 EIS::PN14_Rs1_AR2::Rsrv2_PN14_Rs1_Pr2 = %d\n", intval);
	filePutString (buffer, elcount(buffer), hFile);
	intval = getSignal(CHASSIS::PN14_Rs1_AR2::Rsrv3_PN14_Rs1_Pr2);
	snprintf(buffer, elcount(buffer), "   0.000000 F1 EIS::PN14_Rs1_AR2::Rsrv3_PN14_Rs1_Pr2 = %d\n", intval);
	filePutString (buffer, elcount(buffer), hFile);
	intval = getSignal(CHASSIS::PN14_Rs1_AR2::Rsrv4_PN14_Rs1_Pr2);
	snprintf(buffer, elcount(buffer), "   0.000000 F1 EIS::PN14_Rs1_AR2::Rsrv4_PN14_Rs1_Pr2 = %d\n", intval);
	filePutString (buffer, elcount(buffer), hFile);
	floatval = getSignal(CHASSIS::PN14_Rs2_AR::PN14_SupBat_VoltHP);
	snprintf(buffer, elcount(buffer), "   0.000000 F1 EIS::PN14_Rs2_AR::PN14_SupBat_VoltHP = %f\n", floatval);
	filePutString (buffer, elcount(buffer), hFile);
	intval = getSignal(CHASSIS::PN14_Rs2_AR::PN14_LHC_Lvl);
	snprintf(buffer, elcount(buffer), "   0.000000 F1 EIS::PN14_Rs2_AR::PN14_LHC_Lvl = %d\n", intval);
	filePutString (buffer, elcount(buffer), hFile);
	intval = getSignal(CHASSIS::PN14_Rs2_AR::PN14_BackupBat_Flt);
	snprintf(buffer, elcount(buffer), "   0.000000 F1 EIS::PN14_Rs2_AR::PN14_BackupBat_Flt = %d\n", intval);
	filePutString (buffer, elcount(buffer), hFile);
	floatval = getSignal(CHASSIS::PN14_Rs2_AR::PN14_RecupVolt_Max);
	snprintf(buffer, elcount(buffer), "   0.000000 F1 EIS::PN14_Rs2_AR::PN14_RecupVolt_Max = %f\n", floatval);
	filePutString (buffer, elcount(buffer), hFile);
	intval = getSignal(CHASSIS::PN14_Rs2_AR::PN14_BackupRelay_Rq);
	snprintf(buffer, elcount(buffer), "   0.000000 F1 EIS::PN14_Rs2_AR::PN14_BackupRelay_Rq = %d\n", intval);
	filePutString (buffer, elcount(buffer), hFile);
	intval = getSignal(CHASSIS::PN14_Rs2_AR::PN14_DecoupleRelay_Rq);
	snprintf(buffer, elcount(buffer), "   0.000000 F1 EIS::PN14_Rs2_AR::PN14_DecoupleRelay_Rq = %d\n", intval);
	filePutString (buffer, elcount(buffer), hFile);
	intval = getSignal(CHASSIS::PN14_Rs2_AR::PN14_EU5_Lk_Stat);
	snprintf(buffer, elcount(buffer), "   0.000000 F1 EIS::PN14_Rs2_AR::PN14_EU5_Lk_Stat = %d\n", intval);
	filePutString (buffer, elcount(buffer), hFile);
	floatval = getSignal(CHASSIS::PN14_Rs2_AR::PN14_LmtVolt_Max);
	snprintf(buffer, elcount(buffer), "   0.000000 F1 EIS::PN14_Rs2_AR::PN14_LmtVolt_Max = %f\n", floatval);
	filePutString (buffer, elcount(buffer), hFile);
	intval = getSignal(CHASSIS::PN14_Rs2_AR::SPCR_Flt_PN14);
	snprintf(buffer, elcount(buffer), "   0.000000 F1 EIS::PN14_Rs2_AR::SPCR_Flt_PN14 = %d\n", intval);
	filePutString (buffer, elcount(buffer), hFile);
	intval = getSignal(CHASSIS::PN14_Rs2_AR::PN14_AS_Off_Rq);
	snprintf(buffer, elcount(buffer), "   0.000000 F1 EIS::PN14_Rs2_AR::PN14_AS_Off_Rq = %d\n", intval);
	filePutString (buffer, elcount(buffer), hFile);
	intval = getSignal(CHASSIS::PN14_Rs2_AR::PN14_DCDC_BuckMd_Rq);
	snprintf(buffer, elcount(buffer), "   0.000000 F1 EIS::PN14_Rs2_AR::PN14_DCDC_BuckMd_Rq = %d\n", intval);
	filePutString (buffer, elcount(buffer), hFile);
	intval = getSignal(CHASSIS::PN14_Rs2_AR::PN14_DCDC_BoostMd_Dsabl_Rq);
	snprintf(buffer, elcount(buffer), "   0.000000 F1 EIS::PN14_Rs2_AR::PN14_DCDC_BoostMd_Dsabl_Rq = %d\n", intval);
	filePutString (buffer, elcount(buffer), hFile);
	intval = getSignal(CHASSIS::PN14_Rs2_AR::PN14_ProdMd_Stat);
	snprintf(buffer, elcount(buffer), "   0.000000 F1 EIS::PN14_Rs2_AR::PN14_ProdMd_Stat = %d\n", intval);
	filePutString (buffer, elcount(buffer), hFile);
	intval = getSignal(CHASSIS::PN14_Rs2_AR::PNM_CALID_CVN_ErrNum);
	snprintf(buffer, elcount(buffer), "   0.000000 F1 EIS::PN14_Rs2_AR::PNM_CALID_CVN_ErrNum = %d\n", intval);
	filePutString (buffer, elcount(buffer), hFile);
	intval = getSignal(CHASSIS::PN14_Rs2_AR::PNM_ErrChk_Stat1);
	snprintf(buffer, elcount(buffer), "   0.000000 F1 EIS::PN14_Rs2_AR::PNM_ErrChk_Stat1 = %d\n", intval);
	filePutString (buffer, elcount(buffer), hFile);
	intval = getSignal(CHASSIS::PN14_Rs2_AR::PNM_ErrChk_Stat2);
	snprintf(buffer, elcount(buffer), "   0.000000 F1 EIS::PN14_Rs2_AR::PNM_ErrChk_Stat2 = %d\n", intval);
	filePutString (buffer, elcount(buffer), hFile);
	intval = getSignal(CHASSIS::PN14_Rs2_AR::PN14_Bat_Type);
	snprintf(buffer, elcount(buffer), "   0.000000 F1 EIS::PN14_Rs2_AR::PN14_Bat_Type = %d\n", intval);
	filePutString (buffer, elcount(buffer), hFile);
	intval = getSignal(CHASSIS::PN14_Stat2_AR2::PN14_SolVent_Pwr_Max);
	snprintf(buffer, elcount(buffer), "   0.000000 F1 EIS::PN14_Stat2_AR2::PN14_SolVent_Pwr_Max = %d\n", intval);
	filePutString (buffer, elcount(buffer), hFile);
	intval = getSignal(CHASSIS::PN14_Stat2_AR2::PN14_SolVent_Enbl);
	snprintf(buffer, elcount(buffer), "   0.000000 F1 EIS::PN14_Stat2_AR2::PN14_SolVent_Enbl = %d\n", intval);
	filePutString (buffer, elcount(buffer), hFile);
	intval = getSignal(CHASSIS::PN14_Stat2_AR2::PN14_SolVent_Updt_Rq);
	snprintf(buffer, elcount(buffer), "   0.000000 F1 EIS::PN14_Stat2_AR2::PN14_SolVent_Updt_Rq = %d\n", intval);
	filePutString (buffer, elcount(buffer), hFile);
}
/*@@end*/

/*@@caplFunc:saveVars_49(dword):*/
void saveVars_49(dword hFile)
{
	intval = getSignal(CHASSIS::PN14_Stat2_AR2::PN14_Hibern_Md_Flt);
	snprintf(buffer, elcount(buffer), "   0.000000 F1 EIS::PN14_Stat2_AR2::PN14_Hibern_Md_Flt = %d\n", intval);
	filePutString (buffer, elcount(buffer), hFile);
	intval = getSignal(CHASSIS::PN14_Stat2_AR2::PN14_TDP_Sw_Stat);
	snprintf(buffer, elcount(buffer), "   0.000000 F1 EIS::PN14_Stat2_AR2::PN14_TDP_Sw_Stat = %d\n", intval);
	filePutString (buffer, elcount(buffer), hFile);
	intval = getSignal(CHASSIS::PN14_Stat2_AR2::PN14_TDP_PreWarn_Tm);
	snprintf(buffer, elcount(buffer), "   0.000000 F1 EIS::PN14_Stat2_AR2::PN14_TDP_PreWarn_Tm = %d\n", intval);
	filePutString (buffer, elcount(buffer), hFile);
	intval = getSignal(CHASSIS::PN14_Stat2_AR2::PN14_RemSt_Bat_Stat);
	snprintf(buffer, elcount(buffer), "   0.000000 F1 EIS::PN14_Stat2_AR2::PN14_RemSt_Bat_Stat = %d\n", intval);
	filePutString (buffer, elcount(buffer), hFile);
	intval = getSignal(CHASSIS::PN14_Stat2_AR2::PN14_Hibern_Md_Stat);
	snprintf(buffer, elcount(buffer), "   0.000000 F1 EIS::PN14_Stat2_AR2::PN14_Hibern_Md_Stat = %d\n", intval);
	filePutString (buffer, elcount(buffer), hFile);
	intval = getSignal(CHASSIS::PN14_Stat2_AR2::PN14_Hibern_StdbyTm);
	snprintf(buffer, elcount(buffer), "   0.000000 F1 EIS::PN14_Stat2_AR2::PN14_Hibern_StdbyTm = %d\n", intval);
	filePutString (buffer, elcount(buffer), hFile);
	floatval = getSignal(CHASSIS::PN14_Stat2_AR2::IBS_Bat_Curr_Max);
	snprintf(buffer, elcount(buffer), "   0.000000 F1 EIS::PN14_Stat2_AR2::IBS_Bat_Curr_Max = %f\n", floatval);
	filePutString (buffer, elcount(buffer), hFile);
	intval = getSignal(CHASSIS::PN14_Stat2_AR2::PN14_CycleIndex);
	snprintf(buffer, elcount(buffer), "   0.000000 F1 EIS::PN14_Stat2_AR2::PN14_CycleIndex = %d\n", intval);
	filePutString (buffer, elcount(buffer), hFile);
	floatval = getSignal(CHASSIS::PN14_Stat_AR::PN14_SupBat_Volt);
	snprintf(buffer, elcount(buffer), "   0.000000 F1 EIS::PN14_Stat_AR::PN14_SupBat_Volt = %f\n", floatval);
	filePutString (buffer, elcount(buffer), hFile);
	floatval = getSignal(CHASSIS::PN14_Stat_AR::PN14_SupBat_Curr);
	snprintf(buffer, elcount(buffer), "   0.000000 F1 EIS::PN14_Stat_AR::PN14_SupBat_Curr = %f\n", floatval);
	filePutString (buffer, elcount(buffer), hFile);
	intval = getSignal(CHASSIS::PN14_Stat_AR::PN14_SupBatCutSw_Stat);
	snprintf(buffer, elcount(buffer), "   0.000000 F1 EIS::PN14_Stat_AR::PN14_SupBatCutSw_Stat = %d\n", intval);
	filePutString (buffer, elcount(buffer), hFile);
	intval = getSignal(CHASSIS::PN14_Stat_AR::SSA_EngRestart_Actv);
	snprintf(buffer, elcount(buffer), "   0.000000 F1 EIS::PN14_Stat_AR::SSA_EngRestart_Actv = %d\n", intval);
	filePutString (buffer, elcount(buffer), hFile);
	intval = getSignal(CHASSIS::PN14_Stat_AR::PN14_TransMd_Updt_Rq);
	snprintf(buffer, elcount(buffer), "   0.000000 F1 EIS::PN14_Stat_AR::PN14_TransMd_Updt_Rq = %d\n", intval);
	filePutString (buffer, elcount(buffer), hFile);
	intval = getSignal(CHASSIS::PN14_Stat_AR::DPM_MdLmt_Rq);
	snprintf(buffer, elcount(buffer), "   0.000000 F1 EIS::PN14_Stat_AR::DPM_MdLmt_Rq = %d\n", intval);
	filePutString (buffer, elcount(buffer), hFile);
	intval = getSignal(CHASSIS::PN14_Stat_AR::DPM_ExtMd_Enbl_Rq);
	snprintf(buffer, elcount(buffer), "   0.000000 F1 EIS::PN14_Stat_AR::DPM_ExtMd_Enbl_Rq = %d\n", intval);
	filePutString (buffer, elcount(buffer), hFile);
	intval = getSignal(CHASSIS::PN14_Stat_AR::PN14_TransMd_Stat);
	snprintf(buffer, elcount(buffer), "   0.000000 F1 EIS::PN14_Stat_AR::PN14_TransMd_Stat = %d\n", intval);
	filePutString (buffer, elcount(buffer), hFile);
	intval = getSignal(CHASSIS::PN14_Stat_AR::PN14_eHeV_Enbl);
	snprintf(buffer, elcount(buffer), "   0.000000 F1 EIS::PN14_Stat_AR::PN14_eHeV_Enbl = %d\n", intval);
	filePutString (buffer, elcount(buffer), hFile);
	intval = getSignal(CHASSIS::PN14_Stat_AR::PN14_LHC_Actv);
	snprintf(buffer, elcount(buffer), "   0.000000 F1 EIS::PN14_Stat_AR::PN14_LHC_Actv = %d\n", intval);
	filePutString (buffer, elcount(buffer), hFile);
	intval = getSignal(CHASSIS::PN14_Stat_AR::LHC_Tlm_Rq);
	snprintf(buffer, elcount(buffer), "   0.000000 F1 EIS::PN14_Stat_AR::LHC_Tlm_Rq = %d\n", intval);
	filePutString (buffer, elcount(buffer), hFile);
	intval = getSignal(CHASSIS::PN14_Stat_AR::LHC_PTC6_Rq);
	snprintf(buffer, elcount(buffer), "   0.000000 F1 EIS::PN14_Stat_AR::LHC_PTC6_Rq = %d\n", intval);
	filePutString (buffer, elcount(buffer), hFile);
	intval = getSignal(CHASSIS::PN14_Stat_AR::LHC_PTC5_Rq);
	snprintf(buffer, elcount(buffer), "   0.000000 F1 EIS::PN14_Stat_AR::LHC_PTC5_Rq = %d\n", intval);
	filePutString (buffer, elcount(buffer), hFile);
	intval = getSignal(CHASSIS::PN14_Stat_AR::LHC_PTC4_Rq);
	snprintf(buffer, elcount(buffer), "   0.000000 F1 EIS::PN14_Stat_AR::LHC_PTC4_Rq = %d\n", intval);
	filePutString (buffer, elcount(buffer), hFile);
	intval = getSignal(CHASSIS::PN14_Stat_AR::LHC_PTC3_Rq);
	snprintf(buffer, elcount(buffer), "   0.000000 F1 EIS::PN14_Stat_AR::LHC_PTC3_Rq = %d\n", intval);
	filePutString (buffer, elcount(buffer), hFile);
	intval = getSignal(CHASSIS::PN14_Stat_AR::LHC_PTC2_Rq);
	snprintf(buffer, elcount(buffer), "   0.000000 F1 EIS::PN14_Stat_AR::LHC_PTC2_Rq = %d\n", intval);
	filePutString (buffer, elcount(buffer), hFile);
	intval = getSignal(CHASSIS::PN14_Stat_AR::LHC_PTC1_Rq);
	snprintf(buffer, elcount(buffer), "   0.000000 F1 EIS::PN14_Stat_AR::LHC_PTC1_Rq = %d\n", intval);
	filePutString (buffer, elcount(buffer), hFile);
	intval = getSignal(CHASSIS::PN14_Stat_AR::LHC_EngFan_50_Rq);
	snprintf(buffer, elcount(buffer), "   0.000000 F1 EIS::PN14_Stat_AR::LHC_EngFan_50_Rq = %d\n", intval);
	filePutString (buffer, elcount(buffer), hFile);
	intval = getSignal(CHASSIS::PN14_Stat_AR::LHC_SeatHtStg3_Rq);
	snprintf(buffer, elcount(buffer), "   0.000000 F1 EIS::PN14_Stat_AR::LHC_SeatHtStg3_Rq = %d\n", intval);
	filePutString (buffer, elcount(buffer), hFile);
	intval = getSignal(CHASSIS::PN14_Stat_AR::LHC_SeatHtStg2_Rq);
	snprintf(buffer, elcount(buffer), "   0.000000 F1 EIS::PN14_Stat_AR::LHC_SeatHtStg2_Rq = %d\n", intval);
	filePutString (buffer, elcount(buffer), hFile);
	intval = getSignal(CHASSIS::PN14_Stat_AR::LHC_SeatHtStg1_Rq);
	snprintf(buffer, elcount(buffer), "   0.000000 F1 EIS::PN14_Stat_AR::LHC_SeatHtStg1_Rq = %d\n", intval);
	filePutString (buffer, elcount(buffer), hFile);
	intval = getSignal(CHASSIS::PN14_Stat_AR::LHC_SeatVn_Rq);
	snprintf(buffer, elcount(buffer), "   0.000000 F1 EIS::PN14_Stat_AR::LHC_SeatVn_Rq = %d\n", intval);
	filePutString (buffer, elcount(buffer), hFile);
	intval = getSignal(CHASSIS::PN14_Stat_AR::LHC_StW_Ht_Rq);
	snprintf(buffer, elcount(buffer), "   0.000000 F1 EIS::PN14_Stat_AR::LHC_StW_Ht_Rq = %d\n", intval);
	filePutString (buffer, elcount(buffer), hFile);
	intval = getSignal(CHASSIS::PN14_Stat_AR::LHC_WprPkHt_Rq);
	snprintf(buffer, elcount(buffer), "   0.000000 F1 EIS::PN14_Stat_AR::LHC_WprPkHt_Rq = %d\n", intval);
	filePutString (buffer, elcount(buffer), hFile);
	intval = getSignal(CHASSIS::PN14_Stat_AR::LHC_MirrHt_Rq);
	snprintf(buffer, elcount(buffer), "   0.000000 F1 EIS::PN14_Stat_AR::LHC_MirrHt_Rq = %d\n", intval);
	filePutString (buffer, elcount(buffer), hFile);
	intval = getSignal(CHASSIS::PN14_Stat_AR::LHC_EBL_Rq);
	snprintf(buffer, elcount(buffer), "   0.000000 F1 EIS::PN14_Stat_AR::LHC_EBL_Rq = %d\n", intval);
	filePutString (buffer, elcount(buffer), hFile);
	intval = getSignal(CHASSIS::PN14_Stat_AR::LHC_WShHt_Rq);
	snprintf(buffer, elcount(buffer), "   0.000000 F1 EIS::PN14_Stat_AR::LHC_WShHt_Rq = %d\n", intval);
	filePutString (buffer, elcount(buffer), hFile);
	intval = getSignal(CHASSIS::PN14_Stat_AR::LHC_Taxi_Rq);
	snprintf(buffer, elcount(buffer), "   0.000000 F1 EIS::PN14_Stat_AR::LHC_Taxi_Rq = %d\n", intval);
	filePutString (buffer, elcount(buffer), hFile);
	intval = getSignal(CHASSIS::PN14_Stat_AR::LHC_IntFan_F_50_Rq);
	snprintf(buffer, elcount(buffer), "   0.000000 F1 EIS::PN14_Stat_AR::LHC_IntFan_F_50_Rq = %d\n", intval);
	filePutString (buffer, elcount(buffer), hFile);
	intval = getSignal(CHASSIS::PN14_Stat_AR::LHC_IntFan_R_50_Rq);
	snprintf(buffer, elcount(buffer), "   0.000000 F1 EIS::PN14_Stat_AR::LHC_IntFan_R_50_Rq = %d\n", intval);
	filePutString (buffer, elcount(buffer), hFile);
	intval = getSignal(CHASSIS::PN14_Stat_AR::LHC_IntFan_R_0_Rq);
	snprintf(buffer, elcount(buffer), "   0.000000 F1 EIS::PN14_Stat_AR::LHC_IntFan_R_0_Rq = %d\n", intval);
	filePutString (buffer, elcount(buffer), hFile);
	intval = getSignal(CHASSIS::PN14_Stat_AR::LHC_RHU_Rq);
	snprintf(buffer, elcount(buffer), "   0.000000 F1 EIS::PN14_Stat_AR::LHC_RHU_Rq = %d\n", intval);
	filePutString (buffer, elcount(buffer), hFile);
	intval = getSignal(CHASSIS::PN14_Stat_AR::LHC_ICH_Rq);
	snprintf(buffer, elcount(buffer), "   0.000000 F1 EIS::PN14_Stat_AR::LHC_ICH_Rq = %d\n", intval);
	filePutString (buffer, elcount(buffer), hFile);
	intval = getSignal(CHASSIS::PN14_Stat_AR::LHC_CoolBox_R_Rq);
	snprintf(buffer, elcount(buffer), "   0.000000 F1 EIS::PN14_Stat_AR::LHC_CoolBox_R_Rq = %d\n", intval);
	filePutString (buffer, elcount(buffer), hFile);
	intval = getSignal(CHASSIS::PN14_Stat_AR::LHC_PkLmp_Rq);
	snprintf(buffer, elcount(buffer), "   0.000000 F1 EIS::PN14_Stat_AR::LHC_PkLmp_Rq = %d\n", intval);
	filePutString (buffer, elcount(buffer), hFile);
	intval = getSignal(CHASSIS::PN14_Stat_AR::LHC_PosnLmp_Rq);
	snprintf(buffer, elcount(buffer), "   0.000000 F1 EIS::PN14_Stat_AR::LHC_PosnLmp_Rq = %d\n", intval);
	filePutString (buffer, elcount(buffer), hFile);
	intval = getSignal(CHASSIS::PN14_Stat_AR::LHC_TrlrSock_Rq);
	snprintf(buffer, elcount(buffer), "   0.000000 F1 EIS::PN14_Stat_AR::LHC_TrlrSock_Rq = %d\n", intval);
	filePutString (buffer, elcount(buffer), hFile);
	intval = getSignal(CHASSIS::PN14_Stat_AR::LHC_TrkSock_Rq);
	snprintf(buffer, elcount(buffer), "   0.000000 F1 EIS::PN14_Stat_AR::LHC_TrkSock_Rq = %d\n", intval);
	filePutString (buffer, elcount(buffer), hFile);
	intval = getSignal(CHASSIS::PN14_Stat_AR::LHC_WShHt_50_Rq);
	snprintf(buffer, elcount(buffer), "   0.000000 F1 EIS::PN14_Stat_AR::LHC_WShHt_50_Rq = %d\n", intval);
	filePutString (buffer, elcount(buffer), hFile);
	intval = getSignal(CHASSIS::PN14_Stat_AR::LHC_PT_Stg1_Rq);
	snprintf(buffer, elcount(buffer), "   0.000000 F1 EIS::PN14_Stat_AR::LHC_PT_Stg1_Rq = %d\n", intval);
	filePutString (buffer, elcount(buffer), hFile);
	intval = getSignal(CHASSIS::PN14_Stat_AR::LHC_PT_Stg2_Rq);
	snprintf(buffer, elcount(buffer), "   0.000000 F1 EIS::PN14_Stat_AR::LHC_PT_Stg2_Rq = %d\n", intval);
	filePutString (buffer, elcount(buffer), hFile);
	floatval = getSignal(CHASSIS::PN48_Bat_Stat2_AR2::PN48_Bat_SPC_Volt_Min);
	snprintf(buffer, elcount(buffer), "   0.000000 F1 EIS::PN48_Bat_Stat2_AR2::PN48_Bat_SPC_Volt_Min = %f\n", floatval);
	filePutString (buffer, elcount(buffer), hFile);
	floatval = getSignal(CHASSIS::PN48_Bat_Stat2_AR2::PN48_Bat_SPC_RemCpcty_Estim);
	snprintf(buffer, elcount(buffer), "   0.000000 F1 EIS::PN48_Bat_Stat2_AR2::PN48_Bat_SPC_RemCpcty_Estim = %f\n", floatval);
	filePutString (buffer, elcount(buffer), hFile);
}
/*@@end*/

/*@@caplFunc:saveVars_50(dword):*/
void saveVars_50(dword hFile)
{
	intval = getSignal(CHASSIS::PN48_Bat_Stat2_AR2::PN48_Bat_SPC_Curr_Max);
	snprintf(buffer, elcount(buffer), "   0.000000 F1 EIS::PN48_Bat_Stat2_AR2::PN48_Bat_SPC_Curr_Max = %d\n", intval);
	filePutString (buffer, elcount(buffer), hFile);
	floatval = getSignal(CHASSIS::PN48_Bat_Stat_AR::PN48_Bat_Volt);
	snprintf(buffer, elcount(buffer), "   0.000000 F1 EIS::PN48_Bat_Stat_AR::PN48_Bat_Volt = %f\n", floatval);
	filePutString (buffer, elcount(buffer), hFile);
	intval = getSignal(CHASSIS::PN48_Bat_Stat_AR::PN48_Bat_Curr);
	snprintf(buffer, elcount(buffer), "   0.000000 F1 EIS::PN48_Bat_Stat_AR::PN48_Bat_Curr = %d\n", intval);
	filePutString (buffer, elcount(buffer), hFile);
	floatval = getSignal(CHASSIS::PN48_Bat_Stat_AR::PN48_Bat_CellVolt_Min);
	snprintf(buffer, elcount(buffer), "   0.000000 F1 EIS::PN48_Bat_Stat_AR::PN48_Bat_CellVolt_Min = %f\n", floatval);
	filePutString (buffer, elcount(buffer), hFile);
	floatval = getSignal(CHASSIS::PN48_Bat_Stat_AR::PN48_Bat_CellVolt_Max);
	snprintf(buffer, elcount(buffer), "   0.000000 F1 EIS::PN48_Bat_Stat_AR::PN48_Bat_CellVolt_Max = %f\n", floatval);
	filePutString (buffer, elcount(buffer), hFile);
	floatval = getSignal(CHASSIS::PN48_Bat_Stat_AR::PN48_Bat_DynRes);
	snprintf(buffer, elcount(buffer), "   0.000000 F1 EIS::PN48_Bat_Stat_AR::PN48_Bat_DynRes = %f\n", floatval);
	filePutString (buffer, elcount(buffer), hFile);
	intval = getSignal(CHASSIS::PN48_Bat_Stat_AR::PN48_Bat_Temp);
	snprintf(buffer, elcount(buffer), "   0.000000 F1 EIS::PN48_Bat_Stat_AR::PN48_Bat_Temp = %d\n", intval);
	filePutString (buffer, elcount(buffer), hFile);
	intval = getSignal(CHASSIS::PN48_BatLim_Stat_AR::PN48_Bat_Curr_LimMin);
	snprintf(buffer, elcount(buffer), "   0.000000 F1 EIS::PN48_BatLim_Stat_AR::PN48_Bat_Curr_LimMin = %d\n", intval);
	filePutString (buffer, elcount(buffer), hFile);
	intval = getSignal(CHASSIS::PN48_BatLim_Stat_AR::PN48_Bat_Curr_LimMax);
	snprintf(buffer, elcount(buffer), "   0.000000 F1 EIS::PN48_BatLim_Stat_AR::PN48_Bat_Curr_LimMax = %d\n", intval);
	filePutString (buffer, elcount(buffer), hFile);
	floatval = getSignal(CHASSIS::PN48_BatLim_Stat_AR::PN48_Bat_Volt_LimMin);
	snprintf(buffer, elcount(buffer), "   0.000000 F1 EIS::PN48_BatLim_Stat_AR::PN48_Bat_Volt_LimMin = %f\n", floatval);
	filePutString (buffer, elcount(buffer), hFile);
	floatval = getSignal(CHASSIS::PN48_BatLim_Stat_AR::PN48_Bat_Volt_LimMax);
	snprintf(buffer, elcount(buffer), "   0.000000 F1 EIS::PN48_BatLim_Stat_AR::PN48_Bat_Volt_LimMax = %f\n", floatval);
	filePutString (buffer, elcount(buffer), hFile);
	floatval = getSignal(CHASSIS::PN48_BatLim_Stat_AR::PN48_Bat_CellVolt_LimMin);
	snprintf(buffer, elcount(buffer), "   0.000000 F1 EIS::PN48_BatLim_Stat_AR::PN48_Bat_CellVolt_LimMin = %f\n", floatval);
	filePutString (buffer, elcount(buffer), hFile);
	floatval = getSignal(CHASSIS::PN48_BatLim_Stat_AR::PN48_Bat_CellVolt_LimMax);
	snprintf(buffer, elcount(buffer), "   0.000000 F1 EIS::PN48_BatLim_Stat_AR::PN48_Bat_CellVolt_LimMax = %f\n", floatval);
	filePutString (buffer, elcount(buffer), hFile);
	intval = getSignal(CHASSIS::PN48_DCDC48_LISB48_Stat_AR::PN48_DCDC48_GenLoad);
	snprintf(buffer, elcount(buffer), "   0.000000 F1 EIS::PN48_DCDC48_LISB48_Stat_AR::PN48_DCDC48_GenLoad = %d\n", intval);
	filePutString (buffer, elcount(buffer), hFile);
	intval = getSignal(CHASSIS::PN48_DCDC48_LISB48_Stat_AR::PN48_DCDC48_PN14_OutCurr);
	snprintf(buffer, elcount(buffer), "   0.000000 F1 EIS::PN48_DCDC48_LISB48_Stat_AR::PN48_DCDC48_PN14_OutCurr = %d\n", intval);
	filePutString (buffer, elcount(buffer), hFile);
	intval = getSignal(CHASSIS::PN48_DCDC48_LISB48_Stat_AR::PN48_DCDC48_Md);
	snprintf(buffer, elcount(buffer), "   0.000000 F1 EIS::PN48_DCDC48_LISB48_Stat_AR::PN48_DCDC48_Md = %d\n", intval);
	filePutString (buffer, elcount(buffer), hFile);
	intval = getSignal(CHASSIS::PN48_DCDC48_LISB48_Stat_AR::PN48_PrioLmt_Rch);
	snprintf(buffer, elcount(buffer), "   0.000000 F1 EIS::PN48_DCDC48_LISB48_Stat_AR::PN48_PrioLmt_Rch = %d\n", intval);
	filePutString (buffer, elcount(buffer), hFile);
	intval = getSignal(CHASSIS::PN48_DCDC48_LISB48_Stat_AR::PN48_DCDC48_Temp);
	snprintf(buffer, elcount(buffer), "   0.000000 F1 EIS::PN48_DCDC48_LISB48_Stat_AR::PN48_DCDC48_Temp = %d\n", intval);
	filePutString (buffer, elcount(buffer), hFile);
	intval = getSignal(CHASSIS::PN48_DCDC48_LISB48_Stat_AR::PN48_HtCoolPwr_Rq);
	snprintf(buffer, elcount(buffer), "   0.000000 F1 EIS::PN48_DCDC48_LISB48_Stat_AR::PN48_HtCoolPwr_Rq = %d\n", intval);
	filePutString (buffer, elcount(buffer), hFile);
	intval = getSignal(CHASSIS::PN48_DCDC48_LISB48_Stat_AR::LISB48_CoolInputTemp);
	snprintf(buffer, elcount(buffer), "   0.000000 F1 EIS::PN48_DCDC48_LISB48_Stat_AR::LISB48_CoolInputTemp = %d\n", intval);
	filePutString (buffer, elcount(buffer), hFile);
	intval = getSignal(CHASSIS::PN48_DCDC48_LISB48_Stat_AR::LISB48_CoolOutTemp);
	snprintf(buffer, elcount(buffer), "   0.000000 F1 EIS::PN48_DCDC48_LISB48_Stat_AR::LISB48_CoolOutTemp = %d\n", intval);
	filePutString (buffer, elcount(buffer), hFile);
	intval = getSignal(CHASSIS::PN48_DCDC48_LISB48_Stat_AR::LISB48_CCB_Sw_Stat);
	snprintf(buffer, elcount(buffer), "   0.000000 F1 EIS::PN48_DCDC48_LISB48_Stat_AR::LISB48_CCB_Sw_Stat = %d\n", intval);
	filePutString (buffer, elcount(buffer), hFile);
	intval = getSignal(CHASSIS::PN48_DCDC48_LISB48_Stat_AR::LISB48_DCB_Sw_Stat);
	snprintf(buffer, elcount(buffer), "   0.000000 F1 EIS::PN48_DCDC48_LISB48_Stat_AR::LISB48_DCB_Sw_Stat = %d\n", intval);
	filePutString (buffer, elcount(buffer), hFile);
	intval = getSignal(CHASSIS::PN48_Stat_AR::LHC48_WshHt_Rq);
	snprintf(buffer, elcount(buffer), "   0.000000 F1 EIS::PN48_Stat_AR::LHC48_WshHt_Rq = %d\n", intval);
	filePutString (buffer, elcount(buffer), hFile);
	intval = getSignal(CHASSIS::PN48_Stat_AR::PN48_Comp_On_Rq);
	snprintf(buffer, elcount(buffer), "   0.000000 F1 EIS::PN48_Stat_AR::PN48_Comp_On_Rq = %d\n", intval);
	filePutString (buffer, elcount(buffer), hFile);
	intval = getSignal(CHASSIS::PN48_Stat_AR::HVAC_RecircAir_On_Rq_PN48);
	snprintf(buffer, elcount(buffer), "   0.000000 F1 EIS::PN48_Stat_AR::HVAC_RecircAir_On_Rq_PN48 = %d\n", intval);
	filePutString (buffer, elcount(buffer), hFile);
	intval = getSignal(CHASSIS::PN48_Stat_AR::PN48_DCDC_BoostMd_Rq);
	snprintf(buffer, elcount(buffer), "   0.000000 F1 EIS::PN48_Stat_AR::PN48_DCDC_BoostMd_Rq = %d\n", intval);
	filePutString (buffer, elcount(buffer), hFile);
	intval = getSignal(CHASSIS::PN48_Stat_AR::PN48_DCDC_BuckMd_Dsabl_Rq);
	snprintf(buffer, elcount(buffer), "   0.000000 F1 EIS::PN48_Stat_AR::PN48_DCDC_BuckMd_Dsabl_Rq = %d\n", intval);
	filePutString (buffer, elcount(buffer), hFile);
	intval = getSignal(CHASSIS::PN48_Stat_AR::PN48_Term61_Actv);
	snprintf(buffer, elcount(buffer), "   0.000000 F1 EIS::PN48_Stat_AR::PN48_Term61_Actv = %d\n", intval);
	filePutString (buffer, elcount(buffer), hFile);
	intval = getSignal(CHASSIS::PN48_Stat_AR::PN48_Bat_SOC_Recal_Actv);
	snprintf(buffer, elcount(buffer), "   0.000000 F1 EIS::PN48_Stat_AR::PN48_Bat_SOC_Recal_Actv = %d\n", intval);
	filePutString (buffer, elcount(buffer), hFile);
	floatval = getSignal(CHASSIS::PN48_Stat_AR::PN48_Bat_SOC);
	snprintf(buffer, elcount(buffer), "   0.000000 F1 EIS::PN48_Stat_AR::PN48_Bat_SOC = %f\n", floatval);
	filePutString (buffer, elcount(buffer), hFile);
	floatval = getSignal(CHASSIS::PN48_Stat_AR::PN48_EAC_MaxCurr);
	snprintf(buffer, elcount(buffer), "   0.000000 F1 EIS::PN48_Stat_AR::PN48_EAC_MaxCurr = %f\n", floatval);
	filePutString (buffer, elcount(buffer), hFile);
	floatval = getSignal(CHASSIS::PN48_Stat_AR::PN48_EAC_MinVolt);
	snprintf(buffer, elcount(buffer), "   0.000000 F1 EIS::PN48_Stat_AR::PN48_EAC_MinVolt = %f\n", floatval);
	filePutString (buffer, elcount(buffer), hFile);
	intval = getSignal(CHASSIS::PN48_Stat_AR::PN48_Bat_Min_SOC_Park);
	snprintf(buffer, elcount(buffer), "   0.000000 F1 EIS::PN48_Stat_AR::PN48_Bat_Min_SOC_Park = %d\n", intval);
	filePutString (buffer, elcount(buffer), hFile);
	intval = getSignal(CHASSIS::PN48_Stat_AR::LHC48_eHeV_Rq);
	snprintf(buffer, elcount(buffer), "   0.000000 F1 EIS::PN48_Stat_AR::LHC48_eHeV_Rq = %d\n", intval);
	filePutString (buffer, elcount(buffer), hFile);
	intval = getSignal(CHASSIS::PN48_Stat_AR::PN48_Bat_Temp_Max);
	snprintf(buffer, elcount(buffer), "   0.000000 F1 EIS::PN48_Stat_AR::PN48_Bat_Temp_Max = %d\n", intval);
	filePutString (buffer, elcount(buffer), hFile);
	intval = getSignal(CHASSIS::PN48_Stat_AR::PN48_Bat_Temp_Min);
	snprintf(buffer, elcount(buffer), "   0.000000 F1 EIS::PN48_Stat_AR::PN48_Bat_Temp_Min = %d\n", intval);
	filePutString (buffer, elcount(buffer), hFile);
	intval = getSignal(CHASSIS::PNHV_WeekDepTmTbl_Rq_HU_AR2::PNHV_WeekDepTmTbl_DelTm_Rq_HU);
	snprintf(buffer, elcount(buffer), "   0.000000 F1 EIS::PNHV_WeekDepTmTbl_Rq_HU_AR2::PNHV_WeekDepTmTbl_DelTm_Rq_HU = %d\n", intval);
	filePutString (buffer, elcount(buffer), hFile);
	intval = getSignal(CHASSIS::PNHV_WeekDepTmTbl_Rq_HU_AR2::PNHV_WeekDepTmTbl_Updt_Rq_HU);
	snprintf(buffer, elcount(buffer), "   0.000000 F1 EIS::PNHV_WeekDepTmTbl_Rq_HU_AR2::PNHV_WeekDepTmTbl_Updt_Rq_HU = %d\n", intval);
	filePutString (buffer, elcount(buffer), hFile);
	intval = getSignal(CHASSIS::PNHV_WeekDepTmTbl_Rq_HU_AR2::PNHV_WeekDepTmTbl_DelAll_Rq);
	snprintf(buffer, elcount(buffer), "   0.000000 F1 EIS::PNHV_WeekDepTmTbl_Rq_HU_AR2::PNHV_WeekDepTmTbl_DelAll_Rq = %d\n", intval);
	filePutString (buffer, elcount(buffer), hFile);
	intval = getSignal(CHASSIS::PNHV_WeekDepTmTbl_Rq_HU_AR2::PNHV_WeekDepTmTbl_SetTm_Rq_HU);
	snprintf(buffer, elcount(buffer), "   0.000000 F1 EIS::PNHV_WeekDepTmTbl_Rq_HU_AR2::PNHV_WeekDepTmTbl_SetTm_Rq_HU = %d\n", intval);
	filePutString (buffer, elcount(buffer), hFile);
	intval = getSignal(CHASSIS::PNHV_WeekDepTmTbl_Rq_HU_AR2::HU_WeekDepTmTbl_Edit_Actv);
	snprintf(buffer, elcount(buffer), "   0.000000 F1 EIS::PNHV_WeekDepTmTbl_Rq_HU_AR2::HU_WeekDepTmTbl_Edit_Actv = %d\n", intval);
	filePutString (buffer, elcount(buffer), hFile);
	intval = getSignal(CHASSIS::PNHV_WeekDepTmTbl_Rq_HU_AR2::HU_DepTm_Actv);
	snprintf(buffer, elcount(buffer), "   0.000000 F1 EIS::PNHV_WeekDepTmTbl_Rq_HU_AR2::HU_DepTm_Actv = %d\n", intval);
	filePutString (buffer, elcount(buffer), hFile);
	intval = getSignal(CHASSIS::PNHV_WeekDepTmTbl_Rq_HU_AR2::HU_DepTmManSet_Minute_Rq);
	snprintf(buffer, elcount(buffer), "   0.000000 F1 EIS::PNHV_WeekDepTmTbl_Rq_HU_AR2::HU_DepTmManSet_Minute_Rq = %d\n", intval);
	filePutString (buffer, elcount(buffer), hFile);
	intval = getSignal(CHASSIS::PNHV_WeekDepTmTbl_Rq_HU_AR2::HU_DepTmManSet_Hour_Rq);
	snprintf(buffer, elcount(buffer), "   0.000000 F1 EIS::PNHV_WeekDepTmTbl_Rq_HU_AR2::HU_DepTmManSet_Hour_Rq = %d\n", intval);
	filePutString (buffer, elcount(buffer), hFile);
	intval = getSignal(CHASSIS::PNHV_WeekDepTmTbl_Rq_HU_AR2::EMM_WPT_ManSet_Rq_HU);
	snprintf(buffer, elcount(buffer), "   0.000000 F1 EIS::PNHV_WeekDepTmTbl_Rq_HU_AR2::EMM_WPT_ManSet_Rq_HU = %d\n", intval);
	filePutString (buffer, elcount(buffer), hFile);
	intval = getSignal(CHASSIS::PNHV_WeekDepTmTbl_Rq_HU_AR2::EMM_MaxSOC_Rq_HU);
	snprintf(buffer, elcount(buffer), "   0.000000 F1 EIS::PNHV_WeekDepTmTbl_Rq_HU_AR2::EMM_MaxSOC_Rq_HU = %d\n", intval);
	filePutString (buffer, elcount(buffer), hFile);
	intval = getSignal(CHASSIS::PreCond_On_Rq_AR::PreCond_SeatVn_FL_Dir_Rq);
	snprintf(buffer, elcount(buffer), "   0.000000 F1 EIS::PreCond_On_Rq_AR::PreCond_SeatVn_FL_Dir_Rq = %d\n", intval);
	filePutString (buffer, elcount(buffer), hFile);
	intval = getSignal(CHASSIS::PreCond_On_Rq_AR::PreCond_SeatVn_FR_Dir_Rq);
	snprintf(buffer, elcount(buffer), "   0.000000 F1 EIS::PreCond_On_Rq_AR::PreCond_SeatVn_FR_Dir_Rq = %d\n", intval);
	filePutString (buffer, elcount(buffer), hFile);
	intval = getSignal(CHASSIS::PreCond_On_Rq_AR::PreCond_SeatVn_RL_Dir_Rq);
	snprintf(buffer, elcount(buffer), "   0.000000 F1 EIS::PreCond_On_Rq_AR::PreCond_SeatVn_RL_Dir_Rq = %d\n", intval);
	filePutString (buffer, elcount(buffer), hFile);
	intval = getSignal(CHASSIS::PreCond_On_Rq_AR::PreCond_SeatVn_RR_Dir_Rq);
	snprintf(buffer, elcount(buffer), "   0.000000 F1 EIS::PreCond_On_Rq_AR::PreCond_SeatVn_RR_Dir_Rq = %d\n", intval);
	filePutString (buffer, elcount(buffer), hFile);
}
/*@@end*/

/*@@caplFunc:saveVars_51(dword):*/
void saveVars_51(dword hFile)
{
	intval = getSignal(CHASSIS::PreCond_On_Rq_AR::PreCond_EBL_On_Rq);
	snprintf(buffer, elcount(buffer), "   0.000000 F1 EIS::PreCond_On_Rq_AR::PreCond_EBL_On_Rq = %d\n", intval);
	filePutString (buffer, elcount(buffer), hFile);
	intval = getSignal(CHASSIS::PreCond_On_Rq_AR::PreCond_RB_Dir);
	snprintf(buffer, elcount(buffer), "   0.000000 F1 EIS::PreCond_On_Rq_AR::PreCond_RB_Dir = %d\n", intval);
	filePutString (buffer, elcount(buffer), hFile);
	intval = getSignal(CHASSIS::PreCond_On_Rq_AR::PreCond_RB_On_Rq);
	snprintf(buffer, elcount(buffer), "   0.000000 F1 EIS::PreCond_On_Rq_AR::PreCond_RB_On_Rq = %d\n", intval);
	filePutString (buffer, elcount(buffer), hFile);
	intval = getSignal(CHASSIS::PreCond_On_Rq_AR::PreCond_StW_HT_On_Rq);
	snprintf(buffer, elcount(buffer), "   0.000000 F1 EIS::PreCond_On_Rq_AR::PreCond_StW_HT_On_Rq = %d\n", intval);
	filePutString (buffer, elcount(buffer), hFile);
	intval = getSignal(CHASSIS::PreCond_On_Rq_AR::PreCond_AirScarf_FL_On_Rq);
	snprintf(buffer, elcount(buffer), "   0.000000 F1 EIS::PreCond_On_Rq_AR::PreCond_AirScarf_FL_On_Rq = %d\n", intval);
	filePutString (buffer, elcount(buffer), hFile);
	intval = getSignal(CHASSIS::PreCond_On_Rq_AR::PreCond_AirScarf_FR_On_Rq);
	snprintf(buffer, elcount(buffer), "   0.000000 F1 EIS::PreCond_On_Rq_AR::PreCond_AirScarf_FR_On_Rq = %d\n", intval);
	filePutString (buffer, elcount(buffer), hFile);
	intval = getSignal(CHASSIS::PreCond_On_Rq_AR::PreCond_AirScarf_RL_On_Rq);
	snprintf(buffer, elcount(buffer), "   0.000000 F1 EIS::PreCond_On_Rq_AR::PreCond_AirScarf_RL_On_Rq = %d\n", intval);
	filePutString (buffer, elcount(buffer), hFile);
	intval = getSignal(CHASSIS::PreCond_On_Rq_AR::PreCond_AirScarf_RR_On_Rq);
	snprintf(buffer, elcount(buffer), "   0.000000 F1 EIS::PreCond_On_Rq_AR::PreCond_AirScarf_RR_On_Rq = %d\n", intval);
	filePutString (buffer, elcount(buffer), hFile);
	intval = getSignal(CHASSIS::PreCond_On_Rq_AR::PreCond_SeatVn_FL_On_Rq);
	snprintf(buffer, elcount(buffer), "   0.000000 F1 EIS::PreCond_On_Rq_AR::PreCond_SeatVn_FL_On_Rq = %d\n", intval);
	filePutString (buffer, elcount(buffer), hFile);
	intval = getSignal(CHASSIS::PreCond_On_Rq_AR::PreCond_SeatVn_FR_On_Rq);
	snprintf(buffer, elcount(buffer), "   0.000000 F1 EIS::PreCond_On_Rq_AR::PreCond_SeatVn_FR_On_Rq = %d\n", intval);
	filePutString (buffer, elcount(buffer), hFile);
	intval = getSignal(CHASSIS::PreCond_On_Rq_AR::PreCond_SeatVn_RL_On_Rq);
	snprintf(buffer, elcount(buffer), "   0.000000 F1 EIS::PreCond_On_Rq_AR::PreCond_SeatVn_RL_On_Rq = %d\n", intval);
	filePutString (buffer, elcount(buffer), hFile);
	intval = getSignal(CHASSIS::PreCond_On_Rq_AR::PreCond_SeatVn_RR_On_Rq);
	snprintf(buffer, elcount(buffer), "   0.000000 F1 EIS::PreCond_On_Rq_AR::PreCond_SeatVn_RR_On_Rq = %d\n", intval);
	filePutString (buffer, elcount(buffer), hFile);
	intval = getSignal(CHASSIS::PreCond_On_Rq_AR::PreCond_SeatHt_FL_Rq);
	snprintf(buffer, elcount(buffer), "   0.000000 F1 EIS::PreCond_On_Rq_AR::PreCond_SeatHt_FL_Rq = %d\n", intval);
	filePutString (buffer, elcount(buffer), hFile);
	intval = getSignal(CHASSIS::PreCond_On_Rq_AR::PreCond_SeatHt_FR_Rq);
	snprintf(buffer, elcount(buffer), "   0.000000 F1 EIS::PreCond_On_Rq_AR::PreCond_SeatHt_FR_Rq = %d\n", intval);
	filePutString (buffer, elcount(buffer), hFile);
	intval = getSignal(CHASSIS::PreCond_On_Rq_AR::PreCond_SeatHt_RL_Rq);
	snprintf(buffer, elcount(buffer), "   0.000000 F1 EIS::PreCond_On_Rq_AR::PreCond_SeatHt_RL_Rq = %d\n", intval);
	filePutString (buffer, elcount(buffer), hFile);
	intval = getSignal(CHASSIS::PreCond_On_Rq_AR::PreCond_SeatHt_RR_Rq);
	snprintf(buffer, elcount(buffer), "   0.000000 F1 EIS::PreCond_On_Rq_AR::PreCond_SeatHt_RR_Rq = %d\n", intval);
	filePutString (buffer, elcount(buffer), hFile);
	intval = getSignal(CHASSIS::PreCond_On_Rq_AR::PreCond_PnHt_ArmRst_FL_Rq);
	snprintf(buffer, elcount(buffer), "   0.000000 F1 EIS::PreCond_On_Rq_AR::PreCond_PnHt_ArmRst_FL_Rq = %d\n", intval);
	filePutString (buffer, elcount(buffer), hFile);
	intval = getSignal(CHASSIS::PreCond_On_Rq_AR::PreCond_PnHt_ArmRst_FR_Rq);
	snprintf(buffer, elcount(buffer), "   0.000000 F1 EIS::PreCond_On_Rq_AR::PreCond_PnHt_ArmRst_FR_Rq = %d\n", intval);
	filePutString (buffer, elcount(buffer), hFile);
	intval = getSignal(CHASSIS::PreCond_On_Rq_AR::PreCond_PnHt_ArmRst_RL_Rq);
	snprintf(buffer, elcount(buffer), "   0.000000 F1 EIS::PreCond_On_Rq_AR::PreCond_PnHt_ArmRst_RL_Rq = %d\n", intval);
	filePutString (buffer, elcount(buffer), hFile);
	intval = getSignal(CHASSIS::PreCond_On_Rq_AR::PreCond_PnHt_ArmRst_RR_Rq);
	snprintf(buffer, elcount(buffer), "   0.000000 F1 EIS::PreCond_On_Rq_AR::PreCond_PnHt_ArmRst_RR_Rq = %d\n", intval);
	filePutString (buffer, elcount(buffer), hFile);
	intval = getSignal(CHASSIS::PreCond_On_Rq_AR::PreCond_FtMat_FL_Rq);
	snprintf(buffer, elcount(buffer), "   0.000000 F1 EIS::PreCond_On_Rq_AR::PreCond_FtMat_FL_Rq = %d\n", intval);
	filePutString (buffer, elcount(buffer), hFile);
	intval = getSignal(CHASSIS::PreCond_On_Rq_AR::PreCond_FtMat_FR_Rq);
	snprintf(buffer, elcount(buffer), "   0.000000 F1 EIS::PreCond_On_Rq_AR::PreCond_FtMat_FR_Rq = %d\n", intval);
	filePutString (buffer, elcount(buffer), hFile);
	intval = getSignal(CHASSIS::PreCond_On_Rq_AR::PreCond_FtMat_RL_Rq);
	snprintf(buffer, elcount(buffer), "   0.000000 F1 EIS::PreCond_On_Rq_AR::PreCond_FtMat_RL_Rq = %d\n", intval);
	filePutString (buffer, elcount(buffer), hFile);
	intval = getSignal(CHASSIS::PreCond_On_Rq_AR::PreCond_FtMat_RR_Rq);
	snprintf(buffer, elcount(buffer), "   0.000000 F1 EIS::PreCond_On_Rq_AR::PreCond_FtMat_RR_Rq = %d\n", intval);
	filePutString (buffer, elcount(buffer), hFile);
	intval = getSignal(CHASSIS::PreCond_On_Rq_AR::PreCond_Ht_Md);
	snprintf(buffer, elcount(buffer), "   0.000000 F1 EIS::PreCond_On_Rq_AR::PreCond_Ht_Md = %d\n", intval);
	filePutString (buffer, elcount(buffer), hFile);
	intval = getSignal(CHASSIS::PreCond_On_Rq_AR::PreCond_MirrHt_On_Rq);
	snprintf(buffer, elcount(buffer), "   0.000000 F1 EIS::PreCond_On_Rq_AR::PreCond_MirrHt_On_Rq = %d\n", intval);
	filePutString (buffer, elcount(buffer), hFile);
	intval = getSignal(CHASSIS::PreCond_Rq_HU_AR2::PreCond_Mode_CfgRq);
	snprintf(buffer, elcount(buffer), "   0.000000 F1 EIS::PreCond_Rq_HU_AR2::PreCond_Mode_CfgRq = %d\n", intval);
	filePutString (buffer, elcount(buffer), hFile);
	intval = getSignal(CHASSIS::PreCond_Rq_HU_AR2::PreCond_AirFrshnr_CfgRq);
	snprintf(buffer, elcount(buffer), "   0.000000 F1 EIS::PreCond_Rq_HU_AR2::PreCond_AirFrshnr_CfgRq = %d\n", intval);
	filePutString (buffer, elcount(buffer), hFile);
	intval = getSignal(CHASSIS::PreCond_Rq_HU_AR2::PreCond_Ionzr_CfgRq);
	snprintf(buffer, elcount(buffer), "   0.000000 F1 EIS::PreCond_Rq_HU_AR2::PreCond_Ionzr_CfgRq = %d\n", intval);
	filePutString (buffer, elcount(buffer), hFile);
	intval = getSignal(CHASSIS::PreCond_Rq_HU_AR2::PreCond_Seat_FL_CfgRq);
	snprintf(buffer, elcount(buffer), "   0.000000 F1 EIS::PreCond_Rq_HU_AR2::PreCond_Seat_FL_CfgRq = %d\n", intval);
	filePutString (buffer, elcount(buffer), hFile);
	intval = getSignal(CHASSIS::PreCond_Rq_HU_AR2::PreCond_Seat_FR_CfgRq);
	snprintf(buffer, elcount(buffer), "   0.000000 F1 EIS::PreCond_Rq_HU_AR2::PreCond_Seat_FR_CfgRq = %d\n", intval);
	filePutString (buffer, elcount(buffer), hFile);
	intval = getSignal(CHASSIS::PreCond_Rq_HU_AR2::PreCond_Seat_RL_CfgRq);
	snprintf(buffer, elcount(buffer), "   0.000000 F1 EIS::PreCond_Rq_HU_AR2::PreCond_Seat_RL_CfgRq = %d\n", intval);
	filePutString (buffer, elcount(buffer), hFile);
	intval = getSignal(CHASSIS::PreCond_Rq_HU_AR2::PreCond_Seat_RR_CfgRq);
	snprintf(buffer, elcount(buffer), "   0.000000 F1 EIS::PreCond_Rq_HU_AR2::PreCond_Seat_RR_CfgRq = %d\n", intval);
	filePutString (buffer, elcount(buffer), hFile);
	intval = getSignal(CHASSIS::PreCond_Rq_HU_AR2::HU_PreCond1_ManSet_Rq);
	snprintf(buffer, elcount(buffer), "   0.000000 F1 EIS::PreCond_Rq_HU_AR2::HU_PreCond1_ManSet_Rq = %d\n", intval);
	filePutString (buffer, elcount(buffer), hFile);
	intval = getSignal(CHASSIS::PreCond_Rq_HU_AR2::HU_PreCond2_ManSet_Rq);
	snprintf(buffer, elcount(buffer), "   0.000000 F1 EIS::PreCond_Rq_HU_AR2::HU_PreCond2_ManSet_Rq = %d\n", intval);
	filePutString (buffer, elcount(buffer), hFile);
	intval = getSignal(CHASSIS::PreCond_Stat_AR::HVAC_PreCond1_Rq);
	snprintf(buffer, elcount(buffer), "   0.000000 F1 EIS::PreCond_Stat_AR::HVAC_PreCond1_Rq = %d\n", intval);
	filePutString (buffer, elcount(buffer), hFile);
	intval = getSignal(CHASSIS::PreCond_Stat_AR::HVAC_PreCond2_Rq);
	snprintf(buffer, elcount(buffer), "   0.000000 F1 EIS::PreCond_Stat_AR::HVAC_PreCond2_Rq = %d\n", intval);
	filePutString (buffer, elcount(buffer), hFile);
	intval = getSignal(CHASSIS::PreCond_Stat_AR::HVAC_PreCond4_Rq);
	snprintf(buffer, elcount(buffer), "   0.000000 F1 EIS::PreCond_Stat_AR::HVAC_PreCond4_Rq = %d\n", intval);
	filePutString (buffer, elcount(buffer), hFile);
	intval = getSignal(CHASSIS::PreCond_Stat_AR::HVAC_PreCond2_Avl);
	snprintf(buffer, elcount(buffer), "   0.000000 F1 EIS::PreCond_Stat_AR::HVAC_PreCond2_Avl = %d\n", intval);
	filePutString (buffer, elcount(buffer), hFile);
	intval = getSignal(CHASSIS::PreCond_Stat_AR::HVAC_eHeV_Actv);
	snprintf(buffer, elcount(buffer), "   0.000000 F1 EIS::PreCond_Stat_AR::HVAC_eHeV_Actv = %d\n", intval);
	filePutString (buffer, elcount(buffer), hFile);
	intval = getSignal(CHASSIS::PreCond_Stat_AR::HVAC_PreCond2_Pwr);
	snprintf(buffer, elcount(buffer), "   0.000000 F1 EIS::PreCond_Stat_AR::HVAC_PreCond2_Pwr = %d\n", intval);
	filePutString (buffer, elcount(buffer), hFile);
	intval = getSignal(CHASSIS::PreCond_Stat_AR::HVAC_PreCond2_Actv);
	snprintf(buffer, elcount(buffer), "   0.000000 F1 EIS::PreCond_Stat_AR::HVAC_PreCond2_Actv = %d\n", intval);
	filePutString (buffer, elcount(buffer), hFile);
	intval = getSignal(CHASSIS::PreCond_Stat_AR::HVAC_PreCond2_Tm);
	snprintf(buffer, elcount(buffer), "   0.000000 F1 EIS::PreCond_Stat_AR::HVAC_PreCond2_Tm = %d\n", intval);
	filePutString (buffer, elcount(buffer), hFile);
	intval = getSignal(CHASSIS::PreCond_Stat_AR::HVAC_PreCond4_Actv);
	snprintf(buffer, elcount(buffer), "   0.000000 F1 EIS::PreCond_Stat_AR::HVAC_PreCond4_Actv = %d\n", intval);
	filePutString (buffer, elcount(buffer), hFile);
	intval = @sysvar::CH_Nodes::CH_EISCRC_PT_ObjIntrst_Pr2P_AUTO;
	snprintf(buffer, elcount(buffer), "   0.000000    SV: 2 0 0 ::CH_Nodes::CH_EISCRC_PT_ObjIntrst_Pr2P_AUTO = %d\n", intval);
	filePutString (buffer, elcount(buffer), hFile);
	intval = getSignal(CHASSIS::PT_ObjIntrst_Gw_AR2::CRC_PT_ObjIntrst_Pr2);
	snprintf(buffer, elcount(buffer), "   0.000000 F1 EIS::PT_ObjIntrst_Gw_AR2::CRC_PT_ObjIntrst_Pr2 = %d\n", intval);
	filePutString (buffer, elcount(buffer), hFile);
	intval = @sysvar::CH_Nodes::CH_EISSQC_PT_ObjIntrst_Pr2P_AUTO;
	snprintf(buffer, elcount(buffer), "   0.000000    SV: 2 0 0 ::CH_Nodes::CH_EISSQC_PT_ObjIntrst_Pr2P_AUTO = %d\n", intval);
	filePutString (buffer, elcount(buffer), hFile);
	intval = getSignal(CHASSIS::PT_ObjIntrst_Gw_AR2::SQC_PT_ObjIntrst_Pr2);
	snprintf(buffer, elcount(buffer), "   0.000000 F1 EIS::PT_ObjIntrst_Gw_AR2::SQC_PT_ObjIntrst_Pr2 = %d\n", intval);
	filePutString (buffer, elcount(buffer), hFile);
	intval = getSignal(CHASSIS::PT_ObjIntrst_Gw_AR2::PT_ObjIntrstType);
	snprintf(buffer, elcount(buffer), "   0.000000 F1 EIS::PT_ObjIntrst_Gw_AR2::PT_ObjIntrstType = %d\n", intval);
	filePutString (buffer, elcount(buffer), hFile);
	intval = getSignal(CHASSIS::PT_ObjIntrst_Gw_AR2::PT_ObjIntrstNew);
	snprintf(buffer, elcount(buffer), "   0.000000 F1 EIS::PT_ObjIntrst_Gw_AR2::PT_ObjIntrstNew = %d\n", intval);
	filePutString (buffer, elcount(buffer), hFile);
	floatval = getSignal(CHASSIS::PT_ObjIntrst_Gw_AR2::PT_ObjIntrstDist);
	snprintf(buffer, elcount(buffer), "   0.000000 F1 EIS::PT_ObjIntrst_Gw_AR2::PT_ObjIntrstDist = %f\n", floatval);
	filePutString (buffer, elcount(buffer), hFile);
	floatval = getSignal(CHASSIS::PT_ObjIntrst_Gw_AR2::PT_ObjIntrstRelSpd);
	snprintf(buffer, elcount(buffer), "   0.000000 F1 EIS::PT_ObjIntrst_Gw_AR2::PT_ObjIntrstRelSpd = %f\n", floatval);
	filePutString (buffer, elcount(buffer), hFile);
	intval = getSignal(CHASSIS::PT_ObjIntrst_Gw_AR2::PT_ObjIntrst_Flt);
	snprintf(buffer, elcount(buffer), "   0.000000 F1 EIS::PT_ObjIntrst_Gw_AR2::PT_ObjIntrst_Flt = %d\n", intval);
	filePutString (buffer, elcount(buffer), hFile);
}
/*@@end*/

/*@@caplFunc:saveVars_52(dword):*/
void saveVars_52(dword hFile)
{
	intval = getSignal(CHASSIS::PT_ObjIntrst_Gw_AR2::Rsrv1_PT_ObjIntrst_Pr2);
	snprintf(buffer, elcount(buffer), "   0.000000 F1 EIS::PT_ObjIntrst_Gw_AR2::Rsrv1_PT_ObjIntrst_Pr2 = %d\n", intval);
	filePutString (buffer, elcount(buffer), hFile);
	intval = @sysvar::CH_Nodes::CH_EISCRC_RemPark_Auth_Rs_P_AUTO;
	snprintf(buffer, elcount(buffer), "   0.000000    SV: 2 0 0 ::CH_Nodes::CH_EISCRC_RemPark_Auth_Rs_P_AUTO = %d\n", intval);
	filePutString (buffer, elcount(buffer), hFile);
	intval = getSignal(CHASSIS::RemPark_Auth_Rs_AR2::CRC_RemPark_Auth_Rs_Pr2);
	snprintf(buffer, elcount(buffer), "   0.000000 F1 EIS::RemPark_Auth_Rs_AR2::CRC_RemPark_Auth_Rs_Pr2 = %d\n", intval);
	filePutString (buffer, elcount(buffer), hFile);
	intval = @sysvar::CH_Nodes::CH_EISSQC_RemPark_Auth_Rs_P_AUTO;
	snprintf(buffer, elcount(buffer), "   0.000000    SV: 2 0 0 ::CH_Nodes::CH_EISSQC_RemPark_Auth_Rs_P_AUTO = %d\n", intval);
	filePutString (buffer, elcount(buffer), hFile);
	intval = getSignal(CHASSIS::RemPark_Auth_Rs_AR2::SQC_RemPark_Auth_Rs_Pr2);
	snprintf(buffer, elcount(buffer), "   0.000000 F1 EIS::RemPark_Auth_Rs_AR2::SQC_RemPark_Auth_Rs_Pr2 = %d\n", intval);
	filePutString (buffer, elcount(buffer), hFile);
	intval = getSignal(CHASSIS::RemPark_Auth_Rs_AR2::RemPark_Auth_Rs);
	snprintf(buffer, elcount(buffer), "   0.000000 F1 EIS::RemPark_Auth_Rs_AR2::RemPark_Auth_Rs = %d\n", intval);
	filePutString (buffer, elcount(buffer), hFile);
	intval = getSignal(CHASSIS::RemPark_Auth_Rs_AR2::Rsrv1_RemPark_Auth_Rs_Pr2);
	snprintf(buffer, elcount(buffer), "   0.000000 F1 EIS::RemPark_Auth_Rs_AR2::Rsrv1_RemPark_Auth_Rs_Pr2 = %d\n", intval);
	filePutString (buffer, elcount(buffer), hFile);
	intval = @sysvar::CH_Nodes::CH_EISCRC_RemPark_Stat_EIS__AUTO;
	snprintf(buffer, elcount(buffer), "   0.000000    SV: 2 0 0 ::CH_Nodes::CH_EISCRC_RemPark_Stat_EIS__AUTO = %d\n", intval);
	filePutString (buffer, elcount(buffer), hFile);
	intval = getSignal(CHASSIS::RemPark_Stat_EIS_AR2::CRC_RemPark_Stat_EIS_Pr2);
	snprintf(buffer, elcount(buffer), "   0.000000 F1 EIS::RemPark_Stat_EIS_AR2::CRC_RemPark_Stat_EIS_Pr2 = %d\n", intval);
	filePutString (buffer, elcount(buffer), hFile);
	intval = @sysvar::CH_Nodes::CH_EISSQC_RemPark_Stat_EIS__AUTO;
	snprintf(buffer, elcount(buffer), "   0.000000    SV: 2 0 0 ::CH_Nodes::CH_EISSQC_RemPark_Stat_EIS__AUTO = %d\n", intval);
	filePutString (buffer, elcount(buffer), hFile);
	intval = getSignal(CHASSIS::RemPark_Stat_EIS_AR2::SQC_RemPark_Stat_EIS_Pr2);
	snprintf(buffer, elcount(buffer), "   0.000000 F1 EIS::RemPark_Stat_EIS_AR2::SQC_RemPark_Stat_EIS_Pr2 = %d\n", intval);
	filePutString (buffer, elcount(buffer), hFile);
	intval = getSignal(CHASSIS::RemPark_Stat_EIS_AR2::RemPark_Stat_EIS);
	snprintf(buffer, elcount(buffer), "   0.000000 F1 EIS::RemPark_Stat_EIS_AR2::RemPark_Stat_EIS = %d\n", intval);
	filePutString (buffer, elcount(buffer), hFile);
	intval = getSignal(CHASSIS::RemPark_Stat_EIS_AR2::Rsrv1_RemPark_Stat_EIS_Pr2);
	snprintf(buffer, elcount(buffer), "   0.000000 F1 EIS::RemPark_Stat_EIS_AR2::Rsrv1_RemPark_Stat_EIS_Pr2 = %d\n", intval);
	filePutString (buffer, elcount(buffer), hFile);
	intval = getSignal(CHASSIS::RemPark_Stat_EIS_AR2::RemPark_Cancel_Stat_EIS);
	snprintf(buffer, elcount(buffer), "   0.000000 F1 EIS::RemPark_Stat_EIS_AR2::RemPark_Cancel_Stat_EIS = %d\n", intval);
	filePutString (buffer, elcount(buffer), hFile);
	intval = getSignal(CHASSIS::RemPark_Stat_EIS_AR2::Rsrv2_RemPark_Stat_EIS_Pr2);
	snprintf(buffer, elcount(buffer), "   0.000000 F1 EIS::RemPark_Stat_EIS_AR2::Rsrv2_RemPark_Stat_EIS_Pr2 = %d\n", intval);
	filePutString (buffer, elcount(buffer), hFile);
	intval = getSignal(CHASSIS::RTC_Date_Time_AR2::DateTmHour);
	snprintf(buffer, elcount(buffer), "   0.000000 F1 EIS::RTC_Date_Time_AR2::DateTmHour = %d\n", intval);
	filePutString (buffer, elcount(buffer), hFile);
	intval = getSignal(CHASSIS::RTC_Date_Time_AR2::DateTmMinute);
	snprintf(buffer, elcount(buffer), "   0.000000 F1 EIS::RTC_Date_Time_AR2::DateTmMinute = %d\n", intval);
	filePutString (buffer, elcount(buffer), hFile);
	intval = getSignal(CHASSIS::RTC_Date_Time_AR2::DateTmSecond);
	snprintf(buffer, elcount(buffer), "   0.000000 F1 EIS::RTC_Date_Time_AR2::DateTmSecond = %d\n", intval);
	filePutString (buffer, elcount(buffer), hFile);
	intval = getSignal(CHASSIS::RTC_Date_Time_AR2::DateTmDay);
	snprintf(buffer, elcount(buffer), "   0.000000 F1 EIS::RTC_Date_Time_AR2::DateTmDay = %d\n", intval);
	filePutString (buffer, elcount(buffer), hFile);
	intval = getSignal(CHASSIS::RTC_Date_Time_AR2::DateTmMonth);
	snprintf(buffer, elcount(buffer), "   0.000000 F1 EIS::RTC_Date_Time_AR2::DateTmMonth = %d\n", intval);
	filePutString (buffer, elcount(buffer), hFile);
	intval = getSignal(CHASSIS::RTC_Date_Time_AR2::DateTmYear);
	snprintf(buffer, elcount(buffer), "   0.000000 F1 EIS::RTC_Date_Time_AR2::DateTmYear = %d\n", intval);
	filePutString (buffer, elcount(buffer), hFile);
	intval = getSignal(CHASSIS::RTC_Date_Time_AR2::DateTmStat);
	snprintf(buffer, elcount(buffer), "   0.000000 F1 EIS::RTC_Date_Time_AR2::DateTmStat = %d\n", intval);
	filePutString (buffer, elcount(buffer), hFile);
	intval = getSignal(CHASSIS::RTC_Date_Time_AR2::DateTmWeekday);
	snprintf(buffer, elcount(buffer), "   0.000000 F1 EIS::RTC_Date_Time_AR2::DateTmWeekday = %d\n", intval);
	filePutString (buffer, elcount(buffer), hFile);
	intval = getSignal(CHASSIS::RTC_Date_Time_AR2::ICH_Dur_Rq);
	snprintf(buffer, elcount(buffer), "   0.000000 F1 EIS::RTC_Date_Time_AR2::ICH_Dur_Rq = %d\n", intval);
	filePutString (buffer, elcount(buffer), hFile);
	intval = getSignal(CHASSIS::RTC_Date_Time_AR2::ICH_HtVn_Rq_IC);
	snprintf(buffer, elcount(buffer), "   0.000000 F1 EIS::RTC_Date_Time_AR2::ICH_HtVn_Rq_IC = %d\n", intval);
	filePutString (buffer, elcount(buffer), hFile);
	intval = getSignal(CHASSIS::RTC_Stat1_AR2::DayCnt);
	snprintf(buffer, elcount(buffer), "   0.000000 F1 EIS::RTC_Stat1_AR2::DayCnt = %d\n", intval);
	filePutString (buffer, elcount(buffer), hFile);
	intval = getSignal(CHASSIS::RTC_Stat1_AR2::HVAC_Vprzr_DryVnTmr_Stat);
	snprintf(buffer, elcount(buffer), "   0.000000 F1 EIS::RTC_Stat1_AR2::HVAC_Vprzr_DryVnTmr_Stat = %d\n", intval);
	filePutString (buffer, elcount(buffer), hFile);
	intval = getSignal(CHASSIS::RTC_Stat1_AR2::PT_ShutOffTm);
	snprintf(buffer, elcount(buffer), "   0.000000 F1 EIS::RTC_Stat1_AR2::PT_ShutOffTm = %d\n", intval);
	filePutString (buffer, elcount(buffer), hFile);
	intval = getSignal(CHASSIS::RTC_Stat1_AR2::EngShutOffTm);
	snprintf(buffer, elcount(buffer), "   0.000000 F1 EIS::RTC_Stat1_AR2::EngShutOffTm = %d\n", intval);
	filePutString (buffer, elcount(buffer), hFile);
	intval = @sysvar::CH_Nodes::CH_EISCRC_SADR_Trgr_FCW_Pr2_AUTO;
	snprintf(buffer, elcount(buffer), "   0.000000    SV: 2 0 0 ::CH_Nodes::CH_EISCRC_SADR_Trgr_FCW_Pr2_AUTO = %d\n", intval);
	filePutString (buffer, elcount(buffer), hFile);
	intval = getSignal(CHASSIS::SADR_Trgr_FCW_AR2::CRC_SADR_Trgr_FCW_Pr2);
	snprintf(buffer, elcount(buffer), "   0.000000 F1 EIS::SADR_Trgr_FCW_AR2::CRC_SADR_Trgr_FCW_Pr2 = %d\n", intval);
	filePutString (buffer, elcount(buffer), hFile);
	intval = @sysvar::CH_Nodes::CH_EISSQC_SADR_Trgr_FCW_Pr2_AUTO;
	snprintf(buffer, elcount(buffer), "   0.000000    SV: 2 0 0 ::CH_Nodes::CH_EISSQC_SADR_Trgr_FCW_Pr2_AUTO = %d\n", intval);
	filePutString (buffer, elcount(buffer), hFile);
	intval = getSignal(CHASSIS::SADR_Trgr_FCW_AR2::SQC_SADR_Trgr_FCW_Pr2);
	snprintf(buffer, elcount(buffer), "   0.000000 F1 EIS::SADR_Trgr_FCW_AR2::SQC_SADR_Trgr_FCW_Pr2 = %d\n", intval);
	filePutString (buffer, elcount(buffer), hFile);
	intval = getSignal(CHASSIS::SADR_Trgr_FCW_AR2::SADR_TrgrPrio_FCW);
	snprintf(buffer, elcount(buffer), "   0.000000 F1 EIS::SADR_Trgr_FCW_AR2::SADR_TrgrPrio_FCW = %d\n", intval);
	filePutString (buffer, elcount(buffer), hFile);
	intval = getSignal(CHASSIS::SADR_Trgr_FCW_AR2::Rsrv2_SADR_Trgr_FCW_Pr2);
	snprintf(buffer, elcount(buffer), "   0.000000 F1 EIS::SADR_Trgr_FCW_AR2::Rsrv2_SADR_Trgr_FCW_Pr2 = %d\n", intval);
	filePutString (buffer, elcount(buffer), hFile);
	intval = getSignal(CHASSIS::SADR_Trgr_FCW_AR2::SADR_TrgrTm_FCW);
	snprintf(buffer, elcount(buffer), "   0.000000 F1 EIS::SADR_Trgr_FCW_AR2::SADR_TrgrTm_FCW = %d\n", intval);
	filePutString (buffer, elcount(buffer), hFile);
	intval = getSignal(CHASSIS::SADR_Trgr_FCW_AR2::Rsrv1_SADR_Trgr_FCW_Pr2);
	snprintf(buffer, elcount(buffer), "   0.000000 F1 EIS::SADR_Trgr_FCW_AR2::Rsrv1_SADR_Trgr_FCW_Pr2 = %d\n", intval);
	filePutString (buffer, elcount(buffer), hFile);
	intval = @sysvar::CH_Nodes::CH_EISSeat_FL_TglSeatAdj_FL_AUTO;
	snprintf(buffer, elcount(buffer), "   0.000000    SV: 2 0 0 ::CH_Nodes::CH_EISSeat_FL_TglSeatAdj_FL_AUTO = %d\n", intval);
	filePutString (buffer, elcount(buffer), hFile);
	intval = getSignal(CHASSIS::SeatAdj_FL_Rq_AR::Seat_FL_Tgl);
	snprintf(buffer, elcount(buffer), "   0.000000 F1 EIS::SeatAdj_FL_Rq_AR::Seat_FL_Tgl = %d\n", intval);
	filePutString (buffer, elcount(buffer), hFile);
	intval = getSignal(CHASSIS::SeatAdj_FL_Rq_AR::SeatSwAdj_FL_Psd);
	snprintf(buffer, elcount(buffer), "   0.000000 F1 EIS::SeatAdj_FL_Rq_AR::SeatSwAdj_FL_Psd = %d\n", intval);
	filePutString (buffer, elcount(buffer), hFile);
	intval = getSignal(CHASSIS::SeatAdj_FL_Rq_AR::SeatPosn_FL_Fwd_Rq);
	snprintf(buffer, elcount(buffer), "   0.000000 F1 EIS::SeatAdj_FL_Rq_AR::SeatPosn_FL_Fwd_Rq = %d\n", intval);
	filePutString (buffer, elcount(buffer), hFile);
	intval = getSignal(CHASSIS::SeatAdj_FL_Rq_AR::SeatPosn_FL_Rwd_Rq);
	snprintf(buffer, elcount(buffer), "   0.000000 F1 EIS::SeatAdj_FL_Rq_AR::SeatPosn_FL_Rwd_Rq = %d\n", intval);
	filePutString (buffer, elcount(buffer), hFile);
	intval = getSignal(CHASSIS::SeatAdj_FL_Rq_AR::SeatTilt_FL_Dn_Rq);
	snprintf(buffer, elcount(buffer), "   0.000000 F1 EIS::SeatAdj_FL_Rq_AR::SeatTilt_FL_Dn_Rq = %d\n", intval);
	filePutString (buffer, elcount(buffer), hFile);
	intval = getSignal(CHASSIS::SeatAdj_FL_Rq_AR::SeatTilt_FL_Up_Rq);
	snprintf(buffer, elcount(buffer), "   0.000000 F1 EIS::SeatAdj_FL_Rq_AR::SeatTilt_FL_Up_Rq = %d\n", intval);
	filePutString (buffer, elcount(buffer), hFile);
	intval = getSignal(CHASSIS::SeatAdj_FL_Rq_AR::SeatHght_FL_Dn_Rq);
	snprintf(buffer, elcount(buffer), "   0.000000 F1 EIS::SeatAdj_FL_Rq_AR::SeatHght_FL_Dn_Rq = %d\n", intval);
	filePutString (buffer, elcount(buffer), hFile);
	intval = getSignal(CHASSIS::SeatAdj_FL_Rq_AR::SeatHght_FL_UP_Rq);
	snprintf(buffer, elcount(buffer), "   0.000000 F1 EIS::SeatAdj_FL_Rq_AR::SeatHght_FL_UP_Rq = %d\n", intval);
	filePutString (buffer, elcount(buffer), hFile);
	intval = getSignal(CHASSIS::SeatAdj_FL_Rq_AR::SeatCsn_FL_Fwd_Rq);
	snprintf(buffer, elcount(buffer), "   0.000000 F1 EIS::SeatAdj_FL_Rq_AR::SeatCsn_FL_Fwd_Rq = %d\n", intval);
	filePutString (buffer, elcount(buffer), hFile);
	intval = getSignal(CHASSIS::SeatAdj_FL_Rq_AR::SeatCsn_FL_Rwd_Rq);
	snprintf(buffer, elcount(buffer), "   0.000000 F1 EIS::SeatAdj_FL_Rq_AR::SeatCsn_FL_Rwd_Rq = %d\n", intval);
	filePutString (buffer, elcount(buffer), hFile);
	intval = getSignal(CHASSIS::SeatAdj_FL_Rq_AR::SeatBkRst_FL_Fwd_Rq);
	snprintf(buffer, elcount(buffer), "   0.000000 F1 EIS::SeatAdj_FL_Rq_AR::SeatBkRst_FL_Fwd_Rq = %d\n", intval);
	filePutString (buffer, elcount(buffer), hFile);
	intval = getSignal(CHASSIS::SeatAdj_FL_Rq_AR::SeatBkRst_FL_Rwd_Rq);
	snprintf(buffer, elcount(buffer), "   0.000000 F1 EIS::SeatAdj_FL_Rq_AR::SeatBkRst_FL_Rwd_Rq = %d\n", intval);
	filePutString (buffer, elcount(buffer), hFile);
	intval = getSignal(CHASSIS::SeatAdj_FL_Rq_AR::SeatHdRst_FL_Dn_Rq);
	snprintf(buffer, elcount(buffer), "   0.000000 F1 EIS::SeatAdj_FL_Rq_AR::SeatHdRst_FL_Dn_Rq = %d\n", intval);
	filePutString (buffer, elcount(buffer), hFile);
	intval = getSignal(CHASSIS::SeatAdj_FL_Rq_AR::SeatHdRst_FL_Up_Rq);
	snprintf(buffer, elcount(buffer), "   0.000000 F1 EIS::SeatAdj_FL_Rq_AR::SeatHdRst_FL_Up_Rq = %d\n", intval);
	filePutString (buffer, elcount(buffer), hFile);
	intval = getSignal(CHASSIS::SeatAdj_FL_Rq_AR::MirrAdjSw_Lt_Psd);
	snprintf(buffer, elcount(buffer), "   0.000000 F1 EIS::SeatAdj_FL_Rq_AR::MirrAdjSw_Lt_Psd = %d\n", intval);
	filePutString (buffer, elcount(buffer), hFile);
	intval = getSignal(CHASSIS::SeatAdj_FL_Rq_AR::MemPosn_FL);
	snprintf(buffer, elcount(buffer), "   0.000000 F1 EIS::SeatAdj_FL_Rq_AR::MemPosn_FL = %d\n", intval);
	filePutString (buffer, elcount(buffer), hFile);
	intval = getSignal(CHASSIS::SeatAdj_FL_Rq_AR::MemPosn_FL_Rc_Rq);
	snprintf(buffer, elcount(buffer), "   0.000000 F1 EIS::SeatAdj_FL_Rq_AR::MemPosn_FL_Rc_Rq = %d\n", intval);
	filePutString (buffer, elcount(buffer), hFile);
	intval = getSignal(CHASSIS::SeatAdj_FL_Rq_AR::MemPosn_FL_Sv_Rq);
	snprintf(buffer, elcount(buffer), "   0.000000 F1 EIS::SeatAdj_FL_Rq_AR::MemPosn_FL_Sv_Rq = %d\n", intval);
	filePutString (buffer, elcount(buffer), hFile);
	intval = getSignal(CHASSIS::SeatAdj_FL_Rq_AR::SeatVn_FL_Posn_Rq);
	snprintf(buffer, elcount(buffer), "   0.000000 F1 EIS::SeatAdj_FL_Rq_AR::SeatVn_FL_Posn_Rq = %d\n", intval);
	filePutString (buffer, elcount(buffer), hFile);
	intval = getSignal(CHASSIS::SeatAdj_FL_Rq_AR::SeatHt_FL_Posn_Rq);
	snprintf(buffer, elcount(buffer), "   0.000000 F1 EIS::SeatAdj_FL_Rq_AR::SeatHt_FL_Posn_Rq = %d\n", intval);
	filePutString (buffer, elcount(buffer), hFile);
}
/*@@end*/

/*@@caplFunc:saveVars_53(dword):*/
void saveVars_53(dword hFile)
{
	intval = getSignal(CHASSIS::SeatAdj_FL_Rq_AR::AirScarf_FL_Sw_Psd);
	snprintf(buffer, elcount(buffer), "   0.000000 F1 EIS::SeatAdj_FL_Rq_AR::AirScarf_FL_Sw_Psd = %d\n", intval);
	filePutString (buffer, elcount(buffer), hFile);
	intval = getSignal(CHASSIS::SeatAdj_FL_Rq_AR::SeatHdRst_FL_Fwd_Rq);
	snprintf(buffer, elcount(buffer), "   0.000000 F1 EIS::SeatAdj_FL_Rq_AR::SeatHdRst_FL_Fwd_Rq = %d\n", intval);
	filePutString (buffer, elcount(buffer), hFile);
	intval = getSignal(CHASSIS::SeatAdj_FL_Rq_AR::SeatHdRst_FL_Rwd_Rq);
	snprintf(buffer, elcount(buffer), "   0.000000 F1 EIS::SeatAdj_FL_Rq_AR::SeatHdRst_FL_Rwd_Rq = %d\n", intval);
	filePutString (buffer, elcount(buffer), hFile);
	intval = getSignal(CHASSIS::SeatAdj_FL_Rq_AR::HdRst_R_Sw_Psd_DM_FL);
	snprintf(buffer, elcount(buffer), "   0.000000 F1 EIS::SeatAdj_FL_Rq_AR::HdRst_R_Sw_Psd_DM_FL = %d\n", intval);
	filePutString (buffer, elcount(buffer), hFile);
	intval = getSignal(CHASSIS::SeatAdj_FL_Rq_AR::RB_R_Sw_Psd_DM_FL);
	snprintf(buffer, elcount(buffer), "   0.000000 F1 EIS::SeatAdj_FL_Rq_AR::RB_R_Sw_Psd_DM_FL = %d\n", intval);
	filePutString (buffer, elcount(buffer), hFile);
	intval = @sysvar::CH_Nodes::CH_EISSeat_FR_TglSeatAdj_FR_AUTO;
	snprintf(buffer, elcount(buffer), "   0.000000    SV: 2 0 0 ::CH_Nodes::CH_EISSeat_FR_TglSeatAdj_FR_AUTO = %d\n", intval);
	filePutString (buffer, elcount(buffer), hFile);
	intval = getSignal(CHASSIS::SeatAdj_FR_Rq_AR::Seat_FR_Tgl);
	snprintf(buffer, elcount(buffer), "   0.000000 F1 EIS::SeatAdj_FR_Rq_AR::Seat_FR_Tgl = %d\n", intval);
	filePutString (buffer, elcount(buffer), hFile);
	intval = getSignal(CHASSIS::SeatAdj_FR_Rq_AR::SeatSwAdj_FR_Psd);
	snprintf(buffer, elcount(buffer), "   0.000000 F1 EIS::SeatAdj_FR_Rq_AR::SeatSwAdj_FR_Psd = %d\n", intval);
	filePutString (buffer, elcount(buffer), hFile);
	intval = getSignal(CHASSIS::SeatAdj_FR_Rq_AR::SeatPosn_FR_Fwd_Rq);
	snprintf(buffer, elcount(buffer), "   0.000000 F1 EIS::SeatAdj_FR_Rq_AR::SeatPosn_FR_Fwd_Rq = %d\n", intval);
	filePutString (buffer, elcount(buffer), hFile);
	intval = getSignal(CHASSIS::SeatAdj_FR_Rq_AR::SeatPosn_FR_Rwd_Rq);
	snprintf(buffer, elcount(buffer), "   0.000000 F1 EIS::SeatAdj_FR_Rq_AR::SeatPosn_FR_Rwd_Rq = %d\n", intval);
	filePutString (buffer, elcount(buffer), hFile);
	intval = getSignal(CHASSIS::SeatAdj_FR_Rq_AR::SeatTilt_FR_Dn_Rq);
	snprintf(buffer, elcount(buffer), "   0.000000 F1 EIS::SeatAdj_FR_Rq_AR::SeatTilt_FR_Dn_Rq = %d\n", intval);
	filePutString (buffer, elcount(buffer), hFile);
	intval = getSignal(CHASSIS::SeatAdj_FR_Rq_AR::SeatTilt_FR_Up_Rq);
	snprintf(buffer, elcount(buffer), "   0.000000 F1 EIS::SeatAdj_FR_Rq_AR::SeatTilt_FR_Up_Rq = %d\n", intval);
	filePutString (buffer, elcount(buffer), hFile);
	intval = getSignal(CHASSIS::SeatAdj_FR_Rq_AR::SeatHght_FR_Dn_Rq);
	snprintf(buffer, elcount(buffer), "   0.000000 F1 EIS::SeatAdj_FR_Rq_AR::SeatHght_FR_Dn_Rq = %d\n", intval);
	filePutString (buffer, elcount(buffer), hFile);
	intval = getSignal(CHASSIS::SeatAdj_FR_Rq_AR::SeatHght_FR_Up_Rq);
	snprintf(buffer, elcount(buffer), "   0.000000 F1 EIS::SeatAdj_FR_Rq_AR::SeatHght_FR_Up_Rq = %d\n", intval);
	filePutString (buffer, elcount(buffer), hFile);
	intval = getSignal(CHASSIS::SeatAdj_FR_Rq_AR::SeatCsn_FR_Fwd_Rq);
	snprintf(buffer, elcount(buffer), "   0.000000 F1 EIS::SeatAdj_FR_Rq_AR::SeatCsn_FR_Fwd_Rq = %d\n", intval);
	filePutString (buffer, elcount(buffer), hFile);
	intval = getSignal(CHASSIS::SeatAdj_FR_Rq_AR::SeatCsn_FR_Rwd_Rq);
	snprintf(buffer, elcount(buffer), "   0.000000 F1 EIS::SeatAdj_FR_Rq_AR::SeatCsn_FR_Rwd_Rq = %d\n", intval);
	filePutString (buffer, elcount(buffer), hFile);
	intval = getSignal(CHASSIS::SeatAdj_FR_Rq_AR::SeatBkRst_FR_Fwd_Rq);
	snprintf(buffer, elcount(buffer), "   0.000000 F1 EIS::SeatAdj_FR_Rq_AR::SeatBkRst_FR_Fwd_Rq = %d\n", intval);
	filePutString (buffer, elcount(buffer), hFile);
	intval = getSignal(CHASSIS::SeatAdj_FR_Rq_AR::SeatBkRst_FR_Rwd_Rq);
	snprintf(buffer, elcount(buffer), "   0.000000 F1 EIS::SeatAdj_FR_Rq_AR::SeatBkRst_FR_Rwd_Rq = %d\n", intval);
	filePutString (buffer, elcount(buffer), hFile);
	intval = getSignal(CHASSIS::SeatAdj_FR_Rq_AR::SeatHdRst_FR_Dn_Rq);
	snprintf(buffer, elcount(buffer), "   0.000000 F1 EIS::SeatAdj_FR_Rq_AR::SeatHdRst_FR_Dn_Rq = %d\n", intval);
	filePutString (buffer, elcount(buffer), hFile);
	intval = getSignal(CHASSIS::SeatAdj_FR_Rq_AR::SeatHdRst_FR_Up_Rq);
	snprintf(buffer, elcount(buffer), "   0.000000 F1 EIS::SeatAdj_FR_Rq_AR::SeatHdRst_FR_Up_Rq = %d\n", intval);
	filePutString (buffer, elcount(buffer), hFile);
	intval = getSignal(CHASSIS::SeatAdj_FR_Rq_AR::MirrAdjSw_Rt_Psd);
	snprintf(buffer, elcount(buffer), "   0.000000 F1 EIS::SeatAdj_FR_Rq_AR::MirrAdjSw_Rt_Psd = %d\n", intval);
	filePutString (buffer, elcount(buffer), hFile);
	intval = getSignal(CHASSIS::SeatAdj_FR_Rq_AR::MemPosn_FR);
	snprintf(buffer, elcount(buffer), "   0.000000 F1 EIS::SeatAdj_FR_Rq_AR::MemPosn_FR = %d\n", intval);
	filePutString (buffer, elcount(buffer), hFile);
	intval = getSignal(CHASSIS::SeatAdj_FR_Rq_AR::MemPosn_FR_Rc_Rq);
	snprintf(buffer, elcount(buffer), "   0.000000 F1 EIS::SeatAdj_FR_Rq_AR::MemPosn_FR_Rc_Rq = %d\n", intval);
	filePutString (buffer, elcount(buffer), hFile);
	intval = getSignal(CHASSIS::SeatAdj_FR_Rq_AR::MemPosn_FR_Sv_Rq);
	snprintf(buffer, elcount(buffer), "   0.000000 F1 EIS::SeatAdj_FR_Rq_AR::MemPosn_FR_Sv_Rq = %d\n", intval);
	filePutString (buffer, elcount(buffer), hFile);
	intval = getSignal(CHASSIS::SeatAdj_FR_Rq_AR::SeatVn_FR_Posn_Rq);
	snprintf(buffer, elcount(buffer), "   0.000000 F1 EIS::SeatAdj_FR_Rq_AR::SeatVn_FR_Posn_Rq = %d\n", intval);
	filePutString (buffer, elcount(buffer), hFile);
	intval = getSignal(CHASSIS::SeatAdj_FR_Rq_AR::SeatHt_FR_Posn_Rq);
	snprintf(buffer, elcount(buffer), "   0.000000 F1 EIS::SeatAdj_FR_Rq_AR::SeatHt_FR_Posn_Rq = %d\n", intval);
	filePutString (buffer, elcount(buffer), hFile);
	intval = getSignal(CHASSIS::SeatAdj_FR_Rq_AR::AirScarf_FR_Sw_Psd);
	snprintf(buffer, elcount(buffer), "   0.000000 F1 EIS::SeatAdj_FR_Rq_AR::AirScarf_FR_Sw_Psd = %d\n", intval);
	filePutString (buffer, elcount(buffer), hFile);
	intval = getSignal(CHASSIS::SeatAdj_FR_Rq_AR::SeatHdRst_FR_Fwd_Rq);
	snprintf(buffer, elcount(buffer), "   0.000000 F1 EIS::SeatAdj_FR_Rq_AR::SeatHdRst_FR_Fwd_Rq = %d\n", intval);
	filePutString (buffer, elcount(buffer), hFile);
	intval = getSignal(CHASSIS::SeatAdj_FR_Rq_AR::SeatHdRst_FR_Rwd_Rq);
	snprintf(buffer, elcount(buffer), "   0.000000 F1 EIS::SeatAdj_FR_Rq_AR::SeatHdRst_FR_Rwd_Rq = %d\n", intval);
	filePutString (buffer, elcount(buffer), hFile);
	intval = getSignal(CHASSIS::SeatAdj_FR_Rq_AR::HdRst_R_Sw_Psd_DM_FR);
	snprintf(buffer, elcount(buffer), "   0.000000 F1 EIS::SeatAdj_FR_Rq_AR::HdRst_R_Sw_Psd_DM_FR = %d\n", intval);
	filePutString (buffer, elcount(buffer), hFile);
	intval = getSignal(CHASSIS::SeatAdj_FR_Rq_AR::RB_R_Sw_Psd_DM_FR);
	snprintf(buffer, elcount(buffer), "   0.000000 F1 EIS::SeatAdj_FR_Rq_AR::RB_R_Sw_Psd_DM_FR = %d\n", intval);
	filePutString (buffer, elcount(buffer), hFile);
	intval = @sysvar::CH_Nodes::CH_EISCRC_SPCR_Stat_BC_F_Pr_AUTO;
	snprintf(buffer, elcount(buffer), "   0.000000    SV: 2 0 0 ::CH_Nodes::CH_EISCRC_SPCR_Stat_BC_F_Pr_AUTO = %d\n", intval);
	filePutString (buffer, elcount(buffer), hFile);
	intval = getSignal(CHASSIS::SPCR_Stat_BC_F_AR2::CRC_SPCR_Stat_BC_F_Pr2);
	snprintf(buffer, elcount(buffer), "   0.000000 F1 EIS::SPCR_Stat_BC_F_AR2::CRC_SPCR_Stat_BC_F_Pr2 = %d\n", intval);
	filePutString (buffer, elcount(buffer), hFile);
	intval = @sysvar::CH_Nodes::CH_EISSQC_SPCR_Stat_BC_F_Pr_AUTO;
	snprintf(buffer, elcount(buffer), "   0.000000    SV: 2 0 0 ::CH_Nodes::CH_EISSQC_SPCR_Stat_BC_F_Pr_AUTO = %d\n", intval);
	filePutString (buffer, elcount(buffer), hFile);
	intval = getSignal(CHASSIS::SPCR_Stat_BC_F_AR2::SQC_SPCR_Stat_BC_F_Pr2);
	snprintf(buffer, elcount(buffer), "   0.000000 F1 EIS::SPCR_Stat_BC_F_AR2::SQC_SPCR_Stat_BC_F_Pr2 = %d\n", intval);
	filePutString (buffer, elcount(buffer), hFile);
	intval = getSignal(CHASSIS::SPCR_Stat_BC_F_AR2::SPCR_Conf_BC_F);
	snprintf(buffer, elcount(buffer), "   0.000000 F1 EIS::SPCR_Stat_BC_F_AR2::SPCR_Conf_BC_F = %d\n", intval);
	filePutString (buffer, elcount(buffer), hFile);
	intval = getSignal(CHASSIS::SPCR_Stat_BC_F_AR2::SPCR_Sp_Stat_BC_F);
	snprintf(buffer, elcount(buffer), "   0.000000 F1 EIS::SPCR_Stat_BC_F_AR2::SPCR_Sp_Stat_BC_F = %d\n", intval);
	filePutString (buffer, elcount(buffer), hFile);
	intval = getSignal(CHASSIS::SPCR_Stat_BC_F_AR2::SPCR_WrMon_Stat_BC_F);
	snprintf(buffer, elcount(buffer), "   0.000000 F1 EIS::SPCR_Stat_BC_F_AR2::SPCR_WrMon_Stat_BC_F = %d\n", intval);
	filePutString (buffer, elcount(buffer), hFile);
	intval = getSignal(CHASSIS::SPCR_Stat_BC_F_AR2::SPCR_Flt_BC_F);
	snprintf(buffer, elcount(buffer), "   0.000000 F1 EIS::SPCR_Stat_BC_F_AR2::SPCR_Flt_BC_F = %d\n", intval);
	filePutString (buffer, elcount(buffer), hFile);
	intval = getSignal(CHASSIS::SPCR_Stat_BC_F_AR2::Rsrv1_SPCR_Stat_BC_F_Pr2);
	snprintf(buffer, elcount(buffer), "   0.000000 F1 EIS::SPCR_Stat_BC_F_AR2::Rsrv1_SPCR_Stat_BC_F_Pr2 = %d\n", intval);
	filePutString (buffer, elcount(buffer), hFile);
	intval = @sysvar::CH_Nodes::CH_EISCRC_SPL_Obj1_Obj2_NV__AUTO;
	snprintf(buffer, elcount(buffer), "   0.000000    SV: 2 0 0 ::CH_Nodes::CH_EISCRC_SPL_Obj1_Obj2_NV__AUTO = %d\n", intval);
	filePutString (buffer, elcount(buffer), hFile);
	intval = getSignal(CHASSIS::SPL_Obj1_Obj2_NV_AR2::CRC_SPL_Obj1_Obj2_NV_Pr2);
	snprintf(buffer, elcount(buffer), "   0.000000 F1 EIS::SPL_Obj1_Obj2_NV_AR2::CRC_SPL_Obj1_Obj2_NV_Pr2 = %d\n", intval);
	filePutString (buffer, elcount(buffer), hFile);
	intval = @sysvar::CH_Nodes::CH_EISSQC_SPL_Obj1_Obj2_NV__AUTO;
	snprintf(buffer, elcount(buffer), "   0.000000    SV: 2 0 0 ::CH_Nodes::CH_EISSQC_SPL_Obj1_Obj2_NV__AUTO = %d\n", intval);
	filePutString (buffer, elcount(buffer), hFile);
	intval = getSignal(CHASSIS::SPL_Obj1_Obj2_NV_AR2::SQC_SPL_Obj1_Obj2_NV_Pr2);
	snprintf(buffer, elcount(buffer), "   0.000000 F1 EIS::SPL_Obj1_Obj2_NV_AR2::SQC_SPL_Obj1_Obj2_NV_Pr2 = %d\n", intval);
	filePutString (buffer, elcount(buffer), hFile);
	intval = getSignal(CHASSIS::SPL_Obj1_Obj2_NV_AR2::Rsrv1_SPL_Obj1_Obj2_NV_Pr2);
	snprintf(buffer, elcount(buffer), "   0.000000 F1 EIS::SPL_Obj1_Obj2_NV_AR2::Rsrv1_SPL_Obj1_Obj2_NV_Pr2 = %d\n", intval);
	filePutString (buffer, elcount(buffer), hFile);
	intval = getSignal(CHASSIS::SPL_Obj1_Obj2_NV_AR2::SPL_Obj1_Id_NV);
	snprintf(buffer, elcount(buffer), "   0.000000 F1 EIS::SPL_Obj1_Obj2_NV_AR2::SPL_Obj1_Id_NV = %d\n", intval);
	filePutString (buffer, elcount(buffer), hFile);
	intval = getSignal(CHASSIS::SPL_Obj1_Obj2_NV_AR2::SPL_Obj1_Dist_NV);
	snprintf(buffer, elcount(buffer), "   0.000000 F1 EIS::SPL_Obj1_Obj2_NV_AR2::SPL_Obj1_Dist_NV = %d\n", intval);
	filePutString (buffer, elcount(buffer), hFile);
	floatval = getSignal(CHASSIS::SPL_Obj1_Obj2_NV_AR2::SPL_Obj1_HrztAngl_NV);
	snprintf(buffer, elcount(buffer), "   0.000000 F1 EIS::SPL_Obj1_Obj2_NV_AR2::SPL_Obj1_HrztAngl_NV = %f\n", floatval);
	filePutString (buffer, elcount(buffer), hFile);
	intval = getSignal(CHASSIS::SPL_Obj1_Obj2_NV_AR2::Rsrv2_SPL_Obj1_Obj2_NV_Pr2);
	snprintf(buffer, elcount(buffer), "   0.000000 F1 EIS::SPL_Obj1_Obj2_NV_AR2::Rsrv2_SPL_Obj1_Obj2_NV_Pr2 = %d\n", intval);
	filePutString (buffer, elcount(buffer), hFile);
	intval = getSignal(CHASSIS::SPL_Obj1_Obj2_NV_AR2::SPL_Obj1_Type_NV);
	snprintf(buffer, elcount(buffer), "   0.000000 F1 EIS::SPL_Obj1_Obj2_NV_AR2::SPL_Obj1_Type_NV = %d\n", intval);
	filePutString (buffer, elcount(buffer), hFile);
	intval = getSignal(CHASSIS::SPL_Obj1_Obj2_NV_AR2::SPL_Obj1_Ill_Rq_NV);
	snprintf(buffer, elcount(buffer), "   0.000000 F1 EIS::SPL_Obj1_Obj2_NV_AR2::SPL_Obj1_Ill_Rq_NV = %d\n", intval);
	filePutString (buffer, elcount(buffer), hFile);
	intval = getSignal(CHASSIS::SPL_Obj1_Obj2_NV_AR2::SPL_Obj2_Id_NV);
	snprintf(buffer, elcount(buffer), "   0.000000 F1 EIS::SPL_Obj1_Obj2_NV_AR2::SPL_Obj2_Id_NV = %d\n", intval);
	filePutString (buffer, elcount(buffer), hFile);
	intval = getSignal(CHASSIS::SPL_Obj1_Obj2_NV_AR2::SPL_Obj2_Dist_NV);
	snprintf(buffer, elcount(buffer), "   0.000000 F1 EIS::SPL_Obj1_Obj2_NV_AR2::SPL_Obj2_Dist_NV = %d\n", intval);
	filePutString (buffer, elcount(buffer), hFile);
	floatval = getSignal(CHASSIS::SPL_Obj1_Obj2_NV_AR2::SPL_Obj2_HrztAngl_NV);
	snprintf(buffer, elcount(buffer), "   0.000000 F1 EIS::SPL_Obj1_Obj2_NV_AR2::SPL_Obj2_HrztAngl_NV = %f\n", floatval);
	filePutString (buffer, elcount(buffer), hFile);
	intval = getSignal(CHASSIS::SPL_Obj1_Obj2_NV_AR2::Rsrv3_SPL_Obj1_Obj2_NV_Pr2);
	snprintf(buffer, elcount(buffer), "   0.000000 F1 EIS::SPL_Obj1_Obj2_NV_AR2::Rsrv3_SPL_Obj1_Obj2_NV_Pr2 = %d\n", intval);
	filePutString (buffer, elcount(buffer), hFile);
	intval = getSignal(CHASSIS::SPL_Obj1_Obj2_NV_AR2::SPL_Obj2_Type_NV);
	snprintf(buffer, elcount(buffer), "   0.000000 F1 EIS::SPL_Obj1_Obj2_NV_AR2::SPL_Obj2_Type_NV = %d\n", intval);
	filePutString (buffer, elcount(buffer), hFile);
}
/*@@end*/

/*@@caplFunc:saveVars_54(dword):*/
void saveVars_54(dword hFile)
{
	intval = getSignal(CHASSIS::SPL_Obj1_Obj2_NV_AR2::SPL_Obj2_Ill_Rq_NV);
	snprintf(buffer, elcount(buffer), "   0.000000 F1 EIS::SPL_Obj1_Obj2_NV_AR2::SPL_Obj2_Ill_Rq_NV = %d\n", intval);
	filePutString (buffer, elcount(buffer), hFile);
	intval = @sysvar::CH_Nodes::CH_EISCRC_SPV_ExtLgt_Rq_Pr2_AUTO;
	snprintf(buffer, elcount(buffer), "   0.000000    SV: 2 0 0 ::CH_Nodes::CH_EISCRC_SPV_ExtLgt_Rq_Pr2_AUTO = %d\n", intval);
	filePutString (buffer, elcount(buffer), hFile);
	intval = getSignal(CHASSIS::SPV_Actn_Rq_AR2::CRC_SPV_ExtLgt_Rq_Pr2);
	snprintf(buffer, elcount(buffer), "   0.000000 F1 EIS::SPV_Actn_Rq_AR2::CRC_SPV_ExtLgt_Rq_Pr2 = %d\n", intval);
	filePutString (buffer, elcount(buffer), hFile);
	intval = @sysvar::CH_Nodes::CH_EISSQC_SPV_ExtLgt_Rq_Pr2_AUTO;
	snprintf(buffer, elcount(buffer), "   0.000000    SV: 2 0 0 ::CH_Nodes::CH_EISSQC_SPV_ExtLgt_Rq_Pr2_AUTO = %d\n", intval);
	filePutString (buffer, elcount(buffer), hFile);
	intval = getSignal(CHASSIS::SPV_Actn_Rq_AR2::SQC_SPV_ExtLgt_Rq_Pr2);
	snprintf(buffer, elcount(buffer), "   0.000000 F1 EIS::SPV_Actn_Rq_AR2::SQC_SPV_ExtLgt_Rq_Pr2 = %d\n", intval);
	filePutString (buffer, elcount(buffer), hFile);
	intval = getSignal(CHASSIS::SPV_Actn_Rq_AR2::TurnLvr_Psd_MPM);
	snprintf(buffer, elcount(buffer), "   0.000000 F1 EIS::SPV_Actn_Rq_AR2::TurnLvr_Psd_MPM = %d\n", intval);
	filePutString (buffer, elcount(buffer), hFile);
	intval = getSignal(CHASSIS::SPV_Actn_Rq_AR2::HiBmLvr_Stat_MPM);
	snprintf(buffer, elcount(buffer), "   0.000000 F1 EIS::SPV_Actn_Rq_AR2::HiBmLvr_Stat_MPM = %d\n", intval);
	filePutString (buffer, elcount(buffer), hFile);
	intval = getSignal(CHASSIS::SPV_Actn_Rq_AR2::FogLmp_R_On_Rq_MPM);
	snprintf(buffer, elcount(buffer), "   0.000000 F1 EIS::SPV_Actn_Rq_AR2::FogLmp_R_On_Rq_MPM = %d\n", intval);
	filePutString (buffer, elcount(buffer), hFile);
	intval = getSignal(CHASSIS::SPV_Actn_Rq_AR2::Rsrv1_SPV_ExtLgt_Rq_Pr2);
	snprintf(buffer, elcount(buffer), "   0.000000 F1 EIS::SPV_Actn_Rq_AR2::Rsrv1_SPV_ExtLgt_Rq_Pr2 = %d\n", intval);
	filePutString (buffer, elcount(buffer), hFile);
	intval = @sysvar::CH_Nodes::CH_EISCRC_SPV_WprWash_Rq_Pr_AUTO;
	snprintf(buffer, elcount(buffer), "   0.000000    SV: 2 0 0 ::CH_Nodes::CH_EISCRC_SPV_WprWash_Rq_Pr_AUTO = %d\n", intval);
	filePutString (buffer, elcount(buffer), hFile);
	intval = getSignal(CHASSIS::SPV_Actn_Rq_AR2::CRC_SPV_WprWash_Rq_Pr2);
	snprintf(buffer, elcount(buffer), "   0.000000 F1 EIS::SPV_Actn_Rq_AR2::CRC_SPV_WprWash_Rq_Pr2 = %d\n", intval);
	filePutString (buffer, elcount(buffer), hFile);
	intval = @sysvar::CH_Nodes::CH_EISSQC_SPV_WprWash_Rq_Pr_AUTO;
	snprintf(buffer, elcount(buffer), "   0.000000    SV: 2 0 0 ::CH_Nodes::CH_EISSQC_SPV_WprWash_Rq_Pr_AUTO = %d\n", intval);
	filePutString (buffer, elcount(buffer), hFile);
	intval = getSignal(CHASSIS::SPV_Actn_Rq_AR2::SQC_SPV_WprWash_Rq_Pr2);
	snprintf(buffer, elcount(buffer), "   0.000000 F1 EIS::SPV_Actn_Rq_AR2::SQC_SPV_WprWash_Rq_Pr2 = %d\n", intval);
	filePutString (buffer, elcount(buffer), hFile);
	intval = getSignal(CHASSIS::SPV_Actn_Rq_AR2::WprWashSw_Psd_MPM);
	snprintf(buffer, elcount(buffer), "   0.000000 F1 EIS::SPV_Actn_Rq_AR2::WprWashSw_Psd_MPM = %d\n", intval);
	filePutString (buffer, elcount(buffer), hFile);
	intval = getSignal(CHASSIS::SPV_Actn_Rq_AR2::WprWash_R_Sw_Posn_V2_MPM);
	snprintf(buffer, elcount(buffer), "   0.000000 F1 EIS::SPV_Actn_Rq_AR2::WprWash_R_Sw_Posn_V2_MPM = %d\n", intval);
	filePutString (buffer, elcount(buffer), hFile);
	intval = getSignal(CHASSIS::SPV_Actn_Rq_AR2::WprSw6Posn_MPM);
	snprintf(buffer, elcount(buffer), "   0.000000 F1 EIS::SPV_Actn_Rq_AR2::WprSw6Posn_MPM = %d\n", intval);
	filePutString (buffer, elcount(buffer), hFile);
	intval = getSignal(CHASSIS::SPV_Actn_Rq_AR2::Rsrv1_SPV_WprWash_Rq_Pr2);
	snprintf(buffer, elcount(buffer), "   0.000000 F1 EIS::SPV_Actn_Rq_AR2::Rsrv1_SPV_WprWash_Rq_Pr2 = %d\n", intval);
	filePutString (buffer, elcount(buffer), hFile);
	intval = getSignal(CHASSIS::SPV_Alm_Rq_AR::CLkS_Lk_Rq);
	snprintf(buffer, elcount(buffer), "   0.000000 F1 EIS::SPV_Alm_Rq_AR::CLkS_Lk_Rq = %d\n", intval);
	filePutString (buffer, elcount(buffer), hFile);
	intval = getSignal(CHASSIS::SPV_Alm_Rq_AR::IL_On_Rq);
	snprintf(buffer, elcount(buffer), "   0.000000 F1 EIS::SPV_Alm_Rq_AR::IL_On_Rq = %d\n", intval);
	filePutString (buffer, elcount(buffer), hFile);
	intval = getSignal(CHASSIS::SPV_Alm_Rq_AR::HVAC_RecircAir_On_Rq_MPM);
	snprintf(buffer, elcount(buffer), "   0.000000 F1 EIS::SPV_Alm_Rq_AR::HVAC_RecircAir_On_Rq_MPM = %d\n", intval);
	filePutString (buffer, elcount(buffer), hFile);
	intval = getSignal(CHASSIS::SPV_Alm_Rq_AR::SPV_Alarm_LF_Rq);
	snprintf(buffer, elcount(buffer), "   0.000000 F1 EIS::SPV_Alm_Rq_AR::SPV_Alarm_LF_Rq = %d\n", intval);
	filePutString (buffer, elcount(buffer), hFile);
	intval = getSignal(CHASSIS::SPV_Alm_Rq_AR::SPV_SoSi_LF_Rq);
	snprintf(buffer, elcount(buffer), "   0.000000 F1 EIS::SPV_Alm_Rq_AR::SPV_SoSi_LF_Rq = %d\n", intval);
	filePutString (buffer, elcount(buffer), hFile);
	intval = getSignal(CHASSIS::SPV_Alm_Rq_AR::Hrn_On_Rq_Alm);
	snprintf(buffer, elcount(buffer), "   0.000000 F1 EIS::SPV_Alm_Rq_AR::Hrn_On_Rq_Alm = %d\n", intval);
	filePutString (buffer, elcount(buffer), hFile);
	intval = getSignal(CHASSIS::SPV_Alm_Rq_AR::HrnOnDur);
	snprintf(buffer, elcount(buffer), "   0.000000 F1 EIS::SPV_Alm_Rq_AR::HrnOnDur = %d\n", intval);
	filePutString (buffer, elcount(buffer), hFile);
	intval = getSignal(CHASSIS::SPV_Stat_AR2::PN14_SupBatCutSw_Rq);
	snprintf(buffer, elcount(buffer), "   0.000000 F1 EIS::SPV_Stat_AR2::PN14_SupBatCutSw_Rq = %d\n", intval);
	filePutString (buffer, elcount(buffer), hFile);
	intval = getSignal(CHASSIS::SPV_Stat_AR2::Volt_Low_MPM);
	snprintf(buffer, elcount(buffer), "   0.000000 F1 EIS::SPV_Stat_AR2::Volt_Low_MPM = %d\n", intval);
	filePutString (buffer, elcount(buffer), hFile);
	intval = getSignal(CHASSIS::SPV_Stat_AR2::EmgAlm_Flt);
	snprintf(buffer, elcount(buffer), "   0.000000 F1 EIS::SPV_Stat_AR2::EmgAlm_Flt = %d\n", intval);
	filePutString (buffer, elcount(buffer), hFile);
	intval = getSignal(CHASSIS::SPV_Stat_AR2::ES_EmgVeh_Flt);
	snprintf(buffer, elcount(buffer), "   0.000000 F1 EIS::SPV_Stat_AR2::ES_EmgVeh_Flt = %d\n", intval);
	filePutString (buffer, elcount(buffer), hFile);
	intval = getSignal(CHASSIS::SPV_Stat_AR2::ES_Taxi_Flt);
	snprintf(buffer, elcount(buffer), "   0.000000 F1 EIS::SPV_Stat_AR2::ES_Taxi_Flt = %d\n", intval);
	filePutString (buffer, elcount(buffer), hFile);
	intval = getSignal(CHASSIS::SPV_Stat_AR2::CiA447_Flt);
	snprintf(buffer, elcount(buffer), "   0.000000 F1 EIS::SPV_Stat_AR2::CiA447_Flt = %d\n", intval);
	filePutString (buffer, elcount(buffer), hFile);
	intval = getSignal(CHASSIS::SPV_Stat_AR2::C2X_Emg_Actv);
	snprintf(buffer, elcount(buffer), "   0.000000 F1 EIS::SPV_Stat_AR2::C2X_Emg_Actv = %d\n", intval);
	filePutString (buffer, elcount(buffer), hFile);
	intval = getSignal(CHASSIS::SPV_Stat_AR2::FES_Empty);
	snprintf(buffer, elcount(buffer), "   0.000000 F1 EIS::SPV_Stat_AR2::FES_Empty = %d\n", intval);
	filePutString (buffer, elcount(buffer), hFile);
	intval = getSignal(CHASSIS::SPV_Stat_AR2::FES_Actv);
	snprintf(buffer, elcount(buffer), "   0.000000 F1 EIS::SPV_Stat_AR2::FES_Actv = %d\n", intval);
	filePutString (buffer, elcount(buffer), hFile);
	intval = getSignal(CHASSIS::SPV_Stat_AR2::FES_On);
	snprintf(buffer, elcount(buffer), "   0.000000 F1 EIS::SPV_Stat_AR2::FES_On = %d\n", intval);
	filePutString (buffer, elcount(buffer), hFile);
	intval = getSignal(CHASSIS::SPV_Stat_AR2::FES_Flt);
	snprintf(buffer, elcount(buffer), "   0.000000 F1 EIS::SPV_Stat_AR2::FES_Flt = %d\n", intval);
	filePutString (buffer, elcount(buffer), hFile);
	intval = getSignal(CHASSIS::SPV_Stat_AR2::FAS_Empty);
	snprintf(buffer, elcount(buffer), "   0.000000 F1 EIS::SPV_Stat_AR2::FAS_Empty = %d\n", intval);
	filePutString (buffer, elcount(buffer), hFile);
	intval = getSignal(CHASSIS::SPV_Stat_AR2::FAS_Actv);
	snprintf(buffer, elcount(buffer), "   0.000000 F1 EIS::SPV_Stat_AR2::FAS_Actv = %d\n", intval);
	filePutString (buffer, elcount(buffer), hFile);
	intval = getSignal(CHASSIS::SPV_Stat_AR2::FAS_Inact);
	snprintf(buffer, elcount(buffer), "   0.000000 F1 EIS::SPV_Stat_AR2::FAS_Inact = %d\n", intval);
	filePutString (buffer, elcount(buffer), hFile);
	intval = getSignal(CHASSIS::SPV_Stat_AR2::SSA_Dsbl_Rq_MPM);
	snprintf(buffer, elcount(buffer), "   0.000000 F1 EIS::SPV_Stat_AR2::SSA_Dsbl_Rq_MPM = %d\n", intval);
	filePutString (buffer, elcount(buffer), hFile);
	intval = getSignal(CHASSIS::SPV_Stat_AR2::IL_Dim_On_Rq);
	snprintf(buffer, elcount(buffer), "   0.000000 F1 EIS::SPV_Stat_AR2::IL_Dim_On_Rq = %d\n", intval);
	filePutString (buffer, elcount(buffer), hFile);
	intval = getSignal(CHASSIS::SPV_Stat_AR2::RoofLmpIndLmp_On_Rq);
	snprintf(buffer, elcount(buffer), "   0.000000 F1 EIS::SPV_Stat_AR2::RoofLmpIndLmp_On_Rq = %d\n", intval);
	filePutString (buffer, elcount(buffer), hFile);
	intval = getSignal(CHASSIS::SPV_Stat_AR2::RoofLmpChk_Rq);
	snprintf(buffer, elcount(buffer), "   0.000000 F1 EIS::SPV_Stat_AR2::RoofLmpChk_Rq = %d\n", intval);
	filePutString (buffer, elcount(buffer), hFile);
	intval = getSignal(CHASSIS::SPV_Stat_AR2::ES_TaxiLim_Warn);
	snprintf(buffer, elcount(buffer), "   0.000000 F1 EIS::SPV_Stat_AR2::ES_TaxiLim_Warn = %d\n", intval);
	filePutString (buffer, elcount(buffer), hFile);
	intval = getSignal(CHASSIS::SPV_Stat_AR2::ContEngRun_Sw_Psd);
	snprintf(buffer, elcount(buffer), "   0.000000 F1 EIS::SPV_Stat_AR2::ContEngRun_Sw_Psd = %d\n", intval);
	filePutString (buffer, elcount(buffer), hFile);
	intval = getSignal(CHASSIS::SPV_Stat_AR2::EF_On_Rq_MPM);
	snprintf(buffer, elcount(buffer), "   0.000000 F1 EIS::SPV_Stat_AR2::EF_On_Rq_MPM = %d\n", intval);
	filePutString (buffer, elcount(buffer), hFile);
	intval = getSignal(CHASSIS::SPV_Stat_AR2::TaxiRoofLmpMd_Stat);
	snprintf(buffer, elcount(buffer), "   0.000000 F1 EIS::SPV_Stat_AR2::TaxiRoofLmpMd_Stat = %d\n", intval);
	filePutString (buffer, elcount(buffer), hFile);
	intval = getSignal(CHASSIS::SPV_Stat_AR2::Audio_TwoCabSrc_Rq);
	snprintf(buffer, elcount(buffer), "   0.000000 F1 EIS::SPV_Stat_AR2::Audio_TwoCabSrc_Rq = %d\n", intval);
	filePutString (buffer, elcount(buffer), hFile);
	intval = getSignal(CHASSIS::SPV_Stat_AR2::Audio_TwoCabSnd_Stat);
	snprintf(buffer, elcount(buffer), "   0.000000 F1 EIS::SPV_Stat_AR2::Audio_TwoCabSnd_Stat = %d\n", intval);
	filePutString (buffer, elcount(buffer), hFile);
	intval = getSignal(CHASSIS::SPV_Stat_AR2::Hrn_On_Rq_MPM);
	snprintf(buffer, elcount(buffer), "   0.000000 F1 EIS::SPV_Stat_AR2::Hrn_On_Rq_MPM = %d\n", intval);
	filePutString (buffer, elcount(buffer), hFile);
	intval = getSignal(CHASSIS::SVS_Rq_HU_AR2::SVS_BrtLvl);
	snprintf(buffer, elcount(buffer), "   0.000000 F1 EIS::SVS_Rq_HU_AR2::SVS_BrtLvl = %d\n", intval);
	filePutString (buffer, elcount(buffer), hFile);
	intval = getSignal(CHASSIS::SVS_Rq_HU_AR2::PARK_SysMd_Rq_HU);
	snprintf(buffer, elcount(buffer), "   0.000000 F1 EIS::SVS_Rq_HU_AR2::PARK_SysMd_Rq_HU = %d\n", intval);
	filePutString (buffer, elcount(buffer), hFile);
	intval = getSignal(CHASSIS::SVS_Rq_HU_AR2::SVS_ServMd_Rq);
	snprintf(buffer, elcount(buffer), "   0.000000 F1 EIS::SVS_Rq_HU_AR2::SVS_ServMd_Rq = %d\n", intval);
	filePutString (buffer, elcount(buffer), hFile);
	intval = getSignal(CHASSIS::SVS_Rq_HU_AR2::SVS_Disp_Actv);
	snprintf(buffer, elcount(buffer), "   0.000000 F1 EIS::SVS_Rq_HU_AR2::SVS_Disp_Actv = %d\n", intval);
	filePutString (buffer, elcount(buffer), hFile);
	intval = getSignal(CHASSIS::SVS_Rq_HU_AR2::SVS_RevGrActvMd_Rq);
	snprintf(buffer, elcount(buffer), "   0.000000 F1 EIS::SVS_Rq_HU_AR2::SVS_RevGrActvMd_Rq = %d\n", intval);
	filePutString (buffer, elcount(buffer), hFile);
	intval = getSignal(CHASSIS::SVS_Rq_HU_AR2::SVS_PkActvMd_Rq);
	snprintf(buffer, elcount(buffer), "   0.000000 F1 EIS::SVS_Rq_HU_AR2::SVS_PkActvMd_Rq = %d\n", intval);
	filePutString (buffer, elcount(buffer), hFile);
}
/*@@end*/

/*@@caplFunc:saveVars_55(dword):*/
void saveVars_55(dword hFile)
{
	intval = getSignal(CHASSIS::SVS_Rq_HU_AR2::SVS_ShortRngObjDtct_Actv);
	snprintf(buffer, elcount(buffer), "   0.000000 F1 EIS::SVS_Rq_HU_AR2::SVS_ShortRngObjDtct_Actv = %d\n", intval);
	filePutString (buffer, elcount(buffer), hFile);
	intval = getSignal(CHASSIS::SVS_Rq_HU_AR2::PARK_RemLocalList_Rq);
	snprintf(buffer, elcount(buffer), "   0.000000 F1 EIS::SVS_Rq_HU_AR2::PARK_RemLocalList_Rq = %d\n", intval);
	filePutString (buffer, elcount(buffer), hFile);
	intval = getSignal(CHASSIS::SVS_Rq_HU_AR2::PARK_RemLocalPosn_Rq);
	snprintf(buffer, elcount(buffer), "   0.000000 F1 EIS::SVS_Rq_HU_AR2::PARK_RemLocalPosn_Rq = %d\n", intval);
	filePutString (buffer, elcount(buffer), hFile);
	intval = getSignal(CHASSIS::SVS_Rq_HU_AR2::PARK_Hitch_KinkAngl_Rq);
	snprintf(buffer, elcount(buffer), "   0.000000 F1 EIS::SVS_Rq_HU_AR2::PARK_Hitch_KinkAngl_Rq = %d\n", intval);
	filePutString (buffer, elcount(buffer), hFile);
	intval = getSignal(CHASSIS::TBCSC_DAC_EPS_AR2::TBCSC_DAC_EPS_Data1);
	snprintf(buffer, elcount(buffer), "   0.000000 F1 EIS::TBCSC_DAC_EPS_AR2::TBCSC_DAC_EPS_Data1 = %d\n", intval);
	filePutString (buffer, elcount(buffer), hFile);
	intval = getSignal(CHASSIS::TBCSC_DAC_EPS_AR2::TBCSC_DAC_EPS_Data2);
	snprintf(buffer, elcount(buffer), "   0.000000 F1 EIS::TBCSC_DAC_EPS_AR2::TBCSC_DAC_EPS_Data2 = %d\n", intval);
	filePutString (buffer, elcount(buffer), hFile);
	intval = getSignal(CHASSIS::TBCSC_DAC_EPS_AR2::TBCSC_DAC_EPS_Data3);
	snprintf(buffer, elcount(buffer), "   0.000000 F1 EIS::TBCSC_DAC_EPS_AR2::TBCSC_DAC_EPS_Data3 = %d\n", intval);
	filePutString (buffer, elcount(buffer), hFile);
	intval = getSignal(CHASSIS::TBCSC_DAC_EPS_AR2::TBCSC_DAC_EPS_Data4);
	snprintf(buffer, elcount(buffer), "   0.000000 F1 EIS::TBCSC_DAC_EPS_AR2::TBCSC_DAC_EPS_Data4 = %d\n", intval);
	filePutString (buffer, elcount(buffer), hFile);
	intval = getSignal(CHASSIS::TBCSC_DAC_EPS_AR2::TBCSC_DAC_EPS_Data5);
	snprintf(buffer, elcount(buffer), "   0.000000 F1 EIS::TBCSC_DAC_EPS_AR2::TBCSC_DAC_EPS_Data5 = %d\n", intval);
	filePutString (buffer, elcount(buffer), hFile);
	intval = getSignal(CHASSIS::TBCSC_DAC_EPS_AR2::TBCSC_DAC_EPS_Data6);
	snprintf(buffer, elcount(buffer), "   0.000000 F1 EIS::TBCSC_DAC_EPS_AR2::TBCSC_DAC_EPS_Data6 = %d\n", intval);
	filePutString (buffer, elcount(buffer), hFile);
	intval = getSignal(CHASSIS::TBCSC_DAC_EPS_AR2::TBCSC_DAC_EPS_Data7);
	snprintf(buffer, elcount(buffer), "   0.000000 F1 EIS::TBCSC_DAC_EPS_AR2::TBCSC_DAC_EPS_Data7 = %d\n", intval);
	filePutString (buffer, elcount(buffer), hFile);
	intval = getSignal(CHASSIS::TBCSC_DAC_EPS_AR2::TBCSC_DAC_EPS_Data8);
	snprintf(buffer, elcount(buffer), "   0.000000 F1 EIS::TBCSC_DAC_EPS_AR2::TBCSC_DAC_EPS_Data8 = %d\n", intval);
	filePutString (buffer, elcount(buffer), hFile);
	intval = getSignal(CHASSIS::TBCSC_DAC_ESP_AR2::TBCSC_DAC_ESP_Data1);
	snprintf(buffer, elcount(buffer), "   0.000000 F1 EIS::TBCSC_DAC_ESP_AR2::TBCSC_DAC_ESP_Data1 = %d\n", intval);
	filePutString (buffer, elcount(buffer), hFile);
	intval = getSignal(CHASSIS::TBCSC_DAC_ESP_AR2::TBCSC_DAC_ESP_Data2);
	snprintf(buffer, elcount(buffer), "   0.000000 F1 EIS::TBCSC_DAC_ESP_AR2::TBCSC_DAC_ESP_Data2 = %d\n", intval);
	filePutString (buffer, elcount(buffer), hFile);
	intval = getSignal(CHASSIS::TBCSC_DAC_ESP_AR2::TBCSC_DAC_ESP_Data3);
	snprintf(buffer, elcount(buffer), "   0.000000 F1 EIS::TBCSC_DAC_ESP_AR2::TBCSC_DAC_ESP_Data3 = %d\n", intval);
	filePutString (buffer, elcount(buffer), hFile);
	intval = getSignal(CHASSIS::TBCSC_DAC_ESP_AR2::TBCSC_DAC_ESP_Data4);
	snprintf(buffer, elcount(buffer), "   0.000000 F1 EIS::TBCSC_DAC_ESP_AR2::TBCSC_DAC_ESP_Data4 = %d\n", intval);
	filePutString (buffer, elcount(buffer), hFile);
	intval = getSignal(CHASSIS::TBCSC_DAC_ESP_AR2::TBCSC_DAC_ESP_Data5);
	snprintf(buffer, elcount(buffer), "   0.000000 F1 EIS::TBCSC_DAC_ESP_AR2::TBCSC_DAC_ESP_Data5 = %d\n", intval);
	filePutString (buffer, elcount(buffer), hFile);
	intval = getSignal(CHASSIS::TBCSC_DAC_ESP_AR2::TBCSC_DAC_ESP_Data6);
	snprintf(buffer, elcount(buffer), "   0.000000 F1 EIS::TBCSC_DAC_ESP_AR2::TBCSC_DAC_ESP_Data6 = %d\n", intval);
	filePutString (buffer, elcount(buffer), hFile);
	intval = getSignal(CHASSIS::TBCSC_DAC_ESP_AR2::TBCSC_DAC_ESP_Data7);
	snprintf(buffer, elcount(buffer), "   0.000000 F1 EIS::TBCSC_DAC_ESP_AR2::TBCSC_DAC_ESP_Data7 = %d\n", intval);
	filePutString (buffer, elcount(buffer), hFile);
	intval = getSignal(CHASSIS::TBCSC_DAC_ESP_AR2::TBCSC_DAC_ESP_Data8);
	snprintf(buffer, elcount(buffer), "   0.000000 F1 EIS::TBCSC_DAC_ESP_AR2::TBCSC_DAC_ESP_Data8 = %d\n", intval);
	filePutString (buffer, elcount(buffer), hFile);
	intval = @sysvar::CH_Nodes::CH_EISCRC_TBCSC_Hi_Rq1_Pr2T_AUTO;
	snprintf(buffer, elcount(buffer), "   0.000000    SV: 2 0 0 ::CH_Nodes::CH_EISCRC_TBCSC_Hi_Rq1_Pr2T_AUTO = %d\n", intval);
	filePutString (buffer, elcount(buffer), hFile);
	intval = getSignal(CHASSIS::TBCSC_Hi_Rq1_AR2::CRC_TBCSC_Hi_Rq1_Pr2);
	snprintf(buffer, elcount(buffer), "   0.000000 F1 EIS::TBCSC_Hi_Rq1_AR2::CRC_TBCSC_Hi_Rq1_Pr2 = %d\n", intval);
	filePutString (buffer, elcount(buffer), hFile);
	intval = @sysvar::CH_Nodes::CH_EISSQC_TBCSC_Hi_Rq1_Pr2T_AUTO;
	snprintf(buffer, elcount(buffer), "   0.000000    SV: 2 0 0 ::CH_Nodes::CH_EISSQC_TBCSC_Hi_Rq1_Pr2T_AUTO = %d\n", intval);
	filePutString (buffer, elcount(buffer), hFile);
	intval = getSignal(CHASSIS::TBCSC_Hi_Rq1_AR2::SQC_TBCSC_Hi_Rq1_Pr2);
	snprintf(buffer, elcount(buffer), "   0.000000 F1 EIS::TBCSC_Hi_Rq1_AR2::SQC_TBCSC_Hi_Rq1_Pr2 = %d\n", intval);
	filePutString (buffer, elcount(buffer), hFile);
	intval = getSignal(CHASSIS::TBCSC_Hi_Rq1_AR2::TBCC_Hi_AccelMd_Rq);
	snprintf(buffer, elcount(buffer), "   0.000000 F1 EIS::TBCSC_Hi_Rq1_AR2::TBCC_Hi_AccelMd_Rq = %d\n", intval);
	filePutString (buffer, elcount(buffer), hFile);
	intval = getSignal(CHASSIS::TBCSC_Hi_Rq1_AR2::ASM_Hi_Ifc_Stat);
	snprintf(buffer, elcount(buffer), "   0.000000 F1 EIS::TBCSC_Hi_Rq1_AR2::ASM_Hi_Ifc_Stat = %d\n", intval);
	filePutString (buffer, elcount(buffer), hFile);
	floatval = getSignal(CHASSIS::TBCSC_Hi_Rq1_AR2::TBCC_Hi_Accel_Rq);
	snprintf(buffer, elcount(buffer), "   0.000000 F1 EIS::TBCSC_Hi_Rq1_AR2::TBCC_Hi_Accel_Rq = %f\n", floatval);
	filePutString (buffer, elcount(buffer), hFile);
	intval = getSignal(CHASSIS::TBCSC_Hi_Rq1_AR2::ASM_Hi_Reg_Stat);
	snprintf(buffer, elcount(buffer), "   0.000000 F1 EIS::TBCSC_Hi_Rq1_AR2::ASM_Hi_Reg_Stat = %d\n", intval);
	filePutString (buffer, elcount(buffer), hFile);
	intval = getSignal(CHASSIS::TBCSC_Hi_Rq1_AR2::AddRf_Rq_ASM_Hi);
	snprintf(buffer, elcount(buffer), "   0.000000 F1 EIS::TBCSC_Hi_Rq1_AR2::AddRf_Rq_ASM_Hi = %d\n", intval);
	filePutString (buffer, elcount(buffer), hFile);
	intval = getSignal(CHASSIS::TBCSC_Hi_Rq1_AR2::Rsrv1_TBCSC_Hi_Rq1_Pr2);
	snprintf(buffer, elcount(buffer), "   0.000000 F1 EIS::TBCSC_Hi_Rq1_AR2::Rsrv1_TBCSC_Hi_Rq1_Pr2 = %d\n", intval);
	filePutString (buffer, elcount(buffer), hFile);
	floatval = getSignal(CHASSIS::TBCSC_Hi_Rq1_AR2::FtWhlAngl_Rq_ASM_Hi);
	snprintf(buffer, elcount(buffer), "   0.000000 F1 EIS::TBCSC_Hi_Rq1_AR2::FtWhlAngl_Rq_ASM_Hi = %f\n", floatval);
	filePutString (buffer, elcount(buffer), hFile);
	intval = getSignal(CHASSIS::TBCSC_Hi_Rq1_AR2::Rsrv2_TBCSC_Hi_Rq1_Pr2);
	snprintf(buffer, elcount(buffer), "   0.000000 F1 EIS::TBCSC_Hi_Rq1_AR2::Rsrv2_TBCSC_Hi_Rq1_Pr2 = %d\n", intval);
	filePutString (buffer, elcount(buffer), hFile);
	intval = @sysvar::CH_Nodes::CH_EISCRC_TBCSC_Hi_Rq2_Pr2T_AUTO;
	snprintf(buffer, elcount(buffer), "   0.000000    SV: 2 0 0 ::CH_Nodes::CH_EISCRC_TBCSC_Hi_Rq2_Pr2T_AUTO = %d\n", intval);
	filePutString (buffer, elcount(buffer), hFile);
	intval = getSignal(CHASSIS::TBCSC_Hi_Rq2_AR2::CRC_TBCSC_Hi_Rq2_Pr2);
	snprintf(buffer, elcount(buffer), "   0.000000 F1 EIS::TBCSC_Hi_Rq2_AR2::CRC_TBCSC_Hi_Rq2_Pr2 = %d\n", intval);
	filePutString (buffer, elcount(buffer), hFile);
	intval = @sysvar::CH_Nodes::CH_EISSQC_TBCSC_Hi_Rq2_Pr2T_AUTO;
	snprintf(buffer, elcount(buffer), "   0.000000    SV: 2 0 0 ::CH_Nodes::CH_EISSQC_TBCSC_Hi_Rq2_Pr2T_AUTO = %d\n", intval);
	filePutString (buffer, elcount(buffer), hFile);
	intval = getSignal(CHASSIS::TBCSC_Hi_Rq2_AR2::SQC_TBCSC_Hi_Rq2_Pr2);
	snprintf(buffer, elcount(buffer), "   0.000000 F1 EIS::TBCSC_Hi_Rq2_AR2::SQC_TBCSC_Hi_Rq2_Pr2 = %d\n", intval);
	filePutString (buffer, elcount(buffer), hFile);
	intval = getSignal(CHASSIS::TBCSC_Hi_Rq2_AR2::ShftChrDsp_Rq_TBCC_Hi);
	snprintf(buffer, elcount(buffer), "   0.000000 F1 EIS::TBCSC_Hi_Rq2_AR2::ShftChrDsp_Rq_TBCC_Hi = %d\n", intval);
	filePutString (buffer, elcount(buffer), hFile);
	floatval = getSignal(CHASSIS::TBCSC_Hi_Rq2_AR2::EngTrq_Rq_TBCC_Hi);
	snprintf(buffer, elcount(buffer), "   0.000000 F1 EIS::TBCSC_Hi_Rq2_AR2::EngTrq_Rq_TBCC_Hi = %f\n", floatval);
	filePutString (buffer, elcount(buffer), hFile);
	intval = getSignal(CHASSIS::TBCSC_Hi_Rq2_AR2::KickDn_Rq_TBCC_Hi);
	snprintf(buffer, elcount(buffer), "   0.000000 F1 EIS::TBCSC_Hi_Rq2_AR2::KickDn_Rq_TBCC_Hi = %d\n", intval);
	filePutString (buffer, elcount(buffer), hFile);
	intval = getSignal(CHASSIS::TBCSC_Hi_Rq2_AR2::BrkIntrvntn_Actv_TBCC_Hi);
	snprintf(buffer, elcount(buffer), "   0.000000 F1 EIS::TBCSC_Hi_Rq2_AR2::BrkIntrvntn_Actv_TBCC_Hi = %d\n", intval);
	filePutString (buffer, elcount(buffer), hFile);
	intval = getSignal(CHASSIS::TBCSC_Hi_Rq2_AR2::Rsrv1_TBCSC_Hi_Rq2_Pr2);
	snprintf(buffer, elcount(buffer), "   0.000000 F1 EIS::TBCSC_Hi_Rq2_AR2::Rsrv1_TBCSC_Hi_Rq2_Pr2 = %d\n", intval);
	filePutString (buffer, elcount(buffer), hFile);
	intval = getSignal(CHASSIS::TBCSC_Hi_Rq2_AR2::BrkTrq_Rq_TBCC_Hi);
	snprintf(buffer, elcount(buffer), "   0.000000 F1 EIS::TBCSC_Hi_Rq2_AR2::BrkTrq_Rq_TBCC_Hi = %d\n", intval);
	filePutString (buffer, elcount(buffer), hFile);
	intval = getSignal(CHASSIS::TBCSC_Hi_Rq2_AR2::TBCC_Hi_Reg_Actv);
	snprintf(buffer, elcount(buffer), "   0.000000 F1 EIS::TBCSC_Hi_Rq2_AR2::TBCC_Hi_Reg_Actv = %d\n", intval);
	filePutString (buffer, elcount(buffer), hFile);
	intval = getSignal(CHASSIS::TBCSC_Hi_Rq2_AR2::TBCC_Hi_Ok);
	snprintf(buffer, elcount(buffer), "   0.000000 F1 EIS::TBCSC_Hi_Rq2_AR2::TBCC_Hi_Ok = %d\n", intval);
	filePutString (buffer, elcount(buffer), hFile);
	intval = getSignal(CHASSIS::TBCSC_Hi_Rq2_AR2::GrMin_Rq_TBCC_Hi);
	snprintf(buffer, elcount(buffer), "   0.000000 F1 EIS::TBCSC_Hi_Rq2_AR2::GrMin_Rq_TBCC_Hi = %d\n", intval);
	filePutString (buffer, elcount(buffer), hFile);
	intval = getSignal(CHASSIS::TBCSC_Hi_Rq2_AR2::GrMax_Rq_TBCC_Hi);
	snprintf(buffer, elcount(buffer), "   0.000000 F1 EIS::TBCSC_Hi_Rq2_AR2::GrMax_Rq_TBCC_Hi = %d\n", intval);
	filePutString (buffer, elcount(buffer), hFile);
	floatval = getSignal(CHASSIS::TBCSC_Hi_Rq2_AR2::AccelPdlPosn_Rq_TBCC_Hi);
	snprintf(buffer, elcount(buffer), "   0.000000 F1 EIS::TBCSC_Hi_Rq2_AR2::AccelPdlPosn_Rq_TBCC_Hi = %f\n", floatval);
	filePutString (buffer, elcount(buffer), hFile);
	intval = @sysvar::CH_Nodes::CH_EISCRC_TBCSC_Lo_Rq1_Pr2T_AUTO;
	snprintf(buffer, elcount(buffer), "   0.000000    SV: 2 0 0 ::CH_Nodes::CH_EISCRC_TBCSC_Lo_Rq1_Pr2T_AUTO = %d\n", intval);
	filePutString (buffer, elcount(buffer), hFile);
	intval = getSignal(CHASSIS::TBCSC_Lo_Rq1_AR2::CRC_TBCSC_Lo_Rq1_Pr2);
	snprintf(buffer, elcount(buffer), "   0.000000 F1 EIS::TBCSC_Lo_Rq1_AR2::CRC_TBCSC_Lo_Rq1_Pr2 = %d\n", intval);
	filePutString (buffer, elcount(buffer), hFile);
	intval = @sysvar::CH_Nodes::CH_EISSQC_TBCSC_Lo_Rq1_Pr2T_AUTO;
	snprintf(buffer, elcount(buffer), "   0.000000    SV: 2 0 0 ::CH_Nodes::CH_EISSQC_TBCSC_Lo_Rq1_Pr2T_AUTO = %d\n", intval);
	filePutString (buffer, elcount(buffer), hFile);
	intval = getSignal(CHASSIS::TBCSC_Lo_Rq1_AR2::SQC_TBCSC_Lo_Rq1_Pr2);
	snprintf(buffer, elcount(buffer), "   0.000000 F1 EIS::TBCSC_Lo_Rq1_AR2::SQC_TBCSC_Lo_Rq1_Pr2 = %d\n", intval);
	filePutString (buffer, elcount(buffer), hFile);
	intval = getSignal(CHASSIS::TBCSC_Lo_Rq1_AR2::TBCC_Lo_AccelMd_Rq);
	snprintf(buffer, elcount(buffer), "   0.000000 F1 EIS::TBCSC_Lo_Rq1_AR2::TBCC_Lo_AccelMd_Rq = %d\n", intval);
	filePutString (buffer, elcount(buffer), hFile);
	intval = getSignal(CHASSIS::TBCSC_Lo_Rq1_AR2::ASM_Lo_Ifc_Stat);
	snprintf(buffer, elcount(buffer), "   0.000000 F1 EIS::TBCSC_Lo_Rq1_AR2::ASM_Lo_Ifc_Stat = %d\n", intval);
	filePutString (buffer, elcount(buffer), hFile);
	floatval = getSignal(CHASSIS::TBCSC_Lo_Rq1_AR2::TBCC_Lo_Accel_Rq);
	snprintf(buffer, elcount(buffer), "   0.000000 F1 EIS::TBCSC_Lo_Rq1_AR2::TBCC_Lo_Accel_Rq = %f\n", floatval);
	filePutString (buffer, elcount(buffer), hFile);
	intval = getSignal(CHASSIS::TBCSC_Lo_Rq1_AR2::ASM_Lo_Reg_Stat);
	snprintf(buffer, elcount(buffer), "   0.000000 F1 EIS::TBCSC_Lo_Rq1_AR2::ASM_Lo_Reg_Stat = %d\n", intval);
	filePutString (buffer, elcount(buffer), hFile);
	intval = getSignal(CHASSIS::TBCSC_Lo_Rq1_AR2::AddRf_Rq_ASM_Lo);
	snprintf(buffer, elcount(buffer), "   0.000000 F1 EIS::TBCSC_Lo_Rq1_AR2::AddRf_Rq_ASM_Lo = %d\n", intval);
	filePutString (buffer, elcount(buffer), hFile);
	intval = getSignal(CHASSIS::TBCSC_Lo_Rq1_AR2::Rsrv1_TBCSC_Lo_Rq1_Pr2);
	snprintf(buffer, elcount(buffer), "   0.000000 F1 EIS::TBCSC_Lo_Rq1_AR2::Rsrv1_TBCSC_Lo_Rq1_Pr2 = %d\n", intval);
	filePutString (buffer, elcount(buffer), hFile);
}
/*@@end*/

/*@@caplFunc:saveVars_56(dword):*/
void saveVars_56(dword hFile)
{
	floatval = getSignal(CHASSIS::TBCSC_Lo_Rq1_AR2::FtWhlAngl_Rq_ASM_Lo);
	snprintf(buffer, elcount(buffer), "   0.000000 F1 EIS::TBCSC_Lo_Rq1_AR2::FtWhlAngl_Rq_ASM_Lo = %f\n", floatval);
	filePutString (buffer, elcount(buffer), hFile);
	intval = getSignal(CHASSIS::TBCSC_Lo_Rq1_AR2::Rsrv2_TBCSC_Lo_Rq1_Pr2);
	snprintf(buffer, elcount(buffer), "   0.000000 F1 EIS::TBCSC_Lo_Rq1_AR2::Rsrv2_TBCSC_Lo_Rq1_Pr2 = %d\n", intval);
	filePutString (buffer, elcount(buffer), hFile);
	intval = @sysvar::CH_Nodes::CH_EISCRC_TBCSC_Lo_Rq2_Pr2T_AUTO;
	snprintf(buffer, elcount(buffer), "   0.000000    SV: 2 0 0 ::CH_Nodes::CH_EISCRC_TBCSC_Lo_Rq2_Pr2T_AUTO = %d\n", intval);
	filePutString (buffer, elcount(buffer), hFile);
	intval = getSignal(CHASSIS::TBCSC_Lo_Rq2_AR2::CRC_TBCSC_Lo_Rq2_Pr2);
	snprintf(buffer, elcount(buffer), "   0.000000 F1 EIS::TBCSC_Lo_Rq2_AR2::CRC_TBCSC_Lo_Rq2_Pr2 = %d\n", intval);
	filePutString (buffer, elcount(buffer), hFile);
	intval = @sysvar::CH_Nodes::CH_EISSQC_TBCSC_Lo_Rq2_Pr2T_AUTO;
	snprintf(buffer, elcount(buffer), "   0.000000    SV: 2 0 0 ::CH_Nodes::CH_EISSQC_TBCSC_Lo_Rq2_Pr2T_AUTO = %d\n", intval);
	filePutString (buffer, elcount(buffer), hFile);
	intval = getSignal(CHASSIS::TBCSC_Lo_Rq2_AR2::SQC_TBCSC_Lo_Rq2_Pr2);
	snprintf(buffer, elcount(buffer), "   0.000000 F1 EIS::TBCSC_Lo_Rq2_AR2::SQC_TBCSC_Lo_Rq2_Pr2 = %d\n", intval);
	filePutString (buffer, elcount(buffer), hFile);
	intval = getSignal(CHASSIS::TBCSC_Lo_Rq2_AR2::ShftChrDsp_Rq_TBCC_Lo);
	snprintf(buffer, elcount(buffer), "   0.000000 F1 EIS::TBCSC_Lo_Rq2_AR2::ShftChrDsp_Rq_TBCC_Lo = %d\n", intval);
	filePutString (buffer, elcount(buffer), hFile);
	floatval = getSignal(CHASSIS::TBCSC_Lo_Rq2_AR2::EngTrq_Rq_TBCC_Lo);
	snprintf(buffer, elcount(buffer), "   0.000000 F1 EIS::TBCSC_Lo_Rq2_AR2::EngTrq_Rq_TBCC_Lo = %f\n", floatval);
	filePutString (buffer, elcount(buffer), hFile);
	intval = getSignal(CHASSIS::TBCSC_Lo_Rq2_AR2::KickDn_Rq_TBCC_Lo);
	snprintf(buffer, elcount(buffer), "   0.000000 F1 EIS::TBCSC_Lo_Rq2_AR2::KickDn_Rq_TBCC_Lo = %d\n", intval);
	filePutString (buffer, elcount(buffer), hFile);
	intval = getSignal(CHASSIS::TBCSC_Lo_Rq2_AR2::BrkIntrvntn_Actv_TBCC_Lo);
	snprintf(buffer, elcount(buffer), "   0.000000 F1 EIS::TBCSC_Lo_Rq2_AR2::BrkIntrvntn_Actv_TBCC_Lo = %d\n", intval);
	filePutString (buffer, elcount(buffer), hFile);
	intval = getSignal(CHASSIS::TBCSC_Lo_Rq2_AR2::Rsrv1_TBCSC_Lo_Rq2_Pr2);
	snprintf(buffer, elcount(buffer), "   0.000000 F1 EIS::TBCSC_Lo_Rq2_AR2::Rsrv1_TBCSC_Lo_Rq2_Pr2 = %d\n", intval);
	filePutString (buffer, elcount(buffer), hFile);
	intval = getSignal(CHASSIS::TBCSC_Lo_Rq2_AR2::BrkTrq_Rq_TBCC_Lo);
	snprintf(buffer, elcount(buffer), "   0.000000 F1 EIS::TBCSC_Lo_Rq2_AR2::BrkTrq_Rq_TBCC_Lo = %d\n", intval);
	filePutString (buffer, elcount(buffer), hFile);
	intval = getSignal(CHASSIS::TBCSC_Lo_Rq2_AR2::TBCC_Lo_Reg_Actv);
	snprintf(buffer, elcount(buffer), "   0.000000 F1 EIS::TBCSC_Lo_Rq2_AR2::TBCC_Lo_Reg_Actv = %d\n", intval);
	filePutString (buffer, elcount(buffer), hFile);
	intval = getSignal(CHASSIS::TBCSC_Lo_Rq2_AR2::TBCC_Lo_Ok);
	snprintf(buffer, elcount(buffer), "   0.000000 F1 EIS::TBCSC_Lo_Rq2_AR2::TBCC_Lo_Ok = %d\n", intval);
	filePutString (buffer, elcount(buffer), hFile);
	intval = getSignal(CHASSIS::TBCSC_Lo_Rq2_AR2::GrMin_Rq_TBCC_Lo);
	snprintf(buffer, elcount(buffer), "   0.000000 F1 EIS::TBCSC_Lo_Rq2_AR2::GrMin_Rq_TBCC_Lo = %d\n", intval);
	filePutString (buffer, elcount(buffer), hFile);
	intval = getSignal(CHASSIS::TBCSC_Lo_Rq2_AR2::GrMax_Rq_TBCC_Lo);
	snprintf(buffer, elcount(buffer), "   0.000000 F1 EIS::TBCSC_Lo_Rq2_AR2::GrMax_Rq_TBCC_Lo = %d\n", intval);
	filePutString (buffer, elcount(buffer), hFile);
	floatval = getSignal(CHASSIS::TBCSC_Lo_Rq2_AR2::AccelPdlPosn_Rq_TBCC_Lo);
	snprintf(buffer, elcount(buffer), "   0.000000 F1 EIS::TBCSC_Lo_Rq2_AR2::AccelPdlPosn_Rq_TBCC_Lo = %f\n", floatval);
	filePutString (buffer, elcount(buffer), hFile);
	floatval = getSignal(CHASSIS::TC_Distance_AR::TC_GasFuelTankLvl);
	snprintf(buffer, elcount(buffer), "   0.000000 F1 EIS::TC_Distance_AR::TC_GasFuelTankLvl = %f\n", floatval);
	filePutString (buffer, elcount(buffer), hFile);
	floatval = getSignal(CHASSIS::TC_Distance_AR::TC_GasFuelDist_Reset);
	snprintf(buffer, elcount(buffer), "   0.000000 F1 EIS::TC_Distance_AR::TC_GasFuelDist_Reset = %f\n", floatval);
	filePutString (buffer, elcount(buffer), hFile);
	floatval = getSignal(CHASSIS::TC_Distance_AR::TC_GasFuelDist_Start);
	snprintf(buffer, elcount(buffer), "   0.000000 F1 EIS::TC_Distance_AR::TC_GasFuelDist_Start = %f\n", floatval);
	filePutString (buffer, elcount(buffer), hFile);
	intval = getSignal(CHASSIS::TC_Distance_AR::TC_LiquidFuelRefillEvent_Dtct);
	snprintf(buffer, elcount(buffer), "   0.000000 F1 EIS::TC_Distance_AR::TC_LiquidFuelRefillEvent_Dtct = %d\n", intval);
	filePutString (buffer, elcount(buffer), hFile);
	floatval = getSignal(CHASSIS::TC_Distance_AR::TC_LiquidFuelTankLvl);
	snprintf(buffer, elcount(buffer), "   0.000000 F1 EIS::TC_Distance_AR::TC_LiquidFuelTankLvl = %f\n", floatval);
	filePutString (buffer, elcount(buffer), hFile);
	floatval = getSignal(CHASSIS::TC_Distance_AR::TC_LiquidFuelDist_Reset);
	snprintf(buffer, elcount(buffer), "   0.000000 F1 EIS::TC_Distance_AR::TC_LiquidFuelDist_Reset = %f\n", floatval);
	filePutString (buffer, elcount(buffer), hFile);
	floatval = getSignal(CHASSIS::TC_Distance_AR::TC_LiquidFuelDist_Start);
	snprintf(buffer, elcount(buffer), "   0.000000 F1 EIS::TC_Distance_AR::TC_LiquidFuelDist_Start = %f\n", floatval);
	filePutString (buffer, elcount(buffer), hFile);
	floatval = getSignal(CHASSIS::TC_Distance_AR::TC_ElecEnergyDist_Reset);
	snprintf(buffer, elcount(buffer), "   0.000000 F1 EIS::TC_Distance_AR::TC_ElecEnergyDist_Reset = %f\n", floatval);
	filePutString (buffer, elcount(buffer), hFile);
	floatval = getSignal(CHASSIS::TC_Distance_AR::TC_ElecEnergyDist_Start);
	snprintf(buffer, elcount(buffer), "   0.000000 F1 EIS::TC_Distance_AR::TC_ElecEnergyDist_Start = %f\n", floatval);
	filePutString (buffer, elcount(buffer), hFile);
	intval = getSignal(CHASSIS::TC_Distance_AR::TC_FuelType_TC_DIST);
	snprintf(buffer, elcount(buffer), "   0.000000 F1 EIS::TC_Distance_AR::TC_FuelType_TC_DIST = %d\n", intval);
	filePutString (buffer, elcount(buffer), hFile);
	intval = getSignal(CHASSIS::TGW_DateTm_Stat_AR::DateTm_DST_CntDn);
	snprintf(buffer, elcount(buffer), "   0.000000 F1 EIS::TGW_DateTm_Stat_AR::DateTm_DST_CntDn = %d\n", intval);
	filePutString (buffer, elcount(buffer), hFile);
	intval = getSignal(CHASSIS::TGW_DateTm_Stat_AR::DateTm_DST_HourOffset);
	snprintf(buffer, elcount(buffer), "   0.000000 F1 EIS::TGW_DateTm_Stat_AR::DateTm_DST_HourOffset = %d\n", intval);
	filePutString (buffer, elcount(buffer), hFile);
	floatval = getSignal(CHASSIS::Tire_State_AR2::TirePress_RR);
	snprintf(buffer, elcount(buffer), "   0.000000 F1 EIS::Tire_State_AR2::TirePress_RR = %f\n", floatval);
	filePutString (buffer, elcount(buffer), hFile);
	floatval = getSignal(CHASSIS::Tire_State_AR2::TirePress_RL);
	snprintf(buffer, elcount(buffer), "   0.000000 F1 EIS::Tire_State_AR2::TirePress_RL = %f\n", floatval);
	filePutString (buffer, elcount(buffer), hFile);
	floatval = getSignal(CHASSIS::Tire_State_AR2::TirePress_FL);
	snprintf(buffer, elcount(buffer), "   0.000000 F1 EIS::Tire_State_AR2::TirePress_FL = %f\n", floatval);
	filePutString (buffer, elcount(buffer), hFile);
	floatval = getSignal(CHASSIS::Tire_State_AR2::TirePress_FR);
	snprintf(buffer, elcount(buffer), "   0.000000 F1 EIS::Tire_State_AR2::TirePress_FR = %f\n", floatval);
	filePutString (buffer, elcount(buffer), hFile);
	intval = getSignal(CHASSIS::Tire_State_AR2::TPM_MsgDisp_Rq);
	snprintf(buffer, elcount(buffer), "   0.000000 F1 EIS::Tire_State_AR2::TPM_MsgDisp_Rq = %d\n", intval);
	filePutString (buffer, elcount(buffer), hFile);
	intval = getSignal(CHASSIS::Tire_State_AR2::TPM_Stat);
	snprintf(buffer, elcount(buffer), "   0.000000 F1 EIS::Tire_State_AR2::TPM_Stat = %d\n", intval);
	filePutString (buffer, elcount(buffer), hFile);
	intval = getSignal(CHASSIS::Tire_State_AR2::TPM_WarnDisp_Rq);
	snprintf(buffer, elcount(buffer), "   0.000000 F1 EIS::Tire_State_AR2::TPM_WarnDisp_Rq = %d\n", intval);
	filePutString (buffer, elcount(buffer), hFile);
	intval = getSignal(CHASSIS::Tire_State_AR2::TireStat_FL);
	snprintf(buffer, elcount(buffer), "   0.000000 F1 EIS::Tire_State_AR2::TireStat_FL = %d\n", intval);
	filePutString (buffer, elcount(buffer), hFile);
	intval = getSignal(CHASSIS::Tire_State_AR2::TireStat_FR);
	snprintf(buffer, elcount(buffer), "   0.000000 F1 EIS::Tire_State_AR2::TireStat_FR = %d\n", intval);
	filePutString (buffer, elcount(buffer), hFile);
	intval = getSignal(CHASSIS::Tire_State_AR2::TireStat_RL);
	snprintf(buffer, elcount(buffer), "   0.000000 F1 EIS::Tire_State_AR2::TireStat_RL = %d\n", intval);
	filePutString (buffer, elcount(buffer), hFile);
	intval = getSignal(CHASSIS::Tire_State_AR2::TireStat_RR);
	snprintf(buffer, elcount(buffer), "   0.000000 F1 EIS::Tire_State_AR2::TireStat_RR = %d\n", intval);
	filePutString (buffer, elcount(buffer), hFile);
	intval = getSignal(CHASSIS::Tire_State_AR2::TPM_IndLmp_On_Rq_old);
	snprintf(buffer, elcount(buffer), "   0.000000 F1 EIS::Tire_State_AR2::TPM_IndLmp_On_Rq_old = %d\n", intval);
	filePutString (buffer, elcount(buffer), hFile);
	intval = getSignal(CHASSIS::Tire_State_AR2::TPM_MalfLmp_On_Rq_old);
	snprintf(buffer, elcount(buffer), "   0.000000 F1 EIS::Tire_State_AR2::TPM_MalfLmp_On_Rq_old = %d\n", intval);
	filePutString (buffer, elcount(buffer), hFile);
	intval = getSignal(CHASSIS::Tire_State_AR2::Press_Disp_Avl);
	snprintf(buffer, elcount(buffer), "   0.000000 F1 EIS::Tire_State_AR2::Press_Disp_Avl = %d\n", intval);
	filePutString (buffer, elcount(buffer), hFile);
	intval = getSignal(CHASSIS::TrafficInfo_AR::TrafficInfo_StatPosCurr);
	snprintf(buffer, elcount(buffer), "   0.000000 F1 EIS::TrafficInfo_AR::TrafficInfo_StatPosCurr = %d\n", intval);
	filePutString (buffer, elcount(buffer), hFile);
	intval = getSignal(CHASSIS::TrafficInfo_AR::TrafficInfo_Distance_Stat1);
	snprintf(buffer, elcount(buffer), "   0.000000 F1 EIS::TrafficInfo_AR::TrafficInfo_Distance_Stat1 = %d\n", intval);
	filePutString (buffer, elcount(buffer), hFile);
	intval = getSignal(CHASSIS::TrafficInfo_AR::TrafficInfo_Distance_Stat2);
	snprintf(buffer, elcount(buffer), "   0.000000 F1 EIS::TrafficInfo_AR::TrafficInfo_Distance_Stat2 = %d\n", intval);
	filePutString (buffer, elcount(buffer), hFile);
	intval = getSignal(CHASSIS::TrafficInfo_AR::TrafficInfo_Distance_Stat3);
	snprintf(buffer, elcount(buffer), "   0.000000 F1 EIS::TrafficInfo_AR::TrafficInfo_Distance_Stat3 = %d\n", intval);
	filePutString (buffer, elcount(buffer), hFile);
	intval = getSignal(CHASSIS::TrafficInfo_AR::TrafficInfo_Distance_Stat4);
	snprintf(buffer, elcount(buffer), "   0.000000 F1 EIS::TrafficInfo_AR::TrafficInfo_Distance_Stat4 = %d\n", intval);
	filePutString (buffer, elcount(buffer), hFile);
	intval = getSignal(CHASSIS::TrafficInfo_AR::TrafficInfo_Stat1);
	snprintf(buffer, elcount(buffer), "   0.000000 F1 EIS::TrafficInfo_AR::TrafficInfo_Stat1 = %d\n", intval);
	filePutString (buffer, elcount(buffer), hFile);
	intval = getSignal(CHASSIS::TrafficInfo_AR::TrafficInfo_Stat2);
	snprintf(buffer, elcount(buffer), "   0.000000 F1 EIS::TrafficInfo_AR::TrafficInfo_Stat2 = %d\n", intval);
	filePutString (buffer, elcount(buffer), hFile);
	intval = getSignal(CHASSIS::TrafficInfo_AR::TrafficInfo_Stat3);
	snprintf(buffer, elcount(buffer), "   0.000000 F1 EIS::TrafficInfo_AR::TrafficInfo_Stat3 = %d\n", intval);
	filePutString (buffer, elcount(buffer), hFile);
	intval = getSignal(CHASSIS::TrafficInfo_AR::TrafficInfo_Stat4);
	snprintf(buffer, elcount(buffer), "   0.000000 F1 EIS::TrafficInfo_AR::TrafficInfo_Stat4 = %d\n", intval);
	filePutString (buffer, elcount(buffer), hFile);
	intval = getSignal(CHASSIS::TrafficInfo_AR::TrafficInfo_Distance_Stat5);
	snprintf(buffer, elcount(buffer), "   0.000000 F1 EIS::TrafficInfo_AR::TrafficInfo_Distance_Stat5 = %d\n", intval);
	filePutString (buffer, elcount(buffer), hFile);
}
/*@@end*/

/*@@caplFunc:saveVars_57(dword):*/
void saveVars_57(dword hFile)
{
	intval = getSignal(CHASSIS::TrafficInfo_AR::TrafficInfo_Stat5);
	snprintf(buffer, elcount(buffer), "   0.000000 F1 EIS::TrafficInfo_AR::TrafficInfo_Stat5 = %d\n", intval);
	filePutString (buffer, elcount(buffer), hFile);
	intval = @sysvar::CH_Nodes::CH_EISCRC_ElecTrlrHtch_Stat_AUTO;
	snprintf(buffer, elcount(buffer), "   0.000000    SV: 2 0 0 ::CH_Nodes::CH_EISCRC_ElecTrlrHtch_Stat_AUTO = %d\n", intval);
	filePutString (buffer, elcount(buffer), hFile);
	intval = getSignal(CHASSIS::Trailer_Stat_AR2::CRC_ElecTrlrHtch_Stat_Pr2);
	snprintf(buffer, elcount(buffer), "   0.000000 F1 EIS::Trailer_Stat_AR2::CRC_ElecTrlrHtch_Stat_Pr2 = %d\n", intval);
	filePutString (buffer, elcount(buffer), hFile);
	intval = @sysvar::CH_Nodes::CH_EISSQC_ElecTrlrHtch_Stat_AUTO;
	snprintf(buffer, elcount(buffer), "   0.000000    SV: 2 0 0 ::CH_Nodes::CH_EISSQC_ElecTrlrHtch_Stat_AUTO = %d\n", intval);
	filePutString (buffer, elcount(buffer), hFile);
	intval = getSignal(CHASSIS::Trailer_Stat_AR2::SQC_ElecTrlrHtch_Stat_Pr2);
	snprintf(buffer, elcount(buffer), "   0.000000 F1 EIS::Trailer_Stat_AR2::SQC_ElecTrlrHtch_Stat_Pr2 = %d\n", intval);
	filePutString (buffer, elcount(buffer), hFile);
	intval = getSignal(CHASSIS::Trailer_Stat_AR2::ElecTrlrHtch_Disengg);
	snprintf(buffer, elcount(buffer), "   0.000000 F1 EIS::Trailer_Stat_AR2::ElecTrlrHtch_Disengg = %d\n", intval);
	filePutString (buffer, elcount(buffer), hFile);
	intval = getSignal(CHASSIS::Trailer_Stat_AR2::ElecTrlrHtch_PosnChg_Actv);
	snprintf(buffer, elcount(buffer), "   0.000000 F1 EIS::Trailer_Stat_AR2::ElecTrlrHtch_PosnChg_Actv = %d\n", intval);
	filePutString (buffer, elcount(buffer), hFile);
	intval = getSignal(CHASSIS::Trailer_Stat_AR2::Rsrv1_ElecTrlrHtch_Stat);
	snprintf(buffer, elcount(buffer), "   0.000000 F1 EIS::Trailer_Stat_AR2::Rsrv1_ElecTrlrHtch_Stat = %d\n", intval);
	filePutString (buffer, elcount(buffer), hFile);
	intval = getSignal(CHASSIS::Trailer_Stat_AR2::Trlr_Stat);
	snprintf(buffer, elcount(buffer), "   0.000000 F1 EIS::Trailer_Stat_AR2::Trlr_Stat = %d\n", intval);
	filePutString (buffer, elcount(buffer), hFile);
	intval = getSignal(CHASSIS::Trailer_Stat_AR2::BrkLmpStyle);
	snprintf(buffer, elcount(buffer), "   0.000000 F1 EIS::Trailer_Stat_AR2::BrkLmpStyle = %d\n", intval);
	filePutString (buffer, elcount(buffer), hFile);
	intval = getSignal(CHASSIS::Trailer_Stat_AR2::TM_FogLmp_Stat);
	snprintf(buffer, elcount(buffer), "   0.000000 F1 EIS::Trailer_Stat_AR2::TM_FogLmp_Stat = %d\n", intval);
	filePutString (buffer, elcount(buffer), hFile);
	intval = getSignal(CHASSIS::Trailer_Stat_AR2::Trlr_Term54_Flt);
	snprintf(buffer, elcount(buffer), "   0.000000 F1 EIS::Trailer_Stat_AR2::Trlr_Term54_Flt = %d\n", intval);
	filePutString (buffer, elcount(buffer), hFile);
	intval = getSignal(CHASSIS::Trailer_Stat_AR2::TrlrHtch_Flt);
	snprintf(buffer, elcount(buffer), "   0.000000 F1 EIS::Trailer_Stat_AR2::TrlrHtch_Flt = %d\n", intval);
	filePutString (buffer, elcount(buffer), hFile);
	intval = getSignal(CHASSIS::Trailer_Stat_AR2::TrlrTurnLmp_Rt_Flt);
	snprintf(buffer, elcount(buffer), "   0.000000 F1 EIS::Trailer_Stat_AR2::TrlrTurnLmp_Rt_Flt = %d\n", intval);
	filePutString (buffer, elcount(buffer), hFile);
	intval = getSignal(CHASSIS::Trailer_Stat_AR2::TrlrTlLmp_Rt_Flt);
	snprintf(buffer, elcount(buffer), "   0.000000 F1 EIS::Trailer_Stat_AR2::TrlrTlLmp_Rt_Flt = %d\n", intval);
	filePutString (buffer, elcount(buffer), hFile);
	intval = getSignal(CHASSIS::Trailer_Stat_AR2::TrlrBrkLmp_Flt);
	snprintf(buffer, elcount(buffer), "   0.000000 F1 EIS::Trailer_Stat_AR2::TrlrBrkLmp_Flt = %d\n", intval);
	filePutString (buffer, elcount(buffer), hFile);
	intval = getSignal(CHASSIS::Trailer_Stat_AR2::EmgLgtPath_Flt_TM);
	snprintf(buffer, elcount(buffer), "   0.000000 F1 EIS::Trailer_Stat_AR2::EmgLgtPath_Flt_TM = %d\n", intval);
	filePutString (buffer, elcount(buffer), hFile);
	intval = getSignal(CHASSIS::Trailer_Stat_AR2::TrlrTurnLmp_Lt_Flt);
	snprintf(buffer, elcount(buffer), "   0.000000 F1 EIS::Trailer_Stat_AR2::TrlrTurnLmp_Lt_Flt = %d\n", intval);
	filePutString (buffer, elcount(buffer), hFile);
	intval = getSignal(CHASSIS::Trailer_Stat_AR2::TrlrTlLmp_Lt_Flt);
	snprintf(buffer, elcount(buffer), "   0.000000 F1 EIS::Trailer_Stat_AR2::TrlrTlLmp_Lt_Flt = %d\n", intval);
	filePutString (buffer, elcount(buffer), hFile);
	intval = getSignal(CHASSIS::TSA_Disp_Rq1_AR2::TSA_SpdWarnOffset);
	snprintf(buffer, elcount(buffer), "   0.000000 F1 EIS::TSA_Disp_Rq1_AR2::TSA_SpdWarnOffset = %d\n", intval);
	filePutString (buffer, elcount(buffer), hFile);
	intval = getSignal(CHASSIS::TSA_Disp_Rq1_AR2::TSA_SpdWarnMd_Stat);
	snprintf(buffer, elcount(buffer), "   0.000000 F1 EIS::TSA_Disp_Rq1_AR2::TSA_SpdWarnMd_Stat = %d\n", intval);
	filePutString (buffer, elcount(buffer), hFile);
	intval = getSignal(CHASSIS::TSA_Disp_Rq1_AR2::TSA_HU_DispMd_Stat);
	snprintf(buffer, elcount(buffer), "   0.000000 F1 EIS::TSA_Disp_Rq1_AR2::TSA_HU_DispMd_Stat = %d\n", intval);
	filePutString (buffer, elcount(buffer), hFile);
	intval = getSignal(CHASSIS::TSA_Disp_Rq1_AR2::TSA_IC_DispMd_Stat);
	snprintf(buffer, elcount(buffer), "   0.000000 F1 EIS::TSA_Disp_Rq1_AR2::TSA_IC_DispMd_Stat = %d\n", intval);
	filePutString (buffer, elcount(buffer), hFile);
	intval = getSignal(CHASSIS::TSA_Disp_Rq1_AR2::SLA_SpdWarn_Rq_V2);
	snprintf(buffer, elcount(buffer), "   0.000000 F1 EIS::TSA_Disp_Rq1_AR2::SLA_SpdWarn_Rq_V2 = %d\n", intval);
	filePutString (buffer, elcount(buffer), hFile);
	intval = getSignal(CHASSIS::TSA_Disp_Rq1_AR2::SLA_SpdWarn_IconDisp_Rq);
	snprintf(buffer, elcount(buffer), "   0.000000 F1 EIS::TSA_Disp_Rq1_AR2::SLA_SpdWarn_IconDisp_Rq = %d\n", intval);
	filePutString (buffer, elcount(buffer), hFile);
	intval = getSignal(CHASSIS::TSA_Disp_Rq1_AR2::SLA_WarnSpd_Val_V2);
	snprintf(buffer, elcount(buffer), "   0.000000 F1 EIS::TSA_Disp_Rq1_AR2::SLA_WarnSpd_Val_V2 = %d\n", intval);
	filePutString (buffer, elcount(buffer), hFile);
	intval = getSignal(CHASSIS::TSA_Disp_Rq1_AR2::SLA_SpdWarn_DispType);
	snprintf(buffer, elcount(buffer), "   0.000000 F1 EIS::TSA_Disp_Rq1_AR2::SLA_SpdWarn_DispType = %d\n", intval);
	filePutString (buffer, elcount(buffer), hFile);
	intval = getSignal(CHASSIS::TSA_Disp_Rq1_AR2::SLA_WarnSpd_Unit);
	snprintf(buffer, elcount(buffer), "   0.000000 F1 EIS::TSA_Disp_Rq1_AR2::SLA_WarnSpd_Unit = %d\n", intval);
	filePutString (buffer, elcount(buffer), hFile);
	intval = getSignal(CHASSIS::TSA_Disp_Rq1_AR2::TSA_Stat);
	snprintf(buffer, elcount(buffer), "   0.000000 F1 EIS::TSA_Disp_Rq1_AR2::TSA_Stat = %d\n", intval);
	filePutString (buffer, elcount(buffer), hFile);
	intval = getSignal(CHASSIS::TSA_Disp_Rq1_AR2::SLA_Warn_Rq);
	snprintf(buffer, elcount(buffer), "   0.000000 F1 EIS::TSA_Disp_Rq1_AR2::SLA_Warn_Rq = %d\n", intval);
	filePutString (buffer, elcount(buffer), hFile);
	intval = getSignal(CHASSIS::TSA_Disp_Rq1_AR2::PMA_Warn_Rq);
	snprintf(buffer, elcount(buffer), "   0.000000 F1 EIS::TSA_Disp_Rq1_AR2::PMA_Warn_Rq = %d\n", intval);
	filePutString (buffer, elcount(buffer), hFile);
	intval = getSignal(CHASSIS::TSA_Disp_Rq1_AR2::PMA_Pass_Warn_Rq);
	snprintf(buffer, elcount(buffer), "   0.000000 F1 EIS::TSA_Disp_Rq1_AR2::PMA_Pass_Warn_Rq = %d\n", intval);
	filePutString (buffer, elcount(buffer), hFile);
	intval = getSignal(CHASSIS::TSA_Disp_Rq1_AR2::WWA_Warn_Rq);
	snprintf(buffer, elcount(buffer), "   0.000000 F1 EIS::TSA_Disp_Rq1_AR2::WWA_Warn_Rq = %d\n", intval);
	filePutString (buffer, elcount(buffer), hFile);
	intval = getSignal(CHASSIS::TSA_Disp_Rq1_AR2::RoadWork_Warn_Rq);
	snprintf(buffer, elcount(buffer), "   0.000000 F1 EIS::TSA_Disp_Rq1_AR2::RoadWork_Warn_Rq = %d\n", intval);
	filePutString (buffer, elcount(buffer), hFile);
	intval = getSignal(CHASSIS::TSA_Disp_Rq1_AR2::CrossWalk_Warn_Rq);
	snprintf(buffer, elcount(buffer), "   0.000000 F1 EIS::TSA_Disp_Rq1_AR2::CrossWalk_Warn_Rq = %d\n", intval);
	filePutString (buffer, elcount(buffer), hFile);
	intval = getSignal(CHASSIS::TSA_Disp_Rq1_AR2::TSA_WarnMd_Stat);
	snprintf(buffer, elcount(buffer), "   0.000000 F1 EIS::TSA_Disp_Rq1_AR2::TSA_WarnMd_Stat = %d\n", intval);
	filePutString (buffer, elcount(buffer), hFile);
	intval = getSignal(CHASSIS::TSA_Disp_Rq1_AR2::SLA_WarnSpdNxt_Dist);
	snprintf(buffer, elcount(buffer), "   0.000000 F1 EIS::TSA_Disp_Rq1_AR2::SLA_WarnSpdNxt_Dist = %d\n", intval);
	filePutString (buffer, elcount(buffer), hFile);
	intval = getSignal(CHASSIS::TSA_Disp_Rq1_AR2::SLA_WarnSpdNxt_Type);
	snprintf(buffer, elcount(buffer), "   0.000000 F1 EIS::TSA_Disp_Rq1_AR2::SLA_WarnSpdNxt_Type = %d\n", intval);
	filePutString (buffer, elcount(buffer), hFile);
	intval = getSignal(CHASSIS::TSA_Disp_Rq1_AR2::SLA_WarnSpdNxt_Val);
	snprintf(buffer, elcount(buffer), "   0.000000 F1 EIS::TSA_Disp_Rq1_AR2::SLA_WarnSpdNxt_Val = %d\n", intval);
	filePutString (buffer, elcount(buffer), hFile);
	intval = getSignal(CHASSIS::TSA_Disp_Rq2_AR::TSA_Disp_Rq2_Data1);
	snprintf(buffer, elcount(buffer), "   0.000000 F1 EIS::TSA_Disp_Rq2_AR::TSA_Disp_Rq2_Data1 = %d\n", intval);
	filePutString (buffer, elcount(buffer), hFile);
	intval = getSignal(CHASSIS::TSA_Disp_Rq2_AR::TSA_Disp_Rq2_Data2);
	snprintf(buffer, elcount(buffer), "   0.000000 F1 EIS::TSA_Disp_Rq2_AR::TSA_Disp_Rq2_Data2 = %d\n", intval);
	filePutString (buffer, elcount(buffer), hFile);
	intval = getSignal(CHASSIS::TSA_Disp_Rq2_AR::TSA_Disp_Rq2_Data3);
	snprintf(buffer, elcount(buffer), "   0.000000 F1 EIS::TSA_Disp_Rq2_AR::TSA_Disp_Rq2_Data3 = %d\n", intval);
	filePutString (buffer, elcount(buffer), hFile);
	intval = getSignal(CHASSIS::TSA_Disp_Rq2_AR::TSA_Disp_Rq2_Data4);
	snprintf(buffer, elcount(buffer), "   0.000000 F1 EIS::TSA_Disp_Rq2_AR::TSA_Disp_Rq2_Data4 = %d\n", intval);
	filePutString (buffer, elcount(buffer), hFile);
	intval = getSignal(CHASSIS::TSA_Disp_Rq2_AR::TSA_Disp_Rq2_Data5);
	snprintf(buffer, elcount(buffer), "   0.000000 F1 EIS::TSA_Disp_Rq2_AR::TSA_Disp_Rq2_Data5 = %d\n", intval);
	filePutString (buffer, elcount(buffer), hFile);
	intval = getSignal(CHASSIS::TSA_Disp_Rq2_AR::TSA_Disp_Rq2_Data6);
	snprintf(buffer, elcount(buffer), "   0.000000 F1 EIS::TSA_Disp_Rq2_AR::TSA_Disp_Rq2_Data6 = %d\n", intval);
	filePutString (buffer, elcount(buffer), hFile);
	intval = getSignal(CHASSIS::TSA_Disp_Rq2_AR::TSA_Disp_Rq2_Data7);
	snprintf(buffer, elcount(buffer), "   0.000000 F1 EIS::TSA_Disp_Rq2_AR::TSA_Disp_Rq2_Data7 = %d\n", intval);
	filePutString (buffer, elcount(buffer), hFile);
	intval = getSignal(CHASSIS::TSA_Disp_Rq2_AR::TSA_Disp_Rq2_Data8);
	snprintf(buffer, elcount(buffer), "   0.000000 F1 EIS::TSA_Disp_Rq2_AR::TSA_Disp_Rq2_Data8 = %d\n", intval);
	filePutString (buffer, elcount(buffer), hFile);
	intval = getSignal(CHASSIS::TSA_Disp_Rq3_AR::TSA_StopSign_Dist);
	snprintf(buffer, elcount(buffer), "   0.000000 F1 EIS::TSA_Disp_Rq3_AR::TSA_StopSign_Dist = %d\n", intval);
	filePutString (buffer, elcount(buffer), hFile);
	intval = getSignal(CHASSIS::TSA_Disp_Rq3_AR::TSA_StopSignStyle);
	snprintf(buffer, elcount(buffer), "   0.000000 F1 EIS::TSA_Disp_Rq3_AR::TSA_StopSignStyle = %d\n", intval);
	filePutString (buffer, elcount(buffer), hFile);
	intval = @sysvar::CH_Nodes::CH_EISCRC_VehAccel_X_Rq_Pr2_AUTO;
	snprintf(buffer, elcount(buffer), "   0.000000    SV: 2 0 0 ::CH_Nodes::CH_EISCRC_VehAccel_X_Rq_Pr2_AUTO = %d\n", intval);
	filePutString (buffer, elcount(buffer), hFile);
	intval = getSignal(CHASSIS::VehAccel_X_Rq_Gw_AR2::CRC_VehAccel_X_Rq_Pr2);
	snprintf(buffer, elcount(buffer), "   0.000000 F1 EIS::VehAccel_X_Rq_Gw_AR2::CRC_VehAccel_X_Rq_Pr2 = %d\n", intval);
	filePutString (buffer, elcount(buffer), hFile);
	intval = @sysvar::CH_Nodes::CH_EISSQC_VehAccel_X_Rq_Pr2_AUTO;
	snprintf(buffer, elcount(buffer), "   0.000000    SV: 2 0 0 ::CH_Nodes::CH_EISSQC_VehAccel_X_Rq_Pr2_AUTO = %d\n", intval);
	filePutString (buffer, elcount(buffer), hFile);
	intval = getSignal(CHASSIS::VehAccel_X_Rq_Gw_AR2::SQC_VehAccel_X_Rq_Pr2);
	snprintf(buffer, elcount(buffer), "   0.000000 F1 EIS::VehAccel_X_Rq_Gw_AR2::SQC_VehAccel_X_Rq_Pr2 = %d\n", intval);
	filePutString (buffer, elcount(buffer), hFile);
	intval = getSignal(CHASSIS::VehAccel_X_Rq_Gw_AR2::VehAccel_X_Md_Rq);
	snprintf(buffer, elcount(buffer), "   0.000000 F1 EIS::VehAccel_X_Rq_Gw_AR2::VehAccel_X_Md_Rq = %d\n", intval);
	filePutString (buffer, elcount(buffer), hFile);
	intval = getSignal(CHASSIS::VehAccel_X_Rq_Gw_AR2::Rsrv2_VehAccel_X_Rq_Pr2);
	snprintf(buffer, elcount(buffer), "   0.000000 F1 EIS::VehAccel_X_Rq_Gw_AR2::Rsrv2_VehAccel_X_Rq_Pr2 = %d\n", intval);
	filePutString (buffer, elcount(buffer), hFile);
}
/*@@end*/

/*@@caplFunc:saveVars_58(dword):*/
void saveVars_58(dword hFile)
{
	floatval = getSignal(CHASSIS::VehAccel_X_Rq_Gw_AR2::VehAccel_X_Rq);
	snprintf(buffer, elcount(buffer), "   0.000000 F1 EIS::VehAccel_X_Rq_Gw_AR2::VehAccel_X_Rq = %f\n", floatval);
	filePutString (buffer, elcount(buffer), hFile);
	intval = getSignal(CHASSIS::VehAccel_X_Rq_Gw_AR2::ECU_Flt_Stat);
	snprintf(buffer, elcount(buffer), "   0.000000 F1 EIS::VehAccel_X_Rq_Gw_AR2::ECU_Flt_Stat = %d\n", intval);
	filePutString (buffer, elcount(buffer), hFile);
	floatval = getSignal(CHASSIS::VehAccel_X_Rq_Gw_AR2::VehAccel_X_Rq_Raw);
	snprintf(buffer, elcount(buffer), "   0.000000 F1 EIS::VehAccel_X_Rq_Gw_AR2::VehAccel_X_Rq_Raw = %f\n", floatval);
	filePutString (buffer, elcount(buffer), hFile);
	intval = getSignal(CHASSIS::VehAccel_X_Rq_Gw_AR2::AS_Actv_Ctrl_Stat);
	snprintf(buffer, elcount(buffer), "   0.000000 F1 EIS::VehAccel_X_Rq_Gw_AR2::AS_Actv_Ctrl_Stat = %d\n", intval);
	filePutString (buffer, elcount(buffer), hFile);
	intval = getSignal(CHASSIS::VehAccel_X_Rq_Gw_AR2::PwrFreeD_Supp_Rq_RDU);
	snprintf(buffer, elcount(buffer), "   0.000000 F1 EIS::VehAccel_X_Rq_Gw_AR2::PwrFreeD_Supp_Rq_RDU = %d\n", intval);
	filePutString (buffer, elcount(buffer), hFile);
	intval = getSignal(CHASSIS::VehAccel_X_Rq_Gw_AR2::BrkPrefill_Rq_RDU);
	snprintf(buffer, elcount(buffer), "   0.000000 F1 EIS::VehAccel_X_Rq_Gw_AR2::BrkPrefill_Rq_RDU = %d\n", intval);
	filePutString (buffer, elcount(buffer), hFile);
	intval = getSignal(CHASSIS::VehAccel_X_Rq_Gw_AR2::VehAccel_X_Rq_AS_Actv);
	snprintf(buffer, elcount(buffer), "   0.000000 F1 EIS::VehAccel_X_Rq_Gw_AR2::VehAccel_X_Rq_AS_Actv = %d\n", intval);
	filePutString (buffer, elcount(buffer), hFile);
	intval = getSignal(CHASSIS::VehAccel_X_Rq_Gw_AR2::AS_DrvAway_Rq);
	snprintf(buffer, elcount(buffer), "   0.000000 F1 EIS::VehAccel_X_Rq_Gw_AR2::AS_DrvAway_Rq = %d\n", intval);
	filePutString (buffer, elcount(buffer), hFile);
	intval = getSignal(CHASSIS::VehAccel_X_Rq_Gw_AR2::AS_VehSp_Rq);
	snprintf(buffer, elcount(buffer), "   0.000000 F1 EIS::VehAccel_X_Rq_Gw_AR2::AS_VehSp_Rq = %d\n", intval);
	filePutString (buffer, elcount(buffer), hFile);
	intval = getSignal(CHASSIS::VehAccel_X_Rq_Gw_AR2::SPCR_ErrEntry_Rq);
	snprintf(buffer, elcount(buffer), "   0.000000 F1 EIS::VehAccel_X_Rq_Gw_AR2::SPCR_ErrEntry_Rq = %d\n", intval);
	filePutString (buffer, elcount(buffer), hFile);
	intval = getSignal(CHASSIS::VehAccel_X_Rq_Gw_AR2::AS_SpdCtrl_Actv);
	snprintf(buffer, elcount(buffer), "   0.000000 F1 EIS::VehAccel_X_Rq_Gw_AR2::AS_SpdCtrl_Actv = %d\n", intval);
	filePutString (buffer, elcount(buffer), hFile);
	intval = getSignal(CHASSIS::VehAccel_X_Rq_Gw_AR2::AS_DistCtrl_Actv);
	snprintf(buffer, elcount(buffer), "   0.000000 F1 EIS::VehAccel_X_Rq_Gw_AR2::AS_DistCtrl_Actv = %d\n", intval);
	filePutString (buffer, elcount(buffer), hFile);
	intval = getSignal(CHASSIS::VehAccel_X_Rq_Gw_AR2::SSA_Enbl_Rq_RDU);
	snprintf(buffer, elcount(buffer), "   0.000000 F1 EIS::VehAccel_X_Rq_Gw_AR2::SSA_Enbl_Rq_RDU = %d\n", intval);
	filePutString (buffer, elcount(buffer), hFile);
	intval = getSignal(CHASSIS::VehAccel_X_Rq_Gw_AR2::AS_EV_Md_Rq);
	snprintf(buffer, elcount(buffer), "   0.000000 F1 EIS::VehAccel_X_Rq_Gw_AR2::AS_EV_Md_Rq = %d\n", intval);
	filePutString (buffer, elcount(buffer), hFile);
	intval = getSignal(CHASSIS::VehAccel_X_Rq_Gw_AR2::AS_DnShift_Dsabl_Rq);
	snprintf(buffer, elcount(buffer), "   0.000000 F1 EIS::VehAccel_X_Rq_Gw_AR2::AS_DnShift_Dsabl_Rq = %d\n", intval);
	filePutString (buffer, elcount(buffer), hFile);
	intval = getSignal(CHASSIS::VehAccel_X_Rq_Gw_AR2::AS_UpShift_Dsabl_Rq);
	snprintf(buffer, elcount(buffer), "   0.000000 F1 EIS::VehAccel_X_Rq_Gw_AR2::AS_UpShift_Dsabl_Rq = %d\n", intval);
	filePutString (buffer, elcount(buffer), hFile);
	intval = getSignal(CHASSIS::VehAccel_X_Rq_Gw_AR2::Rsrv1_VehAccel_X_Rq_Pr2);
	snprintf(buffer, elcount(buffer), "   0.000000 F1 EIS::VehAccel_X_Rq_Gw_AR2::Rsrv1_VehAccel_X_Rq_Pr2 = %d\n", intval);
	filePutString (buffer, elcount(buffer), hFile);
	SysGetVariableString(sysvar::CH_Nodes::CH__EIS_VIN, strval, elcount(strval));
	snprintf(buffer, elcount(buffer), "   0.000000    SV: 2 0 0 ::CH_Nodes::CH__EIS_VIN = \"%s\"\n", strval);
	filePutString (buffer, elcount(buffer), hFile);
	intval = getSignal(CHASSIS::VIN_AR::VIN_Data1);
	snprintf(buffer, elcount(buffer), "   0.000000 F1 EIS::VIN_AR::VIN_Data1 = %d\n", intval);
	filePutString (buffer, elcount(buffer), hFile);
	intval = getSignal(CHASSIS::VIN_AR::VIN_Data2);
	snprintf(buffer, elcount(buffer), "   0.000000 F1 EIS::VIN_AR::VIN_Data2 = %d\n", intval);
	filePutString (buffer, elcount(buffer), hFile);
	intval = getSignal(CHASSIS::VIN_AR::VIN_Data3);
	snprintf(buffer, elcount(buffer), "   0.000000 F1 EIS::VIN_AR::VIN_Data3 = %d\n", intval);
	filePutString (buffer, elcount(buffer), hFile);
	intval = getSignal(CHASSIS::VIN_AR::VIN_Data4);
	snprintf(buffer, elcount(buffer), "   0.000000 F1 EIS::VIN_AR::VIN_Data4 = %d\n", intval);
	filePutString (buffer, elcount(buffer), hFile);
	intval = getSignal(CHASSIS::VIN_AR::VIN_Data5);
	snprintf(buffer, elcount(buffer), "   0.000000 F1 EIS::VIN_AR::VIN_Data5 = %d\n", intval);
	filePutString (buffer, elcount(buffer), hFile);
	intval = getSignal(CHASSIS::VIN_AR::VIN_Data6);
	snprintf(buffer, elcount(buffer), "   0.000000 F1 EIS::VIN_AR::VIN_Data6 = %d\n", intval);
	filePutString (buffer, elcount(buffer), hFile);
	intval = getSignal(CHASSIS::VIN_AR::VIN_Data7);
	snprintf(buffer, elcount(buffer), "   0.000000 F1 EIS::VIN_AR::VIN_Data7 = %d\n", intval);
	filePutString (buffer, elcount(buffer), hFile);
	intval = getSignal(CHASSIS::Wiper_Stat_AR::Wpr_Stat);
	snprintf(buffer, elcount(buffer), "   0.000000 F1 EIS::Wiper_Stat_AR::Wpr_Stat = %d\n", intval);
	filePutString (buffer, elcount(buffer), hFile);
	intval = getSignal(CHASSIS::Wiper_Stat_AR::WprOutsdPkPosn);
	snprintf(buffer, elcount(buffer), "   0.000000 F1 EIS::Wiper_Stat_AR::WprOutsdPkPosn = %d\n", intval);
	filePutString (buffer, elcount(buffer), hFile);
	intval = getSignal(CHASSIS::Wiper_Stat_AR::Splash);
	snprintf(buffer, elcount(buffer), "   0.000000 F1 EIS::Wiper_Stat_AR::Splash = %d\n", intval);
	filePutString (buffer, elcount(buffer), hFile);
	intval = getSignal(CHASSIS::Wiper_Stat_AR::WprFltMsgDisp_Rq_WPRM);
	snprintf(buffer, elcount(buffer), "   0.000000 F1 EIS::Wiper_Stat_AR::WprFltMsgDisp_Rq_WPRM = %d\n", intval);
	filePutString (buffer, elcount(buffer), hFile);
	intval = getSignal(CHASSIS::Wiper_Stat_AR::Wpr_R_Actv);
	snprintf(buffer, elcount(buffer), "   0.000000 F1 EIS::Wiper_Stat_AR::Wpr_R_Actv = %d\n", intval);
	filePutString (buffer, elcount(buffer), hFile);
	intval = getSignal(CHASSIS::Wiper_Stat_AR::Wpr_R_On_Rq);
	snprintf(buffer, elcount(buffer), "   0.000000 F1 EIS::Wiper_Stat_AR::Wpr_R_On_Rq = %d\n", intval);
	filePutString (buffer, elcount(buffer), hFile);
	intval = getSignal(CHASSIS::Wiper_Stat_AR::HL_Wash_Actv);
	snprintf(buffer, elcount(buffer), "   0.000000 F1 EIS::Wiper_Stat_AR::HL_Wash_Actv = %d\n", intval);
	filePutString (buffer, elcount(buffer), hFile);
	intval = getSignal(CHASSIS::WUDOP_EIS_FR::WUDOP_1_1);
	snprintf(buffer, elcount(buffer), "   0.000000 F1 EIS::WUDOP_EIS_FR::WUDOP_1_1 = %d\n", intval);
	filePutString (buffer, elcount(buffer), hFile);
	intval = getSignal(CHASSIS::WUDOP_EIS_FR::WUDOP_1_2);
	snprintf(buffer, elcount(buffer), "   0.000000 F1 EIS::WUDOP_EIS_FR::WUDOP_1_2 = %d\n", intval);
	filePutString (buffer, elcount(buffer), hFile);
	intval = getSignal(CHASSIS::WUDOP_EIS_FR::WUDOP_1_3);
	snprintf(buffer, elcount(buffer), "   0.000000 F1 EIS::WUDOP_EIS_FR::WUDOP_1_3 = %d\n", intval);
	filePutString (buffer, elcount(buffer), hFile);
	intval = getSignal(CHASSIS::WUDOP_EIS_FR::WUDOP_1_4);
	snprintf(buffer, elcount(buffer), "   0.000000 F1 EIS::WUDOP_EIS_FR::WUDOP_1_4 = %d\n", intval);
	filePutString (buffer, elcount(buffer), hFile);
	intval = getSignal(CHASSIS::WUDOP_EIS_FR::WUDOP_1_5);
	snprintf(buffer, elcount(buffer), "   0.000000 F1 EIS::WUDOP_EIS_FR::WUDOP_1_5 = %d\n", intval);
	filePutString (buffer, elcount(buffer), hFile);
	intval = getSignal(CHASSIS::WUDOP_EIS_FR::WUDOP_2_1);
	snprintf(buffer, elcount(buffer), "   0.000000 F1 EIS::WUDOP_EIS_FR::WUDOP_2_1 = %d\n", intval);
	filePutString (buffer, elcount(buffer), hFile);
	intval = getSignal(CHASSIS::WUDOP_EIS_FR::WUDOP_2_2);
	snprintf(buffer, elcount(buffer), "   0.000000 F1 EIS::WUDOP_EIS_FR::WUDOP_2_2 = %d\n", intval);
	filePutString (buffer, elcount(buffer), hFile);
	intval = getSignal(CHASSIS::WUDOP_EIS_FR::WUDOP_2_3);
	snprintf(buffer, elcount(buffer), "   0.000000 F1 EIS::WUDOP_EIS_FR::WUDOP_2_3 = %d\n", intval);
	filePutString (buffer, elcount(buffer), hFile);
	intval = getSignal(CHASSIS::WUDOP_EIS_FR::WUDOP_2_4);
	snprintf(buffer, elcount(buffer), "   0.000000 F1 EIS::WUDOP_EIS_FR::WUDOP_2_4 = %d\n", intval);
	filePutString (buffer, elcount(buffer), hFile);
	intval = getSignal(CHASSIS::WUDOP_EIS_FR::WUDOP_2_5);
	snprintf(buffer, elcount(buffer), "   0.000000 F1 EIS::WUDOP_EIS_FR::WUDOP_2_5 = %d\n", intval);
	filePutString (buffer, elcount(buffer), hFile);
	intval = getSignal(CHASSIS::WUDOP_EIS_FR::WUDOP_3_1);
	snprintf(buffer, elcount(buffer), "   0.000000 F1 EIS::WUDOP_EIS_FR::WUDOP_3_1 = %d\n", intval);
	filePutString (buffer, elcount(buffer), hFile);
	intval = getSignal(CHASSIS::WUDOP_EIS_FR::WUDOP_3_2);
	snprintf(buffer, elcount(buffer), "   0.000000 F1 EIS::WUDOP_EIS_FR::WUDOP_3_2 = %d\n", intval);
	filePutString (buffer, elcount(buffer), hFile);
	intval = getSignal(CHASSIS::WUDOP_EIS_FR::WUDOP_3_3);
	snprintf(buffer, elcount(buffer), "   0.000000 F1 EIS::WUDOP_EIS_FR::WUDOP_3_3 = %d\n", intval);
	filePutString (buffer, elcount(buffer), hFile);
	intval = getSignal(CHASSIS::WUDOP_EIS_FR::WUDOP_3_4);
	snprintf(buffer, elcount(buffer), "   0.000000 F1 EIS::WUDOP_EIS_FR::WUDOP_3_4 = %d\n", intval);
	filePutString (buffer, elcount(buffer), hFile);
	intval = getSignal(CHASSIS::WUDOP_EIS_FR::WUDOP_3_5);
	snprintf(buffer, elcount(buffer), "   0.000000 F1 EIS::WUDOP_EIS_FR::WUDOP_3_5 = %d\n", intval);
	filePutString (buffer, elcount(buffer), hFile);
	intval = getSignal(CHASSIS::WUDOP_EIS_FR::WUDOP_4_1);
	snprintf(buffer, elcount(buffer), "   0.000000 F1 EIS::WUDOP_EIS_FR::WUDOP_4_1 = %d\n", intval);
	filePutString (buffer, elcount(buffer), hFile);
	intval = getSignal(CHASSIS::WUDOP_EIS_FR::WUDOP_4_2);
	snprintf(buffer, elcount(buffer), "   0.000000 F1 EIS::WUDOP_EIS_FR::WUDOP_4_2 = %d\n", intval);
	filePutString (buffer, elcount(buffer), hFile);
	intval = getSignal(CHASSIS::WUDOP_EIS_FR::WUDOP_4_3);
	snprintf(buffer, elcount(buffer), "   0.000000 F1 EIS::WUDOP_EIS_FR::WUDOP_4_3 = %d\n", intval);
	filePutString (buffer, elcount(buffer), hFile);
	intval = getSignal(CHASSIS::WUDOP_EIS_FR::WUDOP_4_4);
	snprintf(buffer, elcount(buffer), "   0.000000 F1 EIS::WUDOP_EIS_FR::WUDOP_4_4 = %d\n", intval);
	filePutString (buffer, elcount(buffer), hFile);
}
/*@@end*/

/*@@caplFunc:saveVars_59(dword):*/
void saveVars_59(dword hFile)
{
	intval = getSignal(CHASSIS::WUDOP_EIS_FR::WUDOP_4_5);
	snprintf(buffer, elcount(buffer), "   0.000000 F1 EIS::WUDOP_EIS_FR::WUDOP_4_5 = %d\n", intval);
	filePutString (buffer, elcount(buffer), hFile);
	intval = getSignal(CHASSIS::WUDOP_EIS_FR::WUDOP_4_6);
	snprintf(buffer, elcount(buffer), "   0.000000 F1 EIS::WUDOP_EIS_FR::WUDOP_4_6 = %d\n", intval);
	filePutString (buffer, elcount(buffer), hFile);
	intval = @sysvar::CH_Nodes::CH_EISCRC_YMAS_Rq_MPC_Pr2YM_AUTO;
	snprintf(buffer, elcount(buffer), "   0.000000    SV: 2 0 0 ::CH_Nodes::CH_EISCRC_YMAS_Rq_MPC_Pr2YM_AUTO = %d\n", intval);
	filePutString (buffer, elcount(buffer), hFile);
	intval = getSignal(CHASSIS::YMAS_Rq_MPC_AR2::CRC_YMAS_Rq_MPC_Pr2);
	snprintf(buffer, elcount(buffer), "   0.000000 F1 EIS::YMAS_Rq_MPC_AR2::CRC_YMAS_Rq_MPC_Pr2 = %d\n", intval);
	filePutString (buffer, elcount(buffer), hFile);
	intval = @sysvar::CH_Nodes::CH_EISSQC_YMAS_Rq_MPC_Pr2YM_AUTO;
	snprintf(buffer, elcount(buffer), "   0.000000    SV: 2 0 0 ::CH_Nodes::CH_EISSQC_YMAS_Rq_MPC_Pr2YM_AUTO = %d\n", intval);
	filePutString (buffer, elcount(buffer), hFile);
	intval = getSignal(CHASSIS::YMAS_Rq_MPC_AR2::SQC_YMAS_Rq_MPC_Pr2);
	snprintf(buffer, elcount(buffer), "   0.000000 F1 EIS::YMAS_Rq_MPC_AR2::SQC_YMAS_Rq_MPC_Pr2 = %d\n", intval);
	filePutString (buffer, elcount(buffer), hFile);
	intval = getSignal(CHASSIS::YMAS_Rq_MPC_AR2::YMAS_BrkSrc_MPC);
	snprintf(buffer, elcount(buffer), "   0.000000 F1 EIS::YMAS_Rq_MPC_AR2::YMAS_BrkSrc_MPC = %d\n", intval);
	filePutString (buffer, elcount(buffer), hFile);
	floatval = getSignal(CHASSIS::YMAS_Rq_MPC_AR2::VehYawRate_Rq_MPC);
	snprintf(buffer, elcount(buffer), "   0.000000 F1 EIS::YMAS_Rq_MPC_AR2::VehYawRate_Rq_MPC = %f\n", floatval);
	filePutString (buffer, elcount(buffer), hFile);
	intval = getSignal(CHASSIS::YMAS_Rq_MPC_AR2::VehYawMoment_Ft_Rq_MPC);
	snprintf(buffer, elcount(buffer), "   0.000000 F1 EIS::YMAS_Rq_MPC_AR2::VehYawMoment_Ft_Rq_MPC = %d\n", intval);
	filePutString (buffer, elcount(buffer), hFile);
	intval = getSignal(CHASSIS::YMAS_Rq_MPC_AR2::Rsrv1_YMAS_Rq_MPC_Pr2);
	snprintf(buffer, elcount(buffer), "   0.000000 F1 EIS::YMAS_Rq_MPC_AR2::Rsrv1_YMAS_Rq_MPC_Pr2 = %d\n", intval);
	filePutString (buffer, elcount(buffer), hFile);
	intval = getSignal(CHASSIS::YMAS_Rq_MPC_AR2::VehYawMoment_R_Rq_MPC);
	snprintf(buffer, elcount(buffer), "   0.000000 F1 EIS::YMAS_Rq_MPC_AR2::VehYawMoment_R_Rq_MPC = %d\n", intval);
	filePutString (buffer, elcount(buffer), hFile);
	intval = getSignal(CHASSIS::YMAS_Rq_MPC_AR2::Rsrv2_YMAS_Rq_MPC_Pr2);
	snprintf(buffer, elcount(buffer), "   0.000000 F1 EIS::YMAS_Rq_MPC_AR2::Rsrv2_YMAS_Rq_MPC_Pr2 = %d\n", intval);
	filePutString (buffer, elcount(buffer), hFile);
	intval = getSignal(CHASSIS::YMAS_Rq_MPC_AR2::YMAS_Ok_MPC);
	snprintf(buffer, elcount(buffer), "   0.000000 F1 EIS::YMAS_Rq_MPC_AR2::YMAS_Ok_MPC = %d\n", intval);
	filePutString (buffer, elcount(buffer), hFile);
	snprintf(buffer, elcount(buffer), "   0.000000    SV: 2 0 0 ::CH_Nodes::CH__NMActive_EPS = %X\n", @sysvar::CH_Nodes::CH__NMActive_EPS);
	filePutString (buffer, elcount(buffer), hFile);
	snprintf(buffer, elcount(buffer), "   0.000000    SV: 2 0 0 ::CH_Nodes::CH__NMAwake_EPS = %X\n", @sysvar::CH_Nodes::CH__NMAwake_EPS);
	filePutString (buffer, elcount(buffer), hFile);
	intval = @sysvar::CH_Nodes::CH_EPSCRC_DTQ_Rs_Pr2DTQ_Rs__AUTO;
	snprintf(buffer, elcount(buffer), "   0.000000    SV: 2 0 0 ::CH_Nodes::CH_EPSCRC_DTQ_Rs_Pr2DTQ_Rs__AUTO = %d\n", intval);
	filePutString (buffer, elcount(buffer), hFile);
	intval = getSignal(CHASSIS::DTQ_Rs_AR2::CRC_DTQ_Rs_Pr2);
	snprintf(buffer, elcount(buffer), "   0.000000 F1 EPS::DTQ_Rs_AR2::CRC_DTQ_Rs_Pr2 = %d\n", intval);
	filePutString (buffer, elcount(buffer), hFile);
	intval = @sysvar::CH_Nodes::CH_EPSSQC_DTQ_Rs_Pr2DTQ_Rs__AUTO;
	snprintf(buffer, elcount(buffer), "   0.000000    SV: 2 0 0 ::CH_Nodes::CH_EPSSQC_DTQ_Rs_Pr2DTQ_Rs__AUTO = %d\n", intval);
	filePutString (buffer, elcount(buffer), hFile);
	intval = getSignal(CHASSIS::DTQ_Rs_AR2::SQC_DTQ_Rs_Pr2);
	snprintf(buffer, elcount(buffer), "   0.000000 F1 EPS::DTQ_Rs_AR2::SQC_DTQ_Rs_Pr2 = %d\n", intval);
	filePutString (buffer, elcount(buffer), hFile);
	intval = getSignal(CHASSIS::DTQ_Rs_AR2::DTQ_Can_Stat);
	snprintf(buffer, elcount(buffer), "   0.000000 F1 EPS::DTQ_Rs_AR2::DTQ_Can_Stat = %d\n", intval);
	filePutString (buffer, elcount(buffer), hFile);
	intval = getSignal(CHASSIS::DTQ_Rs_AR2::DTQ_FtWhlAnglCtrl_Rf_Lim_V2);
	snprintf(buffer, elcount(buffer), "   0.000000 F1 EPS::DTQ_Rs_AR2::DTQ_FtWhlAnglCtrl_Rf_Lim_V2 = %d\n", intval);
	filePutString (buffer, elcount(buffer), hFile);
	intval = getSignal(CHASSIS::DTQ_Rs_AR2::DTQ_AddRf_Lim_V2);
	snprintf(buffer, elcount(buffer), "   0.000000 F1 EPS::DTQ_Rs_AR2::DTQ_AddRf_Lim_V2 = %d\n", intval);
	filePutString (buffer, elcount(buffer), hFile);
	intval = getSignal(CHASSIS::DTQ_Rs_AR2::DTQ_AddRf_Lim_Stat);
	snprintf(buffer, elcount(buffer), "   0.000000 F1 EPS::DTQ_Rs_AR2::DTQ_AddRf_Lim_Stat = %d\n", intval);
	filePutString (buffer, elcount(buffer), hFile);
	intval = getSignal(CHASSIS::DTQ_Rs_AR2::DTQ_FtWhlAnglCtrl_Lim);
	snprintf(buffer, elcount(buffer), "   0.000000 F1 EPS::DTQ_Rs_AR2::DTQ_FtWhlAnglCtrl_Lim = %d\n", intval);
	filePutString (buffer, elcount(buffer), hFile);
	intval = getSignal(CHASSIS::DTQ_Rs_AR2::DTQ_Stat_EPS);
	snprintf(buffer, elcount(buffer), "   0.000000 F1 EPS::DTQ_Rs_AR2::DTQ_Stat_EPS = %d\n", intval);
	filePutString (buffer, elcount(buffer), hFile);
	intval = getSignal(CHASSIS::DTQ_Rs_AR2::Rsrv2_DTQ_Rs_Pr2);
	snprintf(buffer, elcount(buffer), "   0.000000 F1 EPS::DTQ_Rs_AR2::Rsrv2_DTQ_Rs_Pr2 = %d\n", intval);
	filePutString (buffer, elcount(buffer), hFile);
	intval = getSignal(CHASSIS::DTQ_Rs_AR2::DTQ_HandsOff_Stat_EPS);
	snprintf(buffer, elcount(buffer), "   0.000000 F1 EPS::DTQ_Rs_AR2::DTQ_HandsOff_Stat_EPS = %d\n", intval);
	filePutString (buffer, elcount(buffer), hFile);
	intval = getSignal(CHASSIS::DTQ_Rs_AR2::DTQ_HandsOff_ConfdcLvl);
	snprintf(buffer, elcount(buffer), "   0.000000 F1 EPS::DTQ_Rs_AR2::DTQ_HandsOff_ConfdcLvl = %d\n", intval);
	filePutString (buffer, elcount(buffer), hFile);
	intval = getSignal(CHASSIS::DTQ_Rs_AR2::DTQ_Flt_Stat_EPS);
	snprintf(buffer, elcount(buffer), "   0.000000 F1 EPS::DTQ_Rs_AR2::DTQ_Flt_Stat_EPS = %d\n", intval);
	filePutString (buffer, elcount(buffer), hFile);
	intval = getSignal(CHASSIS::EPS_Stat_Disp_Rq_AR2::ASM_Stat_EPS);
	snprintf(buffer, elcount(buffer), "   0.000000 F1 EPS::EPS_Stat_Disp_Rq_AR2::ASM_Stat_EPS = %d\n", intval);
	filePutString (buffer, elcount(buffer), hFile);
	intval = getSignal(CHASSIS::EPS_Stat_Disp_Rq_AR2::DPC_Md_St_Rs);
	snprintf(buffer, elcount(buffer), "   0.000000 F1 EPS::EPS_Stat_Disp_Rq_AR2::DPC_Md_St_Rs = %d\n", intval);
	filePutString (buffer, elcount(buffer), hFile);
	intval = @sysvar::CH_Nodes::CH_EPSCRC_EPS_CtrlLmp_Disp__AUTO;
	snprintf(buffer, elcount(buffer), "   0.000000    SV: 2 0 0 ::CH_Nodes::CH_EPSCRC_EPS_CtrlLmp_Disp__AUTO = %d\n", intval);
	filePutString (buffer, elcount(buffer), hFile);
	intval = getSignal(CHASSIS::EPS_Stat_Disp_Rq_AR2::CRC_EPS_CtrlLmp_Disp_Rq_Pr2);
	snprintf(buffer, elcount(buffer), "   0.000000 F1 EPS::EPS_Stat_Disp_Rq_AR2::CRC_EPS_CtrlLmp_Disp_Rq_Pr2 = %d\n", intval);
	filePutString (buffer, elcount(buffer), hFile);
	intval = @sysvar::CH_Nodes::CH_EPSSQC_EPS_CtrlLmp_Disp__AUTO;
	snprintf(buffer, elcount(buffer), "   0.000000    SV: 2 0 0 ::CH_Nodes::CH_EPSSQC_EPS_CtrlLmp_Disp__AUTO = %d\n", intval);
	filePutString (buffer, elcount(buffer), hFile);
	intval = getSignal(CHASSIS::EPS_Stat_Disp_Rq_AR2::SQC_EPS_CtrlLmp_Disp_Rq_Pr2);
	snprintf(buffer, elcount(buffer), "   0.000000 F1 EPS::EPS_Stat_Disp_Rq_AR2::SQC_EPS_CtrlLmp_Disp_Rq_Pr2 = %d\n", intval);
	filePutString (buffer, elcount(buffer), hFile);
	intval = getSignal(CHASSIS::EPS_Stat_Disp_Rq_AR2::EPS_IndLmp_On_Rq);
	snprintf(buffer, elcount(buffer), "   0.000000 F1 EPS::EPS_Stat_Disp_Rq_AR2::EPS_IndLmp_On_Rq = %d\n", intval);
	filePutString (buffer, elcount(buffer), hFile);
	intval = getSignal(CHASSIS::EPS_Stat_Disp_Rq_AR2::Rsrv1_EPS_CtrlLmp_Disp_Rq_Pr2);
	snprintf(buffer, elcount(buffer), "   0.000000 F1 EPS::EPS_Stat_Disp_Rq_AR2::Rsrv1_EPS_CtrlLmp_Disp_Rq_Pr2 = %d\n", intval);
	filePutString (buffer, elcount(buffer), hFile);
	intval = getSignal(CHASSIS::EPS_Stat_Disp_Rq_AR2::EPS_WarnDisp_Rq);
	snprintf(buffer, elcount(buffer), "   0.000000 F1 EPS::EPS_Stat_Disp_Rq_AR2::EPS_WarnDisp_Rq = %d\n", intval);
	filePutString (buffer, elcount(buffer), hFile);
	intval = getSignal(CHASSIS::EPS_Stat_Disp_Rq_AR2::Rsrv2_EPS_CtrlLmp_Disp_Rq_Pr2);
	snprintf(buffer, elcount(buffer), "   0.000000 F1 EPS::EPS_Stat_Disp_Rq_AR2::Rsrv2_EPS_CtrlLmp_Disp_Rq_Pr2 = %d\n", intval);
	filePutString (buffer, elcount(buffer), hFile);
	intval = getSignal(CHASSIS::EPS_Stat_Disp_Rq_AR2::Rsrv3_EPS_CtrlLmp_Disp_Rq_Pr2);
	snprintf(buffer, elcount(buffer), "   0.000000 F1 EPS::EPS_Stat_Disp_Rq_AR2::Rsrv3_EPS_CtrlLmp_Disp_Rq_Pr2 = %d\n", intval);
	filePutString (buffer, elcount(buffer), hFile);
	intval = @sysvar::CH_Nodes::CH_EPSCRC_PARK_St_Rs_Pr2PAR_AUTO;
	snprintf(buffer, elcount(buffer), "   0.000000    SV: 2 0 0 ::CH_Nodes::CH_EPSCRC_PARK_St_Rs_Pr2PAR_AUTO = %d\n", intval);
	filePutString (buffer, elcount(buffer), hFile);
	intval = getSignal(CHASSIS::PARK_St_Rs_AR2::CRC_PARK_St_Rs_Pr2);
	snprintf(buffer, elcount(buffer), "   0.000000 F1 EPS::PARK_St_Rs_AR2::CRC_PARK_St_Rs_Pr2 = %d\n", intval);
	filePutString (buffer, elcount(buffer), hFile);
	intval = @sysvar::CH_Nodes::CH_EPSSQC_PARK_St_Rs_Pr2PAR_AUTO;
	snprintf(buffer, elcount(buffer), "   0.000000    SV: 2 0 0 ::CH_Nodes::CH_EPSSQC_PARK_St_Rs_Pr2PAR_AUTO = %d\n", intval);
	filePutString (buffer, elcount(buffer), hFile);
	intval = getSignal(CHASSIS::PARK_St_Rs_AR2::SQC_PARK_St_Rs_Pr2);
	snprintf(buffer, elcount(buffer), "   0.000000 F1 EPS::PARK_St_Rs_AR2::SQC_PARK_St_Rs_Pr2 = %d\n", intval);
	filePutString (buffer, elcount(buffer), hFile);
	intval = getSignal(CHASSIS::PARK_St_Rs_AR2::PPS_Cancel_Stat);
	snprintf(buffer, elcount(buffer), "   0.000000 F1 EPS::PARK_St_Rs_AR2::PPS_Cancel_Stat = %d\n", intval);
	filePutString (buffer, elcount(buffer), hFile);
	intval = getSignal(CHASSIS::PARK_St_Rs_AR2::PPS_Stat_EPS);
	snprintf(buffer, elcount(buffer), "   0.000000 F1 EPS::PARK_St_Rs_AR2::PPS_Stat_EPS = %d\n", intval);
	filePutString (buffer, elcount(buffer), hFile);
	intval = getSignal(CHASSIS::PARK_St_Rs_AR2::Rsrv1_PARK_St_Rs_Pr2);
	snprintf(buffer, elcount(buffer), "   0.000000 F1 EPS::PARK_St_Rs_AR2::Rsrv1_PARK_St_Rs_Pr2 = %d\n", intval);
	filePutString (buffer, elcount(buffer), hFile);
	intval = getSignal(CHASSIS::PARK_St_Rs_AR2::PPS_HandsOff_ConfdcLvl);
	snprintf(buffer, elcount(buffer), "   0.000000 F1 EPS::PARK_St_Rs_AR2::PPS_HandsOff_ConfdcLvl = %d\n", intval);
	filePutString (buffer, elcount(buffer), hFile);
	intval = getSignal(CHASSIS::PARK_St_Rs_AR2::PPS_HandsOff_Stat_EPS);
	snprintf(buffer, elcount(buffer), "   0.000000 F1 EPS::PARK_St_Rs_AR2::PPS_HandsOff_Stat_EPS = %d\n", intval);
	filePutString (buffer, elcount(buffer), hFile);
	intval = getSignal(CHASSIS::PARK_St_Rs_AR2::PPS_FtWhlAnglCtrl_Rf_Lim);
	snprintf(buffer, elcount(buffer), "   0.000000 F1 EPS::PARK_St_Rs_AR2::PPS_FtWhlAnglCtrl_Rf_Lim = %d\n", intval);
	filePutString (buffer, elcount(buffer), hFile);
	intval = getSignal(CHASSIS::PARK_St_Rs_AR2::PARK_Stat_EPS);
	snprintf(buffer, elcount(buffer), "   0.000000 F1 EPS::PARK_St_Rs_AR2::PARK_Stat_EPS = %d\n", intval);
	filePutString (buffer, elcount(buffer), hFile);
	intval = getSignal(CHASSIS::PARK_St_Rs_AR2::PPS_AddRf_Lim_Stat);
	snprintf(buffer, elcount(buffer), "   0.000000 F1 EPS::PARK_St_Rs_AR2::PPS_AddRf_Lim_Stat = %d\n", intval);
	filePutString (buffer, elcount(buffer), hFile);
	intval = getSignal(CHASSIS::PARK_St_Rs_AR2::PPS_AddRf_Lim);
	snprintf(buffer, elcount(buffer), "   0.000000 F1 EPS::PARK_St_Rs_AR2::PPS_AddRf_Lim = %d\n", intval);
	filePutString (buffer, elcount(buffer), hFile);
	intval = getSignal(CHASSIS::PARK_St_Rs_AR2::PARK_Cancel_Stat);
	snprintf(buffer, elcount(buffer), "   0.000000 F1 EPS::PARK_St_Rs_AR2::PARK_Cancel_Stat = %d\n", intval);
	filePutString (buffer, elcount(buffer), hFile);
	intval = getSignal(CHASSIS::ROE_EPS::ROE_Header_EPS);
	snprintf(buffer, elcount(buffer), "   0.000000 F1 EPS::ROE_EPS::ROE_Header_EPS = %d\n", intval);
	filePutString (buffer, elcount(buffer), hFile);
	intval = getSignal(CHASSIS::ROE_EPS::ROE_DTC_EPS);
	snprintf(buffer, elcount(buffer), "   0.000000 F1 EPS::ROE_EPS::ROE_DTC_EPS = %d\n", intval);
	filePutString (buffer, elcount(buffer), hFile);
	intval = getSignal(CHASSIS::ROE_EPS::ROE_DTC_Stat_EPS);
	snprintf(buffer, elcount(buffer), "   0.000000 F1 EPS::ROE_EPS::ROE_DTC_Stat_EPS = %d\n", intval);
	filePutString (buffer, elcount(buffer), hFile);
	intval = @sysvar::CH_Nodes::CH_EPSCRC_STA_Rs1_Pr2STA_Rs_AUTO;
	snprintf(buffer, elcount(buffer), "   0.000000    SV: 2 0 0 ::CH_Nodes::CH_EPSCRC_STA_Rs1_Pr2STA_Rs_AUTO = %d\n", intval);
	filePutString (buffer, elcount(buffer), hFile);
	intval = getSignal(CHASSIS::STA_Rs1_AR2::CRC_STA_Rs1_Pr2);
	snprintf(buffer, elcount(buffer), "   0.000000 F1 EPS::STA_Rs1_AR2::CRC_STA_Rs1_Pr2 = %d\n", intval);
	filePutString (buffer, elcount(buffer), hFile);
	intval = @sysvar::CH_Nodes::CH_EPSSQC_STA_Rs1_Pr2STA_Rs_AUTO;
	snprintf(buffer, elcount(buffer), "   0.000000    SV: 2 0 0 ::CH_Nodes::CH_EPSSQC_STA_Rs1_Pr2STA_Rs_AUTO = %d\n", intval);
	filePutString (buffer, elcount(buffer), hFile);
	intval = getSignal(CHASSIS::STA_Rs1_AR2::SQC_STA_Rs1_Pr2);
	snprintf(buffer, elcount(buffer), "   0.000000 F1 EPS::STA_Rs1_AR2::SQC_STA_Rs1_Pr2 = %d\n", intval);
	filePutString (buffer, elcount(buffer), hFile);
}
/*@@end*/

/*@@caplFunc:saveVars_60(dword):*/
void saveVars_60(dword hFile)
{
	intval = getSignal(CHASSIS::STA_Rs1_AR2::STA_Stat);
	snprintf(buffer, elcount(buffer), "   0.000000 F1 EPS::STA_Rs1_AR2::STA_Stat = %d\n", intval);
	filePutString (buffer, elcount(buffer), hFile);
	intval = getSignal(CHASSIS::STA_Rs1_AR2::EPS_FtWhlAngl_Stat);
	snprintf(buffer, elcount(buffer), "   0.000000 F1 EPS::STA_Rs1_AR2::EPS_FtWhlAngl_Stat = %d\n", intval);
	filePutString (buffer, elcount(buffer), hFile);
	floatval = getSignal(CHASSIS::STA_Rs1_AR2::EPS_FtWhlAngl);
	snprintf(buffer, elcount(buffer), "   0.000000 F1 EPS::STA_Rs1_AR2::EPS_FtWhlAngl = %f\n", floatval);
	filePutString (buffer, elcount(buffer), hFile);
	intval = getSignal(CHASSIS::STA_Rs1_AR2::Rsrv1_STA_Rs1_Pr2);
	snprintf(buffer, elcount(buffer), "   0.000000 F1 EPS::STA_Rs1_AR2::Rsrv1_STA_Rs1_Pr2 = %d\n", intval);
	filePutString (buffer, elcount(buffer), hFile);
	floatval = getSignal(CHASSIS::STA_Rs1_AR2::EPS_FtWhlAngl_Offset);
	snprintf(buffer, elcount(buffer), "   0.000000 F1 EPS::STA_Rs1_AR2::EPS_FtWhlAngl_Offset = %f\n", floatval);
	filePutString (buffer, elcount(buffer), hFile);
	floatval = getSignal(CHASSIS::STA_Rs1_AR2::StW_Trq_EPS);
	snprintf(buffer, elcount(buffer), "   0.000000 F1 EPS::STA_Rs1_AR2::StW_Trq_EPS = %f\n", floatval);
	filePutString (buffer, elcount(buffer), hFile);
	intval = getSignal(CHASSIS::STA_Rs1_AR2::Rsrv2_STA_Rs1_Pr2);
	snprintf(buffer, elcount(buffer), "   0.000000 F1 EPS::STA_Rs1_AR2::Rsrv2_STA_Rs1_Pr2 = %d\n", intval);
	filePutString (buffer, elcount(buffer), hFile);
	floatval = getSignal(CHASSIS::STA_Rs1_AR2::SADR_AddData1_EPS);
	snprintf(buffer, elcount(buffer), "   0.000000 F1 EPS::STA_Rs1_AR2::SADR_AddData1_EPS = %f\n", floatval);
	filePutString (buffer, elcount(buffer), hFile);
	intval = getSignal(CHASSIS::TBCSC_EPS_DAC_AR2::TBCSC_EPS_DAC_Data1);
	snprintf(buffer, elcount(buffer), "   0.000000 F1 EPS::TBCSC_EPS_DAC_AR2::TBCSC_EPS_DAC_Data1 = %d\n", intval);
	filePutString (buffer, elcount(buffer), hFile);
	intval = getSignal(CHASSIS::TBCSC_EPS_DAC_AR2::TBCSC_EPS_DAC_Data2);
	snprintf(buffer, elcount(buffer), "   0.000000 F1 EPS::TBCSC_EPS_DAC_AR2::TBCSC_EPS_DAC_Data2 = %d\n", intval);
	filePutString (buffer, elcount(buffer), hFile);
	intval = getSignal(CHASSIS::TBCSC_EPS_DAC_AR2::TBCSC_EPS_DAC_Data3);
	snprintf(buffer, elcount(buffer), "   0.000000 F1 EPS::TBCSC_EPS_DAC_AR2::TBCSC_EPS_DAC_Data3 = %d\n", intval);
	filePutString (buffer, elcount(buffer), hFile);
	intval = getSignal(CHASSIS::TBCSC_EPS_DAC_AR2::TBCSC_EPS_DAC_Data4);
	snprintf(buffer, elcount(buffer), "   0.000000 F1 EPS::TBCSC_EPS_DAC_AR2::TBCSC_EPS_DAC_Data4 = %d\n", intval);
	filePutString (buffer, elcount(buffer), hFile);
	intval = getSignal(CHASSIS::TBCSC_EPS_DAC_AR2::TBCSC_EPS_DAC_Data5);
	snprintf(buffer, elcount(buffer), "   0.000000 F1 EPS::TBCSC_EPS_DAC_AR2::TBCSC_EPS_DAC_Data5 = %d\n", intval);
	filePutString (buffer, elcount(buffer), hFile);
	intval = getSignal(CHASSIS::TBCSC_EPS_DAC_AR2::TBCSC_EPS_DAC_Data6);
	snprintf(buffer, elcount(buffer), "   0.000000 F1 EPS::TBCSC_EPS_DAC_AR2::TBCSC_EPS_DAC_Data6 = %d\n", intval);
	filePutString (buffer, elcount(buffer), hFile);
	intval = getSignal(CHASSIS::TBCSC_EPS_DAC_AR2::TBCSC_EPS_DAC_Data7);
	snprintf(buffer, elcount(buffer), "   0.000000 F1 EPS::TBCSC_EPS_DAC_AR2::TBCSC_EPS_DAC_Data7 = %d\n", intval);
	filePutString (buffer, elcount(buffer), hFile);
	intval = getSignal(CHASSIS::TBCSC_EPS_DAC_AR2::TBCSC_EPS_DAC_Data8);
	snprintf(buffer, elcount(buffer), "   0.000000 F1 EPS::TBCSC_EPS_DAC_AR2::TBCSC_EPS_DAC_Data8 = %d\n", intval);
	filePutString (buffer, elcount(buffer), hFile);
	intval = @sysvar::CH_Nodes::CH_EPSCRC_TBCSC_Rs_EPS_Pr2T_AUTO;
	snprintf(buffer, elcount(buffer), "   0.000000    SV: 2 0 0 ::CH_Nodes::CH_EPSCRC_TBCSC_Rs_EPS_Pr2T_AUTO = %d\n", intval);
	filePutString (buffer, elcount(buffer), hFile);
	intval = getSignal(CHASSIS::TBCSC_Rs_EPS_AR2::CRC_TBCSC_Rs_EPS_Pr2);
	snprintf(buffer, elcount(buffer), "   0.000000 F1 EPS::TBCSC_Rs_EPS_AR2::CRC_TBCSC_Rs_EPS_Pr2 = %d\n", intval);
	filePutString (buffer, elcount(buffer), hFile);
	intval = @sysvar::CH_Nodes::CH_EPSSQC_TBCSC_Rs_EPS_Pr2T_AUTO;
	snprintf(buffer, elcount(buffer), "   0.000000    SV: 2 0 0 ::CH_Nodes::CH_EPSSQC_TBCSC_Rs_EPS_Pr2T_AUTO = %d\n", intval);
	filePutString (buffer, elcount(buffer), hFile);
	intval = getSignal(CHASSIS::TBCSC_Rs_EPS_AR2::SQC_TBCSC_Rs_EPS_Pr2);
	snprintf(buffer, elcount(buffer), "   0.000000 F1 EPS::TBCSC_Rs_EPS_AR2::SQC_TBCSC_Rs_EPS_Pr2 = %d\n", intval);
	filePutString (buffer, elcount(buffer), hFile);
	intval = getSignal(CHASSIS::TBCSC_Rs_EPS_AR2::ASM_Ifc_Stat_EPS_V2);
	snprintf(buffer, elcount(buffer), "   0.000000 F1 EPS::TBCSC_Rs_EPS_AR2::ASM_Ifc_Stat_EPS_V2 = %d\n", intval);
	filePutString (buffer, elcount(buffer), hFile);
	intval = getSignal(CHASSIS::TBCSC_Rs_EPS_AR2::Rsrv1_TBCSC_Rs_EPS_Pr2);
	snprintf(buffer, elcount(buffer), "   0.000000 F1 EPS::TBCSC_Rs_EPS_AR2::Rsrv1_TBCSC_Rs_EPS_Pr2 = %d\n", intval);
	filePutString (buffer, elcount(buffer), hFile);
	intval = getSignal(CHASSIS::TBCSC_Rs_EPS_AR2::EPS_AddRF_ASM_V2);
	snprintf(buffer, elcount(buffer), "   0.000000 F1 EPS::TBCSC_Rs_EPS_AR2::EPS_AddRF_ASM_V2 = %d\n", intval);
	filePutString (buffer, elcount(buffer), hFile);
	intval = getSignal(CHASSIS::TBCSC_Rs_EPS_AR2::Rsrv2_TBCSC_Rs_EPS_Pr2);
	snprintf(buffer, elcount(buffer), "   0.000000 F1 EPS::TBCSC_Rs_EPS_AR2::Rsrv2_TBCSC_Rs_EPS_Pr2 = %d\n", intval);
	filePutString (buffer, elcount(buffer), hFile);
	floatval = getSignal(CHASSIS::TBCSC_Rs_EPS_AR2::EPS_FtwhlAngl_ASM);
	snprintf(buffer, elcount(buffer), "   0.000000 F1 EPS::TBCSC_Rs_EPS_AR2::EPS_FtwhlAngl_ASM = %f\n", floatval);
	filePutString (buffer, elcount(buffer), hFile);
	intval = getSignal(CHASSIS::TBCSC_Rs_EPS_AR2::Rsrv3_TBCSC_Rs_EPS_Pr2);
	snprintf(buffer, elcount(buffer), "   0.000000 F1 EPS::TBCSC_Rs_EPS_AR2::Rsrv3_TBCSC_Rs_EPS_Pr2 = %d\n", intval);
	filePutString (buffer, elcount(buffer), hFile);
	intval = getSignal(CHASSIS::TBCSC_Rs_EPS_AR2::EPS_SysPrio_ASM);
	snprintf(buffer, elcount(buffer), "   0.000000 F1 EPS::TBCSC_Rs_EPS_AR2::EPS_SysPrio_ASM = %d\n", intval);
	filePutString (buffer, elcount(buffer), hFile);
	intval = getSignal(CHASSIS::TBCSC_Rs_EPS_AR2::ASM_Flt_Stat_EPS);
	snprintf(buffer, elcount(buffer), "   0.000000 F1 EPS::TBCSC_Rs_EPS_AR2::ASM_Flt_Stat_EPS = %d\n", intval);
	filePutString (buffer, elcount(buffer), hFile);
	intval = getSignal(CHASSIS::TBCSC_Rs_EPS_AR2::Rsrv4_TBCSC_Rs_EPS_Pr2);
	snprintf(buffer, elcount(buffer), "   0.000000 F1 EPS::TBCSC_Rs_EPS_AR2::Rsrv4_TBCSC_Rs_EPS_Pr2 = %d\n", intval);
	filePutString (buffer, elcount(buffer), hFile);
	intval = getSignal(CHASSIS::WUDOP_EPS_FR::WUDOP_1_1);
	snprintf(buffer, elcount(buffer), "   0.000000 F1 EPS::WUDOP_EPS_FR::WUDOP_1_1 = %d\n", intval);
	filePutString (buffer, elcount(buffer), hFile);
	intval = getSignal(CHASSIS::WUDOP_EPS_FR::WUDOP_1_2);
	snprintf(buffer, elcount(buffer), "   0.000000 F1 EPS::WUDOP_EPS_FR::WUDOP_1_2 = %d\n", intval);
	filePutString (buffer, elcount(buffer), hFile);
	intval = getSignal(CHASSIS::WUDOP_EPS_FR::WUDOP_1_3);
	snprintf(buffer, elcount(buffer), "   0.000000 F1 EPS::WUDOP_EPS_FR::WUDOP_1_3 = %d\n", intval);
	filePutString (buffer, elcount(buffer), hFile);
	intval = getSignal(CHASSIS::WUDOP_EPS_FR::WUDOP_1_4);
	snprintf(buffer, elcount(buffer), "   0.000000 F1 EPS::WUDOP_EPS_FR::WUDOP_1_4 = %d\n", intval);
	filePutString (buffer, elcount(buffer), hFile);
	intval = getSignal(CHASSIS::WUDOP_EPS_FR::WUDOP_1_5);
	snprintf(buffer, elcount(buffer), "   0.000000 F1 EPS::WUDOP_EPS_FR::WUDOP_1_5 = %d\n", intval);
	filePutString (buffer, elcount(buffer), hFile);
	intval = getSignal(CHASSIS::WUDOP_EPS_FR::WUDOP_2_1);
	snprintf(buffer, elcount(buffer), "   0.000000 F1 EPS::WUDOP_EPS_FR::WUDOP_2_1 = %d\n", intval);
	filePutString (buffer, elcount(buffer), hFile);
	intval = getSignal(CHASSIS::WUDOP_EPS_FR::WUDOP_2_2);
	snprintf(buffer, elcount(buffer), "   0.000000 F1 EPS::WUDOP_EPS_FR::WUDOP_2_2 = %d\n", intval);
	filePutString (buffer, elcount(buffer), hFile);
	intval = getSignal(CHASSIS::WUDOP_EPS_FR::WUDOP_2_3);
	snprintf(buffer, elcount(buffer), "   0.000000 F1 EPS::WUDOP_EPS_FR::WUDOP_2_3 = %d\n", intval);
	filePutString (buffer, elcount(buffer), hFile);
	intval = getSignal(CHASSIS::WUDOP_EPS_FR::WUDOP_2_4);
	snprintf(buffer, elcount(buffer), "   0.000000 F1 EPS::WUDOP_EPS_FR::WUDOP_2_4 = %d\n", intval);
	filePutString (buffer, elcount(buffer), hFile);
	intval = getSignal(CHASSIS::WUDOP_EPS_FR::WUDOP_2_5);
	snprintf(buffer, elcount(buffer), "   0.000000 F1 EPS::WUDOP_EPS_FR::WUDOP_2_5 = %d\n", intval);
	filePutString (buffer, elcount(buffer), hFile);
	intval = getSignal(CHASSIS::WUDOP_EPS_FR::WUDOP_3_1);
	snprintf(buffer, elcount(buffer), "   0.000000 F1 EPS::WUDOP_EPS_FR::WUDOP_3_1 = %d\n", intval);
	filePutString (buffer, elcount(buffer), hFile);
	intval = getSignal(CHASSIS::WUDOP_EPS_FR::WUDOP_3_2);
	snprintf(buffer, elcount(buffer), "   0.000000 F1 EPS::WUDOP_EPS_FR::WUDOP_3_2 = %d\n", intval);
	filePutString (buffer, elcount(buffer), hFile);
	intval = getSignal(CHASSIS::WUDOP_EPS_FR::WUDOP_3_3);
	snprintf(buffer, elcount(buffer), "   0.000000 F1 EPS::WUDOP_EPS_FR::WUDOP_3_3 = %d\n", intval);
	filePutString (buffer, elcount(buffer), hFile);
	intval = getSignal(CHASSIS::WUDOP_EPS_FR::WUDOP_3_4);
	snprintf(buffer, elcount(buffer), "   0.000000 F1 EPS::WUDOP_EPS_FR::WUDOP_3_4 = %d\n", intval);
	filePutString (buffer, elcount(buffer), hFile);
	intval = getSignal(CHASSIS::WUDOP_EPS_FR::WUDOP_3_5);
	snprintf(buffer, elcount(buffer), "   0.000000 F1 EPS::WUDOP_EPS_FR::WUDOP_3_5 = %d\n", intval);
	filePutString (buffer, elcount(buffer), hFile);
	intval = getSignal(CHASSIS::WUDOP_EPS_FR::WUDOP_4_1);
	snprintf(buffer, elcount(buffer), "   0.000000 F1 EPS::WUDOP_EPS_FR::WUDOP_4_1 = %d\n", intval);
	filePutString (buffer, elcount(buffer), hFile);
	intval = getSignal(CHASSIS::WUDOP_EPS_FR::WUDOP_4_2);
	snprintf(buffer, elcount(buffer), "   0.000000 F1 EPS::WUDOP_EPS_FR::WUDOP_4_2 = %d\n", intval);
	filePutString (buffer, elcount(buffer), hFile);
	intval = getSignal(CHASSIS::WUDOP_EPS_FR::WUDOP_4_3);
	snprintf(buffer, elcount(buffer), "   0.000000 F1 EPS::WUDOP_EPS_FR::WUDOP_4_3 = %d\n", intval);
	filePutString (buffer, elcount(buffer), hFile);
	intval = getSignal(CHASSIS::WUDOP_EPS_FR::WUDOP_4_4);
	snprintf(buffer, elcount(buffer), "   0.000000 F1 EPS::WUDOP_EPS_FR::WUDOP_4_4 = %d\n", intval);
	filePutString (buffer, elcount(buffer), hFile);
	intval = getSignal(CHASSIS::WUDOP_EPS_FR::WUDOP_4_5);
	snprintf(buffer, elcount(buffer), "   0.000000 F1 EPS::WUDOP_EPS_FR::WUDOP_4_5 = %d\n", intval);
	filePutString (buffer, elcount(buffer), hFile);
	intval = getSignal(CHASSIS::WUDOP_EPS_FR::WUDOP_4_6);
	snprintf(buffer, elcount(buffer), "   0.000000 F1 EPS::WUDOP_EPS_FR::WUDOP_4_6 = %d\n", intval);
	filePutString (buffer, elcount(buffer), hFile);
	snprintf(buffer, elcount(buffer), "   0.000000    SV: 2 0 0 ::CH_Nodes::CH__NMActive_ESP = %X\n", @sysvar::CH_Nodes::CH__NMActive_ESP);
	filePutString (buffer, elcount(buffer), hFile);
	snprintf(buffer, elcount(buffer), "   0.000000    SV: 2 0 0 ::CH_Nodes::CH__NMAwake_ESP = %X\n", @sysvar::CH_Nodes::CH__NMAwake_ESP);
	filePutString (buffer, elcount(buffer), hFile);
	intval = @sysvar::CH_Nodes::CH_ESPCRC_AWD_TCASE_Rq_ESP__AUTO;
	snprintf(buffer, elcount(buffer), "   0.000000    SV: 2 0 0 ::CH_Nodes::CH_ESPCRC_AWD_TCASE_Rq_ESP__AUTO = %d\n", intval);
	filePutString (buffer, elcount(buffer), hFile);
	intval = getSignal(CHASSIS::AWD_TCASE_Rq_ESP_AR2::CRC_AWD_TCASE_Rq_ESP_Pr2);
	snprintf(buffer, elcount(buffer), "   0.000000 F1 ESP::AWD_TCASE_Rq_ESP_AR2::CRC_AWD_TCASE_Rq_ESP_Pr2 = %d\n", intval);
	filePutString (buffer, elcount(buffer), hFile);
}
/*@@end*/

/*@@caplFunc:saveVars_61(dword):*/
void saveVars_61(dword hFile)
{
	intval = @sysvar::CH_Nodes::CH_ESPSQC_AWD_TCASE_Rq_ESP__AUTO;
	snprintf(buffer, elcount(buffer), "   0.000000    SV: 2 0 0 ::CH_Nodes::CH_ESPSQC_AWD_TCASE_Rq_ESP__AUTO = %d\n", intval);
	filePutString (buffer, elcount(buffer), hFile);
	intval = getSignal(CHASSIS::AWD_TCASE_Rq_ESP_AR2::SQC_AWD_TCASE_Rq_ESP_Pr2);
	snprintf(buffer, elcount(buffer), "   0.000000 F1 ESP::AWD_TCASE_Rq_ESP_AR2::SQC_AWD_TCASE_Rq_ESP_Pr2 = %d\n", intval);
	filePutString (buffer, elcount(buffer), hFile);
	intval = getSignal(CHASSIS::AWD_TCASE_Rq_ESP_AR2::DiffLk_M_Md_Rq_ESP);
	snprintf(buffer, elcount(buffer), "   0.000000 F1 ESP::AWD_TCASE_Rq_ESP_AR2::DiffLk_M_Md_Rq_ESP = %d\n", intval);
	filePutString (buffer, elcount(buffer), hFile);
	intval = getSignal(CHASSIS::AWD_TCASE_Rq_ESP_AR2::Rsrv1_AWD_TCASE_Rq_ESP_Pr2);
	snprintf(buffer, elcount(buffer), "   0.000000 F1 ESP::AWD_TCASE_Rq_ESP_AR2::Rsrv1_AWD_TCASE_Rq_ESP_Pr2 = %d\n", intval);
	filePutString (buffer, elcount(buffer), hFile);
	intval = getSignal(CHASSIS::AWD_TCASE_Rq_ESP_AR2::DiffLk_M_LkTrq_Rq_ESP);
	snprintf(buffer, elcount(buffer), "   0.000000 F1 ESP::AWD_TCASE_Rq_ESP_AR2::DiffLk_M_LkTrq_Rq_ESP = %d\n", intval);
	filePutString (buffer, elcount(buffer), hFile);
	intval = getSignal(CHASSIS::AWD_TCASE_Rq_ESP_AR2::Rsrv2_AWD_TCASE_Rq_ESP_Pr2);
	snprintf(buffer, elcount(buffer), "   0.000000 F1 ESP::AWD_TCASE_Rq_ESP_AR2::Rsrv2_AWD_TCASE_Rq_ESP_Pr2 = %d\n", intval);
	filePutString (buffer, elcount(buffer), hFile);
	intval = @sysvar::CH_Nodes::CH_ESPCRC_BrkSys_Stat_Pr2Br_AUTO;
	snprintf(buffer, elcount(buffer), "   0.000000    SV: 2 0 0 ::CH_Nodes::CH_ESPCRC_BrkSys_Stat_Pr2Br_AUTO = %d\n", intval);
	filePutString (buffer, elcount(buffer), hFile);
	intval = getSignal(CHASSIS::BrkSys_Stat_AR2::CRC_BrkSys_Stat_Pr2);
	snprintf(buffer, elcount(buffer), "   0.000000 F1 ESP::BrkSys_Stat_AR2::CRC_BrkSys_Stat_Pr2 = %d\n", intval);
	filePutString (buffer, elcount(buffer), hFile);
	intval = @sysvar::CH_Nodes::CH_ESPSQC_BrkSys_Stat_Pr2Br_AUTO;
	snprintf(buffer, elcount(buffer), "   0.000000    SV: 2 0 0 ::CH_Nodes::CH_ESPSQC_BrkSys_Stat_Pr2Br_AUTO = %d\n", intval);
	filePutString (buffer, elcount(buffer), hFile);
	intval = getSignal(CHASSIS::BrkSys_Stat_AR2::SQC_BrkSys_Stat_Pr2);
	snprintf(buffer, elcount(buffer), "   0.000000 F1 ESP::BrkSys_Stat_AR2::SQC_BrkSys_Stat_Pr2 = %d\n", intval);
	filePutString (buffer, elcount(buffer), hFile);
	intval = getSignal(CHASSIS::BrkSys_Stat_AR2::Brk_Stat);
	snprintf(buffer, elcount(buffer), "   0.000000 F1 ESP::BrkSys_Stat_AR2::Brk_Stat = %d\n", intval);
	filePutString (buffer, elcount(buffer), hFile);
	intval = getSignal(CHASSIS::BrkSys_Stat_AR2::BrkPdl_Stat);
	snprintf(buffer, elcount(buffer), "   0.000000 F1 ESP::BrkSys_Stat_AR2::BrkPdl_Stat = %d\n", intval);
	filePutString (buffer, elcount(buffer), hFile);
	intval = getSignal(CHASSIS::BrkSys_Stat_AR2::BrkTrq_V2);
	snprintf(buffer, elcount(buffer), "   0.000000 F1 ESP::BrkSys_Stat_AR2::BrkTrq_V2 = %d\n", intval);
	filePutString (buffer, elcount(buffer), hFile);
	intval = getSignal(CHASSIS::BrkSys_Stat_AR2::SSA_EmgBrk_Actv);
	snprintf(buffer, elcount(buffer), "   0.000000 F1 ESP::BrkSys_Stat_AR2::SSA_EmgBrk_Actv = %d\n", intval);
	filePutString (buffer, elcount(buffer), hFile);
	intval = getSignal(CHASSIS::BrkSys_Stat_AR2::EmgBrk_Actv);
	snprintf(buffer, elcount(buffer), "   0.000000 F1 ESP::BrkSys_Stat_AR2::EmgBrk_Actv = %d\n", intval);
	filePutString (buffer, elcount(buffer), hFile);
	intval = getSignal(CHASSIS::BrkSys_Stat_AR2::FullBrk_Actv);
	snprintf(buffer, elcount(buffer), "   0.000000 F1 ESP::BrkSys_Stat_AR2::FullBrk_Actv = %d\n", intval);
	filePutString (buffer, elcount(buffer), hFile);
	intval = getSignal(CHASSIS::BrkSys_Stat_AR2::BrkTrq_D_V2);
	snprintf(buffer, elcount(buffer), "   0.000000 F1 ESP::BrkSys_Stat_AR2::BrkTrq_D_V2 = %d\n", intval);
	filePutString (buffer, elcount(buffer), hFile);
	intval = getSignal(CHASSIS::BrkSys_Stat_AR2::Rsrv5_BrkSys_Stat_Pr2);
	snprintf(buffer, elcount(buffer), "   0.000000 F1 ESP::BrkSys_Stat_AR2::Rsrv5_BrkSys_Stat_Pr2 = %d\n", intval);
	filePutString (buffer, elcount(buffer), hFile);
	intval = getSignal(CHASSIS::BrkSys_Stat_AR2::BrkRq_PT_Enbl);
	snprintf(buffer, elcount(buffer), "   0.000000 F1 ESP::BrkSys_Stat_AR2::BrkRq_PT_Enbl = %d\n", intval);
	filePutString (buffer, elcount(buffer), hFile);
	intval = getSignal(CHASSIS::BrkSys_Stat_AR2::ESP_Oprtn_Stat_AS_V2);
	snprintf(buffer, elcount(buffer), "   0.000000 F1 ESP::BrkSys_Stat_AR2::ESP_Oprtn_Stat_AS_V2 = %d\n", intval);
	filePutString (buffer, elcount(buffer), hFile);
	intval = getSignal(CHASSIS::BrkSys_Stat_AR2::ESP_Sys_Stat_V2);
	snprintf(buffer, elcount(buffer), "   0.000000 F1 ESP::BrkSys_Stat_AR2::ESP_Sys_Stat_V2 = %d\n", intval);
	filePutString (buffer, elcount(buffer), hFile);
	intval = getSignal(CHASSIS::BrkSys_Stat_AR2::BrkIntrvntn_Actv_CWA);
	snprintf(buffer, elcount(buffer), "   0.000000 F1 ESP::BrkSys_Stat_AR2::BrkIntrvntn_Actv_CWA = %d\n", intval);
	filePutString (buffer, elcount(buffer), hFile);
	intval = getSignal(CHASSIS::BrkSys_Stat_AR2::BrkIntrvntn_Actv_ESP);
	snprintf(buffer, elcount(buffer), "   0.000000 F1 ESP::BrkSys_Stat_AR2::BrkIntrvntn_Actv_ESP = %d\n", intval);
	filePutString (buffer, elcount(buffer), hFile);
	intval = getSignal(CHASSIS::BrkSys_Stat_AR2::BrkIntrvntn_Actv_AS);
	snprintf(buffer, elcount(buffer), "   0.000000 F1 ESP::BrkSys_Stat_AR2::BrkIntrvntn_Actv_AS = %d\n", intval);
	filePutString (buffer, elcount(buffer), hFile);
	intval = getSignal(CHASSIS::BrkSys_Stat_AR2::BrkIntrvntn_Actv_EPKB);
	snprintf(buffer, elcount(buffer), "   0.000000 F1 ESP::BrkSys_Stat_AR2::BrkIntrvntn_Actv_EPKB = %d\n", intval);
	filePutString (buffer, elcount(buffer), hFile);
	intval = getSignal(CHASSIS::BrkSys_Stat_AR2::FTW_PressDrop_Stat);
	snprintf(buffer, elcount(buffer), "   0.000000 F1 ESP::BrkSys_Stat_AR2::FTW_PressDrop_Stat = %d\n", intval);
	filePutString (buffer, elcount(buffer), hFile);
	intval = getSignal(CHASSIS::BrkSys_Stat_AR2::DSR_Actv);
	snprintf(buffer, elcount(buffer), "   0.000000 F1 ESP::BrkSys_Stat_AR2::DSR_Actv = %d\n", intval);
	filePutString (buffer, elcount(buffer), hFile);
	intval = getSignal(CHASSIS::BrkSys_Stat_AR2::DSR_Sys_Flt);
	snprintf(buffer, elcount(buffer), "   0.000000 F1 ESP::BrkSys_Stat_AR2::DSR_Sys_Flt = %d\n", intval);
	filePutString (buffer, elcount(buffer), hFile);
	intval = @sysvar::CH_Nodes::CH_ESPCRC_DPC_Disp_Rq_Pr2DP_AUTO;
	snprintf(buffer, elcount(buffer), "   0.000000    SV: 2 0 0 ::CH_Nodes::CH_ESPCRC_DPC_Disp_Rq_Pr2DP_AUTO = %d\n", intval);
	filePutString (buffer, elcount(buffer), hFile);
	intval = getSignal(CHASSIS::DPC_Disp_Rq_AR2::CRC_DPC_Disp_Rq_Pr2);
	snprintf(buffer, elcount(buffer), "   0.000000 F1 ESP::DPC_Disp_Rq_AR2::CRC_DPC_Disp_Rq_Pr2 = %d\n", intval);
	filePutString (buffer, elcount(buffer), hFile);
	intval = @sysvar::CH_Nodes::CH_ESPSQC_DPC_Disp_Rq_Pr2DP_AUTO;
	snprintf(buffer, elcount(buffer), "   0.000000    SV: 2 0 0 ::CH_Nodes::CH_ESPSQC_DPC_Disp_Rq_Pr2DP_AUTO = %d\n", intval);
	filePutString (buffer, elcount(buffer), hFile);
	intval = getSignal(CHASSIS::DPC_Disp_Rq_AR2::SQC_DPC_Disp_Rq_Pr2);
	snprintf(buffer, elcount(buffer), "   0.000000 F1 ESP::DPC_Disp_Rq_AR2::SQC_DPC_Disp_Rq_Pr2 = %d\n", intval);
	filePutString (buffer, elcount(buffer), hFile);
	intval = getSignal(CHASSIS::DPC_Disp_Rq_AR2::DPC_Md_Disp_Rq);
	snprintf(buffer, elcount(buffer), "   0.000000 F1 ESP::DPC_Disp_Rq_AR2::DPC_Md_Disp_Rq = %d\n", intval);
	filePutString (buffer, elcount(buffer), hFile);
	intval = getSignal(CHASSIS::DPC_Disp_Rq_AR2::DPC_OnroadMd_Disp_Rq);
	snprintf(buffer, elcount(buffer), "   0.000000 F1 ESP::DPC_Disp_Rq_AR2::DPC_OnroadMd_Disp_Rq = %d\n", intval);
	filePutString (buffer, elcount(buffer), hFile);
	intval = getSignal(CHASSIS::DPC_Disp_Rq_AR2::DPC_OnroadMd_Disp_TrgRq);
	snprintf(buffer, elcount(buffer), "   0.000000 F1 ESP::DPC_Disp_Rq_AR2::DPC_OnroadMd_Disp_TrgRq = %d\n", intval);
	filePutString (buffer, elcount(buffer), hFile);
	intval = getSignal(CHASSIS::DPC_Disp_Rq_AR2::DPC_Offroad_Abort_Disp_Rq);
	snprintf(buffer, elcount(buffer), "   0.000000 F1 ESP::DPC_Disp_Rq_AR2::DPC_Offroad_Abort_Disp_Rq = %d\n", intval);
	filePutString (buffer, elcount(buffer), hFile);
	intval = getSignal(CHASSIS::DPC_Disp_Rq_AR2::DPC_OnroadMd_Style);
	snprintf(buffer, elcount(buffer), "   0.000000 F1 ESP::DPC_Disp_Rq_AR2::DPC_OnroadMd_Style = %d\n", intval);
	filePutString (buffer, elcount(buffer), hFile);
	intval = getSignal(CHASSIS::DPC_Disp_Rq_AR2::Rsrv1_DPC_Disp_Rq_Pr2);
	snprintf(buffer, elcount(buffer), "   0.000000 F1 ESP::DPC_Disp_Rq_AR2::Rsrv1_DPC_Disp_Rq_Pr2 = %d\n", intval);
	filePutString (buffer, elcount(buffer), hFile);
	intval = getSignal(CHASSIS::DPC_Disp_Rq_AR2::Rsrv2_DPC_Disp_Rq_Pr2);
	snprintf(buffer, elcount(buffer), "   0.000000 F1 ESP::DPC_Disp_Rq_AR2::Rsrv2_DPC_Disp_Rq_Pr2 = %d\n", intval);
	filePutString (buffer, elcount(buffer), hFile);
	intval = @sysvar::CH_Nodes::CH_ESPCRC_DPC_IndMd_Stat_Pr_AUTO;
	snprintf(buffer, elcount(buffer), "   0.000000    SV: 2 0 0 ::CH_Nodes::CH_ESPCRC_DPC_IndMd_Stat_Pr_AUTO = %d\n", intval);
	filePutString (buffer, elcount(buffer), hFile);
	intval = getSignal(CHASSIS::DPC_IndMd_Stat_AR2::CRC_DPC_IndMd_Stat_Pr2);
	snprintf(buffer, elcount(buffer), "   0.000000 F1 ESP::DPC_IndMd_Stat_AR2::CRC_DPC_IndMd_Stat_Pr2 = %d\n", intval);
	filePutString (buffer, elcount(buffer), hFile);
	intval = @sysvar::CH_Nodes::CH_ESPSQC_DPC_IndMd_Stat_Pr_AUTO;
	snprintf(buffer, elcount(buffer), "   0.000000    SV: 2 0 0 ::CH_Nodes::CH_ESPSQC_DPC_IndMd_Stat_Pr_AUTO = %d\n", intval);
	filePutString (buffer, elcount(buffer), hFile);
	intval = getSignal(CHASSIS::DPC_IndMd_Stat_AR2::SQC_DPC_IndMd_Stat_Pr2);
	snprintf(buffer, elcount(buffer), "   0.000000 F1 ESP::DPC_IndMd_Stat_AR2::SQC_DPC_IndMd_Stat_Pr2 = %d\n", intval);
	filePutString (buffer, elcount(buffer), hFile);
	intval = getSignal(CHASSIS::DPC_IndMd_Stat_AR2::DPC_IndMd_PT_Stat);
	snprintf(buffer, elcount(buffer), "   0.000000 F1 ESP::DPC_IndMd_Stat_AR2::DPC_IndMd_PT_Stat = %d\n", intval);
	filePutString (buffer, elcount(buffer), hFile);
	intval = getSignal(CHASSIS::DPC_IndMd_Stat_AR2::DPC_IndMd_St_Stat);
	snprintf(buffer, elcount(buffer), "   0.000000 F1 ESP::DPC_IndMd_Stat_AR2::DPC_IndMd_St_Stat = %d\n", intval);
	filePutString (buffer, elcount(buffer), hFile);
	intval = getSignal(CHASSIS::DPC_IndMd_Stat_AR2::DPC_IndMd_Susp_Stat);
	snprintf(buffer, elcount(buffer), "   0.000000 F1 ESP::DPC_IndMd_Stat_AR2::DPC_IndMd_Susp_Stat = %d\n", intval);
	filePutString (buffer, elcount(buffer), hFile);
	intval = getSignal(CHASSIS::DPC_IndMd_Stat_AR2::DPC_IndMd_SSA_Stat);
	snprintf(buffer, elcount(buffer), "   0.000000 F1 ESP::DPC_IndMd_Stat_AR2::DPC_IndMd_SSA_Stat = %d\n", intval);
	filePutString (buffer, elcount(buffer), hFile);
	intval = getSignal(CHASSIS::DPC_IndMd_Stat_AR2::DPC_OffroadMd_Stat);
	snprintf(buffer, elcount(buffer), "   0.000000 F1 ESP::DPC_IndMd_Stat_AR2::DPC_OffroadMd_Stat = %d\n", intval);
	filePutString (buffer, elcount(buffer), hFile);
	intval = getSignal(CHASSIS::DPC_IndMd_Stat_AR2::DPC_IndMd_eDrv_Stat);
	snprintf(buffer, elcount(buffer), "   0.000000 F1 ESP::DPC_IndMd_Stat_AR2::DPC_IndMd_eDrv_Stat = %d\n", intval);
	filePutString (buffer, elcount(buffer), hFile);
	intval = getSignal(CHASSIS::DPC_IndMd_Stat_AR2::DPC_IndMd_PwrFreeD_Plus_Stat);
	snprintf(buffer, elcount(buffer), "   0.000000 F1 ESP::DPC_IndMd_Stat_AR2::DPC_IndMd_PwrFreeD_Plus_Stat = %d\n", intval);
	filePutString (buffer, elcount(buffer), hFile);
	intval = getSignal(CHASSIS::DPC_IndMd_Stat_AR2::DPC_IndMd_ECO_Assist_Stat);
	snprintf(buffer, elcount(buffer), "   0.000000 F1 ESP::DPC_IndMd_Stat_AR2::DPC_IndMd_ECO_Assist_Stat = %d\n", intval);
	filePutString (buffer, elcount(buffer), hFile);
	intval = getSignal(CHASSIS::DPC_IndMd_Stat_AR2::DPC_IndMd_AC_Stat);
	snprintf(buffer, elcount(buffer), "   0.000000 F1 ESP::DPC_IndMd_Stat_AR2::DPC_IndMd_AC_Stat = %d\n", intval);
	filePutString (buffer, elcount(buffer), hFile);
	intval = getSignal(CHASSIS::DPC_IndMd_Stat_AR2::DPC_IndMd_Ht_Stat);
	snprintf(buffer, elcount(buffer), "   0.000000 F1 ESP::DPC_IndMd_Stat_AR2::DPC_IndMd_Ht_Stat = %d\n", intval);
	filePutString (buffer, elcount(buffer), hFile);
	intval = getSignal(CHASSIS::DPC_IndMd_Stat_AR2::DPC_IndMd_ExhstFlap_Stat);
	snprintf(buffer, elcount(buffer), "   0.000000 F1 ESP::DPC_IndMd_Stat_AR2::DPC_IndMd_ExhstFlap_Stat = %d\n", intval);
	filePutString (buffer, elcount(buffer), hFile);
	intval = getSignal(CHASSIS::DPC_IndMd_Stat_AR2::DPC_IndMd_ESP_Stat);
	snprintf(buffer, elcount(buffer), "   0.000000 F1 ESP::DPC_IndMd_Stat_AR2::DPC_IndMd_ESP_Stat = %d\n", intval);
	filePutString (buffer, elcount(buffer), hFile);
	intval = getSignal(CHASSIS::DPC_IndMd_Stat_AR2::DPC_IndMd_Tx_Stat);
	snprintf(buffer, elcount(buffer), "   0.000000 F1 ESP::DPC_IndMd_Stat_AR2::DPC_IndMd_Tx_Stat = %d\n", intval);
	filePutString (buffer, elcount(buffer), hFile);
	intval = getSignal(CHASSIS::DPC_IndMd_Stat_AR2::DPC_IndMd_AS_Stat);
	snprintf(buffer, elcount(buffer), "   0.000000 F1 ESP::DPC_IndMd_Stat_AR2::DPC_IndMd_AS_Stat = %d\n", intval);
	filePutString (buffer, elcount(buffer), hFile);
	intval = getSignal(CHASSIS::DPC_IndMd_Stat_AR2::DPC_IndMd_ABC_Stat);
	snprintf(buffer, elcount(buffer), "   0.000000 F1 ESP::DPC_IndMd_Stat_AR2::DPC_IndMd_ABC_Stat = %d\n", intval);
	filePutString (buffer, elcount(buffer), hFile);
}
/*@@end*/

/*@@caplFunc:saveVars_62(dword):*/
void saveVars_62(dword hFile)
{
	intval = getSignal(CHASSIS::DPC_IndMd_Stat_AR2::Rsrv2_DPC_IndMd_Stat_Pr2);
	snprintf(buffer, elcount(buffer), "   0.000000 F1 ESP::DPC_IndMd_Stat_AR2::Rsrv2_DPC_IndMd_Stat_Pr2 = %d\n", intval);
	filePutString (buffer, elcount(buffer), hFile);
	intval = getSignal(CHASSIS::DPC_IndMd_Stat_AR2::Rsrv3_DPC_IndMd_Stat_Pr2);
	snprintf(buffer, elcount(buffer), "   0.000000 F1 ESP::DPC_IndMd_Stat_AR2::Rsrv3_DPC_IndMd_Stat_Pr2 = %d\n", intval);
	filePutString (buffer, elcount(buffer), hFile);
	intval = @sysvar::CH_Nodes::CH_ESPCRC_DPC_IndMd_Style2__AUTO;
	snprintf(buffer, elcount(buffer), "   0.000000    SV: 2 0 0 ::CH_Nodes::CH_ESPCRC_DPC_IndMd_Style2__AUTO = %d\n", intval);
	filePutString (buffer, elcount(buffer), hFile);
	intval = getSignal(CHASSIS::DPC_IndMd_Style2_AR2::CRC_DPC_IndMd_Style2_Pr2);
	snprintf(buffer, elcount(buffer), "   0.000000 F1 ESP::DPC_IndMd_Style2_AR2::CRC_DPC_IndMd_Style2_Pr2 = %d\n", intval);
	filePutString (buffer, elcount(buffer), hFile);
	intval = @sysvar::CH_Nodes::CH_ESPSQC_DPC_IndMd_Style2__AUTO;
	snprintf(buffer, elcount(buffer), "   0.000000    SV: 2 0 0 ::CH_Nodes::CH_ESPSQC_DPC_IndMd_Style2__AUTO = %d\n", intval);
	filePutString (buffer, elcount(buffer), hFile);
	intval = getSignal(CHASSIS::DPC_IndMd_Style2_AR2::SQC_DPC_IndMd_Style2_Pr2);
	snprintf(buffer, elcount(buffer), "   0.000000 F1 ESP::DPC_IndMd_Style2_AR2::SQC_DPC_IndMd_Style2_Pr2 = %d\n", intval);
	filePutString (buffer, elcount(buffer), hFile);
	intval = getSignal(CHASSIS::DPC_IndMd_Style2_AR2::Rsrv0_DPC_IndMd_Style2_Pr2);
	snprintf(buffer, elcount(buffer), "   0.000000 F1 ESP::DPC_IndMd_Style2_AR2::Rsrv0_DPC_IndMd_Style2_Pr2 = %d\n", intval);
	filePutString (buffer, elcount(buffer), hFile);
	intval = getSignal(CHASSIS::DPC_IndMd_Style2_AR2::DPC_IndMd_ABC_Style);
	snprintf(buffer, elcount(buffer), "   0.000000 F1 ESP::DPC_IndMd_Style2_AR2::DPC_IndMd_ABC_Style = %d\n", intval);
	filePutString (buffer, elcount(buffer), hFile);
	intval = getSignal(CHASSIS::DPC_IndMd_Style2_AR2::Rsrv1_DPC_IndMd_Style2_Pr2);
	snprintf(buffer, elcount(buffer), "   0.000000 F1 ESP::DPC_IndMd_Style2_AR2::Rsrv1_DPC_IndMd_Style2_Pr2 = %d\n", intval);
	filePutString (buffer, elcount(buffer), hFile);
	intval = getSignal(CHASSIS::DPC_IndMd_Style2_AR2::Rsrv2_DPC_IndMd_Style2_Pr2);
	snprintf(buffer, elcount(buffer), "   0.000000 F1 ESP::DPC_IndMd_Style2_AR2::Rsrv2_DPC_IndMd_Style2_Pr2 = %d\n", intval);
	filePutString (buffer, elcount(buffer), hFile);
	intval = getSignal(CHASSIS::DPC_IndMd_Style2_AR2::Rsrv3_DPC_IndMd_Style2_Pr2);
	snprintf(buffer, elcount(buffer), "   0.000000 F1 ESP::DPC_IndMd_Style2_AR2::Rsrv3_DPC_IndMd_Style2_Pr2 = %d\n", intval);
	filePutString (buffer, elcount(buffer), hFile);
	intval = getSignal(CHASSIS::DPC_IndMd_Style2_AR2::Rsrv4_DPC_IndMd_Style2_Pr2);
	snprintf(buffer, elcount(buffer), "   0.000000 F1 ESP::DPC_IndMd_Style2_AR2::Rsrv4_DPC_IndMd_Style2_Pr2 = %d\n", intval);
	filePutString (buffer, elcount(buffer), hFile);
	intval = getSignal(CHASSIS::DPC_IndMd_Style2_AR2::Rsrv5_DPC_IndMd_Style2_Pr2);
	snprintf(buffer, elcount(buffer), "   0.000000 F1 ESP::DPC_IndMd_Style2_AR2::Rsrv5_DPC_IndMd_Style2_Pr2 = %d\n", intval);
	filePutString (buffer, elcount(buffer), hFile);
	intval = getSignal(CHASSIS::DPC_IndMd_Style2_AR2::Rsrv6_DPC_IndMd_Style2_Pr2);
	snprintf(buffer, elcount(buffer), "   0.000000 F1 ESP::DPC_IndMd_Style2_AR2::Rsrv6_DPC_IndMd_Style2_Pr2 = %d\n", intval);
	filePutString (buffer, elcount(buffer), hFile);
	intval = @sysvar::CH_Nodes::CH_ESPCRC_DPC_IndMd_Style_P_AUTO;
	snprintf(buffer, elcount(buffer), "   0.000000    SV: 2 0 0 ::CH_Nodes::CH_ESPCRC_DPC_IndMd_Style_P_AUTO = %d\n", intval);
	filePutString (buffer, elcount(buffer), hFile);
	intval = getSignal(CHASSIS::DPC_IndMd_Style_AR2::CRC_DPC_IndMd_Style_Pr2);
	snprintf(buffer, elcount(buffer), "   0.000000 F1 ESP::DPC_IndMd_Style_AR2::CRC_DPC_IndMd_Style_Pr2 = %d\n", intval);
	filePutString (buffer, elcount(buffer), hFile);
	intval = @sysvar::CH_Nodes::CH_ESPSQC_DPC_IndMd_Style_P_AUTO;
	snprintf(buffer, elcount(buffer), "   0.000000    SV: 2 0 0 ::CH_Nodes::CH_ESPSQC_DPC_IndMd_Style_P_AUTO = %d\n", intval);
	filePutString (buffer, elcount(buffer), hFile);
	intval = getSignal(CHASSIS::DPC_IndMd_Style_AR2::SQC_DPC_IndMd_Style_Pr2);
	snprintf(buffer, elcount(buffer), "   0.000000 F1 ESP::DPC_IndMd_Style_AR2::SQC_DPC_IndMd_Style_Pr2 = %d\n", intval);
	filePutString (buffer, elcount(buffer), hFile);
	intval = getSignal(CHASSIS::DPC_IndMd_Style_AR2::DPC_IndMd_St_Style);
	snprintf(buffer, elcount(buffer), "   0.000000 F1 ESP::DPC_IndMd_Style_AR2::DPC_IndMd_St_Style = %d\n", intval);
	filePutString (buffer, elcount(buffer), hFile);
	intval = getSignal(CHASSIS::DPC_IndMd_Style_AR2::DPC_IndMd_PT_Style);
	snprintf(buffer, elcount(buffer), "   0.000000 F1 ESP::DPC_IndMd_Style_AR2::DPC_IndMd_PT_Style = %d\n", intval);
	filePutString (buffer, elcount(buffer), hFile);
	intval = getSignal(CHASSIS::DPC_IndMd_Style_AR2::DPC_IndMd_Susp_Style);
	snprintf(buffer, elcount(buffer), "   0.000000 F1 ESP::DPC_IndMd_Style_AR2::DPC_IndMd_Susp_Style = %d\n", intval);
	filePutString (buffer, elcount(buffer), hFile);
	intval = getSignal(CHASSIS::DPC_IndMd_Style_AR2::DPC_IndMd_SSA_Style);
	snprintf(buffer, elcount(buffer), "   0.000000 F1 ESP::DPC_IndMd_Style_AR2::DPC_IndMd_SSA_Style = %d\n", intval);
	filePutString (buffer, elcount(buffer), hFile);
	intval = getSignal(CHASSIS::DPC_IndMd_Style_AR2::DPC_IndMd_AS_Style);
	snprintf(buffer, elcount(buffer), "   0.000000 F1 ESP::DPC_IndMd_Style_AR2::DPC_IndMd_AS_Style = %d\n", intval);
	filePutString (buffer, elcount(buffer), hFile);
	intval = getSignal(CHASSIS::DPC_IndMd_Style_AR2::DPC_IndMd_eDrv_Style);
	snprintf(buffer, elcount(buffer), "   0.000000 F1 ESP::DPC_IndMd_Style_AR2::DPC_IndMd_eDrv_Style = %d\n", intval);
	filePutString (buffer, elcount(buffer), hFile);
	intval = getSignal(CHASSIS::DPC_IndMd_Style_AR2::DPC_IndMd_PwrFreeD_Plus_Style);
	snprintf(buffer, elcount(buffer), "   0.000000 F1 ESP::DPC_IndMd_Style_AR2::DPC_IndMd_PwrFreeD_Plus_Style = %d\n", intval);
	filePutString (buffer, elcount(buffer), hFile);
	intval = getSignal(CHASSIS::DPC_IndMd_Style_AR2::DPC_IndMd_ECO_Assist_Style);
	snprintf(buffer, elcount(buffer), "   0.000000 F1 ESP::DPC_IndMd_Style_AR2::DPC_IndMd_ECO_Assist_Style = %d\n", intval);
	filePutString (buffer, elcount(buffer), hFile);
	intval = getSignal(CHASSIS::DPC_IndMd_Style_AR2::DPC_IndMd_AC_Style);
	snprintf(buffer, elcount(buffer), "   0.000000 F1 ESP::DPC_IndMd_Style_AR2::DPC_IndMd_AC_Style = %d\n", intval);
	filePutString (buffer, elcount(buffer), hFile);
	intval = getSignal(CHASSIS::DPC_IndMd_Style_AR2::DPC_IndMd_Ht_Style);
	snprintf(buffer, elcount(buffer), "   0.000000 F1 ESP::DPC_IndMd_Style_AR2::DPC_IndMd_Ht_Style = %d\n", intval);
	filePutString (buffer, elcount(buffer), hFile);
	intval = getSignal(CHASSIS::DPC_IndMd_Style_AR2::DPC_IndMd_ExhstFlap_Style);
	snprintf(buffer, elcount(buffer), "   0.000000 F1 ESP::DPC_IndMd_Style_AR2::DPC_IndMd_ExhstFlap_Style = %d\n", intval);
	filePutString (buffer, elcount(buffer), hFile);
	intval = getSignal(CHASSIS::DPC_IndMd_Style_AR2::DPC_IndMd_ESP_Style);
	snprintf(buffer, elcount(buffer), "   0.000000 F1 ESP::DPC_IndMd_Style_AR2::DPC_IndMd_ESP_Style = %d\n", intval);
	filePutString (buffer, elcount(buffer), hFile);
	intval = getSignal(CHASSIS::DPC_IndMd_Style_AR2::DPC_IndMd_Tx_Style);
	snprintf(buffer, elcount(buffer), "   0.000000 F1 ESP::DPC_IndMd_Style_AR2::DPC_IndMd_Tx_Style = %d\n", intval);
	filePutString (buffer, elcount(buffer), hFile);
	intval = getSignal(CHASSIS::DPC_IndMd_Style_AR2::DPC_OffroadMd_Style);
	snprintf(buffer, elcount(buffer), "   0.000000 F1 ESP::DPC_IndMd_Style_AR2::DPC_OffroadMd_Style = %d\n", intval);
	filePutString (buffer, elcount(buffer), hFile);
	intval = @sysvar::CH_Nodes::CH_ESPCRC_DPC_Master_Rq_Pr2_AUTO;
	snprintf(buffer, elcount(buffer), "   0.000000    SV: 2 0 0 ::CH_Nodes::CH_ESPCRC_DPC_Master_Rq_Pr2_AUTO = %d\n", intval);
	filePutString (buffer, elcount(buffer), hFile);
	intval = getSignal(CHASSIS::DPC_Master_Rq_AR2::CRC_DPC_Master_Rq_Pr2);
	snprintf(buffer, elcount(buffer), "   0.000000 F1 ESP::DPC_Master_Rq_AR2::CRC_DPC_Master_Rq_Pr2 = %d\n", intval);
	filePutString (buffer, elcount(buffer), hFile);
	intval = @sysvar::CH_Nodes::CH_ESPSQC_DPC_Master_Rq_Pr2_AUTO;
	snprintf(buffer, elcount(buffer), "   0.000000    SV: 2 0 0 ::CH_Nodes::CH_ESPSQC_DPC_Master_Rq_Pr2_AUTO = %d\n", intval);
	filePutString (buffer, elcount(buffer), hFile);
	intval = getSignal(CHASSIS::DPC_Master_Rq_AR2::SQC_DPC_Master_Rq_Pr2);
	snprintf(buffer, elcount(buffer), "   0.000000 F1 ESP::DPC_Master_Rq_AR2::SQC_DPC_Master_Rq_Pr2 = %d\n", intval);
	filePutString (buffer, elcount(buffer), hFile);
	intval = getSignal(CHASSIS::DPC_Master_Rq_AR2::DPC_GlobalMd_Rq);
	snprintf(buffer, elcount(buffer), "   0.000000 F1 ESP::DPC_Master_Rq_AR2::DPC_GlobalMd_Rq = %d\n", intval);
	filePutString (buffer, elcount(buffer), hFile);
	intval = getSignal(CHASSIS::DPC_Master_Rq_AR2::DPC_Md_St_Rq);
	snprintf(buffer, elcount(buffer), "   0.000000 F1 ESP::DPC_Master_Rq_AR2::DPC_Md_St_Rq = %d\n", intval);
	filePutString (buffer, elcount(buffer), hFile);
	intval = getSignal(CHASSIS::DPC_Master_Rq_AR2::DPC_Md_Susp_Rq_V2);
	snprintf(buffer, elcount(buffer), "   0.000000 F1 ESP::DPC_Master_Rq_AR2::DPC_Md_Susp_Rq_V2 = %d\n", intval);
	filePutString (buffer, elcount(buffer), hFile);
	intval = getSignal(CHASSIS::DPC_Master_Rq_AR2::DPC_Md_PT_Rq);
	snprintf(buffer, elcount(buffer), "   0.000000 F1 ESP::DPC_Master_Rq_AR2::DPC_Md_PT_Rq = %d\n", intval);
	filePutString (buffer, elcount(buffer), hFile);
	intval = getSignal(CHASSIS::DPC_Master_Rq_AR2::DPC_Md_eDrv_Rq);
	snprintf(buffer, elcount(buffer), "   0.000000 F1 ESP::DPC_Master_Rq_AR2::DPC_Md_eDrv_Rq = %d\n", intval);
	filePutString (buffer, elcount(buffer), hFile);
	intval = getSignal(CHASSIS::DPC_Master_Rq_AR2::DPC_Md_PwrFreeD_Plus_Rq);
	snprintf(buffer, elcount(buffer), "   0.000000 F1 ESP::DPC_Master_Rq_AR2::DPC_Md_PwrFreeD_Plus_Rq = %d\n", intval);
	filePutString (buffer, elcount(buffer), hFile);
	intval = getSignal(CHASSIS::DPC_Master_Rq_AR2::DPC_Md_ECO_Assist_Rq);
	snprintf(buffer, elcount(buffer), "   0.000000 F1 ESP::DPC_Master_Rq_AR2::DPC_Md_ECO_Assist_Rq = %d\n", intval);
	filePutString (buffer, elcount(buffer), hFile);
	intval = getSignal(CHASSIS::DPC_Master_Rq_AR2::DPC_Md_AC_Rq);
	snprintf(buffer, elcount(buffer), "   0.000000 F1 ESP::DPC_Master_Rq_AR2::DPC_Md_AC_Rq = %d\n", intval);
	filePutString (buffer, elcount(buffer), hFile);
	intval = getSignal(CHASSIS::DPC_Master_Rq_AR2::DPC_Md_Ht_Rq);
	snprintf(buffer, elcount(buffer), "   0.000000 F1 ESP::DPC_Master_Rq_AR2::DPC_Md_Ht_Rq = %d\n", intval);
	filePutString (buffer, elcount(buffer), hFile);
	intval = getSignal(CHASSIS::DPC_Master_Rq_AR2::DPC_Md_ABC_Preview_Rq);
	snprintf(buffer, elcount(buffer), "   0.000000 F1 ESP::DPC_Master_Rq_AR2::DPC_Md_ABC_Preview_Rq = %d\n", intval);
	filePutString (buffer, elcount(buffer), hFile);
	intval = getSignal(CHASSIS::DPC_Master_Rq_AR2::DPC_Md_SSA_Rq);
	snprintf(buffer, elcount(buffer), "   0.000000 F1 ESP::DPC_Master_Rq_AR2::DPC_Md_SSA_Rq = %d\n", intval);
	filePutString (buffer, elcount(buffer), hFile);
	intval = getSignal(CHASSIS::DPC_Master_Rq_AR2::DPC_Md_AS_Rq);
	snprintf(buffer, elcount(buffer), "   0.000000 F1 ESP::DPC_Master_Rq_AR2::DPC_Md_AS_Rq = %d\n", intval);
	filePutString (buffer, elcount(buffer), hFile);
	intval = getSignal(CHASSIS::DPC_Master_Rq_AR2::DPC_Md_ExhstFlap_Rq);
	snprintf(buffer, elcount(buffer), "   0.000000 F1 ESP::DPC_Master_Rq_AR2::DPC_Md_ExhstFlap_Rq = %d\n", intval);
	filePutString (buffer, elcount(buffer), hFile);
	intval = getSignal(CHASSIS::DPC_Master_Rq_AR2::DPC_Md_ESP_Rq);
	snprintf(buffer, elcount(buffer), "   0.000000 F1 ESP::DPC_Master_Rq_AR2::DPC_Md_ESP_Rq = %d\n", intval);
	filePutString (buffer, elcount(buffer), hFile);
	intval = getSignal(CHASSIS::DPC_Master_Rq_AR2::DPC_Md_Tx_Rq);
	snprintf(buffer, elcount(buffer), "   0.000000 F1 ESP::DPC_Master_Rq_AR2::DPC_Md_Tx_Rq = %d\n", intval);
	filePutString (buffer, elcount(buffer), hFile);
	intval = getSignal(CHASSIS::DPC_Master_Rq_AR2::DPC_PopupDisp_Rq);
	snprintf(buffer, elcount(buffer), "   0.000000 F1 ESP::DPC_Master_Rq_AR2::DPC_PopupDisp_Rq = %d\n", intval);
	filePutString (buffer, elcount(buffer), hFile);
	intval = getSignal(CHASSIS::DPC_Master_Rq_AR2::DPC_PopupSupp_Rq);
	snprintf(buffer, elcount(buffer), "   0.000000 F1 ESP::DPC_Master_Rq_AR2::DPC_PopupSupp_Rq = %d\n", intval);
	filePutString (buffer, elcount(buffer), hFile);
	intval = getSignal(CHASSIS::DPC_Master_Rq_AR2::Rsrv2_DPC_Master_Rq_Pr2);
	snprintf(buffer, elcount(buffer), "   0.000000 F1 ESP::DPC_Master_Rq_AR2::Rsrv2_DPC_Master_Rq_Pr2 = %d\n", intval);
	filePutString (buffer, elcount(buffer), hFile);
	intval = getSignal(CHASSIS::DPC_Master_Rq_AR2::DPC_Md_ABC_Carv_Rq);
	snprintf(buffer, elcount(buffer), "   0.000000 F1 ESP::DPC_Master_Rq_AR2::DPC_Md_ABC_Carv_Rq = %d\n", intval);
	filePutString (buffer, elcount(buffer), hFile);
	intval = getSignal(CHASSIS::DPC_Master_Rq_AR2::Rsrv3_DPC_Master_Rq_Pr2);
	snprintf(buffer, elcount(buffer), "   0.000000 F1 ESP::DPC_Master_Rq_AR2::Rsrv3_DPC_Master_Rq_Pr2 = %d\n", intval);
	filePutString (buffer, elcount(buffer), hFile);
	intval = @sysvar::CH_Nodes::CH_ESPCRC_Eng_Susp_Rq_AS_Pr_AUTO;
	snprintf(buffer, elcount(buffer), "   0.000000    SV: 2 0 0 ::CH_Nodes::CH_ESPCRC_Eng_Susp_Rq_AS_Pr_AUTO = %d\n", intval);
	filePutString (buffer, elcount(buffer), hFile);
	intval = getSignal(CHASSIS::Eng_Susp_Rq_AS_AR2::CRC_Eng_Susp_Rq_AS_Pr2);
	snprintf(buffer, elcount(buffer), "   0.000000 F1 ESP::Eng_Susp_Rq_AS_AR2::CRC_Eng_Susp_Rq_AS_Pr2 = %d\n", intval);
	filePutString (buffer, elcount(buffer), hFile);
}
/*@@end*/

/*@@caplFunc:saveVars_63(dword):*/
void saveVars_63(dword hFile)
{
	intval = @sysvar::CH_Nodes::CH_ESPSQC_Eng_Susp_Rq_AS_Pr_AUTO;
	snprintf(buffer, elcount(buffer), "   0.000000    SV: 2 0 0 ::CH_Nodes::CH_ESPSQC_Eng_Susp_Rq_AS_Pr_AUTO = %d\n", intval);
	filePutString (buffer, elcount(buffer), hFile);
	intval = getSignal(CHASSIS::Eng_Susp_Rq_AS_AR2::SQC_Eng_Susp_Rq_AS_Pr2);
	snprintf(buffer, elcount(buffer), "   0.000000 F1 ESP::Eng_Susp_Rq_AS_AR2::SQC_Eng_Susp_Rq_AS_Pr2 = %d\n", intval);
	filePutString (buffer, elcount(buffer), hFile);
	intval = getSignal(CHASSIS::Eng_Susp_Rq_AS_AR2::OFC_Supp_Rq_AS);
	snprintf(buffer, elcount(buffer), "   0.000000 F1 ESP::Eng_Susp_Rq_AS_AR2::OFC_Supp_Rq_AS = %d\n", intval);
	filePutString (buffer, elcount(buffer), hFile);
	intval = getSignal(CHASSIS::Eng_Susp_Rq_AS_AR2::SSA_Enbl_Rq_AS);
	snprintf(buffer, elcount(buffer), "   0.000000 F1 ESP::Eng_Susp_Rq_AS_AR2::SSA_Enbl_Rq_AS = %d\n", intval);
	filePutString (buffer, elcount(buffer), hFile);
	intval = getSignal(CHASSIS::Eng_Susp_Rq_AS_AR2::KickDn_Rq_AS);
	snprintf(buffer, elcount(buffer), "   0.000000 F1 ESP::Eng_Susp_Rq_AS_AR2::KickDn_Rq_AS = %d\n", intval);
	filePutString (buffer, elcount(buffer), hFile);
	floatval = getSignal(CHASSIS::Eng_Susp_Rq_AS_AR2::EngTrq_Rq_AS);
	snprintf(buffer, elcount(buffer), "   0.000000 F1 ESP::Eng_Susp_Rq_AS_AR2::EngTrq_Rq_AS = %f\n", floatval);
	filePutString (buffer, elcount(buffer), hFile);
	intval = getSignal(CHASSIS::Eng_Susp_Rq_AS_AR2::Rsrv1_Eng_Rq_AS_Pr2);
	snprintf(buffer, elcount(buffer), "   0.000000 F1 ESP::Eng_Susp_Rq_AS_AR2::Rsrv1_Eng_Rq_AS_Pr2 = %d\n", intval);
	filePutString (buffer, elcount(buffer), hFile);
	intval = getSignal(CHASSIS::Eng_Susp_Rq_AS_AR2::EngTrqMax_Rq_AS);
	snprintf(buffer, elcount(buffer), "   0.000000 F1 ESP::Eng_Susp_Rq_AS_AR2::EngTrqMax_Rq_AS = %d\n", intval);
	filePutString (buffer, elcount(buffer), hFile);
	intval = getSignal(CHASSIS::Eng_Susp_Rq_AS_AR2::EngTrqMin_Rq_AS);
	snprintf(buffer, elcount(buffer), "   0.000000 F1 ESP::Eng_Susp_Rq_AS_AR2::EngTrqMin_Rq_AS = %d\n", intval);
	filePutString (buffer, elcount(buffer), hFile);
	intval = getSignal(CHASSIS::Eng_Susp_Rq_AS_AR2::Boost_Supp_Rq_AS);
	snprintf(buffer, elcount(buffer), "   0.000000 F1 ESP::Eng_Susp_Rq_AS_AR2::Boost_Supp_Rq_AS = %d\n", intval);
	filePutString (buffer, elcount(buffer), hFile);
	intval = getSignal(CHASSIS::Eng_Susp_Rq_AS_AR2::EM_NegTrq_Dsabl);
	snprintf(buffer, elcount(buffer), "   0.000000 F1 ESP::Eng_Susp_Rq_AS_AR2::EM_NegTrq_Dsabl = %d\n", intval);
	filePutString (buffer, elcount(buffer), hFile);
	intval = getSignal(CHASSIS::Eng_Susp_Rq_AS_AR2::IntrvntnMd_ESP);
	snprintf(buffer, elcount(buffer), "   0.000000 F1 ESP::Eng_Susp_Rq_AS_AR2::IntrvntnMd_ESP = %d\n", intval);
	filePutString (buffer, elcount(buffer), hFile);
	intval = getSignal(CHASSIS::Eng_Susp_Rq_AS_AR2::Rsrv2_Eng_Rq_AS_Pr2);
	snprintf(buffer, elcount(buffer), "   0.000000 F1 ESP::Eng_Susp_Rq_AS_AR2::Rsrv2_Eng_Rq_AS_Pr2 = %d\n", intval);
	filePutString (buffer, elcount(buffer), hFile);
	floatval = getSignal(CHASSIS::Eng_Susp_Rq_AS_AR2::LDC_VehDecel);
	snprintf(buffer, elcount(buffer), "   0.000000 F1 ESP::Eng_Susp_Rq_AS_AR2::LDC_VehDecel = %f\n", floatval);
	filePutString (buffer, elcount(buffer), hFile);
	floatval = getSignal(CHASSIS::Eng_Susp_Rq_AS_AR2::AccelPdlPosn_Rq_AS);
	snprintf(buffer, elcount(buffer), "   0.000000 F1 ESP::Eng_Susp_Rq_AS_AR2::AccelPdlPosn_Rq_AS = %f\n", floatval);
	filePutString (buffer, elcount(buffer), hFile);
	intval = getSignal(CHASSIS::Eng_Susp_Rq_AS_AR2::AxleRollMomentRatio_Rq);
	snprintf(buffer, elcount(buffer), "   0.000000 F1 ESP::Eng_Susp_Rq_AS_AR2::AxleRollMomentRatio_Rq = %d\n", intval);
	filePutString (buffer, elcount(buffer), hFile);
	intval = getSignal(CHASSIS::Eng_Susp_Rq_AS_AR2::Rsrv5_Eng_Rq_AS_Pr2);
	snprintf(buffer, elcount(buffer), "   0.000000 F1 ESP::Eng_Susp_Rq_AS_AR2::Rsrv5_Eng_Rq_AS_Pr2 = %d\n", intval);
	filePutString (buffer, elcount(buffer), hFile);
	intval = @sysvar::CH_Nodes::CH_ESPCRC_EPKB_Disp_IndLmp__AUTO;
	snprintf(buffer, elcount(buffer), "   0.000000    SV: 2 0 0 ::CH_Nodes::CH_ESPCRC_EPKB_Disp_IndLmp__AUTO = %d\n", intval);
	filePutString (buffer, elcount(buffer), hFile);
	intval = getSignal(CHASSIS::EPKB_Disp_IndLmp_Rq_2_AR2::CRC_EPKB_Disp_IndLmp_Rq_Pr2);
	snprintf(buffer, elcount(buffer), "   0.000000 F1 ESP::EPKB_Disp_IndLmp_Rq_2_AR2::CRC_EPKB_Disp_IndLmp_Rq_Pr2 = %d\n", intval);
	filePutString (buffer, elcount(buffer), hFile);
	intval = @sysvar::CH_Nodes::CH_ESPSQC_EPKB_Disp_IndLmp__AUTO;
	snprintf(buffer, elcount(buffer), "   0.000000    SV: 2 0 0 ::CH_Nodes::CH_ESPSQC_EPKB_Disp_IndLmp__AUTO = %d\n", intval);
	filePutString (buffer, elcount(buffer), hFile);
	intval = getSignal(CHASSIS::EPKB_Disp_IndLmp_Rq_2_AR2::SQC_EPKB_Disp_IndLmp_Rq_Pr2);
	snprintf(buffer, elcount(buffer), "   0.000000 F1 ESP::EPKB_Disp_IndLmp_Rq_2_AR2::SQC_EPKB_Disp_IndLmp_Rq_Pr2 = %d\n", intval);
	filePutString (buffer, elcount(buffer), hFile);
	intval = getSignal(CHASSIS::EPKB_Disp_IndLmp_Rq_2_AR2::Rsrv1_EPKB_Disp_IndLmp_Rq_Pr2);
	snprintf(buffer, elcount(buffer), "   0.000000 F1 ESP::EPKB_Disp_IndLmp_Rq_2_AR2::Rsrv1_EPKB_Disp_IndLmp_Rq_Pr2 = %d\n", intval);
	filePutString (buffer, elcount(buffer), hFile);
	intval = getSignal(CHASSIS::EPKB_Disp_IndLmp_Rq_2_AR2::EPKB_Msg_Disp_Rq);
	snprintf(buffer, elcount(buffer), "   0.000000 F1 ESP::EPKB_Disp_IndLmp_Rq_2_AR2::EPKB_Msg_Disp_Rq = %d\n", intval);
	filePutString (buffer, elcount(buffer), hFile);
	intval = getSignal(CHASSIS::EPKB_Disp_IndLmp_Rq_2_AR2::EPKB_Msg_Disp_TrgrRq);
	snprintf(buffer, elcount(buffer), "   0.000000 F1 ESP::EPKB_Disp_IndLmp_Rq_2_AR2::EPKB_Msg_Disp_TrgrRq = %d\n", intval);
	filePutString (buffer, elcount(buffer), hFile);
	intval = getSignal(CHASSIS::EPKB_Disp_IndLmp_Rq_2_AR2::PkBrkIndLmp_On_Rq);
	snprintf(buffer, elcount(buffer), "   0.000000 F1 ESP::EPKB_Disp_IndLmp_Rq_2_AR2::PkBrkIndLmp_On_Rq = %d\n", intval);
	filePutString (buffer, elcount(buffer), hFile);
	intval = getSignal(CHASSIS::EPKB_Disp_IndLmp_Rq_2_AR2::BrkIndLmp_On_Rq_EPkB);
	snprintf(buffer, elcount(buffer), "   0.000000 F1 ESP::EPKB_Disp_IndLmp_Rq_2_AR2::BrkIndLmp_On_Rq_EPkB = %d\n", intval);
	filePutString (buffer, elcount(buffer), hFile);
	intval = getSignal(CHASSIS::EPKB_Disp_IndLmp_Rq_2_AR2::BrkLnServMd_MsgDisp_Rq);
	snprintf(buffer, elcount(buffer), "   0.000000 F1 ESP::EPKB_Disp_IndLmp_Rq_2_AR2::BrkLnServMd_MsgDisp_Rq = %d\n", intval);
	filePutString (buffer, elcount(buffer), hFile);
	intval = @sysvar::CH_Nodes::CH_ESPCRC_EPKB_Stat_Pr2EPKB_AUTO;
	snprintf(buffer, elcount(buffer), "   0.000000    SV: 2 0 0 ::CH_Nodes::CH_ESPCRC_EPKB_Stat_Pr2EPKB_AUTO = %d\n", intval);
	filePutString (buffer, elcount(buffer), hFile);
	intval = getSignal(CHASSIS::EPKB_Stat_Gw_AR2::CRC_EPKB_Stat_Pr2);
	snprintf(buffer, elcount(buffer), "   0.000000 F1 ESP::EPKB_Stat_Gw_AR2::CRC_EPKB_Stat_Pr2 = %d\n", intval);
	filePutString (buffer, elcount(buffer), hFile);
	intval = @sysvar::CH_Nodes::CH_ESPSQC_EPKB_Stat_Pr2EPKB_AUTO;
	snprintf(buffer, elcount(buffer), "   0.000000    SV: 2 0 0 ::CH_Nodes::CH_ESPSQC_EPKB_Stat_Pr2EPKB_AUTO = %d\n", intval);
	filePutString (buffer, elcount(buffer), hFile);
	intval = getSignal(CHASSIS::EPKB_Stat_Gw_AR2::SQC_EPKB_Stat_Pr2);
	snprintf(buffer, elcount(buffer), "   0.000000 F1 ESP::EPKB_Stat_Gw_AR2::SQC_EPKB_Stat_Pr2 = %d\n", intval);
	filePutString (buffer, elcount(buffer), hFile);
	intval = getSignal(CHASSIS::EPKB_Stat_Gw_AR2::BatCplSw_Rq_EPKB);
	snprintf(buffer, elcount(buffer), "   0.000000 F1 ESP::EPKB_Stat_Gw_AR2::BatCplSw_Rq_EPKB = %d\n", intval);
	filePutString (buffer, elcount(buffer), hFile);
	intval = getSignal(CHASSIS::EPKB_Stat_Gw_AR2::TxPkPosn_Rq_EPKB);
	snprintf(buffer, elcount(buffer), "   0.000000 F1 ESP::EPKB_Stat_Gw_AR2::TxPkPosn_Rq_EPKB = %d\n", intval);
	filePutString (buffer, elcount(buffer), hFile);
	intval = getSignal(CHASSIS::EPKB_Stat_Gw_AR2::PkBrk_Stat);
	snprintf(buffer, elcount(buffer), "   0.000000 F1 ESP::EPKB_Stat_Gw_AR2::PkBrk_Stat = %d\n", intval);
	filePutString (buffer, elcount(buffer), hFile);
	intval = getSignal(CHASSIS::EPKB_Stat_Gw_AR2::PkBrkSw_Stat);
	snprintf(buffer, elcount(buffer), "   0.000000 F1 ESP::EPKB_Stat_Gw_AR2::PkBrkSw_Stat = %d\n", intval);
	filePutString (buffer, elcount(buffer), hFile);
	intval = getSignal(CHASSIS::EPKB_Stat_Gw_AR2::EPkBrk_Stat);
	snprintf(buffer, elcount(buffer), "   0.000000 F1 ESP::EPKB_Stat_Gw_AR2::EPkBrk_Stat = %d\n", intval);
	filePutString (buffer, elcount(buffer), hFile);
	intval = getSignal(CHASSIS::EPKB_Stat_Gw_AR2::Rsrv4_EPKB_Stat_Pr2);
	snprintf(buffer, elcount(buffer), "   0.000000 F1 ESP::EPKB_Stat_Gw_AR2::Rsrv4_EPKB_Stat_Pr2 = %d\n", intval);
	filePutString (buffer, elcount(buffer), hFile);
	intval = getSignal(CHASSIS::EPKB_Stat_Gw_AR2::DynBrkMd);
	snprintf(buffer, elcount(buffer), "   0.000000 F1 ESP::EPKB_Stat_Gw_AR2::DynBrkMd = %d\n", intval);
	filePutString (buffer, elcount(buffer), hFile);
	intval = getSignal(CHASSIS::EPKB_Stat_Gw_AR2::BrkLgt_On_Rq);
	snprintf(buffer, elcount(buffer), "   0.000000 F1 ESP::EPKB_Stat_Gw_AR2::BrkLgt_On_Rq = %d\n", intval);
	filePutString (buffer, elcount(buffer), hFile);
	intval = getSignal(CHASSIS::EPKB_Stat_Gw_AR2::Rsrv1_EPKB_Stat_Pr2);
	snprintf(buffer, elcount(buffer), "   0.000000 F1 ESP::EPKB_Stat_Gw_AR2::Rsrv1_EPKB_Stat_Pr2 = %d\n", intval);
	filePutString (buffer, elcount(buffer), hFile);
	intval = getSignal(CHASSIS::EPKB_Stat_Gw_AR2::ESP_Enbl_Rq_EPKB);
	snprintf(buffer, elcount(buffer), "   0.000000 F1 ESP::EPKB_Stat_Gw_AR2::ESP_Enbl_Rq_EPKB = %d\n", intval);
	filePutString (buffer, elcount(buffer), hFile);
	intval = getSignal(CHASSIS::EPKB_Stat_Gw_AR2::Rsrv2_EPKB_Stat_Pr2);
	snprintf(buffer, elcount(buffer), "   0.000000 F1 ESP::EPKB_Stat_Gw_AR2::Rsrv2_EPKB_Stat_Pr2 = %d\n", intval);
	filePutString (buffer, elcount(buffer), hFile);
	intval = getSignal(CHASSIS::EPKB_Stat_Gw_AR2::Rsrv3_EPKB_Stat_Pr2);
	snprintf(buffer, elcount(buffer), "   0.000000 F1 ESP::EPKB_Stat_Gw_AR2::Rsrv3_EPKB_Stat_Pr2 = %d\n", intval);
	filePutString (buffer, elcount(buffer), hFile);
	intval = getSignal(CHASSIS::ESP_Disp_Rq2_AR2::DrowDtct_DrvTmHour_Disp_Rq);
	snprintf(buffer, elcount(buffer), "   0.000000 F1 ESP::ESP_Disp_Rq2_AR2::DrowDtct_DrvTmHour_Disp_Rq = %d\n", intval);
	filePutString (buffer, elcount(buffer), hFile);
	intval = getSignal(CHASSIS::ESP_Disp_Rq2_AR2::DrowDtct_DrvTmMinute_Disp_Rq);
	snprintf(buffer, elcount(buffer), "   0.000000 F1 ESP::ESP_Disp_Rq2_AR2::DrowDtct_DrvTmMinute_Disp_Rq = %d\n", intval);
	filePutString (buffer, elcount(buffer), hFile);
	intval = getSignal(CHASSIS::ESP_Disp_Rq2_AR2::DrowLvl_Disp_Rq);
	snprintf(buffer, elcount(buffer), "   0.000000 F1 ESP::ESP_Disp_Rq2_AR2::DrowLvl_Disp_Rq = %d\n", intval);
	filePutString (buffer, elcount(buffer), hFile);
	intval = getSignal(CHASSIS::ESP_Disp_Rq2_AR2::DrowLvlDisp_Md_Rq);
	snprintf(buffer, elcount(buffer), "   0.000000 F1 ESP::ESP_Disp_Rq2_AR2::DrowLvlDisp_Md_Rq = %d\n", intval);
	filePutString (buffer, elcount(buffer), hFile);
	intval = getSignal(CHASSIS::ESP_Disp_Rq2_AR2::DrowWarn_Rq);
	snprintf(buffer, elcount(buffer), "   0.000000 F1 ESP::ESP_Disp_Rq2_AR2::DrowWarn_Rq = %d\n", intval);
	filePutString (buffer, elcount(buffer), hFile);
	intval = getSignal(CHASSIS::ESP_Disp_Rq2_AR2::DrowDtctIndLmp_On_Rq);
	snprintf(buffer, elcount(buffer), "   0.000000 F1 ESP::ESP_Disp_Rq2_AR2::DrowDtctIndLmp_On_Rq = %d\n", intval);
	filePutString (buffer, elcount(buffer), hFile);
	intval = getSignal(CHASSIS::ESP_Disp_Rq2_AR2::DrowDtct_Actv);
	snprintf(buffer, elcount(buffer), "   0.000000 F1 ESP::ESP_Disp_Rq2_AR2::DrowDtct_Actv = %d\n", intval);
	filePutString (buffer, elcount(buffer), hFile);
	intval = @sysvar::CH_Nodes::CH_ESPCRC_DSR_Disp_Rq_Pr2ES_AUTO;
	snprintf(buffer, elcount(buffer), "   0.000000    SV: 2 0 0 ::CH_Nodes::CH_ESPCRC_DSR_Disp_Rq_Pr2ES_AUTO = %d\n", intval);
	filePutString (buffer, elcount(buffer), hFile);
	intval = getSignal(CHASSIS::ESP_Disp_Rq2_AR2::CRC_DSR_Disp_Rq_Pr2);
	snprintf(buffer, elcount(buffer), "   0.000000 F1 ESP::ESP_Disp_Rq2_AR2::CRC_DSR_Disp_Rq_Pr2 = %d\n", intval);
	filePutString (buffer, elcount(buffer), hFile);
	intval = @sysvar::CH_Nodes::CH_ESPSQC_DSR_Disp_Rq_Pr2ES_AUTO;
	snprintf(buffer, elcount(buffer), "   0.000000    SV: 2 0 0 ::CH_Nodes::CH_ESPSQC_DSR_Disp_Rq_Pr2ES_AUTO = %d\n", intval);
	filePutString (buffer, elcount(buffer), hFile);
	intval = getSignal(CHASSIS::ESP_Disp_Rq2_AR2::SQC_DSR_Disp_Rq_Pr2);
	snprintf(buffer, elcount(buffer), "   0.000000 F1 ESP::ESP_Disp_Rq2_AR2::SQC_DSR_Disp_Rq_Pr2 = %d\n", intval);
	filePutString (buffer, elcount(buffer), hFile);
	intval = getSignal(CHASSIS::ESP_Disp_Rq2_AR2::DSR_Disp_Rq2);
	snprintf(buffer, elcount(buffer), "   0.000000 F1 ESP::ESP_Disp_Rq2_AR2::DSR_Disp_Rq2 = %d\n", intval);
	filePutString (buffer, elcount(buffer), hFile);
	intval = getSignal(CHASSIS::ESP_Disp_Rq2_AR2::DSR_Disp_TrgrRq);
	snprintf(buffer, elcount(buffer), "   0.000000 F1 ESP::ESP_Disp_Rq2_AR2::DSR_Disp_TrgrRq = %d\n", intval);
	filePutString (buffer, elcount(buffer), hFile);
	intval = getSignal(CHASSIS::ESP_Disp_Rq2_AR2::DSR_Disp_Rq1);
	snprintf(buffer, elcount(buffer), "   0.000000 F1 ESP::ESP_Disp_Rq2_AR2::DSR_Disp_Rq1 = %d\n", intval);
	filePutString (buffer, elcount(buffer), hFile);
	intval = getSignal(CHASSIS::ESP_Disp_Rq2_AR2::DSR_SpdUnit_Rs);
	snprintf(buffer, elcount(buffer), "   0.000000 F1 ESP::ESP_Disp_Rq2_AR2::DSR_SpdUnit_Rs = %d\n", intval);
	filePutString (buffer, elcount(buffer), hFile);
}
/*@@end*/

/*@@caplFunc:saveVars_64(dword):*/
void saveVars_64(dword hFile)
{
	intval = getSignal(CHASSIS::ESP_Disp_Rq2_AR2::DSR_Sw_LED_On_Rq);
	snprintf(buffer, elcount(buffer), "   0.000000 F1 ESP::ESP_Disp_Rq2_AR2::DSR_Sw_LED_On_Rq = %d\n", intval);
	filePutString (buffer, elcount(buffer), hFile);
	intval = getSignal(CHASSIS::ESP_Disp_Rq2_AR2::ESP_LastMd_Disp_Rq);
	snprintf(buffer, elcount(buffer), "   0.000000 F1 ESP::ESP_Disp_Rq2_AR2::ESP_LastMd_Disp_Rq = %d\n", intval);
	filePutString (buffer, elcount(buffer), hFile);
	intval = getSignal(CHASSIS::ESP_Disp_Rq2_AR2::ABS_Actv_Stat_EDR);
	snprintf(buffer, elcount(buffer), "   0.000000 F1 ESP::ESP_Disp_Rq2_AR2::ABS_Actv_Stat_EDR = %d\n", intval);
	filePutString (buffer, elcount(buffer), hFile);
	intval = getSignal(CHASSIS::ESP_Disp_Rq2_AR2::ESP_Actv_Stat_EDR);
	snprintf(buffer, elcount(buffer), "   0.000000 F1 ESP::ESP_Disp_Rq2_AR2::ESP_Actv_Stat_EDR = %d\n", intval);
	filePutString (buffer, elcount(buffer), hFile);
	intval = getSignal(CHASSIS::ESP_Disp_Rq2_AR2::RoofLuggMd_MenuSubs_Rq);
	snprintf(buffer, elcount(buffer), "   0.000000 F1 ESP::ESP_Disp_Rq2_AR2::RoofLuggMd_MenuSubs_Rq = %d\n", intval);
	filePutString (buffer, elcount(buffer), hFile);
	intval = getSignal(CHASSIS::ESP_Disp_Rq3_AR::Incl_X_Num);
	snprintf(buffer, elcount(buffer), "   0.000000 F1 ESP::ESP_Disp_Rq3_AR::Incl_X_Num = %d\n", intval);
	filePutString (buffer, elcount(buffer), hFile);
	intval = getSignal(CHASSIS::ESP_Disp_Rq3_AR::Incl_X_Graph);
	snprintf(buffer, elcount(buffer), "   0.000000 F1 ESP::ESP_Disp_Rq3_AR::Incl_X_Graph = %d\n", intval);
	filePutString (buffer, elcount(buffer), hFile);
	intval = getSignal(CHASSIS::ESP_Disp_Rq3_AR::Incl_Y_Num);
	snprintf(buffer, elcount(buffer), "   0.000000 F1 ESP::ESP_Disp_Rq3_AR::Incl_Y_Num = %d\n", intval);
	filePutString (buffer, elcount(buffer), hFile);
	intval = getSignal(CHASSIS::ESP_Disp_Rq3_AR::Incl_Y_Graph);
	snprintf(buffer, elcount(buffer), "   0.000000 F1 ESP::ESP_Disp_Rq3_AR::Incl_Y_Graph = %d\n", intval);
	filePutString (buffer, elcount(buffer), hFile);
	intval = getSignal(CHASSIS::ESP_Disp_Rq3_AR::DrowDtct_Md_Stat);
	snprintf(buffer, elcount(buffer), "   0.000000 F1 ESP::ESP_Disp_Rq3_AR::DrowDtct_Md_Stat = %d\n", intval);
	filePutString (buffer, elcount(buffer), hFile);
	floatval = getSignal(CHASSIS::ESP_Disp_Rq_AMG_AR2::VehAccel_Y_V3);
	snprintf(buffer, elcount(buffer), "   0.000000 F1 ESP::ESP_Disp_Rq_AMG_AR2::VehAccel_Y_V3 = %f\n", floatval);
	filePutString (buffer, elcount(buffer), hFile);
	intval = @sysvar::CH_Nodes::CH_ESPCRC_ESP_Disp_Rq_Pr2ES_AUTO;
	snprintf(buffer, elcount(buffer), "   0.000000    SV: 2 0 0 ::CH_Nodes::CH_ESPCRC_ESP_Disp_Rq_Pr2ES_AUTO = %d\n", intval);
	filePutString (buffer, elcount(buffer), hFile);
	intval = getSignal(CHASSIS::ESP_Disp_Rq_AR2::CRC_ESP_Disp_Rq_Pr2);
	snprintf(buffer, elcount(buffer), "   0.000000 F1 ESP::ESP_Disp_Rq_AR2::CRC_ESP_Disp_Rq_Pr2 = %d\n", intval);
	filePutString (buffer, elcount(buffer), hFile);
	intval = @sysvar::CH_Nodes::CH_ESPSQC_ESP_Disp_Rq_Pr2ES_AUTO;
	snprintf(buffer, elcount(buffer), "   0.000000    SV: 2 0 0 ::CH_Nodes::CH_ESPSQC_ESP_Disp_Rq_Pr2ES_AUTO = %d\n", intval);
	filePutString (buffer, elcount(buffer), hFile);
	intval = getSignal(CHASSIS::ESP_Disp_Rq_AR2::SQC_ESP_Disp_Rq_Pr2);
	snprintf(buffer, elcount(buffer), "   0.000000 F1 ESP::ESP_Disp_Rq_AR2::SQC_ESP_Disp_Rq_Pr2 = %d\n", intval);
	filePutString (buffer, elcount(buffer), hFile);
	intval = getSignal(CHASSIS::ESP_Disp_Rq_AR2::RBS_AcustWarn_Rq);
	snprintf(buffer, elcount(buffer), "   0.000000 F1 ESP::ESP_Disp_Rq_AR2::RBS_AcustWarn_Rq = %d\n", intval);
	filePutString (buffer, elcount(buffer), hFile);
	intval = getSignal(CHASSIS::ESP_Disp_Rq_AR2::ESP_Md_Rq_Ack);
	snprintf(buffer, elcount(buffer), "   0.000000 F1 ESP::ESP_Disp_Rq_AR2::ESP_Md_Rq_Ack = %d\n", intval);
	filePutString (buffer, elcount(buffer), hFile);
	intval = getSignal(CHASSIS::ESP_Disp_Rq_AR2::ESP_BrkMsg_Disp_Rq);
	snprintf(buffer, elcount(buffer), "   0.000000 F1 ESP::ESP_Disp_Rq_AR2::ESP_BrkMsg_Disp_Rq = %d\n", intval);
	filePutString (buffer, elcount(buffer), hFile);
	intval = getSignal(CHASSIS::ESP_Disp_Rq_AR2::ESP_BrkMsg_Disp_TrgRq);
	snprintf(buffer, elcount(buffer), "   0.000000 F1 ESP::ESP_Disp_Rq_AR2::ESP_BrkMsg_Disp_TrgRq = %d\n", intval);
	filePutString (buffer, elcount(buffer), hFile);
	intval = getSignal(CHASSIS::ESP_Disp_Rq_AR2::ESP_VDC_Msg_Disp_Rq);
	snprintf(buffer, elcount(buffer), "   0.000000 F1 ESP::ESP_Disp_Rq_AR2::ESP_VDC_Msg_Disp_Rq = %d\n", intval);
	filePutString (buffer, elcount(buffer), hFile);
	intval = getSignal(CHASSIS::ESP_Disp_Rq_AR2::ESP_VDC_Msg_Disp_TrgRq);
	snprintf(buffer, elcount(buffer), "   0.000000 F1 ESP::ESP_Disp_Rq_AR2::ESP_VDC_Msg_Disp_TrgRq = %d\n", intval);
	filePutString (buffer, elcount(buffer), hFile);
	intval = getSignal(CHASSIS::ESP_Disp_Rq_AR2::ABS_IndLmp_On_Rq);
	snprintf(buffer, elcount(buffer), "   0.000000 F1 ESP::ESP_Disp_Rq_AR2::ABS_IndLmp_On_Rq = %d\n", intval);
	filePutString (buffer, elcount(buffer), hFile);
	intval = getSignal(CHASSIS::ESP_Disp_Rq_AR2::BrkIndLmp_On_Rq_ESP);
	snprintf(buffer, elcount(buffer), "   0.000000 F1 ESP::ESP_Disp_Rq_AR2::BrkIndLmp_On_Rq_ESP = %d\n", intval);
	filePutString (buffer, elcount(buffer), hFile);
	intval = getSignal(CHASSIS::ESP_Disp_Rq_AR2::ESP_CtrlLmp_Info);
	snprintf(buffer, elcount(buffer), "   0.000000 F1 ESP::ESP_Disp_Rq_AR2::ESP_CtrlLmp_Info = %d\n", intval);
	filePutString (buffer, elcount(buffer), hFile);
	intval = getSignal(CHASSIS::ESP_Disp_Rq_AR2::ESP_Off_IndLmp_On_Rq);
	snprintf(buffer, elcount(buffer), "   0.000000 F1 ESP::ESP_Disp_Rq_AR2::ESP_Off_IndLmp_On_Rq = %d\n", intval);
	filePutString (buffer, elcount(buffer), hFile);
	intval = getSignal(CHASSIS::ESP_Disp_Rq_AR2::RBS_IndLmp_On_Rq);
	snprintf(buffer, elcount(buffer), "   0.000000 F1 ESP::ESP_Disp_Rq_AR2::RBS_IndLmp_On_Rq = %d\n", intval);
	filePutString (buffer, elcount(buffer), hFile);
	intval = getSignal(CHASSIS::ESP_Disp_Rq_AR2::RollTestMd_Rq_Ack);
	snprintf(buffer, elcount(buffer), "   0.000000 F1 ESP::ESP_Disp_Rq_AR2::RollTestMd_Rq_Ack = %d\n", intval);
	filePutString (buffer, elcount(buffer), hFile);
	intval = getSignal(CHASSIS::ESP_Disp_Rq_AR2::Rsrv1_ESP_Disp_Rq_Pr2);
	snprintf(buffer, elcount(buffer), "   0.000000 F1 ESP::ESP_Disp_Rq_AR2::Rsrv1_ESP_Disp_Rq_Pr2 = %d\n", intval);
	filePutString (buffer, elcount(buffer), hFile);
	intval = getSignal(CHASSIS::ESP_Disp_Rq_AR2::SPCR_StatMsg_Disp_Rq);
	snprintf(buffer, elcount(buffer), "   0.000000 F1 ESP::ESP_Disp_Rq_AR2::SPCR_StatMsg_Disp_Rq = %d\n", intval);
	filePutString (buffer, elcount(buffer), hFile);
	intval = getSignal(CHASSIS::ESP_Disp_Rq_AR2::SPCR_Stat);
	snprintf(buffer, elcount(buffer), "   0.000000 F1 ESP::ESP_Disp_Rq_AR2::SPCR_Stat = %d\n", intval);
	filePutString (buffer, elcount(buffer), hFile);
	intval = getSignal(CHASSIS::ESP_Disp_Rq_AR2::ESP_Md_Disp_Rq);
	snprintf(buffer, elcount(buffer), "   0.000000 F1 ESP::ESP_Disp_Rq_AR2::ESP_Md_Disp_Rq = %d\n", intval);
	filePutString (buffer, elcount(buffer), hFile);
	intval = getSignal(CHASSIS::ESP_Disp_Rq_AR2::FTW_Msg_Disp_Rq);
	snprintf(buffer, elcount(buffer), "   0.000000 F1 ESP::ESP_Disp_Rq_AR2::FTW_Msg_Disp_Rq = %d\n", intval);
	filePutString (buffer, elcount(buffer), hFile);
	intval = getSignal(CHASSIS::ESP_Disp_Rq_AR2::FTW_Stat);
	snprintf(buffer, elcount(buffer), "   0.000000 F1 ESP::ESP_Disp_Rq_AR2::FTW_Stat = %d\n", intval);
	filePutString (buffer, elcount(buffer), hFile);
	intval = getSignal(CHASSIS::ESP_Disp_Rq_AR2::MIL_On_Rq_ESP);
	snprintf(buffer, elcount(buffer), "   0.000000 F1 ESP::ESP_Disp_Rq_AR2::MIL_On_Rq_ESP = %d\n", intval);
	filePutString (buffer, elcount(buffer), hFile);
	intval = getSignal(CHASSIS::ESP_OBD_Stat_AR::OBD_WhlSpdSens_ECU_Mon_Stat);
	snprintf(buffer, elcount(buffer), "   0.000000 F1 ESP::ESP_OBD_Stat_AR::OBD_WhlSpdSens_ECU_Mon_Stat = %d\n", intval);
	filePutString (buffer, elcount(buffer), hFile);
	intval = getSignal(CHASSIS::ESP_OBD_Stat_AR::OBD_WhlSpdSens_SupVoltMon_Stat);
	snprintf(buffer, elcount(buffer), "   0.000000 F1 ESP::ESP_OBD_Stat_AR::OBD_WhlSpdSens_SupVoltMon_Stat = %d\n", intval);
	filePutString (buffer, elcount(buffer), hFile);
	intval = getSignal(CHASSIS::ESP_OBD_Stat_AR::OBD_WhlSpdSens_FL_ShortCircHiMon_Stat);
	snprintf(buffer, elcount(buffer), "   0.000000 F1 ESP::ESP_OBD_Stat_AR::OBD_WhlSpdSens_FL_ShortCircHiMon_Stat = %d\n", intval);
	filePutString (buffer, elcount(buffer), hFile);
	intval = getSignal(CHASSIS::ESP_OBD_Stat_AR::OBD_WhlSpdSens_FL_ShortCircLoMon_Stat);
	snprintf(buffer, elcount(buffer), "   0.000000 F1 ESP::ESP_OBD_Stat_AR::OBD_WhlSpdSens_FL_ShortCircLoMon_Stat = %d\n", intval);
	filePutString (buffer, elcount(buffer), hFile);
	intval = getSignal(CHASSIS::ESP_OBD_Stat_AR::OBD_WhlSpdSens_FL_OpenLoopMon_Stat);
	snprintf(buffer, elcount(buffer), "   0.000000 F1 ESP::ESP_OBD_Stat_AR::OBD_WhlSpdSens_FL_OpenLoopMon_Stat = %d\n", intval);
	filePutString (buffer, elcount(buffer), hFile);
	intval = getSignal(CHASSIS::ESP_OBD_Stat_AR::OBD_WhlSpdSens_FL_SigMon_Stat);
	snprintf(buffer, elcount(buffer), "   0.000000 F1 ESP::ESP_OBD_Stat_AR::OBD_WhlSpdSens_FL_SigMon_Stat = %d\n", intval);
	filePutString (buffer, elcount(buffer), hFile);
	intval = getSignal(CHASSIS::ESP_OBD_Stat_AR::OBD_WhlSpdSens_FL_ToneWhlMon_Stat);
	snprintf(buffer, elcount(buffer), "   0.000000 F1 ESP::ESP_OBD_Stat_AR::OBD_WhlSpdSens_FL_ToneWhlMon_Stat = %d\n", intval);
	filePutString (buffer, elcount(buffer), hFile);
	intval = getSignal(CHASSIS::ESP_OBD_Stat_AR::OBD_WhlSpdSens_FL_RationalityMon_Stat);
	snprintf(buffer, elcount(buffer), "   0.000000 F1 ESP::ESP_OBD_Stat_AR::OBD_WhlSpdSens_FL_RationalityMon_Stat = %d\n", intval);
	filePutString (buffer, elcount(buffer), hFile);
	intval = getSignal(CHASSIS::ESP_OBD_Stat_AR::OBD_WhlSpdSens_FR_ShortCircHiMon_Stat);
	snprintf(buffer, elcount(buffer), "   0.000000 F1 ESP::ESP_OBD_Stat_AR::OBD_WhlSpdSens_FR_ShortCircHiMon_Stat = %d\n", intval);
	filePutString (buffer, elcount(buffer), hFile);
	intval = getSignal(CHASSIS::ESP_OBD_Stat_AR::OBD_WhlSpdSens_FR_ShortCircLoMon_Stat);
	snprintf(buffer, elcount(buffer), "   0.000000 F1 ESP::ESP_OBD_Stat_AR::OBD_WhlSpdSens_FR_ShortCircLoMon_Stat = %d\n", intval);
	filePutString (buffer, elcount(buffer), hFile);
	intval = getSignal(CHASSIS::ESP_OBD_Stat_AR::OBD_WhlSpdSens_FR_OpenLoopMon_Stat);
	snprintf(buffer, elcount(buffer), "   0.000000 F1 ESP::ESP_OBD_Stat_AR::OBD_WhlSpdSens_FR_OpenLoopMon_Stat = %d\n", intval);
	filePutString (buffer, elcount(buffer), hFile);
	intval = getSignal(CHASSIS::ESP_OBD_Stat_AR::OBD_WhlSpdSens_FR_SigMon_Stat);
	snprintf(buffer, elcount(buffer), "   0.000000 F1 ESP::ESP_OBD_Stat_AR::OBD_WhlSpdSens_FR_SigMon_Stat = %d\n", intval);
	filePutString (buffer, elcount(buffer), hFile);
	intval = getSignal(CHASSIS::ESP_OBD_Stat_AR::OBD_WhlSpdSens_FR_ToneWhlMon_Stat);
	snprintf(buffer, elcount(buffer), "   0.000000 F1 ESP::ESP_OBD_Stat_AR::OBD_WhlSpdSens_FR_ToneWhlMon_Stat = %d\n", intval);
	filePutString (buffer, elcount(buffer), hFile);
	intval = getSignal(CHASSIS::ESP_OBD_Stat_AR::OBD_WhlSpdSens_FR_RationalityMon_Stat);
	snprintf(buffer, elcount(buffer), "   0.000000 F1 ESP::ESP_OBD_Stat_AR::OBD_WhlSpdSens_FR_RationalityMon_Stat = %d\n", intval);
	filePutString (buffer, elcount(buffer), hFile);
	intval = getSignal(CHASSIS::ESP_OBD_Stat_AR::OBD_WhlSpdSens_RL_ShortCircHiMon_Stat);
	snprintf(buffer, elcount(buffer), "   0.000000 F1 ESP::ESP_OBD_Stat_AR::OBD_WhlSpdSens_RL_ShortCircHiMon_Stat = %d\n", intval);
	filePutString (buffer, elcount(buffer), hFile);
	intval = getSignal(CHASSIS::ESP_OBD_Stat_AR::OBD_WhlSpdSens_RL_ShortCircLoMon_Stat);
	snprintf(buffer, elcount(buffer), "   0.000000 F1 ESP::ESP_OBD_Stat_AR::OBD_WhlSpdSens_RL_ShortCircLoMon_Stat = %d\n", intval);
	filePutString (buffer, elcount(buffer), hFile);
	intval = getSignal(CHASSIS::ESP_OBD_Stat_AR::OBD_WhlSpdSens_RL_OpenLoopMon_Stat);
	snprintf(buffer, elcount(buffer), "   0.000000 F1 ESP::ESP_OBD_Stat_AR::OBD_WhlSpdSens_RL_OpenLoopMon_Stat = %d\n", intval);
	filePutString (buffer, elcount(buffer), hFile);
	intval = getSignal(CHASSIS::ESP_OBD_Stat_AR::OBD_WhlSpdSens_RL_SigMon_Stat);
	snprintf(buffer, elcount(buffer), "   0.000000 F1 ESP::ESP_OBD_Stat_AR::OBD_WhlSpdSens_RL_SigMon_Stat = %d\n", intval);
	filePutString (buffer, elcount(buffer), hFile);
	intval = getSignal(CHASSIS::ESP_OBD_Stat_AR::OBD_WhlSpdSens_RL_ToneWhlMon_Stat);
	snprintf(buffer, elcount(buffer), "   0.000000 F1 ESP::ESP_OBD_Stat_AR::OBD_WhlSpdSens_RL_ToneWhlMon_Stat = %d\n", intval);
	filePutString (buffer, elcount(buffer), hFile);
}
/*@@end*/

/*@@caplFunc:saveVars_65(dword):*/
void saveVars_65(dword hFile)
{
	intval = getSignal(CHASSIS::ESP_OBD_Stat_AR::OBD_WhlSpdSens_RL_RationalityMon_Stat);
	snprintf(buffer, elcount(buffer), "   0.000000 F1 ESP::ESP_OBD_Stat_AR::OBD_WhlSpdSens_RL_RationalityMon_Stat = %d\n", intval);
	filePutString (buffer, elcount(buffer), hFile);
	intval = getSignal(CHASSIS::ESP_OBD_Stat_AR::OBD_WhlSpdSens_RR_ShortCircHiMon_Stat);
	snprintf(buffer, elcount(buffer), "   0.000000 F1 ESP::ESP_OBD_Stat_AR::OBD_WhlSpdSens_RR_ShortCircHiMon_Stat = %d\n", intval);
	filePutString (buffer, elcount(buffer), hFile);
	intval = getSignal(CHASSIS::ESP_OBD_Stat_AR::OBD_WhlSpdSens_RR_ShortCircLoMon_Stat);
	snprintf(buffer, elcount(buffer), "   0.000000 F1 ESP::ESP_OBD_Stat_AR::OBD_WhlSpdSens_RR_ShortCircLoMon_Stat = %d\n", intval);
	filePutString (buffer, elcount(buffer), hFile);
	intval = getSignal(CHASSIS::ESP_OBD_Stat_AR::OBD_WhlSpdSens_RR_OpenLoopMon_Stat);
	snprintf(buffer, elcount(buffer), "   0.000000 F1 ESP::ESP_OBD_Stat_AR::OBD_WhlSpdSens_RR_OpenLoopMon_Stat = %d\n", intval);
	filePutString (buffer, elcount(buffer), hFile);
	intval = getSignal(CHASSIS::ESP_OBD_Stat_AR::OBD_WhlSpdSens_RR_SigMon_Stat);
	snprintf(buffer, elcount(buffer), "   0.000000 F1 ESP::ESP_OBD_Stat_AR::OBD_WhlSpdSens_RR_SigMon_Stat = %d\n", intval);
	filePutString (buffer, elcount(buffer), hFile);
	intval = getSignal(CHASSIS::ESP_OBD_Stat_AR::OBD_WhlSpdSens_RR_ToneWhlMon_Stat);
	snprintf(buffer, elcount(buffer), "   0.000000 F1 ESP::ESP_OBD_Stat_AR::OBD_WhlSpdSens_RR_ToneWhlMon_Stat = %d\n", intval);
	filePutString (buffer, elcount(buffer), hFile);
	intval = getSignal(CHASSIS::ESP_OBD_Stat_AR::OBD_WhlSpdSens_RR_RationalityMon_Stat);
	snprintf(buffer, elcount(buffer), "   0.000000 F1 ESP::ESP_OBD_Stat_AR::OBD_WhlSpdSens_RR_RationalityMon_Stat = %d\n", intval);
	filePutString (buffer, elcount(buffer), hFile);
	intval = getSignal(CHASSIS::ESP_Stat1_AR2::PN14_ElecPwr_Rq_ESP);
	snprintf(buffer, elcount(buffer), "   0.000000 F1 ESP::ESP_Stat1_AR2::PN14_ElecPwr_Rq_ESP = %d\n", intval);
	filePutString (buffer, elcount(buffer), hFile);
	intval = getSignal(CHASSIS::LDC_Disp_Rq_ESP_AR::LDC_DTR_MsgDisp_Rq);
	snprintf(buffer, elcount(buffer), "   0.000000 F1 ESP::LDC_Disp_Rq_ESP_AR::LDC_DTR_MsgDisp_Rq = %d\n", intval);
	filePutString (buffer, elcount(buffer), hFile);
	intval = getSignal(CHASSIS::LDC_Disp_Rq_ESP_AR::LDC_IconDisp_Rq_ESP);
	snprintf(buffer, elcount(buffer), "   0.000000 F1 ESP::LDC_Disp_Rq_ESP_AR::LDC_IconDisp_Rq_ESP = %d\n", intval);
	filePutString (buffer, elcount(buffer), hFile);
	intval = getSignal(CHASSIS::LDC_Disp_Rq_ESP_AR::LDC_DTR_Stat);
	snprintf(buffer, elcount(buffer), "   0.000000 F1 ESP::LDC_Disp_Rq_ESP_AR::LDC_DTR_Stat = %d\n", intval);
	filePutString (buffer, elcount(buffer), hFile);
	intval = getSignal(CHASSIS::LDC_Disp_Rq_ESP_AR::LDC_WTSL_Spd_Max_Disp_TrgrRq);
	snprintf(buffer, elcount(buffer), "   0.000000 F1 ESP::LDC_Disp_Rq_ESP_AR::LDC_WTSL_Spd_Max_Disp_TrgrRq = %d\n", intval);
	filePutString (buffer, elcount(buffer), hFile);
	intval = getSignal(CHASSIS::LDC_Disp_Rq_ESP_AR::LDC_WTSL_Flt);
	snprintf(buffer, elcount(buffer), "   0.000000 F1 ESP::LDC_Disp_Rq_ESP_AR::LDC_WTSL_Flt = %d\n", intval);
	filePutString (buffer, elcount(buffer), hFile);
	intval = getSignal(CHASSIS::LDC_Disp_Rq_ESP_AR::LDC_SpdUnit_Rs);
	snprintf(buffer, elcount(buffer), "   0.000000 F1 ESP::LDC_Disp_Rq_ESP_AR::LDC_SpdUnit_Rs = %d\n", intval);
	filePutString (buffer, elcount(buffer), hFile);
	intval = getSignal(CHASSIS::LDC_Disp_Rq_ESP_AR::LDC_VSL_On);
	snprintf(buffer, elcount(buffer), "   0.000000 F1 ESP::LDC_Disp_Rq_ESP_AR::LDC_VSL_On = %d\n", intval);
	filePutString (buffer, elcount(buffer), hFile);
	intval = getSignal(CHASSIS::LDC_Disp_Rq_ESP_AR::LDC_MsgDisp_Rq);
	snprintf(buffer, elcount(buffer), "   0.000000 F1 ESP::LDC_Disp_Rq_ESP_AR::LDC_MsgDisp_Rq = %d\n", intval);
	filePutString (buffer, elcount(buffer), hFile);
	intval = getSignal(CHASSIS::LDC_Disp_Rq_ESP_AR::LDC_MsgDisp_TrgrRq);
	snprintf(buffer, elcount(buffer), "   0.000000 F1 ESP::LDC_Disp_Rq_ESP_AR::LDC_MsgDisp_TrgrRq = %d\n", intval);
	filePutString (buffer, elcount(buffer), hFile);
	intval = getSignal(CHASSIS::LDC_Disp_Rq_ESP_AR::LDC_WTSL_MsgDisp_Rq);
	snprintf(buffer, elcount(buffer), "   0.000000 F1 ESP::LDC_Disp_Rq_ESP_AR::LDC_WTSL_MsgDisp_Rq = %d\n", intval);
	filePutString (buffer, elcount(buffer), hFile);
	intval = getSignal(CHASSIS::LDC_Disp_Rq_ESP_AR::LDC_AcustWarn_Rq);
	snprintf(buffer, elcount(buffer), "   0.000000 F1 ESP::LDC_Disp_Rq_ESP_AR::LDC_AcustWarn_Rq = %d\n", intval);
	filePutString (buffer, elcount(buffer), hFile);
	intval = getSignal(CHASSIS::LDC_Disp_Rq_ESP_AR::LDC_Master);
	snprintf(buffer, elcount(buffer), "   0.000000 F1 ESP::LDC_Disp_Rq_ESP_AR::LDC_Master = %d\n", intval);
	filePutString (buffer, elcount(buffer), hFile);
	intval = getSignal(CHASSIS::LDC_Disp_Rq_ESP_AR::LDC_SPEEDO_SegRing_Disp_Rq);
	snprintf(buffer, elcount(buffer), "   0.000000 F1 ESP::LDC_Disp_Rq_ESP_AR::LDC_SPEEDO_SegRing_Disp_Rq = %d\n", intval);
	filePutString (buffer, elcount(buffer), hFile);
	intval = getSignal(CHASSIS::LDC_Disp_Rq_ESP_AR::LDC_DTR_MM_Ctrl_Actv);
	snprintf(buffer, elcount(buffer), "   0.000000 F1 ESP::LDC_Disp_Rq_ESP_AR::LDC_DTR_MM_Ctrl_Actv = %d\n", intval);
	filePutString (buffer, elcount(buffer), hFile);
	intval = getSignal(CHASSIS::LDC_Disp_Rq_ESP_AR::LDC_Spd_Dsr);
	snprintf(buffer, elcount(buffer), "   0.000000 F1 ESP::LDC_Disp_Rq_ESP_AR::LDC_Spd_Dsr = %d\n", intval);
	filePutString (buffer, elcount(buffer), hFile);
	intval = getSignal(CHASSIS::LDC_Disp_Rq_ESP_AR::LDC_Spd_Add);
	snprintf(buffer, elcount(buffer), "   0.000000 F1 ESP::LDC_Disp_Rq_ESP_AR::LDC_Spd_Add = %d\n", intval);
	filePutString (buffer, elcount(buffer), hFile);
	intval = getSignal(CHASSIS::LDC_Disp_Rq_ESP_AR::LDC_WTSL_Spd_Max_Stat);
	snprintf(buffer, elcount(buffer), "   0.000000 F1 ESP::LDC_Disp_Rq_ESP_AR::LDC_WTSL_Spd_Max_Stat = %d\n", intval);
	filePutString (buffer, elcount(buffer), hFile);
	intval = @sysvar::CH_Nodes::CH_ESPCRC_PARK_Brk_Rs_Pr2PA_AUTO;
	snprintf(buffer, elcount(buffer), "   0.000000    SV: 2 0 0 ::CH_Nodes::CH_ESPCRC_PARK_Brk_Rs_Pr2PA_AUTO = %d\n", intval);
	filePutString (buffer, elcount(buffer), hFile);
	intval = getSignal(CHASSIS::PARK_Brk_Rs_AR2::CRC_PARK_Brk_Rs_Pr2);
	snprintf(buffer, elcount(buffer), "   0.000000 F1 ESP::PARK_Brk_Rs_AR2::CRC_PARK_Brk_Rs_Pr2 = %d\n", intval);
	filePutString (buffer, elcount(buffer), hFile);
	intval = @sysvar::CH_Nodes::CH_ESPSQC_PARK_Brk_Rs_Pr2PA_AUTO;
	snprintf(buffer, elcount(buffer), "   0.000000    SV: 2 0 0 ::CH_Nodes::CH_ESPSQC_PARK_Brk_Rs_Pr2PA_AUTO = %d\n", intval);
	filePutString (buffer, elcount(buffer), hFile);
	intval = getSignal(CHASSIS::PARK_Brk_Rs_AR2::SQC_PARK_Brk_Rs_Pr2);
	snprintf(buffer, elcount(buffer), "   0.000000 F1 ESP::PARK_Brk_Rs_AR2::SQC_PARK_Brk_Rs_Pr2 = %d\n", intval);
	filePutString (buffer, elcount(buffer), hFile);
	intval = getSignal(CHASSIS::PARK_Brk_Rs_AR2::PARK_Brk_Stat_ESP);
	snprintf(buffer, elcount(buffer), "   0.000000 F1 ESP::PARK_Brk_Rs_AR2::PARK_Brk_Stat_ESP = %d\n", intval);
	filePutString (buffer, elcount(buffer), hFile);
	intval = getSignal(CHASSIS::PARK_Brk_Rs_AR2::PARK_BrkMd_Rs);
	snprintf(buffer, elcount(buffer), "   0.000000 F1 ESP::PARK_Brk_Rs_AR2::PARK_BrkMd_Rs = %d\n", intval);
	filePutString (buffer, elcount(buffer), hFile);
	intval = getSignal(CHASSIS::PARK_Brk_Rs_AR2::PARK_Flt_Stat_ESP);
	snprintf(buffer, elcount(buffer), "   0.000000 F1 ESP::PARK_Brk_Rs_AR2::PARK_Flt_Stat_ESP = %d\n", intval);
	filePutString (buffer, elcount(buffer), hFile);
	intval = getSignal(CHASSIS::PARK_Brk_Rs_AR2::Rsrv1_PARK_Brk_Rs_Pr2);
	snprintf(buffer, elcount(buffer), "   0.000000 F1 ESP::PARK_Brk_Rs_AR2::Rsrv1_PARK_Brk_Rs_Pr2 = %d\n", intval);
	filePutString (buffer, elcount(buffer), hFile);
	intval = getSignal(CHASSIS::PARK_Brk_Rs_AR2::PARK_Impact_Stat);
	snprintf(buffer, elcount(buffer), "   0.000000 F1 ESP::PARK_Brk_Rs_AR2::PARK_Impact_Stat = %d\n", intval);
	filePutString (buffer, elcount(buffer), hFile);
	intval = getSignal(CHASSIS::PARK_Brk_Rs_AR2::PARK_CtrlMd_Rs);
	snprintf(buffer, elcount(buffer), "   0.000000 F1 ESP::PARK_Brk_Rs_AR2::PARK_CtrlMd_Rs = %d\n", intval);
	filePutString (buffer, elcount(buffer), hFile);
	intval = getSignal(CHASSIS::PARK_Brk_Rs_AR2::PARK_BrkDist_Min);
	snprintf(buffer, elcount(buffer), "   0.000000 F1 ESP::PARK_Brk_Rs_AR2::PARK_BrkDist_Min = %d\n", intval);
	filePutString (buffer, elcount(buffer), hFile);
	intval = getSignal(CHASSIS::PARK_Brk_Rs_AR2::PARK_Enbl_Stat_ESP);
	snprintf(buffer, elcount(buffer), "   0.000000 F1 ESP::PARK_Brk_Rs_AR2::PARK_Enbl_Stat_ESP = %d\n", intval);
	filePutString (buffer, elcount(buffer), hFile);
	intval = getSignal(CHASSIS::PARK_Brk_Rs_AR2::PARK_LDC_AfterrunCtrl_Actv);
	snprintf(buffer, elcount(buffer), "   0.000000 F1 ESP::PARK_Brk_Rs_AR2::PARK_LDC_AfterrunCtrl_Actv = %d\n", intval);
	filePutString (buffer, elcount(buffer), hFile);
	intval = getSignal(CHASSIS::PARK_Brk_Rs_AR2::Rsrv2_PARK_Brk_Rs_Pr2);
	snprintf(buffer, elcount(buffer), "   0.000000 F1 ESP::PARK_Brk_Rs_AR2::Rsrv2_PARK_Brk_Rs_Pr2 = %d\n", intval);
	filePutString (buffer, elcount(buffer), hFile);
	intval = getSignal(CHASSIS::PARK_Brk_Rs_AR2::Rsrv3_PARK_Brk_Rs_Pr2);
	snprintf(buffer, elcount(buffer), "   0.000000 F1 ESP::PARK_Brk_Rs_AR2::Rsrv3_PARK_Brk_Rs_Pr2 = %d\n", intval);
	filePutString (buffer, elcount(buffer), hFile);
	intval = @sysvar::CH_Nodes::CH_ESPCRC_PARK_Drv_Rq_ESP_P_AUTO;
	snprintf(buffer, elcount(buffer), "   0.000000    SV: 2 0 0 ::CH_Nodes::CH_ESPCRC_PARK_Drv_Rq_ESP_P_AUTO = %d\n", intval);
	filePutString (buffer, elcount(buffer), hFile);
	intval = getSignal(CHASSIS::PARK_Drv_Rq_ESP_AR2::CRC_PARK_Drv_Rq_ESP_Pr2);
	snprintf(buffer, elcount(buffer), "   0.000000 F1 ESP::PARK_Drv_Rq_ESP_AR2::CRC_PARK_Drv_Rq_ESP_Pr2 = %d\n", intval);
	filePutString (buffer, elcount(buffer), hFile);
	intval = @sysvar::CH_Nodes::CH_ESPSQC_PARK_Drv_Rq_ESP_P_AUTO;
	snprintf(buffer, elcount(buffer), "   0.000000    SV: 2 0 0 ::CH_Nodes::CH_ESPSQC_PARK_Drv_Rq_ESP_P_AUTO = %d\n", intval);
	filePutString (buffer, elcount(buffer), hFile);
	intval = getSignal(CHASSIS::PARK_Drv_Rq_ESP_AR2::SQC_PARK_Drv_Rq_ESP_Pr2);
	snprintf(buffer, elcount(buffer), "   0.000000 F1 ESP::PARK_Drv_Rq_ESP_AR2::SQC_PARK_Drv_Rq_ESP_Pr2 = %d\n", intval);
	filePutString (buffer, elcount(buffer), hFile);
	intval = getSignal(CHASSIS::PARK_Drv_Rq_ESP_AR2::PARK_DrvDir_Rq_ESP);
	snprintf(buffer, elcount(buffer), "   0.000000 F1 ESP::PARK_Drv_Rq_ESP_AR2::PARK_DrvDir_Rq_ESP = %d\n", intval);
	filePutString (buffer, elcount(buffer), hFile);
	intval = getSignal(CHASSIS::PARK_Drv_Rq_ESP_AR2::PARK_DrvDir_Stat_ESP);
	snprintf(buffer, elcount(buffer), "   0.000000 F1 ESP::PARK_Drv_Rq_ESP_AR2::PARK_DrvDir_Stat_ESP = %d\n", intval);
	filePutString (buffer, elcount(buffer), hFile);
	intval = getSignal(CHASSIS::PARK_Drv_Rq_ESP_AR2::PARK_ShiftLk_Rq_ESP);
	snprintf(buffer, elcount(buffer), "   0.000000 F1 ESP::PARK_Drv_Rq_ESP_AR2::PARK_ShiftLk_Rq_ESP = %d\n", intval);
	filePutString (buffer, elcount(buffer), hFile);
	intval = getSignal(CHASSIS::PARK_Drv_Rq_ESP_AR2::Rsrv1_PARK_Drv_Rq_ESP_Pr2);
	snprintf(buffer, elcount(buffer), "   0.000000 F1 ESP::PARK_Drv_Rq_ESP_AR2::Rsrv1_PARK_Drv_Rq_ESP_Pr2 = %d\n", intval);
	filePutString (buffer, elcount(buffer), hFile);
	intval = getSignal(CHASSIS::PARK_Drv_Rq_ESP_AR2::PT_AS_Actv);
	snprintf(buffer, elcount(buffer), "   0.000000 F1 ESP::PARK_Drv_Rq_ESP_AR2::PT_AS_Actv = %d\n", intval);
	filePutString (buffer, elcount(buffer), hFile);
	intval = getSignal(CHASSIS::PARK_Drv_Rq_ESP_AR2::Rsrv4_PARK_Drv_Rq_ESP_Pr2);
	snprintf(buffer, elcount(buffer), "   0.000000 F1 ESP::PARK_Drv_Rq_ESP_AR2::Rsrv4_PARK_Drv_Rq_ESP_Pr2 = %d\n", intval);
	filePutString (buffer, elcount(buffer), hFile);
	intval = getSignal(CHASSIS::PARK_Drv_Rq_ESP_AR2::Rsrv2_PARK_Drv_Rq_ESP_Pr2);
	snprintf(buffer, elcount(buffer), "   0.000000 F1 ESP::PARK_Drv_Rq_ESP_AR2::Rsrv2_PARK_Drv_Rq_ESP_Pr2 = %d\n", intval);
	filePutString (buffer, elcount(buffer), hFile);
	intval = getSignal(CHASSIS::PARK_Drv_Rq_ESP_AR2::Rsrv3_PARK_Drv_Rq_ESP_Pr2);
	snprintf(buffer, elcount(buffer), "   0.000000 F1 ESP::PARK_Drv_Rq_ESP_AR2::Rsrv3_PARK_Drv_Rq_ESP_Pr2 = %d\n", intval);
	filePutString (buffer, elcount(buffer), hFile);
	intval = @sysvar::CH_Nodes::CH_ESPCRC_PresfCtrl_Rq_ESP__AUTO;
	snprintf(buffer, elcount(buffer), "   0.000000    SV: 2 0 0 ::CH_Nodes::CH_ESPCRC_PresfCtrl_Rq_ESP__AUTO = %d\n", intval);
	filePutString (buffer, elcount(buffer), hFile);
	intval = getSignal(CHASSIS::PresfCtrl_Rq_ESP_AR2::CRC_PresfCtrl_Rq_ESP_Pr2);
	snprintf(buffer, elcount(buffer), "   0.000000 F1 ESP::PresfCtrl_Rq_ESP_AR2::CRC_PresfCtrl_Rq_ESP_Pr2 = %d\n", intval);
	filePutString (buffer, elcount(buffer), hFile);
	intval = @sysvar::CH_Nodes::CH_ESPSQC_PresfCtrl_Rq_ESP__AUTO;
	snprintf(buffer, elcount(buffer), "   0.000000    SV: 2 0 0 ::CH_Nodes::CH_ESPSQC_PresfCtrl_Rq_ESP__AUTO = %d\n", intval);
	filePutString (buffer, elcount(buffer), hFile);
	intval = getSignal(CHASSIS::PresfCtrl_Rq_ESP_AR2::SQC_PresfCtrl_Rq_ESP_Pr2);
	snprintf(buffer, elcount(buffer), "   0.000000 F1 ESP::PresfCtrl_Rq_ESP_AR2::SQC_PresfCtrl_Rq_ESP_Pr2 = %d\n", intval);
	filePutString (buffer, elcount(buffer), hFile);
	intval = getSignal(CHASSIS::PresfCtrl_Rq_ESP_AR2::Presf_Enbl);
	snprintf(buffer, elcount(buffer), "   0.000000 F1 ESP::PresfCtrl_Rq_ESP_AR2::Presf_Enbl = %d\n", intval);
	filePutString (buffer, elcount(buffer), hFile);
}
/*@@end*/

/*@@caplFunc:saveVars_66(dword):*/
void saveVars_66(dword hFile)
{
	intval = getSignal(CHASSIS::PresfCtrl_Rq_ESP_AR2::PresfAccelReset_NotExcd);
	snprintf(buffer, elcount(buffer), "   0.000000 F1 ESP::PresfCtrl_Rq_ESP_AR2::PresfAccelReset_NotExcd = %d\n", intval);
	filePutString (buffer, elcount(buffer), hFile);
	intval = getSignal(CHASSIS::PresfCtrl_Rq_ESP_AR2::Presf_FricFctr_Lo);
	snprintf(buffer, elcount(buffer), "   0.000000 F1 ESP::PresfCtrl_Rq_ESP_AR2::Presf_FricFctr_Lo = %d\n", intval);
	filePutString (buffer, elcount(buffer), hFile);
	intval = @sysvar::CH_Nodes::CH_ESPPresfAct_Adj_TglPresf_AUTO;
	snprintf(buffer, elcount(buffer), "   0.000000    SV: 2 0 0 ::CH_Nodes::CH_ESPPresfAct_Adj_TglPresf_AUTO = %d\n", intval);
	filePutString (buffer, elcount(buffer), hFile);
	intval = getSignal(CHASSIS::PresfCtrl_Rq_ESP_AR2::PresfAct_Adj_Tgl);
	snprintf(buffer, elcount(buffer), "   0.000000 F1 ESP::PresfCtrl_Rq_ESP_AR2::PresfAct_Adj_Tgl = %d\n", intval);
	filePutString (buffer, elcount(buffer), hFile);
	intval = getSignal(CHASSIS::PresfCtrl_Rq_ESP_AR2::Presf_Lvl_V2);
	snprintf(buffer, elcount(buffer), "   0.000000 F1 ESP::PresfCtrl_Rq_ESP_AR2::Presf_Lvl_V2 = %d\n", intval);
	filePutString (buffer, elcount(buffer), hFile);
	intval = getSignal(CHASSIS::PresfCtrl_Rq_ESP_AR2::Presf_Snd_Rq);
	snprintf(buffer, elcount(buffer), "   0.000000 F1 ESP::PresfCtrl_Rq_ESP_AR2::Presf_Snd_Rq = %d\n", intval);
	filePutString (buffer, elcount(buffer), hFile);
	intval = getSignal(CHASSIS::PresfCtrl_Rq_ESP_AR2::Rsrv2_PresfCtrl_Rq_ESP_Pr2);
	snprintf(buffer, elcount(buffer), "   0.000000 F1 ESP::PresfCtrl_Rq_ESP_AR2::Rsrv2_PresfCtrl_Rq_ESP_Pr2 = %d\n", intval);
	filePutString (buffer, elcount(buffer), hFile);
	intval = getSignal(CHASSIS::PresfCtrl_Rq_ESP_AR2::PresfAct1_Adj_Rq);
	snprintf(buffer, elcount(buffer), "   0.000000 F1 ESP::PresfCtrl_Rq_ESP_AR2::PresfAct1_Adj_Rq = %d\n", intval);
	filePutString (buffer, elcount(buffer), hFile);
	intval = getSignal(CHASSIS::PresfCtrl_Rq_ESP_AR2::PresfAct2_Adj_Rq);
	snprintf(buffer, elcount(buffer), "   0.000000 F1 ESP::PresfCtrl_Rq_ESP_AR2::PresfAct2_Adj_Rq = %d\n", intval);
	filePutString (buffer, elcount(buffer), hFile);
	intval = getSignal(CHASSIS::PresfCtrl_Rq_ESP_AR2::PresfAct3_Adj_Rq);
	snprintf(buffer, elcount(buffer), "   0.000000 F1 ESP::PresfCtrl_Rq_ESP_AR2::PresfAct3_Adj_Rq = %d\n", intval);
	filePutString (buffer, elcount(buffer), hFile);
	intval = getSignal(CHASSIS::PresfCtrl_Rq_ESP_AR2::PresfAct4_Adj_Rq);
	snprintf(buffer, elcount(buffer), "   0.000000 F1 ESP::PresfCtrl_Rq_ESP_AR2::PresfAct4_Adj_Rq = %d\n", intval);
	filePutString (buffer, elcount(buffer), hFile);
	intval = getSignal(CHASSIS::PresfCtrl_Rq_ESP_AR2::PresfAct5_Adj_Rq);
	snprintf(buffer, elcount(buffer), "   0.000000 F1 ESP::PresfCtrl_Rq_ESP_AR2::PresfAct5_Adj_Rq = %d\n", intval);
	filePutString (buffer, elcount(buffer), hFile);
	intval = getSignal(CHASSIS::PresfCtrl_Rq_ESP_AR2::PresfAct6_Adj_Rq);
	snprintf(buffer, elcount(buffer), "   0.000000 F1 ESP::PresfCtrl_Rq_ESP_AR2::PresfAct6_Adj_Rq = %d\n", intval);
	filePutString (buffer, elcount(buffer), hFile);
	intval = getSignal(CHASSIS::PresfCtrl_Rq_ESP_AR2::PresfAct7_Adj_Rq);
	snprintf(buffer, elcount(buffer), "   0.000000 F1 ESP::PresfCtrl_Rq_ESP_AR2::PresfAct7_Adj_Rq = %d\n", intval);
	filePutString (buffer, elcount(buffer), hFile);
	intval = getSignal(CHASSIS::PresfCtrl_Rq_ESP_AR2::PresfAct8_Adj_Rq);
	snprintf(buffer, elcount(buffer), "   0.000000 F1 ESP::PresfCtrl_Rq_ESP_AR2::PresfAct8_Adj_Rq = %d\n", intval);
	filePutString (buffer, elcount(buffer), hFile);
	intval = getSignal(CHASSIS::PresfCtrl_Rq_ESP_AR2::PresfAct9_Adj_Rq);
	snprintf(buffer, elcount(buffer), "   0.000000 F1 ESP::PresfCtrl_Rq_ESP_AR2::PresfAct9_Adj_Rq = %d\n", intval);
	filePutString (buffer, elcount(buffer), hFile);
	intval = getSignal(CHASSIS::PresfCtrl_Rq_ESP_AR2::PresfAct10_Adj_Rq);
	snprintf(buffer, elcount(buffer), "   0.000000 F1 ESP::PresfCtrl_Rq_ESP_AR2::PresfAct10_Adj_Rq = %d\n", intval);
	filePutString (buffer, elcount(buffer), hFile);
	intval = getSignal(CHASSIS::PresfCtrl_Rq_ESP_AR2::PresfAct11_Adj_Rq);
	snprintf(buffer, elcount(buffer), "   0.000000 F1 ESP::PresfCtrl_Rq_ESP_AR2::PresfAct11_Adj_Rq = %d\n", intval);
	filePutString (buffer, elcount(buffer), hFile);
	intval = getSignal(CHASSIS::PresfCtrl_Rq_ESP_AR2::PresfAct12_Adj_Rq);
	snprintf(buffer, elcount(buffer), "   0.000000 F1 ESP::PresfCtrl_Rq_ESP_AR2::PresfAct12_Adj_Rq = %d\n", intval);
	filePutString (buffer, elcount(buffer), hFile);
	intval = getSignal(CHASSIS::PresfCtrl_Rq_ESP_AR2::Rsrv3_PresfCtrl_Rq_ESP_Pr2);
	snprintf(buffer, elcount(buffer), "   0.000000 F1 ESP::PresfCtrl_Rq_ESP_AR2::Rsrv3_PresfCtrl_Rq_ESP_Pr2 = %d\n", intval);
	filePutString (buffer, elcount(buffer), hFile);
	intval = getSignal(CHASSIS::PresfCtrl_Rq_ESP_AR2::PresfAct_RBTM_FL_TensSupp_Rq);
	snprintf(buffer, elcount(buffer), "   0.000000 F1 ESP::PresfCtrl_Rq_ESP_AR2::PresfAct_RBTM_FL_TensSupp_Rq = %d\n", intval);
	filePutString (buffer, elcount(buffer), hFile);
	intval = getSignal(CHASSIS::PresfCtrl_Rq_ESP_AR2::PresfAct_RBTM_FR_TensSupp_Rq);
	snprintf(buffer, elcount(buffer), "   0.000000 F1 ESP::PresfCtrl_Rq_ESP_AR2::PresfAct_RBTM_FR_TensSupp_Rq = %d\n", intval);
	filePutString (buffer, elcount(buffer), hFile);
	intval = getSignal(CHASSIS::PresfCtrl_Rq_ESP_AR2::Rsrv4_PresfCtrl_Rq_ESP_Pr2);
	snprintf(buffer, elcount(buffer), "   0.000000 F1 ESP::PresfCtrl_Rq_ESP_AR2::Rsrv4_PresfCtrl_Rq_ESP_Pr2 = %d\n", intval);
	filePutString (buffer, elcount(buffer), hFile);
	intval = getSignal(CHASSIS::PresfCtrl_Rq_ESP_AR2::Rsrv5_PresfCtrl_Rq_ESP_Pr2);
	snprintf(buffer, elcount(buffer), "   0.000000 F1 ESP::PresfCtrl_Rq_ESP_AR2::Rsrv5_PresfCtrl_Rq_ESP_Pr2 = %d\n", intval);
	filePutString (buffer, elcount(buffer), hFile);
	intval = getSignal(CHASSIS::PresfCtrl_Rq_ESP_AR2::Rsrv6_PresfCtrl_Rq_ESP_Pr2);
	snprintf(buffer, elcount(buffer), "   0.000000 F1 ESP::PresfCtrl_Rq_ESP_AR2::Rsrv6_PresfCtrl_Rq_ESP_Pr2 = %d\n", intval);
	filePutString (buffer, elcount(buffer), hFile);
	intval = @sysvar::CH_Nodes::CH_ESPCRC_PT_Rq_ESP_Pr2PT_R_AUTO;
	snprintf(buffer, elcount(buffer), "   0.000000    SV: 2 0 0 ::CH_Nodes::CH_ESPCRC_PT_Rq_ESP_Pr2PT_R_AUTO = %d\n", intval);
	filePutString (buffer, elcount(buffer), hFile);
	intval = getSignal(CHASSIS::PT_Rq_ESP_AR2::CRC_PT_Rq_ESP_Pr2);
	snprintf(buffer, elcount(buffer), "   0.000000 F1 ESP::PT_Rq_ESP_AR2::CRC_PT_Rq_ESP_Pr2 = %d\n", intval);
	filePutString (buffer, elcount(buffer), hFile);
	intval = @sysvar::CH_Nodes::CH_ESPSQC_PT_Rq_ESP_Pr2PT_R_AUTO;
	snprintf(buffer, elcount(buffer), "   0.000000    SV: 2 0 0 ::CH_Nodes::CH_ESPSQC_PT_Rq_ESP_Pr2PT_R_AUTO = %d\n", intval);
	filePutString (buffer, elcount(buffer), hFile);
	intval = getSignal(CHASSIS::PT_Rq_ESP_AR2::SQC_PT_Rq_ESP_Pr2);
	snprintf(buffer, elcount(buffer), "   0.000000 F1 ESP::PT_Rq_ESP_AR2::SQC_PT_Rq_ESP_Pr2 = %d\n", intval);
	filePutString (buffer, elcount(buffer), hFile);
	intval = getSignal(CHASSIS::PT_Rq_ESP_AR2::RDU_Enbl_Rq);
	snprintf(buffer, elcount(buffer), "   0.000000 F1 ESP::PT_Rq_ESP_AR2::RDU_Enbl_Rq = %d\n", intval);
	filePutString (buffer, elcount(buffer), hFile);
	intval = getSignal(CHASSIS::PT_Rq_ESP_AR2::GrMinMax_Rq_DTR);
	snprintf(buffer, elcount(buffer), "   0.000000 F1 ESP::PT_Rq_ESP_AR2::GrMinMax_Rq_DTR = %d\n", intval);
	filePutString (buffer, elcount(buffer), hFile);
	intval = getSignal(CHASSIS::PT_Rq_ESP_AR2::SSA_Enbl_Rq_ESP);
	snprintf(buffer, elcount(buffer), "   0.000000 F1 ESP::PT_Rq_ESP_AR2::SSA_Enbl_Rq_ESP = %d\n", intval);
	filePutString (buffer, elcount(buffer), hFile);
	intval = getSignal(CHASSIS::PT_Rq_ESP_AR2::SSA_DsablPrmnt_Rq_ESP);
	snprintf(buffer, elcount(buffer), "   0.000000 F1 ESP::PT_Rq_ESP_AR2::SSA_DsablPrmnt_Rq_ESP = %d\n", intval);
	filePutString (buffer, elcount(buffer), hFile);
	floatval = getSignal(CHASSIS::PT_Rq_ESP_AR2::EngTrq_Rq_ESP);
	snprintf(buffer, elcount(buffer), "   0.000000 F1 ESP::PT_Rq_ESP_AR2::EngTrq_Rq_ESP = %f\n", floatval);
	filePutString (buffer, elcount(buffer), hFile);
	intval = getSignal(CHASSIS::PT_Rq_ESP_AR2::WhlSlpRecup);
	snprintf(buffer, elcount(buffer), "   0.000000 F1 ESP::PT_Rq_ESP_AR2::WhlSlpRecup = %d\n", intval);
	filePutString (buffer, elcount(buffer), hFile);
	intval = getSignal(CHASSIS::PT_Rq_ESP_AR2::EngTrqMax_Rq_ESP);
	snprintf(buffer, elcount(buffer), "   0.000000 F1 ESP::PT_Rq_ESP_AR2::EngTrqMax_Rq_ESP = %d\n", intval);
	filePutString (buffer, elcount(buffer), hFile);
	intval = getSignal(CHASSIS::PT_Rq_ESP_AR2::EngTrqMin_Rq_ESP);
	snprintf(buffer, elcount(buffer), "   0.000000 F1 ESP::PT_Rq_ESP_AR2::EngTrqMin_Rq_ESP = %d\n", intval);
	filePutString (buffer, elcount(buffer), hFile);
	floatval = getSignal(CHASSIS::PT_Rq_ESP_AR2::EngTrq_Rq_RBS);
	snprintf(buffer, elcount(buffer), "   0.000000 F1 ESP::PT_Rq_ESP_AR2::EngTrq_Rq_RBS = %f\n", floatval);
	filePutString (buffer, elcount(buffer), hFile);
	intval = getSignal(CHASSIS::PT_Rq_ESP_AR2::RecupEnbl_RBS);
	snprintf(buffer, elcount(buffer), "   0.000000 F1 ESP::PT_Rq_ESP_AR2::RecupEnbl_RBS = %d\n", intval);
	filePutString (buffer, elcount(buffer), hFile);
	intval = getSignal(CHASSIS::PT_Rq_ESP_AR2::EngTrqMax_Rq_RBS);
	snprintf(buffer, elcount(buffer), "   0.000000 F1 ESP::PT_Rq_ESP_AR2::EngTrqMax_Rq_RBS = %d\n", intval);
	filePutString (buffer, elcount(buffer), hFile);
	intval = getSignal(CHASSIS::PT_Rq_ESP_AR2::EngTrqMin_Rq_RBS);
	snprintf(buffer, elcount(buffer), "   0.000000 F1 ESP::PT_Rq_ESP_AR2::EngTrqMin_Rq_RBS = %d\n", intval);
	filePutString (buffer, elcount(buffer), hFile);
	intval = getSignal(CHASSIS::PT_Rq_ESP_AR2::GrMin_Rq_ESP_V2);
	snprintf(buffer, elcount(buffer), "   0.000000 F1 ESP::PT_Rq_ESP_AR2::GrMin_Rq_ESP_V2 = %d\n", intval);
	filePutString (buffer, elcount(buffer), hFile);
	intval = getSignal(CHASSIS::PT_Rq_ESP_AR2::GrMax_Rq_ESP_V2);
	snprintf(buffer, elcount(buffer), "   0.000000 F1 ESP::PT_Rq_ESP_AR2::GrMax_Rq_ESP_V2 = %d\n", intval);
	filePutString (buffer, elcount(buffer), hFile);
	intval = getSignal(CHASSIS::PT_Rq_ESP_AR2::ShftChrDsp_Rq_AS);
	snprintf(buffer, elcount(buffer), "   0.000000 F1 ESP::PT_Rq_ESP_AR2::ShftChrDsp_Rq_AS = %d\n", intval);
	filePutString (buffer, elcount(buffer), hFile);
	intval = getSignal(CHASSIS::PT_Rq_ESP_AR2::PwrFreeD_Supp_Rq_AS);
	snprintf(buffer, elcount(buffer), "   0.000000 F1 ESP::PT_Rq_ESP_AR2::PwrFreeD_Supp_Rq_AS = %d\n", intval);
	filePutString (buffer, elcount(buffer), hFile);
	intval = getSignal(CHASSIS::PT_Rq_ESP_AR2::DynFLDS_Supp_Rq_AS);
	snprintf(buffer, elcount(buffer), "   0.000000 F1 ESP::PT_Rq_ESP_AR2::DynFLDS_Supp_Rq_AS = %d\n", intval);
	filePutString (buffer, elcount(buffer), hFile);
	intval = getSignal(CHASSIS::PT_Rq_ESP_AR2::ActvDnShift_Rq_AS);
	snprintf(buffer, elcount(buffer), "   0.000000 F1 ESP::PT_Rq_ESP_AR2::ActvDnShift_Rq_AS = %d\n", intval);
	filePutString (buffer, elcount(buffer), hFile);
	intval = getSignal(CHASSIS::ROE_ESP::ROE_Header_ESP);
	snprintf(buffer, elcount(buffer), "   0.000000 F1 ESP::ROE_ESP::ROE_Header_ESP = %d\n", intval);
	filePutString (buffer, elcount(buffer), hFile);
	intval = getSignal(CHASSIS::ROE_ESP::ROE_DTC_ESP);
	snprintf(buffer, elcount(buffer), "   0.000000 F1 ESP::ROE_ESP::ROE_DTC_ESP = %d\n", intval);
	filePutString (buffer, elcount(buffer), hFile);
	intval = getSignal(CHASSIS::ROE_ESP::ROE_DTC_Stat_ESP);
	snprintf(buffer, elcount(buffer), "   0.000000 F1 ESP::ROE_ESP::ROE_DTC_Stat_ESP = %d\n", intval);
	filePutString (buffer, elcount(buffer), hFile);
	intval = @sysvar::CH_Nodes::CH_ESPCRC_SADR_Trgr_ESP_Pr2_AUTO;
	snprintf(buffer, elcount(buffer), "   0.000000    SV: 2 0 0 ::CH_Nodes::CH_ESPCRC_SADR_Trgr_ESP_Pr2_AUTO = %d\n", intval);
	filePutString (buffer, elcount(buffer), hFile);
	intval = getSignal(CHASSIS::SADR_Trgr_ESP_AR2::CRC_SADR_Trgr_ESP_Pr2);
	snprintf(buffer, elcount(buffer), "   0.000000 F1 ESP::SADR_Trgr_ESP_AR2::CRC_SADR_Trgr_ESP_Pr2 = %d\n", intval);
	filePutString (buffer, elcount(buffer), hFile);
	intval = @sysvar::CH_Nodes::CH_ESPSQC_SADR_Trgr_ESP_Pr2_AUTO;
	snprintf(buffer, elcount(buffer), "   0.000000    SV: 2 0 0 ::CH_Nodes::CH_ESPSQC_SADR_Trgr_ESP_Pr2_AUTO = %d\n", intval);
	filePutString (buffer, elcount(buffer), hFile);
	intval = getSignal(CHASSIS::SADR_Trgr_ESP_AR2::SQC_SADR_Trgr_ESP_Pr2);
	snprintf(buffer, elcount(buffer), "   0.000000 F1 ESP::SADR_Trgr_ESP_AR2::SQC_SADR_Trgr_ESP_Pr2 = %d\n", intval);
	filePutString (buffer, elcount(buffer), hFile);
	intval = getSignal(CHASSIS::SADR_Trgr_ESP_AR2::SADR_TrgrPrio_ESP);
	snprintf(buffer, elcount(buffer), "   0.000000 F1 ESP::SADR_Trgr_ESP_AR2::SADR_TrgrPrio_ESP = %d\n", intval);
	filePutString (buffer, elcount(buffer), hFile);
	intval = getSignal(CHASSIS::SADR_Trgr_ESP_AR2::Rsrv2_SADR_Trgr_ESP_Pr2);
	snprintf(buffer, elcount(buffer), "   0.000000 F1 ESP::SADR_Trgr_ESP_AR2::Rsrv2_SADR_Trgr_ESP_Pr2 = %d\n", intval);
	filePutString (buffer, elcount(buffer), hFile);
}
/*@@end*/

/*@@caplFunc:saveVars_67(dword):*/
void saveVars_67(dword hFile)
{
	intval = getSignal(CHASSIS::SADR_Trgr_ESP_AR2::SADR_TrgrTm_ESP);
	snprintf(buffer, elcount(buffer), "   0.000000 F1 ESP::SADR_Trgr_ESP_AR2::SADR_TrgrTm_ESP = %d\n", intval);
	filePutString (buffer, elcount(buffer), hFile);
	intval = getSignal(CHASSIS::SADR_Trgr_ESP_AR2::Rsrv1_SADR_Trgr_ESP_Pr2);
	snprintf(buffer, elcount(buffer), "   0.000000 F1 ESP::SADR_Trgr_ESP_AR2::Rsrv1_SADR_Trgr_ESP_Pr2 = %d\n", intval);
	filePutString (buffer, elcount(buffer), hFile);
	intval = @sysvar::CH_Nodes::CH_ESPCRC_St_Rq_STA_Pr2St_R_AUTO;
	snprintf(buffer, elcount(buffer), "   0.000000    SV: 2 0 0 ::CH_Nodes::CH_ESPCRC_St_Rq_STA_Pr2St_R_AUTO = %d\n", intval);
	filePutString (buffer, elcount(buffer), hFile);
	intval = getSignal(CHASSIS::St_Rq_STA_AR2::CRC_St_Rq_STA_Pr2);
	snprintf(buffer, elcount(buffer), "   0.000000 F1 ESP::St_Rq_STA_AR2::CRC_St_Rq_STA_Pr2 = %d\n", intval);
	filePutString (buffer, elcount(buffer), hFile);
	intval = @sysvar::CH_Nodes::CH_ESPSQC_St_Rq_STA_Pr2St_R_AUTO;
	snprintf(buffer, elcount(buffer), "   0.000000    SV: 2 0 0 ::CH_Nodes::CH_ESPSQC_St_Rq_STA_Pr2St_R_AUTO = %d\n", intval);
	filePutString (buffer, elcount(buffer), hFile);
	intval = getSignal(CHASSIS::St_Rq_STA_AR2::SQC_St_Rq_STA_Pr2);
	snprintf(buffer, elcount(buffer), "   0.000000 F1 ESP::St_Rq_STA_AR2::SQC_St_Rq_STA_Pr2 = %d\n", intval);
	filePutString (buffer, elcount(buffer), hFile);
	intval = getSignal(CHASSIS::St_Rq_STA_AR2::Rsrv1_St_Rq_STA_Pr2);
	snprintf(buffer, elcount(buffer), "   0.000000 F1 ESP::St_Rq_STA_AR2::Rsrv1_St_Rq_STA_Pr2 = %d\n", intval);
	filePutString (buffer, elcount(buffer), hFile);
	intval = getSignal(CHASSIS::St_Rq_STA_AR2::STA_ActvReturn_Dsbl);
	snprintf(buffer, elcount(buffer), "   0.000000 F1 ESP::St_Rq_STA_AR2::STA_ActvReturn_Dsbl = %d\n", intval);
	filePutString (buffer, elcount(buffer), hFile);
	intval = getSignal(CHASSIS::St_Rq_STA_AR2::STA_Intrvntn_Actv_ESP);
	snprintf(buffer, elcount(buffer), "   0.000000 F1 ESP::St_Rq_STA_AR2::STA_Intrvntn_Actv_ESP = %d\n", intval);
	filePutString (buffer, elcount(buffer), hFile);
	floatval = getSignal(CHASSIS::St_Rq_STA_AR2::StW_Trq_Rq_STA);
	snprintf(buffer, elcount(buffer), "   0.000000 F1 ESP::St_Rq_STA_AR2::StW_Trq_Rq_STA = %f\n", floatval);
	filePutString (buffer, elcount(buffer), hFile);
	intval = getSignal(CHASSIS::St_Rq_STA_AR2::STA_AnglIfc_Rq);
	snprintf(buffer, elcount(buffer), "   0.000000 F1 ESP::St_Rq_STA_AR2::STA_AnglIfc_Rq = %d\n", intval);
	filePutString (buffer, elcount(buffer), hFile);
	intval = getSignal(CHASSIS::St_Rq_STA_AR2::STA_RfIfc_Rq);
	snprintf(buffer, elcount(buffer), "   0.000000 F1 ESP::St_Rq_STA_AR2::STA_RfIfc_Rq = %d\n", intval);
	filePutString (buffer, elcount(buffer), hFile);
	floatval = getSignal(CHASSIS::St_Rq_STA_AR2::STA_FtWhlAngl_Rq);
	snprintf(buffer, elcount(buffer), "   0.000000 F1 ESP::St_Rq_STA_AR2::STA_FtWhlAngl_Rq = %f\n", floatval);
	filePutString (buffer, elcount(buffer), hFile);
	intval = getSignal(CHASSIS::St_Rq_STA_AR2::STA_AddRf_Rq);
	snprintf(buffer, elcount(buffer), "   0.000000 F1 ESP::St_Rq_STA_AR2::STA_AddRf_Rq = %d\n", intval);
	filePutString (buffer, elcount(buffer), hFile);
	intval = getSignal(CHASSIS::St_Rq_STA_AR2::Rsrv2_St_Rq_STA_Pr2);
	snprintf(buffer, elcount(buffer), "   0.000000 F1 ESP::St_Rq_STA_AR2::Rsrv2_St_Rq_STA_Pr2 = %d\n", intval);
	filePutString (buffer, elcount(buffer), hFile);
	intval = getSignal(CHASSIS::St_Rq_STA_AR2::Rsrv3_St_Rq_STA_Pr2);
	snprintf(buffer, elcount(buffer), "   0.000000 F1 ESP::St_Rq_STA_AR2::Rsrv3_St_Rq_STA_Pr2 = %d\n", intval);
	filePutString (buffer, elcount(buffer), hFile);
	intval = getSignal(CHASSIS::TBCSC_ESP_DAC_AR2::TBCSC_ESP_DAC_Data1);
	snprintf(buffer, elcount(buffer), "   0.000000 F1 ESP::TBCSC_ESP_DAC_AR2::TBCSC_ESP_DAC_Data1 = %d\n", intval);
	filePutString (buffer, elcount(buffer), hFile);
	intval = getSignal(CHASSIS::TBCSC_ESP_DAC_AR2::TBCSC_ESP_DAC_Data2);
	snprintf(buffer, elcount(buffer), "   0.000000 F1 ESP::TBCSC_ESP_DAC_AR2::TBCSC_ESP_DAC_Data2 = %d\n", intval);
	filePutString (buffer, elcount(buffer), hFile);
	intval = getSignal(CHASSIS::TBCSC_ESP_DAC_AR2::TBCSC_ESP_DAC_Data3);
	snprintf(buffer, elcount(buffer), "   0.000000 F1 ESP::TBCSC_ESP_DAC_AR2::TBCSC_ESP_DAC_Data3 = %d\n", intval);
	filePutString (buffer, elcount(buffer), hFile);
	intval = getSignal(CHASSIS::TBCSC_ESP_DAC_AR2::TBCSC_ESP_DAC_Data4);
	snprintf(buffer, elcount(buffer), "   0.000000 F1 ESP::TBCSC_ESP_DAC_AR2::TBCSC_ESP_DAC_Data4 = %d\n", intval);
	filePutString (buffer, elcount(buffer), hFile);
	intval = getSignal(CHASSIS::TBCSC_ESP_DAC_AR2::TBCSC_ESP_DAC_Data5);
	snprintf(buffer, elcount(buffer), "   0.000000 F1 ESP::TBCSC_ESP_DAC_AR2::TBCSC_ESP_DAC_Data5 = %d\n", intval);
	filePutString (buffer, elcount(buffer), hFile);
	intval = getSignal(CHASSIS::TBCSC_ESP_DAC_AR2::TBCSC_ESP_DAC_Data6);
	snprintf(buffer, elcount(buffer), "   0.000000 F1 ESP::TBCSC_ESP_DAC_AR2::TBCSC_ESP_DAC_Data6 = %d\n", intval);
	filePutString (buffer, elcount(buffer), hFile);
	intval = getSignal(CHASSIS::TBCSC_ESP_DAC_AR2::TBCSC_ESP_DAC_Data7);
	snprintf(buffer, elcount(buffer), "   0.000000 F1 ESP::TBCSC_ESP_DAC_AR2::TBCSC_ESP_DAC_Data7 = %d\n", intval);
	filePutString (buffer, elcount(buffer), hFile);
	intval = getSignal(CHASSIS::TBCSC_ESP_DAC_AR2::TBCSC_ESP_DAC_Data8);
	snprintf(buffer, elcount(buffer), "   0.000000 F1 ESP::TBCSC_ESP_DAC_AR2::TBCSC_ESP_DAC_Data8 = %d\n", intval);
	filePutString (buffer, elcount(buffer), hFile);
	intval = @sysvar::CH_Nodes::CH_ESPCRC_TBCSC_Rs1_ESP_Pr2_AUTO;
	snprintf(buffer, elcount(buffer), "   0.000000    SV: 2 0 0 ::CH_Nodes::CH_ESPCRC_TBCSC_Rs1_ESP_Pr2_AUTO = %d\n", intval);
	filePutString (buffer, elcount(buffer), hFile);
	intval = getSignal(CHASSIS::TBCSC_Rs1_ESP_AR2::CRC_TBCSC_Rs1_ESP_Pr2);
	snprintf(buffer, elcount(buffer), "   0.000000 F1 ESP::TBCSC_Rs1_ESP_AR2::CRC_TBCSC_Rs1_ESP_Pr2 = %d\n", intval);
	filePutString (buffer, elcount(buffer), hFile);
	intval = @sysvar::CH_Nodes::CH_ESPSQC_TBCSC_Rs1_ESP_Pr2_AUTO;
	snprintf(buffer, elcount(buffer), "   0.000000    SV: 2 0 0 ::CH_Nodes::CH_ESPSQC_TBCSC_Rs1_ESP_Pr2_AUTO = %d\n", intval);
	filePutString (buffer, elcount(buffer), hFile);
	intval = getSignal(CHASSIS::TBCSC_Rs1_ESP_AR2::SQC_TBCSC_Rs1_ESP_Pr2);
	snprintf(buffer, elcount(buffer), "   0.000000 F1 ESP::TBCSC_Rs1_ESP_AR2::SQC_TBCSC_Rs1_ESP_Pr2 = %d\n", intval);
	filePutString (buffer, elcount(buffer), hFile);
	intval = getSignal(CHASSIS::TBCSC_Rs1_ESP_AR2::Gr_TBCC);
	snprintf(buffer, elcount(buffer), "   0.000000 F1 ESP::TBCSC_Rs1_ESP_AR2::Gr_TBCC = %d\n", intval);
	filePutString (buffer, elcount(buffer), hFile);
	intval = getSignal(CHASSIS::TBCSC_Rs1_ESP_AR2::EngRPM_TBCC);
	snprintf(buffer, elcount(buffer), "   0.000000 F1 ESP::TBCSC_Rs1_ESP_AR2::EngRPM_TBCC = %d\n", intval);
	filePutString (buffer, elcount(buffer), hFile);
	intval = getSignal(CHASSIS::TBCSC_Rs1_ESP_AR2::BrkPdl_Stat_TBCC);
	snprintf(buffer, elcount(buffer), "   0.000000 F1 ESP::TBCSC_Rs1_ESP_AR2::BrkPdl_Stat_TBCC = %d\n", intval);
	filePutString (buffer, elcount(buffer), hFile);
	floatval = getSignal(CHASSIS::TBCSC_Rs1_ESP_AR2::EngTrqMin_TBCC);
	snprintf(buffer, elcount(buffer), "   0.000000 F1 ESP::TBCSC_Rs1_ESP_AR2::EngTrqMin_TBCC = %f\n", floatval);
	filePutString (buffer, elcount(buffer), hFile);
	intval = getSignal(CHASSIS::TBCSC_Rs1_ESP_AR2::EngRun_Stat_TBCC);
	snprintf(buffer, elcount(buffer), "   0.000000 F1 ESP::TBCSC_Rs1_ESP_AR2::EngRun_Stat_TBCC = %d\n", intval);
	filePutString (buffer, elcount(buffer), hFile);
	floatval = getSignal(CHASSIS::TBCSC_Rs1_ESP_AR2::EngWhlTrqRatio_TBCC);
	snprintf(buffer, elcount(buffer), "   0.000000 F1 ESP::TBCSC_Rs1_ESP_AR2::EngWhlTrqRatio_TBCC = %f\n", floatval);
	filePutString (buffer, elcount(buffer), hFile);
	intval = getSignal(CHASSIS::TBCSC_Rs1_ESP_AR2::MPkBrk_Stat_TBCC);
	snprintf(buffer, elcount(buffer), "   0.000000 F1 ESP::TBCSC_Rs1_ESP_AR2::MPkBrk_Stat_TBCC = %d\n", intval);
	filePutString (buffer, elcount(buffer), hFile);
	intval = getSignal(CHASSIS::TBCSC_Rs1_ESP_AR2::TBCC_Enbl);
	snprintf(buffer, elcount(buffer), "   0.000000 F1 ESP::TBCSC_Rs1_ESP_AR2::TBCC_Enbl = %d\n", intval);
	filePutString (buffer, elcount(buffer), hFile);
	intval = @sysvar::CH_Nodes::CH_ESPCRC_TBCSC_Rs2_ESP_Pr2_AUTO;
	snprintf(buffer, elcount(buffer), "   0.000000    SV: 2 0 0 ::CH_Nodes::CH_ESPCRC_TBCSC_Rs2_ESP_Pr2_AUTO = %d\n", intval);
	filePutString (buffer, elcount(buffer), hFile);
	intval = getSignal(CHASSIS::TBCSC_Rs2_ESP_AR2::CRC_TBCSC_Rs2_ESP_Pr2);
	snprintf(buffer, elcount(buffer), "   0.000000 F1 ESP::TBCSC_Rs2_ESP_AR2::CRC_TBCSC_Rs2_ESP_Pr2 = %d\n", intval);
	filePutString (buffer, elcount(buffer), hFile);
	intval = @sysvar::CH_Nodes::CH_ESPSQC_TBCSC_Rs2_ESP_Pr2_AUTO;
	snprintf(buffer, elcount(buffer), "   0.000000    SV: 2 0 0 ::CH_Nodes::CH_ESPSQC_TBCSC_Rs2_ESP_Pr2_AUTO = %d\n", intval);
	filePutString (buffer, elcount(buffer), hFile);
	intval = getSignal(CHASSIS::TBCSC_Rs2_ESP_AR2::SQC_TBCSC_Rs2_ESP_Pr2);
	snprintf(buffer, elcount(buffer), "   0.000000 F1 ESP::TBCSC_Rs2_ESP_AR2::SQC_TBCSC_Rs2_ESP_Pr2 = %d\n", intval);
	filePutString (buffer, elcount(buffer), hFile);
	intval = getSignal(CHASSIS::TBCSC_Rs2_ESP_AR2::Gr_Target_TBCC);
	snprintf(buffer, elcount(buffer), "   0.000000 F1 ESP::TBCSC_Rs2_ESP_AR2::Gr_Target_TBCC = %d\n", intval);
	filePutString (buffer, elcount(buffer), hFile);
	intval = getSignal(CHASSIS::TBCSC_Rs2_ESP_AR2::PT_Rdy_V2_TBCC);
	snprintf(buffer, elcount(buffer), "   0.000000 F1 ESP::TBCSC_Rs2_ESP_AR2::PT_Rdy_V2_TBCC = %d\n", intval);
	filePutString (buffer, elcount(buffer), hFile);
	intval = getSignal(CHASSIS::TBCSC_Rs2_ESP_AR2::Rsrv1_TBCSC_Rs2_ESP_Pr2);
	snprintf(buffer, elcount(buffer), "   0.000000 F1 ESP::TBCSC_Rs2_ESP_AR2::Rsrv1_TBCSC_Rs2_ESP_Pr2 = %d\n", intval);
	filePutString (buffer, elcount(buffer), hFile);
	intval = getSignal(CHASSIS::TBCSC_Rs2_ESP_AR2::Rsrv2_TBCSC_Rs2_ESP_Pr2);
	snprintf(buffer, elcount(buffer), "   0.000000 F1 ESP::TBCSC_Rs2_ESP_AR2::Rsrv2_TBCSC_Rs2_ESP_Pr2 = %d\n", intval);
	filePutString (buffer, elcount(buffer), hFile);
	intval = getSignal(CHASSIS::TBCSC_Rs2_ESP_AR2::Rsrv3_TBCSC_Rs2_ESP_Pr2);
	snprintf(buffer, elcount(buffer), "   0.000000 F1 ESP::TBCSC_Rs2_ESP_AR2::Rsrv3_TBCSC_Rs2_ESP_Pr2 = %d\n", intval);
	filePutString (buffer, elcount(buffer), hFile);
	intval = getSignal(CHASSIS::TBCSC_Rs2_ESP_AR2::Rsrv4_TBCSC_Rs2_ESP_Pr2);
	snprintf(buffer, elcount(buffer), "   0.000000 F1 ESP::TBCSC_Rs2_ESP_AR2::Rsrv4_TBCSC_Rs2_ESP_Pr2 = %d\n", intval);
	filePutString (buffer, elcount(buffer), hFile);
	intval = getSignal(CHASSIS::TBCSC_Rs2_ESP_AR2::Rsrv5_TBCSC_Rs2_ESP_Pr2);
	snprintf(buffer, elcount(buffer), "   0.000000 F1 ESP::TBCSC_Rs2_ESP_AR2::Rsrv5_TBCSC_Rs2_ESP_Pr2 = %d\n", intval);
	filePutString (buffer, elcount(buffer), hFile);
	intval = getSignal(CHASSIS::TBCSC_Rs2_ESP_AR2::Rsrv6_TBCSC_Rs2_ESP_Pr2);
	snprintf(buffer, elcount(buffer), "   0.000000 F1 ESP::TBCSC_Rs2_ESP_AR2::Rsrv6_TBCSC_Rs2_ESP_Pr2 = %d\n", intval);
	filePutString (buffer, elcount(buffer), hFile);
	intval = @sysvar::CH_Nodes::CH_ESPCRC_VehAccel_X_Rs1_Pr_AUTO;
	snprintf(buffer, elcount(buffer), "   0.000000    SV: 2 0 0 ::CH_Nodes::CH_ESPCRC_VehAccel_X_Rs1_Pr_AUTO = %d\n", intval);
	filePutString (buffer, elcount(buffer), hFile);
	intval = getSignal(CHASSIS::VehAccel_X_Rs1_AR2::CRC_VehAccel_X_Rs1_Pr2);
	snprintf(buffer, elcount(buffer), "   0.000000 F1 ESP::VehAccel_X_Rs1_AR2::CRC_VehAccel_X_Rs1_Pr2 = %d\n", intval);
	filePutString (buffer, elcount(buffer), hFile);
	intval = @sysvar::CH_Nodes::CH_ESPSQC_VehAccel_X_Rs1_Pr_AUTO;
	snprintf(buffer, elcount(buffer), "   0.000000    SV: 2 0 0 ::CH_Nodes::CH_ESPSQC_VehAccel_X_Rs1_Pr_AUTO = %d\n", intval);
	filePutString (buffer, elcount(buffer), hFile);
	intval = getSignal(CHASSIS::VehAccel_X_Rs1_AR2::SQC_VehAccel_X_Rs1_Pr2);
	snprintf(buffer, elcount(buffer), "   0.000000 F1 ESP::VehAccel_X_Rs1_AR2::SQC_VehAccel_X_Rs1_Pr2 = %d\n", intval);
	filePutString (buffer, elcount(buffer), hFile);
	intval = getSignal(CHASSIS::VehAccel_X_Rs1_AR2::VehAccel_X_Dsabl_Rq_ESP);
	snprintf(buffer, elcount(buffer), "   0.000000 F1 ESP::VehAccel_X_Rs1_AR2::VehAccel_X_Dsabl_Rq_ESP = %d\n", intval);
	filePutString (buffer, elcount(buffer), hFile);
	intval = getSignal(CHASSIS::VehAccel_X_Rs1_AR2::VehAccel_X_LDC_Stat);
	snprintf(buffer, elcount(buffer), "   0.000000 F1 ESP::VehAccel_X_Rs1_AR2::VehAccel_X_LDC_Stat = %d\n", intval);
	filePutString (buffer, elcount(buffer), hFile);
	floatval = getSignal(CHASSIS::VehAccel_X_Rs1_AR2::VehAccel_X_Rs);
	snprintf(buffer, elcount(buffer), "   0.000000 F1 ESP::VehAccel_X_Rs1_AR2::VehAccel_X_Rs = %f\n", floatval);
	filePutString (buffer, elcount(buffer), hFile);
	intval = getSignal(CHASSIS::VehAccel_X_Rs1_AR2::AS_Ovr_D);
	snprintf(buffer, elcount(buffer), "   0.000000 F1 ESP::VehAccel_X_Rs1_AR2::AS_Ovr_D = %d\n", intval);
	filePutString (buffer, elcount(buffer), hFile);
	floatval = getSignal(CHASSIS::VehAccel_X_Rs1_AR2::VehAccel_X_Calc_EM_Trq);
	snprintf(buffer, elcount(buffer), "   0.000000 F1 ESP::VehAccel_X_Rs1_AR2::VehAccel_X_Calc_EM_Trq = %f\n", floatval);
	filePutString (buffer, elcount(buffer), hFile);
	intval = getSignal(CHASSIS::VehAccel_X_Rs1_AR2::VehAccel_X_AS_Actv_Rs);
	snprintf(buffer, elcount(buffer), "   0.000000 F1 ESP::VehAccel_X_Rs1_AR2::VehAccel_X_AS_Actv_Rs = %d\n", intval);
	filePutString (buffer, elcount(buffer), hFile);
	floatval = getSignal(CHASSIS::VehAccel_X_Rs1_AR2::VehAccel_X_EngTrqDrag);
	snprintf(buffer, elcount(buffer), "   0.000000 F1 ESP::VehAccel_X_Rs1_AR2::VehAccel_X_EngTrqDrag = %f\n", floatval);
	filePutString (buffer, elcount(buffer), hFile);
}
/*@@end*/

/*@@caplFunc:saveVars_68(dword):*/
void saveVars_68(dword hFile)
{
	intval = getSignal(CHASSIS::VehAccel_X_Rs1_AR2::VehAccel_X_LDC_VehSp_Rs);
	snprintf(buffer, elcount(buffer), "   0.000000 F1 ESP::VehAccel_X_Rs1_AR2::VehAccel_X_LDC_VehSp_Rs = %d\n", intval);
	filePutString (buffer, elcount(buffer), hFile);
	intval = getSignal(CHASSIS::VehAccel_X_Rs1_AR2::VehAccel_X_LDC_VehDir);
	snprintf(buffer, elcount(buffer), "   0.000000 F1 ESP::VehAccel_X_Rs1_AR2::VehAccel_X_LDC_VehDir = %d\n", intval);
	filePutString (buffer, elcount(buffer), hFile);
	intval = getSignal(CHASSIS::VehAccel_X_Rs1_AR2::VehAccel_X_Jerk_Stat);
	snprintf(buffer, elcount(buffer), "   0.000000 F1 ESP::VehAccel_X_Rs1_AR2::VehAccel_X_Jerk_Stat = %d\n", intval);
	filePutString (buffer, elcount(buffer), hFile);
	intval = @sysvar::CH_Nodes::CH_ESPCRC_VehAccel_X_Rs2_Pr_AUTO;
	snprintf(buffer, elcount(buffer), "   0.000000    SV: 2 0 0 ::CH_Nodes::CH_ESPCRC_VehAccel_X_Rs2_Pr_AUTO = %d\n", intval);
	filePutString (buffer, elcount(buffer), hFile);
	intval = getSignal(CHASSIS::VehAccel_X_Rs2_AR2::CRC_VehAccel_X_Rs2_Pr2);
	snprintf(buffer, elcount(buffer), "   0.000000 F1 ESP::VehAccel_X_Rs2_AR2::CRC_VehAccel_X_Rs2_Pr2 = %d\n", intval);
	filePutString (buffer, elcount(buffer), hFile);
	intval = @sysvar::CH_Nodes::CH_ESPSQC_VehAccel_X_Rs2_Pr_AUTO;
	snprintf(buffer, elcount(buffer), "   0.000000    SV: 2 0 0 ::CH_Nodes::CH_ESPSQC_VehAccel_X_Rs2_Pr_AUTO = %d\n", intval);
	filePutString (buffer, elcount(buffer), hFile);
	intval = getSignal(CHASSIS::VehAccel_X_Rs2_AR2::SQC_VehAccel_X_Rs2_Pr2);
	snprintf(buffer, elcount(buffer), "   0.000000 F1 ESP::VehAccel_X_Rs2_AR2::SQC_VehAccel_X_Rs2_Pr2 = %d\n", intval);
	filePutString (buffer, elcount(buffer), hFile);
	intval = getSignal(CHASSIS::VehAccel_X_Rs2_AR2::Rsrv1_VehAccel_X_Rs2);
	snprintf(buffer, elcount(buffer), "   0.000000 F1 ESP::VehAccel_X_Rs2_AR2::Rsrv1_VehAccel_X_Rs2 = %d\n", intval);
	filePutString (buffer, elcount(buffer), hFile);
	intval = getSignal(CHASSIS::VehAccel_X_Rs2_AR2::VehAccel_X_LDC_BrkTrq_Rs);
	snprintf(buffer, elcount(buffer), "   0.000000 F1 ESP::VehAccel_X_Rs2_AR2::VehAccel_X_LDC_BrkTrq_Rs = %d\n", intval);
	filePutString (buffer, elcount(buffer), hFile);
	floatval = getSignal(CHASSIS::VehAccel_X_Rs2_AR2::VehAccel_X_LDC_WhlTrq_Rs);
	snprintf(buffer, elcount(buffer), "   0.000000 F1 ESP::VehAccel_X_Rs2_AR2::VehAccel_X_LDC_WhlTrq_Rs = %f\n", floatval);
	filePutString (buffer, elcount(buffer), hFile);
	floatval = getSignal(CHASSIS::VehAccel_X_Rs2_AR2::VehAccel_X_LDC_VehSpd_Rs);
	snprintf(buffer, elcount(buffer), "   0.000000 F1 ESP::VehAccel_X_Rs2_AR2::VehAccel_X_LDC_VehSpd_Rs = %f\n", floatval);
	filePutString (buffer, elcount(buffer), hFile);
	intval = @sysvar::CH_Nodes::CH_ESPCRC_VehDyn_Stat1_Pr2V_AUTO;
	snprintf(buffer, elcount(buffer), "   0.000000    SV: 2 0 0 ::CH_Nodes::CH_ESPCRC_VehDyn_Stat1_Pr2V_AUTO = %d\n", intval);
	filePutString (buffer, elcount(buffer), hFile);
	intval = getSignal(CHASSIS::VehDyn_Stat1_AR2::CRC_VehDyn_Stat1_Pr2);
	snprintf(buffer, elcount(buffer), "   0.000000 F1 ESP::VehDyn_Stat1_AR2::CRC_VehDyn_Stat1_Pr2 = %d\n", intval);
	filePutString (buffer, elcount(buffer), hFile);
	intval = @sysvar::CH_Nodes::CH_ESPSQC_VehDyn_Stat1_Pr2V_AUTO;
	snprintf(buffer, elcount(buffer), "   0.000000    SV: 2 0 0 ::CH_Nodes::CH_ESPSQC_VehDyn_Stat1_Pr2V_AUTO = %d\n", intval);
	filePutString (buffer, elcount(buffer), hFile);
	intval = getSignal(CHASSIS::VehDyn_Stat1_AR2::SQC_VehDyn_Stat1_Pr2);
	snprintf(buffer, elcount(buffer), "   0.000000 F1 ESP::VehDyn_Stat1_AR2::SQC_VehDyn_Stat1_Pr2 = %d\n", intval);
	filePutString (buffer, elcount(buffer), hFile);
	floatval = getSignal(CHASSIS::VehDyn_Stat1_AR2::VehAccel_X_V2);
	snprintf(buffer, elcount(buffer), "   0.000000 F1 ESP::VehDyn_Stat1_AR2::VehAccel_X_V2 = %f\n", floatval);
	filePutString (buffer, elcount(buffer), hFile);
	floatval = getSignal(CHASSIS::VehDyn_Stat1_AR2::VehAccel_Y_V2);
	snprintf(buffer, elcount(buffer), "   0.000000 F1 ESP::VehDyn_Stat1_AR2::VehAccel_Y_V2 = %f\n", floatval);
	filePutString (buffer, elcount(buffer), hFile);
	intval = getSignal(CHASSIS::VehDyn_Stat1_AR2::VehAccel_X_Qual);
	snprintf(buffer, elcount(buffer), "   0.000000 F1 ESP::VehDyn_Stat1_AR2::VehAccel_X_Qual = %d\n", intval);
	filePutString (buffer, elcount(buffer), hFile);
	intval = getSignal(CHASSIS::VehDyn_Stat1_AR2::VehAccel_Y_Qual);
	snprintf(buffer, elcount(buffer), "   0.000000 F1 ESP::VehDyn_Stat1_AR2::VehAccel_Y_Qual = %d\n", intval);
	filePutString (buffer, elcount(buffer), hFile);
	intval = getSignal(CHASSIS::VehDyn_Stat1_AR2::Rsrv1_VehDyn_Stat1_Pr2);
	snprintf(buffer, elcount(buffer), "   0.000000 F1 ESP::VehDyn_Stat1_AR2::Rsrv1_VehDyn_Stat1_Pr2 = %d\n", intval);
	filePutString (buffer, elcount(buffer), hFile);
	floatval = getSignal(CHASSIS::VehDyn_Stat1_AR2::VehAccel_X_Offset);
	snprintf(buffer, elcount(buffer), "   0.000000 F1 ESP::VehDyn_Stat1_AR2::VehAccel_X_Offset = %f\n", floatval);
	filePutString (buffer, elcount(buffer), hFile);
	floatval = getSignal(CHASSIS::VehDyn_Stat1_AR2::VehAccel_Y_Offset);
	snprintf(buffer, elcount(buffer), "   0.000000 F1 ESP::VehDyn_Stat1_AR2::VehAccel_Y_Offset = %f\n", floatval);
	filePutString (buffer, elcount(buffer), hFile);
	intval = getSignal(CHASSIS::VehDyn_Stat1_AR2::SPCR_Sp_Stat);
	snprintf(buffer, elcount(buffer), "   0.000000 F1 ESP::VehDyn_Stat1_AR2::SPCR_Sp_Stat = %d\n", intval);
	filePutString (buffer, elcount(buffer), hFile);
	intval = getSignal(CHASSIS::VehDyn_Stat1_AR2::SPCR_Excpt_Rq_V2);
	snprintf(buffer, elcount(buffer), "   0.000000 F1 ESP::VehDyn_Stat1_AR2::SPCR_Excpt_Rq_V2 = %d\n", intval);
	filePutString (buffer, elcount(buffer), hFile);
	intval = getSignal(CHASSIS::VehDyn_Stat1_AR2::SPCR_Md);
	snprintf(buffer, elcount(buffer), "   0.000000 F1 ESP::VehDyn_Stat1_AR2::SPCR_Md = %d\n", intval);
	filePutString (buffer, elcount(buffer), hFile);
	intval = @sysvar::CH_Nodes::CH_ESPCRC_VehDyn_Stat2_Pr2V_AUTO;
	snprintf(buffer, elcount(buffer), "   0.000000    SV: 2 0 0 ::CH_Nodes::CH_ESPCRC_VehDyn_Stat2_Pr2V_AUTO = %d\n", intval);
	filePutString (buffer, elcount(buffer), hFile);
	intval = getSignal(CHASSIS::VehDyn_Stat2_AR2::CRC_VehDyn_Stat2_Pr2);
	snprintf(buffer, elcount(buffer), "   0.000000 F1 ESP::VehDyn_Stat2_AR2::CRC_VehDyn_Stat2_Pr2 = %d\n", intval);
	filePutString (buffer, elcount(buffer), hFile);
	intval = @sysvar::CH_Nodes::CH_ESPSQC_VehDyn_Stat2_Pr2V_AUTO;
	snprintf(buffer, elcount(buffer), "   0.000000    SV: 2 0 0 ::CH_Nodes::CH_ESPSQC_VehDyn_Stat2_Pr2V_AUTO = %d\n", intval);
	filePutString (buffer, elcount(buffer), hFile);
	intval = getSignal(CHASSIS::VehDyn_Stat2_AR2::SQC_VehDyn_Stat2_Pr2);
	snprintf(buffer, elcount(buffer), "   0.000000 F1 ESP::VehDyn_Stat2_AR2::SQC_VehDyn_Stat2_Pr2 = %d\n", intval);
	filePutString (buffer, elcount(buffer), hFile);
	intval = getSignal(CHASSIS::VehDyn_Stat2_AR2::VehYawRate_Raw_Qual);
	snprintf(buffer, elcount(buffer), "   0.000000 F1 ESP::VehDyn_Stat2_AR2::VehYawRate_Raw_Qual = %d\n", intval);
	filePutString (buffer, elcount(buffer), hFile);
	floatval = getSignal(CHASSIS::VehDyn_Stat2_AR2::VehYawRateOffset_V2);
	snprintf(buffer, elcount(buffer), "   0.000000 F1 ESP::VehDyn_Stat2_AR2::VehYawRateOffset_V2 = %f\n", floatval);
	filePutString (buffer, elcount(buffer), hFile);
	floatval = getSignal(CHASSIS::VehDyn_Stat2_AR2::VehYawRate_Raw);
	snprintf(buffer, elcount(buffer), "   0.000000 F1 ESP::VehDyn_Stat2_AR2::VehYawRate_Raw = %f\n", floatval);
	filePutString (buffer, elcount(buffer), hFile);
	intval = getSignal(CHASSIS::VehDyn_Stat2_AR2::SPCR_Style);
	snprintf(buffer, elcount(buffer), "   0.000000 F1 ESP::VehDyn_Stat2_AR2::SPCR_Style = %d\n", intval);
	filePutString (buffer, elcount(buffer), hFile);
	intval = getSignal(CHASSIS::VehDyn_Stat2_AR2::TxPkPosn_Rq_SPCR);
	snprintf(buffer, elcount(buffer), "   0.000000 F1 ESP::VehDyn_Stat2_AR2::TxPkPosn_Rq_SPCR = %d\n", intval);
	filePutString (buffer, elcount(buffer), hFile);
	intval = getSignal(CHASSIS::VehDyn_Stat2_AR2::SPCR_Veh_Immo);
	snprintf(buffer, elcount(buffer), "   0.000000 F1 ESP::VehDyn_Stat2_AR2::SPCR_Veh_Immo = %d\n", intval);
	filePutString (buffer, elcount(buffer), hFile);
	intval = getSignal(CHASSIS::VehDyn_Stat2_AR2::SPCR_AS_Off_Rq);
	snprintf(buffer, elcount(buffer), "   0.000000 F1 ESP::VehDyn_Stat2_AR2::SPCR_AS_Off_Rq = %d\n", intval);
	filePutString (buffer, elcount(buffer), hFile);
	intval = getSignal(CHASSIS::VehDyn_Stat2_AR2::SPCR_AS_Dsabl);
	snprintf(buffer, elcount(buffer), "   0.000000 F1 ESP::VehDyn_Stat2_AR2::SPCR_AS_Dsabl = %d\n", intval);
	filePutString (buffer, elcount(buffer), hFile);
	intval = getSignal(CHASSIS::VehDyn_Stat2_AR2::BrkTrq_R);
	snprintf(buffer, elcount(buffer), "   0.000000 F1 ESP::VehDyn_Stat2_AR2::BrkTrq_R = %d\n", intval);
	filePutString (buffer, elcount(buffer), hFile);
	intval = getSignal(CHASSIS::VehDyn_Stat2_AR2::HSA_Sys_Flt);
	snprintf(buffer, elcount(buffer), "   0.000000 F1 ESP::VehDyn_Stat2_AR2::HSA_Sys_Flt = %d\n", intval);
	filePutString (buffer, elcount(buffer), hFile);
	intval = getSignal(CHASSIS::VehDyn_Stat2_AR2::EPKB_Enbl_Rq);
	snprintf(buffer, elcount(buffer), "   0.000000 F1 ESP::VehDyn_Stat2_AR2::EPKB_Enbl_Rq = %d\n", intval);
	filePutString (buffer, elcount(buffer), hFile);
	intval = getSignal(CHASSIS::VehDyn_Stat2_AR2::PkBrk_Rq_SPCR);
	snprintf(buffer, elcount(buffer), "   0.000000 F1 ESP::VehDyn_Stat2_AR2::PkBrk_Rq_SPCR = %d\n", intval);
	filePutString (buffer, elcount(buffer), hFile);
	intval = @sysvar::CH_Nodes::CH_ESPCRC_VehSpd_X_Pr2VehSp_AUTO;
	snprintf(buffer, elcount(buffer), "   0.000000    SV: 2 0 0 ::CH_Nodes::CH_ESPCRC_VehSpd_X_Pr2VehSp_AUTO = %d\n", intval);
	filePutString (buffer, elcount(buffer), hFile);
	intval = getSignal(CHASSIS::VehSpd_X_AR2::CRC_VehSpd_X_Pr2);
	snprintf(buffer, elcount(buffer), "   0.000000 F1 ESP::VehSpd_X_AR2::CRC_VehSpd_X_Pr2 = %d\n", intval);
	filePutString (buffer, elcount(buffer), hFile);
	intval = @sysvar::CH_Nodes::CH_ESPSQC_VehSpd_X_Pr2VehSp_AUTO;
	snprintf(buffer, elcount(buffer), "   0.000000    SV: 2 0 0 ::CH_Nodes::CH_ESPSQC_VehSpd_X_Pr2VehSp_AUTO = %d\n", intval);
	filePutString (buffer, elcount(buffer), hFile);
	intval = getSignal(CHASSIS::VehSpd_X_AR2::SQC_VehSpd_X_Pr2);
	snprintf(buffer, elcount(buffer), "   0.000000 F1 ESP::VehSpd_X_AR2::SQC_VehSpd_X_Pr2 = %d\n", intval);
	filePutString (buffer, elcount(buffer), hFile);
	intval = getSignal(CHASSIS::VehSpd_X_AR2::VehSpd_X_Qual);
	snprintf(buffer, elcount(buffer), "   0.000000 F1 ESP::VehSpd_X_AR2::VehSpd_X_Qual = %d\n", intval);
	filePutString (buffer, elcount(buffer), hFile);
	intval = getSignal(CHASSIS::VehSpd_X_AR2::VehDrvDir_Stat);
	snprintf(buffer, elcount(buffer), "   0.000000 F1 ESP::VehSpd_X_AR2::VehDrvDir_Stat = %d\n", intval);
	filePutString (buffer, elcount(buffer), hFile);
	floatval = getSignal(CHASSIS::VehSpd_X_AR2::VehSpd_X_Min);
	snprintf(buffer, elcount(buffer), "   0.000000 F1 ESP::VehSpd_X_AR2::VehSpd_X_Min = %f\n", floatval);
	filePutString (buffer, elcount(buffer), hFile);
	floatval = getSignal(CHASSIS::VehSpd_X_AR2::VehSpd_X);
	snprintf(buffer, elcount(buffer), "   0.000000 F1 ESP::VehSpd_X_AR2::VehSpd_X = %f\n", floatval);
	filePutString (buffer, elcount(buffer), hFile);
	floatval = getSignal(CHASSIS::VehSpd_X_AR2::VehSpd_X_Max);
	snprintf(buffer, elcount(buffer), "   0.000000 F1 ESP::VehSpd_X_AR2::VehSpd_X_Max = %f\n", floatval);
	filePutString (buffer, elcount(buffer), hFile);
	intval = getSignal(CHASSIS::VehSpd_X_AR2::VehSp_Stat);
	snprintf(buffer, elcount(buffer), "   0.000000 F1 ESP::VehSpd_X_AR2::VehSp_Stat = %d\n", intval);
	filePutString (buffer, elcount(buffer), hFile);
	intval = getSignal(CHASSIS::VehSpd_X_AR2::Rsrv1_VehSpd_X_Pr2);
	snprintf(buffer, elcount(buffer), "   0.000000 F1 ESP::VehSpd_X_AR2::Rsrv1_VehSpd_X_Pr2 = %d\n", intval);
	filePutString (buffer, elcount(buffer), hFile);
	floatval = getSignal(CHASSIS::VehSpd_X_AR2::StWhl_Angl_CarvOffset);
	snprintf(buffer, elcount(buffer), "   0.000000 F1 ESP::VehSpd_X_AR2::StWhl_Angl_CarvOffset = %f\n", floatval);
	filePutString (buffer, elcount(buffer), hFile);
	intval = @sysvar::CH_Nodes::CH_ESPCRC_Whl_Lt_Stat_Pr2Wh_AUTO;
	snprintf(buffer, elcount(buffer), "   0.000000    SV: 2 0 0 ::CH_Nodes::CH_ESPCRC_Whl_Lt_Stat_Pr2Wh_AUTO = %d\n", intval);
	filePutString (buffer, elcount(buffer), hFile);
	intval = getSignal(CHASSIS::Whl_Lt_Stat_AR2::CRC_Whl_Lt_Stat_Pr2);
	snprintf(buffer, elcount(buffer), "   0.000000 F1 ESP::Whl_Lt_Stat_AR2::CRC_Whl_Lt_Stat_Pr2 = %d\n", intval);
	filePutString (buffer, elcount(buffer), hFile);
	intval = @sysvar::CH_Nodes::CH_ESPSQC_Whl_Lt_Stat_Pr2Wh_AUTO;
	snprintf(buffer, elcount(buffer), "   0.000000    SV: 2 0 0 ::CH_Nodes::CH_ESPSQC_Whl_Lt_Stat_Pr2Wh_AUTO = %d\n", intval);
	filePutString (buffer, elcount(buffer), hFile);
	intval = getSignal(CHASSIS::Whl_Lt_Stat_AR2::SQC_Whl_Lt_Stat_Pr2);
	snprintf(buffer, elcount(buffer), "   0.000000 F1 ESP::Whl_Lt_Stat_AR2::SQC_Whl_Lt_Stat_Pr2 = %d\n", intval);
	filePutString (buffer, elcount(buffer), hFile);
	intval = getSignal(CHASSIS::Whl_Lt_Stat_AR2::WhlRPM_FL_Qual);
	snprintf(buffer, elcount(buffer), "   0.000000 F1 ESP::Whl_Lt_Stat_AR2::WhlRPM_FL_Qual = %d\n", intval);
	filePutString (buffer, elcount(buffer), hFile);
	intval = getSignal(CHASSIS::Whl_Lt_Stat_AR2::WhlRPM_RL_Qual);
	snprintf(buffer, elcount(buffer), "   0.000000 F1 ESP::Whl_Lt_Stat_AR2::WhlRPM_RL_Qual = %d\n", intval);
	filePutString (buffer, elcount(buffer), hFile);
	floatval = getSignal(CHASSIS::Whl_Lt_Stat_AR2::WhlRPM_FL);
	snprintf(buffer, elcount(buffer), "   0.000000 F1 ESP::Whl_Lt_Stat_AR2::WhlRPM_FL = %f\n", floatval);
	filePutString (buffer, elcount(buffer), hFile);
	intval = getSignal(CHASSIS::Whl_Lt_Stat_AR2::WhlDir_FL_Stat);
	snprintf(buffer, elcount(buffer), "   0.000000 F1 ESP::Whl_Lt_Stat_AR2::WhlDir_FL_Stat = %d\n", intval);
	filePutString (buffer, elcount(buffer), hFile);
}
/*@@end*/

/*@@caplFunc:saveVars_69(dword):*/
void saveVars_69(dword hFile)
{
	snprintf(buffer, elcount(buffer), "   0.000000    SV: 2 0 0 ::CH_Nodes::CH__ESP_WhlPlsCnt_FL = %X\n", @sysvar::CH_Nodes::CH__ESP_WhlPlsCnt_FL);
	filePutString (buffer, elcount(buffer), hFile);
	floatval = getSignal(CHASSIS::Whl_Lt_Stat_AR2::WhlRPM_RL);
	snprintf(buffer, elcount(buffer), "   0.000000 F1 ESP::Whl_Lt_Stat_AR2::WhlRPM_RL = %f\n", floatval);
	filePutString (buffer, elcount(buffer), hFile);
	intval = getSignal(CHASSIS::Whl_Lt_Stat_AR2::WhlDir_RL_Stat);
	snprintf(buffer, elcount(buffer), "   0.000000 F1 ESP::Whl_Lt_Stat_AR2::WhlDir_RL_Stat = %d\n", intval);
	filePutString (buffer, elcount(buffer), hFile);
	snprintf(buffer, elcount(buffer), "   0.000000    SV: 2 0 0 ::CH_Nodes::CH__ESP_WhlPlsCnt_RL = %X\n", @sysvar::CH_Nodes::CH__ESP_WhlPlsCnt_RL);
	filePutString (buffer, elcount(buffer), hFile);
	intval = @sysvar::CH_Nodes::CH_ESPCRC_Whl_Rt_Stat_Pr2Wh_AUTO;
	snprintf(buffer, elcount(buffer), "   0.000000    SV: 2 0 0 ::CH_Nodes::CH_ESPCRC_Whl_Rt_Stat_Pr2Wh_AUTO = %d\n", intval);
	filePutString (buffer, elcount(buffer), hFile);
	intval = getSignal(CHASSIS::Whl_Rt_Stat_AR2::CRC_Whl_Rt_Stat_Pr2);
	snprintf(buffer, elcount(buffer), "   0.000000 F1 ESP::Whl_Rt_Stat_AR2::CRC_Whl_Rt_Stat_Pr2 = %d\n", intval);
	filePutString (buffer, elcount(buffer), hFile);
	intval = @sysvar::CH_Nodes::CH_ESPSQC_Whl_Rt_Stat_Pr2Wh_AUTO;
	snprintf(buffer, elcount(buffer), "   0.000000    SV: 2 0 0 ::CH_Nodes::CH_ESPSQC_Whl_Rt_Stat_Pr2Wh_AUTO = %d\n", intval);
	filePutString (buffer, elcount(buffer), hFile);
	intval = getSignal(CHASSIS::Whl_Rt_Stat_AR2::SQC_Whl_Rt_Stat_Pr2);
	snprintf(buffer, elcount(buffer), "   0.000000 F1 ESP::Whl_Rt_Stat_AR2::SQC_Whl_Rt_Stat_Pr2 = %d\n", intval);
	filePutString (buffer, elcount(buffer), hFile);
	intval = getSignal(CHASSIS::Whl_Rt_Stat_AR2::WhlRPM_FR_Qual);
	snprintf(buffer, elcount(buffer), "   0.000000 F1 ESP::Whl_Rt_Stat_AR2::WhlRPM_FR_Qual = %d\n", intval);
	filePutString (buffer, elcount(buffer), hFile);
	intval = getSignal(CHASSIS::Whl_Rt_Stat_AR2::WhlRPM_RR_Qual);
	snprintf(buffer, elcount(buffer), "   0.000000 F1 ESP::Whl_Rt_Stat_AR2::WhlRPM_RR_Qual = %d\n", intval);
	filePutString (buffer, elcount(buffer), hFile);
	floatval = getSignal(CHASSIS::Whl_Rt_Stat_AR2::WhlRPM_FR);
	snprintf(buffer, elcount(buffer), "   0.000000 F1 ESP::Whl_Rt_Stat_AR2::WhlRPM_FR = %f\n", floatval);
	filePutString (buffer, elcount(buffer), hFile);
	intval = getSignal(CHASSIS::Whl_Rt_Stat_AR2::WhlDir_FR_Stat);
	snprintf(buffer, elcount(buffer), "   0.000000 F1 ESP::Whl_Rt_Stat_AR2::WhlDir_FR_Stat = %d\n", intval);
	filePutString (buffer, elcount(buffer), hFile);
	snprintf(buffer, elcount(buffer), "   0.000000    SV: 2 0 0 ::CH_Nodes::CH__ESP_WhlPlsCnt_FR = %X\n", @sysvar::CH_Nodes::CH__ESP_WhlPlsCnt_FR);
	filePutString (buffer, elcount(buffer), hFile);
	floatval = getSignal(CHASSIS::Whl_Rt_Stat_AR2::WhlRPM_RR);
	snprintf(buffer, elcount(buffer), "   0.000000 F1 ESP::Whl_Rt_Stat_AR2::WhlRPM_RR = %f\n", floatval);
	filePutString (buffer, elcount(buffer), hFile);
	intval = getSignal(CHASSIS::Whl_Rt_Stat_AR2::WhlDir_RR_Stat);
	snprintf(buffer, elcount(buffer), "   0.000000 F1 ESP::Whl_Rt_Stat_AR2::WhlDir_RR_Stat = %d\n", intval);
	filePutString (buffer, elcount(buffer), hFile);
	snprintf(buffer, elcount(buffer), "   0.000000    SV: 2 0 0 ::CH_Nodes::CH__ESP_WhlPlsCnt_RR = %X\n", @sysvar::CH_Nodes::CH__ESP_WhlPlsCnt_RR);
	filePutString (buffer, elcount(buffer), hFile);
	intval = @sysvar::CH_Nodes::CH_ESPCRC_WhlPlsCnt_TPM_Pr2_AUTO;
	snprintf(buffer, elcount(buffer), "   0.000000    SV: 2 0 0 ::CH_Nodes::CH_ESPCRC_WhlPlsCnt_TPM_Pr2_AUTO = %d\n", intval);
	filePutString (buffer, elcount(buffer), hFile);
	intval = getSignal(CHASSIS::WhlPlsCnt_TPM_AR2::CRC_WhlPlsCnt_TPM_Pr2);
	snprintf(buffer, elcount(buffer), "   0.000000 F1 ESP::WhlPlsCnt_TPM_AR2::CRC_WhlPlsCnt_TPM_Pr2 = %d\n", intval);
	filePutString (buffer, elcount(buffer), hFile);
	intval = @sysvar::CH_Nodes::CH_ESPSQC_WhlPlsCnt_TPM_Pr2_AUTO;
	snprintf(buffer, elcount(buffer), "   0.000000    SV: 2 0 0 ::CH_Nodes::CH_ESPSQC_WhlPlsCnt_TPM_Pr2_AUTO = %d\n", intval);
	filePutString (buffer, elcount(buffer), hFile);
	intval = getSignal(CHASSIS::WhlPlsCnt_TPM_AR2::SQC_WhlPlsCnt_TPM_Pr2);
	snprintf(buffer, elcount(buffer), "   0.000000 F1 ESP::WhlPlsCnt_TPM_AR2::SQC_WhlPlsCnt_TPM_Pr2 = %d\n", intval);
	filePutString (buffer, elcount(buffer), hFile);
	intval = getSignal(CHASSIS::WhlPlsCnt_TPM_AR2::Rsrv1_WhlPlsCnt_TPM_Pr2);
	snprintf(buffer, elcount(buffer), "   0.000000 F1 ESP::WhlPlsCnt_TPM_AR2::Rsrv1_WhlPlsCnt_TPM_Pr2 = %d\n", intval);
	filePutString (buffer, elcount(buffer), hFile);
	intval = getSignal(CHASSIS::WhlPlsCnt_TPM_AR2::WhlPlsCnt_FL);
	snprintf(buffer, elcount(buffer), "   0.000000 F1 ESP::WhlPlsCnt_TPM_AR2::WhlPlsCnt_FL = %d\n", intval);
	filePutString (buffer, elcount(buffer), hFile);
	intval = getSignal(CHASSIS::WhlPlsCnt_TPM_AR2::WhlPlsCnt_FR);
	snprintf(buffer, elcount(buffer), "   0.000000 F1 ESP::WhlPlsCnt_TPM_AR2::WhlPlsCnt_FR = %d\n", intval);
	filePutString (buffer, elcount(buffer), hFile);
	intval = getSignal(CHASSIS::WhlPlsCnt_TPM_AR2::WhlPlsCnt_RL);
	snprintf(buffer, elcount(buffer), "   0.000000 F1 ESP::WhlPlsCnt_TPM_AR2::WhlPlsCnt_RL = %d\n", intval);
	filePutString (buffer, elcount(buffer), hFile);
	intval = getSignal(CHASSIS::WhlPlsCnt_TPM_AR2::WhlPlsCnt_RR);
	snprintf(buffer, elcount(buffer), "   0.000000 F1 ESP::WhlPlsCnt_TPM_AR2::WhlPlsCnt_RR = %d\n", intval);
	filePutString (buffer, elcount(buffer), hFile);
	intval = getSignal(CHASSIS::WhlPlsCnt_TPM_AR2::WhlPlsCnt_TmStmp);
	snprintf(buffer, elcount(buffer), "   0.000000 F1 ESP::WhlPlsCnt_TPM_AR2::WhlPlsCnt_TmStmp = %d\n", intval);
	filePutString (buffer, elcount(buffer), hFile);
	intval = getSignal(CHASSIS::WhlPlsCnt_TPM_AR2::Rsrv2_WhlPlsCnt_TPM_Pr2);
	snprintf(buffer, elcount(buffer), "   0.000000 F1 ESP::WhlPlsCnt_TPM_AR2::Rsrv2_WhlPlsCnt_TPM_Pr2 = %d\n", intval);
	filePutString (buffer, elcount(buffer), hFile);
	intval = getSignal(CHASSIS::WUDOP_ESP_FR::WUDOP_1_1);
	snprintf(buffer, elcount(buffer), "   0.000000 F1 ESP::WUDOP_ESP_FR::WUDOP_1_1 = %d\n", intval);
	filePutString (buffer, elcount(buffer), hFile);
	intval = getSignal(CHASSIS::WUDOP_ESP_FR::WUDOP_1_2);
	snprintf(buffer, elcount(buffer), "   0.000000 F1 ESP::WUDOP_ESP_FR::WUDOP_1_2 = %d\n", intval);
	filePutString (buffer, elcount(buffer), hFile);
	intval = getSignal(CHASSIS::WUDOP_ESP_FR::WUDOP_1_3);
	snprintf(buffer, elcount(buffer), "   0.000000 F1 ESP::WUDOP_ESP_FR::WUDOP_1_3 = %d\n", intval);
	filePutString (buffer, elcount(buffer), hFile);
	intval = getSignal(CHASSIS::WUDOP_ESP_FR::WUDOP_1_4);
	snprintf(buffer, elcount(buffer), "   0.000000 F1 ESP::WUDOP_ESP_FR::WUDOP_1_4 = %d\n", intval);
	filePutString (buffer, elcount(buffer), hFile);
	intval = getSignal(CHASSIS::WUDOP_ESP_FR::WUDOP_1_5);
	snprintf(buffer, elcount(buffer), "   0.000000 F1 ESP::WUDOP_ESP_FR::WUDOP_1_5 = %d\n", intval);
	filePutString (buffer, elcount(buffer), hFile);
	intval = getSignal(CHASSIS::WUDOP_ESP_FR::WUDOP_2_1);
	snprintf(buffer, elcount(buffer), "   0.000000 F1 ESP::WUDOP_ESP_FR::WUDOP_2_1 = %d\n", intval);
	filePutString (buffer, elcount(buffer), hFile);
	intval = getSignal(CHASSIS::WUDOP_ESP_FR::WUDOP_2_2);
	snprintf(buffer, elcount(buffer), "   0.000000 F1 ESP::WUDOP_ESP_FR::WUDOP_2_2 = %d\n", intval);
	filePutString (buffer, elcount(buffer), hFile);
	intval = getSignal(CHASSIS::WUDOP_ESP_FR::WUDOP_2_3);
	snprintf(buffer, elcount(buffer), "   0.000000 F1 ESP::WUDOP_ESP_FR::WUDOP_2_3 = %d\n", intval);
	filePutString (buffer, elcount(buffer), hFile);
	intval = getSignal(CHASSIS::WUDOP_ESP_FR::WUDOP_2_4);
	snprintf(buffer, elcount(buffer), "   0.000000 F1 ESP::WUDOP_ESP_FR::WUDOP_2_4 = %d\n", intval);
	filePutString (buffer, elcount(buffer), hFile);
	intval = getSignal(CHASSIS::WUDOP_ESP_FR::WUDOP_2_5);
	snprintf(buffer, elcount(buffer), "   0.000000 F1 ESP::WUDOP_ESP_FR::WUDOP_2_5 = %d\n", intval);
	filePutString (buffer, elcount(buffer), hFile);
	intval = getSignal(CHASSIS::WUDOP_ESP_FR::WUDOP_3_1);
	snprintf(buffer, elcount(buffer), "   0.000000 F1 ESP::WUDOP_ESP_FR::WUDOP_3_1 = %d\n", intval);
	filePutString (buffer, elcount(buffer), hFile);
	intval = getSignal(CHASSIS::WUDOP_ESP_FR::WUDOP_3_2);
	snprintf(buffer, elcount(buffer), "   0.000000 F1 ESP::WUDOP_ESP_FR::WUDOP_3_2 = %d\n", intval);
	filePutString (buffer, elcount(buffer), hFile);
	intval = getSignal(CHASSIS::WUDOP_ESP_FR::WUDOP_3_3);
	snprintf(buffer, elcount(buffer), "   0.000000 F1 ESP::WUDOP_ESP_FR::WUDOP_3_3 = %d\n", intval);
	filePutString (buffer, elcount(buffer), hFile);
	intval = getSignal(CHASSIS::WUDOP_ESP_FR::WUDOP_3_4);
	snprintf(buffer, elcount(buffer), "   0.000000 F1 ESP::WUDOP_ESP_FR::WUDOP_3_4 = %d\n", intval);
	filePutString (buffer, elcount(buffer), hFile);
	intval = getSignal(CHASSIS::WUDOP_ESP_FR::WUDOP_3_5);
	snprintf(buffer, elcount(buffer), "   0.000000 F1 ESP::WUDOP_ESP_FR::WUDOP_3_5 = %d\n", intval);
	filePutString (buffer, elcount(buffer), hFile);
	intval = getSignal(CHASSIS::WUDOP_ESP_FR::WUDOP_4_1);
	snprintf(buffer, elcount(buffer), "   0.000000 F1 ESP::WUDOP_ESP_FR::WUDOP_4_1 = %d\n", intval);
	filePutString (buffer, elcount(buffer), hFile);
	intval = getSignal(CHASSIS::WUDOP_ESP_FR::WUDOP_4_2);
	snprintf(buffer, elcount(buffer), "   0.000000 F1 ESP::WUDOP_ESP_FR::WUDOP_4_2 = %d\n", intval);
	filePutString (buffer, elcount(buffer), hFile);
	intval = getSignal(CHASSIS::WUDOP_ESP_FR::WUDOP_4_3);
	snprintf(buffer, elcount(buffer), "   0.000000 F1 ESP::WUDOP_ESP_FR::WUDOP_4_3 = %d\n", intval);
	filePutString (buffer, elcount(buffer), hFile);
	intval = getSignal(CHASSIS::WUDOP_ESP_FR::WUDOP_4_4);
	snprintf(buffer, elcount(buffer), "   0.000000 F1 ESP::WUDOP_ESP_FR::WUDOP_4_4 = %d\n", intval);
	filePutString (buffer, elcount(buffer), hFile);
	intval = getSignal(CHASSIS::WUDOP_ESP_FR::WUDOP_4_5);
	snprintf(buffer, elcount(buffer), "   0.000000 F1 ESP::WUDOP_ESP_FR::WUDOP_4_5 = %d\n", intval);
	filePutString (buffer, elcount(buffer), hFile);
	intval = getSignal(CHASSIS::WUDOP_ESP_FR::WUDOP_4_6);
	snprintf(buffer, elcount(buffer), "   0.000000 F1 ESP::WUDOP_ESP_FR::WUDOP_4_6 = %d\n", intval);
	filePutString (buffer, elcount(buffer), hFile);
	intval = @sysvar::CH_Nodes::CH_ESPCRC_YMAS_Rs_Pr2YMAS_R_AUTO;
	snprintf(buffer, elcount(buffer), "   0.000000    SV: 2 0 0 ::CH_Nodes::CH_ESPCRC_YMAS_Rs_Pr2YMAS_R_AUTO = %d\n", intval);
	filePutString (buffer, elcount(buffer), hFile);
	intval = getSignal(CHASSIS::YMAS_Rs_AR2::CRC_YMAS_Rs_Pr2);
	snprintf(buffer, elcount(buffer), "   0.000000 F1 ESP::YMAS_Rs_AR2::CRC_YMAS_Rs_Pr2 = %d\n", intval);
	filePutString (buffer, elcount(buffer), hFile);
	intval = @sysvar::CH_Nodes::CH_ESPSQC_YMAS_Rs_Pr2YMAS_R_AUTO;
	snprintf(buffer, elcount(buffer), "   0.000000    SV: 2 0 0 ::CH_Nodes::CH_ESPSQC_YMAS_Rs_Pr2YMAS_R_AUTO = %d\n", intval);
	filePutString (buffer, elcount(buffer), hFile);
	intval = getSignal(CHASSIS::YMAS_Rs_AR2::SQC_YMAS_Rs_Pr2);
	snprintf(buffer, elcount(buffer), "   0.000000 F1 ESP::YMAS_Rs_AR2::SQC_YMAS_Rs_Pr2 = %d\n", intval);
	filePutString (buffer, elcount(buffer), hFile);
	intval = getSignal(CHASSIS::YMAS_Rs_AR2::YMAS_Off_Rq);
	snprintf(buffer, elcount(buffer), "   0.000000 F1 ESP::YMAS_Rs_AR2::YMAS_Off_Rq = %d\n", intval);
	filePutString (buffer, elcount(buffer), hFile);
	intval = getSignal(CHASSIS::YMAS_Rs_AR2::BrkIntrvntn_Actv_YMAS);
	snprintf(buffer, elcount(buffer), "   0.000000 F1 ESP::YMAS_Rs_AR2::BrkIntrvntn_Actv_YMAS = %d\n", intval);
	filePutString (buffer, elcount(buffer), hFile);
	intval = getSignal(CHASSIS::YMAS_Rs_AR2::Rsrv1_YMAS_Rs_Pr2);
	snprintf(buffer, elcount(buffer), "   0.000000 F1 ESP::YMAS_Rs_AR2::Rsrv1_YMAS_Rs_Pr2 = %d\n", intval);
	filePutString (buffer, elcount(buffer), hFile);
	intval = getSignal(CHASSIS::YMAS_Rs_AR2::VehYawMoment_Ft);
	snprintf(buffer, elcount(buffer), "   0.000000 F1 ESP::YMAS_Rs_AR2::VehYawMoment_Ft = %d\n", intval);
	filePutString (buffer, elcount(buffer), hFile);
	intval = getSignal(CHASSIS::YMAS_Rs_AR2::VehYawMoment_R);
	snprintf(buffer, elcount(buffer), "   0.000000 F1 ESP::YMAS_Rs_AR2::VehYawMoment_R = %d\n", intval);
	filePutString (buffer, elcount(buffer), hFile);
}
/*@@end*/

/*@@caplFunc:saveVars_70(dword):*/
void saveVars_70(dword hFile)
{
	intval = getSignal(CHASSIS::YMAS_Rs_AR2::YMAS_UtilRatio_Y);
	snprintf(buffer, elcount(buffer), "   0.000000 F1 ESP::YMAS_Rs_AR2::YMAS_UtilRatio_Y = %d\n", intval);
	filePutString (buffer, elcount(buffer), hFile);
	intval = getSignal(CHASSIS::YMAS_Rs_AR2::YMAS_UtilRatio_Max);
	snprintf(buffer, elcount(buffer), "   0.000000 F1 ESP::YMAS_Rs_AR2::YMAS_UtilRatio_Max = %d\n", intval);
	filePutString (buffer, elcount(buffer), hFile);
	intval = getSignal(CHASSIS::YMAS_Rs_AR2::YMAS_UtilRatio_X);
	snprintf(buffer, elcount(buffer), "   0.000000 F1 ESP::YMAS_Rs_AR2::YMAS_UtilRatio_X = %d\n", intval);
	filePutString (buffer, elcount(buffer), hFile);
	snprintf(buffer, elcount(buffer), "   0.000000    SV: 2 0 0 ::CH_Nodes::CH__NMActive_FCW = %X\n", @sysvar::CH_Nodes::CH__NMActive_FCW);
	filePutString (buffer, elcount(buffer), hFile);
	snprintf(buffer, elcount(buffer), "   0.000000    SV: 2 0 0 ::CH_Nodes::CH__NMAwake_FCW = %X\n", @sysvar::CH_Nodes::CH__NMAwake_FCW);
	filePutString (buffer, elcount(buffer), hFile);
	intval = @sysvar::CH_Nodes::CH_FCWCRC_CMS_PI_Stat_Pr2CM_AUTO;
	snprintf(buffer, elcount(buffer), "   0.000000    SV: 2 0 0 ::CH_Nodes::CH_FCWCRC_CMS_PI_Stat_Pr2CM_AUTO = %d\n", intval);
	filePutString (buffer, elcount(buffer), hFile);
	intval = getSignal(CHASSIS::CMS_PI_State_AR2::CRC_CMS_PI_Stat_Pr2);
	snprintf(buffer, elcount(buffer), "   0.000000 F1 FCW::CMS_PI_State_AR2::CRC_CMS_PI_Stat_Pr2 = %d\n", intval);
	filePutString (buffer, elcount(buffer), hFile);
	intval = @sysvar::CH_Nodes::CH_FCWSQC_CMS_PI_Stat_Pr2CM_AUTO;
	snprintf(buffer, elcount(buffer), "   0.000000    SV: 2 0 0 ::CH_Nodes::CH_FCWSQC_CMS_PI_Stat_Pr2CM_AUTO = %d\n", intval);
	filePutString (buffer, elcount(buffer), hFile);
	intval = getSignal(CHASSIS::CMS_PI_State_AR2::SQC_CMS_PI_Stat_Pr2);
	snprintf(buffer, elcount(buffer), "   0.000000 F1 FCW::CMS_PI_State_AR2::SQC_CMS_PI_Stat_Pr2 = %d\n", intval);
	filePutString (buffer, elcount(buffer), hFile);
	intval = getSignal(CHASSIS::CMS_PI_State_AR2::PI_Enbl);
	snprintf(buffer, elcount(buffer), "   0.000000 F1 FCW::CMS_PI_State_AR2::PI_Enbl = %d\n", intval);
	filePutString (buffer, elcount(buffer), hFile);
	intval = getSignal(CHASSIS::CMS_PI_State_AR2::CMS_Brk_Rq_V2);
	snprintf(buffer, elcount(buffer), "   0.000000 F1 FCW::CMS_PI_State_AR2::CMS_Brk_Rq_V2 = %d\n", intval);
	filePutString (buffer, elcount(buffer), hFile);
	floatval = getSignal(CHASSIS::CMS_PI_State_AR2::CMS_VehDecel_Rq);
	snprintf(buffer, elcount(buffer), "   0.000000 F1 FCW::CMS_PI_State_AR2::CMS_VehDecel_Rq = %f\n", floatval);
	filePutString (buffer, elcount(buffer), hFile);
	floatval = getSignal(CHASSIS::CMS_PI_State_AR2::PI_Obj_R_RelSpd);
	snprintf(buffer, elcount(buffer), "   0.000000 F1 FCW::CMS_PI_State_AR2::PI_Obj_R_RelSpd = %f\n", floatval);
	filePutString (buffer, elcount(buffer), hFile);
	intval = getSignal(CHASSIS::CMS_PI_State_AR2::PI_TTI_R);
	snprintf(buffer, elcount(buffer), "   0.000000 F1 FCW::CMS_PI_State_AR2::PI_TTI_R = %d\n", intval);
	filePutString (buffer, elcount(buffer), hFile);
	intval = getSignal(CHASSIS::CMS_PI_State_AR2::CMS_R_Warn_Rq);
	snprintf(buffer, elcount(buffer), "   0.000000 F1 FCW::CMS_PI_State_AR2::CMS_R_Warn_Rq = %d\n", intval);
	filePutString (buffer, elcount(buffer), hFile);
	intval = getSignal(CHASSIS::CMS_PI_State_AR2::Rsrv1_CMS_PI_Stat_Pr2);
	snprintf(buffer, elcount(buffer), "   0.000000 F1 FCW::CMS_PI_State_AR2::Rsrv1_CMS_PI_Stat_Pr2 = %d\n", intval);
	filePutString (buffer, elcount(buffer), hFile);
	intval = getSignal(CHASSIS::CMS_PI_State_AR2::PI_RelsRcmmnd_R);
	snprintf(buffer, elcount(buffer), "   0.000000 F1 FCW::CMS_PI_State_AR2::PI_RelsRcmmnd_R = %d\n", intval);
	filePutString (buffer, elcount(buffer), hFile);
	intval = getSignal(CHASSIS::CMS_PI_State_AR2::PI_R_Enbl);
	snprintf(buffer, elcount(buffer), "   0.000000 F1 FCW::CMS_PI_State_AR2::PI_R_Enbl = %d\n", intval);
	filePutString (buffer, elcount(buffer), hFile);
	intval = getSignal(CHASSIS::CMS_PI_State_AR2::PI_RelsRcmmnd_Ft);
	snprintf(buffer, elcount(buffer), "   0.000000 F1 FCW::CMS_PI_State_AR2::PI_RelsRcmmnd_Ft = %d\n", intval);
	filePutString (buffer, elcount(buffer), hFile);
	intval = getSignal(CHASSIS::CMS_PI_State_AR2::PI_TTI_Ft);
	snprintf(buffer, elcount(buffer), "   0.000000 F1 FCW::CMS_PI_State_AR2::PI_TTI_Ft = %d\n", intval);
	filePutString (buffer, elcount(buffer), hFile);
	floatval = getSignal(CHASSIS::CMS_PI_State_AR2::PI_ObjAhdRelSpd);
	snprintf(buffer, elcount(buffer), "   0.000000 F1 FCW::CMS_PI_State_AR2::PI_ObjAhdRelSpd = %f\n", floatval);
	filePutString (buffer, elcount(buffer), hFile);
	intval = getSignal(CHASSIS::FCW_Disp_Rq_Gw_AR::FCW_IndLmp_On_Rq);
	snprintf(buffer, elcount(buffer), "   0.000000 F1 FCW::FCW_Disp_Rq_Gw_AR::FCW_IndLmp_On_Rq = %d\n", intval);
	filePutString (buffer, elcount(buffer), hFile);
	intval = getSignal(CHASSIS::FCW_Disp_Rq_Gw_AR::FCW_AcustWarn_Rq);
	snprintf(buffer, elcount(buffer), "   0.000000 F1 FCW::FCW_Disp_Rq_Gw_AR::FCW_AcustWarn_Rq = %d\n", intval);
	filePutString (buffer, elcount(buffer), hFile);
	intval = getSignal(CHASSIS::FCW_Disp_Rq_Gw_AR::FCW_Stat);
	snprintf(buffer, elcount(buffer), "   0.000000 F1 FCW::FCW_Disp_Rq_Gw_AR::FCW_Stat = %d\n", intval);
	filePutString (buffer, elcount(buffer), hFile);
	intval = getSignal(CHASSIS::FCW_Disp_Rq_Gw_AR::FCW_ObjIntrstDist);
	snprintf(buffer, elcount(buffer), "   0.000000 F1 FCW::FCW_Disp_Rq_Gw_AR::FCW_ObjIntrstDist = %d\n", intval);
	filePutString (buffer, elcount(buffer), hFile);
	intval = getSignal(CHASSIS::FCW_Disp_Rq_Gw_AR::FCW_ObjIntrstDist_SPEEDO1);
	snprintf(buffer, elcount(buffer), "   0.000000 F1 FCW::FCW_Disp_Rq_Gw_AR::FCW_ObjIntrstDist_SPEEDO1 = %d\n", intval);
	filePutString (buffer, elcount(buffer), hFile);
	intval = getSignal(CHASSIS::FCW_Disp_Rq_Gw_AR::FCW_ObjIntrstDist_SPEEDO2);
	snprintf(buffer, elcount(buffer), "   0.000000 F1 FCW::FCW_Disp_Rq_Gw_AR::FCW_ObjIntrstDist_SPEEDO2 = %d\n", intval);
	filePutString (buffer, elcount(buffer), hFile);
	intval = getSignal(CHASSIS::FCW_Disp_Rq_Gw_AR::FCW_MsgDisp_Rq);
	snprintf(buffer, elcount(buffer), "   0.000000 F1 FCW::FCW_Disp_Rq_Gw_AR::FCW_MsgDisp_Rq = %d\n", intval);
	filePutString (buffer, elcount(buffer), hFile);
	intval = getSignal(CHASSIS::FCW_Disp_Rq_Gw_AR::PN14_ElecPwr_Rq_AS);
	snprintf(buffer, elcount(buffer), "   0.000000 F1 FCW::FCW_Disp_Rq_Gw_AR::PN14_ElecPwr_Rq_AS = %d\n", intval);
	filePutString (buffer, elcount(buffer), hFile);
	intval = @sysvar::CH_Nodes::CH_FCWCRC_PT_ObjIntrst_Pr2P_AUTO;
	snprintf(buffer, elcount(buffer), "   0.000000    SV: 2 0 0 ::CH_Nodes::CH_FCWCRC_PT_ObjIntrst_Pr2P_AUTO = %d\n", intval);
	filePutString (buffer, elcount(buffer), hFile);
	intval = getSignal(CHASSIS::PT_ObjIntrst_AR2::CRC_PT_ObjIntrst_Pr2);
	snprintf(buffer, elcount(buffer), "   0.000000 F1 FCW::PT_ObjIntrst_AR2::CRC_PT_ObjIntrst_Pr2 = %d\n", intval);
	filePutString (buffer, elcount(buffer), hFile);
	intval = @sysvar::CH_Nodes::CH_FCWSQC_PT_ObjIntrst_Pr2P_AUTO;
	snprintf(buffer, elcount(buffer), "   0.000000    SV: 2 0 0 ::CH_Nodes::CH_FCWSQC_PT_ObjIntrst_Pr2P_AUTO = %d\n", intval);
	filePutString (buffer, elcount(buffer), hFile);
	intval = getSignal(CHASSIS::PT_ObjIntrst_AR2::SQC_PT_ObjIntrst_Pr2);
	snprintf(buffer, elcount(buffer), "   0.000000 F1 FCW::PT_ObjIntrst_AR2::SQC_PT_ObjIntrst_Pr2 = %d\n", intval);
	filePutString (buffer, elcount(buffer), hFile);
	intval = getSignal(CHASSIS::PT_ObjIntrst_AR2::PT_ObjIntrstType);
	snprintf(buffer, elcount(buffer), "   0.000000 F1 FCW::PT_ObjIntrst_AR2::PT_ObjIntrstType = %d\n", intval);
	filePutString (buffer, elcount(buffer), hFile);
	intval = getSignal(CHASSIS::PT_ObjIntrst_AR2::PT_ObjIntrstNew);
	snprintf(buffer, elcount(buffer), "   0.000000 F1 FCW::PT_ObjIntrst_AR2::PT_ObjIntrstNew = %d\n", intval);
	filePutString (buffer, elcount(buffer), hFile);
	floatval = getSignal(CHASSIS::PT_ObjIntrst_AR2::PT_ObjIntrstDist);
	snprintf(buffer, elcount(buffer), "   0.000000 F1 FCW::PT_ObjIntrst_AR2::PT_ObjIntrstDist = %f\n", floatval);
	filePutString (buffer, elcount(buffer), hFile);
	floatval = getSignal(CHASSIS::PT_ObjIntrst_AR2::PT_ObjIntrstRelSpd);
	snprintf(buffer, elcount(buffer), "   0.000000 F1 FCW::PT_ObjIntrst_AR2::PT_ObjIntrstRelSpd = %f\n", floatval);
	filePutString (buffer, elcount(buffer), hFile);
	intval = getSignal(CHASSIS::PT_ObjIntrst_AR2::PT_ObjIntrst_Flt);
	snprintf(buffer, elcount(buffer), "   0.000000 F1 FCW::PT_ObjIntrst_AR2::PT_ObjIntrst_Flt = %d\n", intval);
	filePutString (buffer, elcount(buffer), hFile);
	intval = getSignal(CHASSIS::PT_ObjIntrst_AR2::Rsrv1_PT_ObjIntrst_Pr2);
	snprintf(buffer, elcount(buffer), "   0.000000 F1 FCW::PT_ObjIntrst_AR2::Rsrv1_PT_ObjIntrst_Pr2 = %d\n", intval);
	filePutString (buffer, elcount(buffer), hFile);
	intval = getSignal(CHASSIS::RDU_Disp_Rq_AR::PN14_ElecPwr_Rq_AS);
	snprintf(buffer, elcount(buffer), "   0.000000 F1 FCW::RDU_Disp_Rq_AR::PN14_ElecPwr_Rq_AS = %d\n", intval);
	filePutString (buffer, elcount(buffer), hFile);
	intval = getSignal(CHASSIS::RDU_Disp_Rq_AR::LDC_Dist_Dsr_MsgDisp_Rq_RDU);
	snprintf(buffer, elcount(buffer), "   0.000000 F1 FCW::RDU_Disp_Rq_AR::LDC_Dist_Dsr_MsgDisp_Rq_RDU = %d\n", intval);
	filePutString (buffer, elcount(buffer), hFile);
	intval = getSignal(CHASSIS::RDU_Disp_Rq_AR::LDC_SLA_SpdLmtTkOvr_Stat);
	snprintf(buffer, elcount(buffer), "   0.000000 F1 FCW::RDU_Disp_Rq_AR::LDC_SLA_SpdLmtTkOvr_Stat = %d\n", intval);
	filePutString (buffer, elcount(buffer), hFile);
	intval = getSignal(CHASSIS::RDU_Disp_Rq_AR::LDC_SLA_SpdLmtTkOvr_Avl_Stat);
	snprintf(buffer, elcount(buffer), "   0.000000 F1 FCW::RDU_Disp_Rq_AR::LDC_SLA_SpdLmtTkOvr_Avl_Stat = %d\n", intval);
	filePutString (buffer, elcount(buffer), hFile);
	intval = getSignal(CHASSIS::RDU_Disp_Rq_AR::LDC_CMS_Md_Stat);
	snprintf(buffer, elcount(buffer), "   0.000000 F1 FCW::RDU_Disp_Rq_AR::LDC_CMS_Md_Stat = %d\n", intval);
	filePutString (buffer, elcount(buffer), hFile);
	intval = getSignal(CHASSIS::ROE_RDU::ROE_Header_RDU);
	snprintf(buffer, elcount(buffer), "   0.000000 F1 FCW::ROE_RDU::ROE_Header_RDU = %d\n", intval);
	filePutString (buffer, elcount(buffer), hFile);
	intval = getSignal(CHASSIS::ROE_RDU::ROE_DTC_RDU);
	snprintf(buffer, elcount(buffer), "   0.000000 F1 FCW::ROE_RDU::ROE_DTC_RDU = %d\n", intval);
	filePutString (buffer, elcount(buffer), hFile);
	intval = getSignal(CHASSIS::ROE_RDU::ROE_DTC_Stat_RDU);
	snprintf(buffer, elcount(buffer), "   0.000000 F1 FCW::ROE_RDU::ROE_DTC_Stat_RDU = %d\n", intval);
	filePutString (buffer, elcount(buffer), hFile);
	intval = @sysvar::CH_Nodes::CH_FCWCRC_SADR_Trgr_RDU_Pr2_AUTO;
	snprintf(buffer, elcount(buffer), "   0.000000    SV: 2 0 0 ::CH_Nodes::CH_FCWCRC_SADR_Trgr_RDU_Pr2_AUTO = %d\n", intval);
	filePutString (buffer, elcount(buffer), hFile);
	intval = getSignal(CHASSIS::SADR_Trgr_RDU_AR2::CRC_SADR_Trgr_RDU_Pr2);
	snprintf(buffer, elcount(buffer), "   0.000000 F1 FCW::SADR_Trgr_RDU_AR2::CRC_SADR_Trgr_RDU_Pr2 = %d\n", intval);
	filePutString (buffer, elcount(buffer), hFile);
	intval = @sysvar::CH_Nodes::CH_FCWSQC_SADR_Trgr_RDU_Pr2_AUTO;
	snprintf(buffer, elcount(buffer), "   0.000000    SV: 2 0 0 ::CH_Nodes::CH_FCWSQC_SADR_Trgr_RDU_Pr2_AUTO = %d\n", intval);
	filePutString (buffer, elcount(buffer), hFile);
	intval = getSignal(CHASSIS::SADR_Trgr_RDU_AR2::SQC_SADR_Trgr_RDU_Pr2);
	snprintf(buffer, elcount(buffer), "   0.000000 F1 FCW::SADR_Trgr_RDU_AR2::SQC_SADR_Trgr_RDU_Pr2 = %d\n", intval);
	filePutString (buffer, elcount(buffer), hFile);
	intval = getSignal(CHASSIS::SADR_Trgr_RDU_AR2::SADR_TrgrPrio_RDU);
	snprintf(buffer, elcount(buffer), "   0.000000 F1 FCW::SADR_Trgr_RDU_AR2::SADR_TrgrPrio_RDU = %d\n", intval);
	filePutString (buffer, elcount(buffer), hFile);
	intval = getSignal(CHASSIS::SADR_Trgr_RDU_AR2::Rsrv2_SADR_Trgr_RDU_Pr2);
	snprintf(buffer, elcount(buffer), "   0.000000 F1 FCW::SADR_Trgr_RDU_AR2::Rsrv2_SADR_Trgr_RDU_Pr2 = %d\n", intval);
	filePutString (buffer, elcount(buffer), hFile);
	intval = getSignal(CHASSIS::SADR_Trgr_RDU_AR2::SADR_TrgrTm_RDU);
	snprintf(buffer, elcount(buffer), "   0.000000 F1 FCW::SADR_Trgr_RDU_AR2::SADR_TrgrTm_RDU = %d\n", intval);
	filePutString (buffer, elcount(buffer), hFile);
	intval = getSignal(CHASSIS::SADR_Trgr_RDU_AR2::Rsrv1_SADR_Trgr_RDU_Pr2);
	snprintf(buffer, elcount(buffer), "   0.000000 F1 FCW::SADR_Trgr_RDU_AR2::Rsrv1_SADR_Trgr_RDU_Pr2 = %d\n", intval);
	filePutString (buffer, elcount(buffer), hFile);
	intval = @sysvar::CH_Nodes::CH_FCWCRC_VehAccel_X_Rq_Pr2_AUTO;
	snprintf(buffer, elcount(buffer), "   0.000000    SV: 2 0 0 ::CH_Nodes::CH_FCWCRC_VehAccel_X_Rq_Pr2_AUTO = %d\n", intval);
	filePutString (buffer, elcount(buffer), hFile);
	intval = getSignal(CHASSIS::VehAccel_X_Rq_AR2::CRC_VehAccel_X_Rq_Pr2);
	snprintf(buffer, elcount(buffer), "   0.000000 F1 FCW::VehAccel_X_Rq_AR2::CRC_VehAccel_X_Rq_Pr2 = %d\n", intval);
	filePutString (buffer, elcount(buffer), hFile);
	intval = @sysvar::CH_Nodes::CH_FCWSQC_VehAccel_X_Rq_Pr2_AUTO;
	snprintf(buffer, elcount(buffer), "   0.000000    SV: 2 0 0 ::CH_Nodes::CH_FCWSQC_VehAccel_X_Rq_Pr2_AUTO = %d\n", intval);
	filePutString (buffer, elcount(buffer), hFile);
	intval = getSignal(CHASSIS::VehAccel_X_Rq_AR2::SQC_VehAccel_X_Rq_Pr2);
	snprintf(buffer, elcount(buffer), "   0.000000 F1 FCW::VehAccel_X_Rq_AR2::SQC_VehAccel_X_Rq_Pr2 = %d\n", intval);
	filePutString (buffer, elcount(buffer), hFile);
}
/*@@end*/

/*@@caplFunc:saveVars_71(dword):*/
void saveVars_71(dword hFile)
{
	intval = getSignal(CHASSIS::VehAccel_X_Rq_AR2::VehAccel_X_Md_Rq);
	snprintf(buffer, elcount(buffer), "   0.000000 F1 FCW::VehAccel_X_Rq_AR2::VehAccel_X_Md_Rq = %d\n", intval);
	filePutString (buffer, elcount(buffer), hFile);
	intval = getSignal(CHASSIS::VehAccel_X_Rq_AR2::Rsrv2_VehAccel_X_Rq_Pr2);
	snprintf(buffer, elcount(buffer), "   0.000000 F1 FCW::VehAccel_X_Rq_AR2::Rsrv2_VehAccel_X_Rq_Pr2 = %d\n", intval);
	filePutString (buffer, elcount(buffer), hFile);
	floatval = getSignal(CHASSIS::VehAccel_X_Rq_AR2::VehAccel_X_Rq);
	snprintf(buffer, elcount(buffer), "   0.000000 F1 FCW::VehAccel_X_Rq_AR2::VehAccel_X_Rq = %f\n", floatval);
	filePutString (buffer, elcount(buffer), hFile);
	intval = getSignal(CHASSIS::VehAccel_X_Rq_AR2::ECU_Flt_Stat);
	snprintf(buffer, elcount(buffer), "   0.000000 F1 FCW::VehAccel_X_Rq_AR2::ECU_Flt_Stat = %d\n", intval);
	filePutString (buffer, elcount(buffer), hFile);
	floatval = getSignal(CHASSIS::VehAccel_X_Rq_AR2::VehAccel_X_Rq_Raw);
	snprintf(buffer, elcount(buffer), "   0.000000 F1 FCW::VehAccel_X_Rq_AR2::VehAccel_X_Rq_Raw = %f\n", floatval);
	filePutString (buffer, elcount(buffer), hFile);
	intval = getSignal(CHASSIS::VehAccel_X_Rq_AR2::AS_Actv_Ctrl_Stat);
	snprintf(buffer, elcount(buffer), "   0.000000 F1 FCW::VehAccel_X_Rq_AR2::AS_Actv_Ctrl_Stat = %d\n", intval);
	filePutString (buffer, elcount(buffer), hFile);
	intval = getSignal(CHASSIS::VehAccel_X_Rq_AR2::PwrFreeD_Supp_Rq_RDU);
	snprintf(buffer, elcount(buffer), "   0.000000 F1 FCW::VehAccel_X_Rq_AR2::PwrFreeD_Supp_Rq_RDU = %d\n", intval);
	filePutString (buffer, elcount(buffer), hFile);
	intval = getSignal(CHASSIS::VehAccel_X_Rq_AR2::BrkPrefill_Rq_RDU);
	snprintf(buffer, elcount(buffer), "   0.000000 F1 FCW::VehAccel_X_Rq_AR2::BrkPrefill_Rq_RDU = %d\n", intval);
	filePutString (buffer, elcount(buffer), hFile);
	intval = getSignal(CHASSIS::VehAccel_X_Rq_AR2::VehAccel_X_Rq_AS_Actv);
	snprintf(buffer, elcount(buffer), "   0.000000 F1 FCW::VehAccel_X_Rq_AR2::VehAccel_X_Rq_AS_Actv = %d\n", intval);
	filePutString (buffer, elcount(buffer), hFile);
	intval = getSignal(CHASSIS::VehAccel_X_Rq_AR2::AS_DrvAway_Rq);
	snprintf(buffer, elcount(buffer), "   0.000000 F1 FCW::VehAccel_X_Rq_AR2::AS_DrvAway_Rq = %d\n", intval);
	filePutString (buffer, elcount(buffer), hFile);
	intval = getSignal(CHASSIS::VehAccel_X_Rq_AR2::AS_VehSp_Rq);
	snprintf(buffer, elcount(buffer), "   0.000000 F1 FCW::VehAccel_X_Rq_AR2::AS_VehSp_Rq = %d\n", intval);
	filePutString (buffer, elcount(buffer), hFile);
	intval = getSignal(CHASSIS::VehAccel_X_Rq_AR2::SPCR_ErrEntry_Rq);
	snprintf(buffer, elcount(buffer), "   0.000000 F1 FCW::VehAccel_X_Rq_AR2::SPCR_ErrEntry_Rq = %d\n", intval);
	filePutString (buffer, elcount(buffer), hFile);
	intval = getSignal(CHASSIS::VehAccel_X_Rq_AR2::AS_SpdCtrl_Actv);
	snprintf(buffer, elcount(buffer), "   0.000000 F1 FCW::VehAccel_X_Rq_AR2::AS_SpdCtrl_Actv = %d\n", intval);
	filePutString (buffer, elcount(buffer), hFile);
	intval = getSignal(CHASSIS::VehAccel_X_Rq_AR2::AS_DistCtrl_Actv);
	snprintf(buffer, elcount(buffer), "   0.000000 F1 FCW::VehAccel_X_Rq_AR2::AS_DistCtrl_Actv = %d\n", intval);
	filePutString (buffer, elcount(buffer), hFile);
	intval = getSignal(CHASSIS::VehAccel_X_Rq_AR2::SSA_Enbl_Rq_RDU);
	snprintf(buffer, elcount(buffer), "   0.000000 F1 FCW::VehAccel_X_Rq_AR2::SSA_Enbl_Rq_RDU = %d\n", intval);
	filePutString (buffer, elcount(buffer), hFile);
	intval = getSignal(CHASSIS::VehAccel_X_Rq_AR2::AS_EV_Md_Rq);
	snprintf(buffer, elcount(buffer), "   0.000000 F1 FCW::VehAccel_X_Rq_AR2::AS_EV_Md_Rq = %d\n", intval);
	filePutString (buffer, elcount(buffer), hFile);
	intval = getSignal(CHASSIS::VehAccel_X_Rq_AR2::AS_DnShift_Dsabl_Rq);
	snprintf(buffer, elcount(buffer), "   0.000000 F1 FCW::VehAccel_X_Rq_AR2::AS_DnShift_Dsabl_Rq = %d\n", intval);
	filePutString (buffer, elcount(buffer), hFile);
	intval = getSignal(CHASSIS::VehAccel_X_Rq_AR2::AS_UpShift_Dsabl_Rq);
	snprintf(buffer, elcount(buffer), "   0.000000 F1 FCW::VehAccel_X_Rq_AR2::AS_UpShift_Dsabl_Rq = %d\n", intval);
	filePutString (buffer, elcount(buffer), hFile);
	intval = getSignal(CHASSIS::VehAccel_X_Rq_AR2::Rsrv1_VehAccel_X_Rq_Pr2);
	snprintf(buffer, elcount(buffer), "   0.000000 F1 FCW::VehAccel_X_Rq_AR2::Rsrv1_VehAccel_X_Rq_Pr2 = %d\n", intval);
	filePutString (buffer, elcount(buffer), hFile);
	snprintf(buffer, elcount(buffer), "   0.000000    SV: 2 0 0 ::CH_Nodes::CH__NMActive_LRR = %X\n", @sysvar::CH_Nodes::CH__NMActive_LRR);
	filePutString (buffer, elcount(buffer), hFile);
	snprintf(buffer, elcount(buffer), "   0.000000    SV: 2 0 0 ::CH_Nodes::CH__NMAwake_LRR = %X\n", @sysvar::CH_Nodes::CH__NMAwake_LRR);
	filePutString (buffer, elcount(buffer), hFile);
	intval = @sysvar::CH_Nodes::CH_LRRCRC_DTR_Obj_A_Pr2DTR__AUTO;
	snprintf(buffer, elcount(buffer), "   0.000000    SV: 2 0 0 ::CH_Nodes::CH_LRRCRC_DTR_Obj_A_Pr2DTR__AUTO = %d\n", intval);
	filePutString (buffer, elcount(buffer), hFile);
	intval = getSignal(CHASSIS::DTR_Obj_A_FR2::CRC_DTR_Obj_A_Pr2);
	snprintf(buffer, elcount(buffer), "   0.000000 F1 LRR::DTR_Obj_A_FR2::CRC_DTR_Obj_A_Pr2 = %d\n", intval);
	filePutString (buffer, elcount(buffer), hFile);
	intval = @sysvar::CH_Nodes::CH_LRRSQC_DTR_Obj_A_Pr2DTR__AUTO;
	snprintf(buffer, elcount(buffer), "   0.000000    SV: 2 0 0 ::CH_Nodes::CH_LRRSQC_DTR_Obj_A_Pr2DTR__AUTO = %d\n", intval);
	filePutString (buffer, elcount(buffer), hFile);
	intval = getSignal(CHASSIS::DTR_Obj_A_FR2::SQC_DTR_Obj_A_Pr2);
	snprintf(buffer, elcount(buffer), "   0.000000 F1 LRR::DTR_Obj_A_FR2::SQC_DTR_Obj_A_Pr2 = %d\n", intval);
	filePutString (buffer, elcount(buffer), hFile);
	intval = getSignal(CHASSIS::DTR_Obj_A_FR2::DTR_Obj_A_Class);
	snprintf(buffer, elcount(buffer), "   0.000000 F1 LRR::DTR_Obj_A_FR2::DTR_Obj_A_Class = %d\n", intval);
	filePutString (buffer, elcount(buffer), hFile);
	floatval = getSignal(CHASSIS::DTR_Obj_A_FR2::DTR_Obj_A_Dist_X);
	snprintf(buffer, elcount(buffer), "   0.000000 F1 LRR::DTR_Obj_A_FR2::DTR_Obj_A_Dist_X = %f\n", floatval);
	filePutString (buffer, elcount(buffer), hFile);
	intval = getSignal(CHASSIS::DTR_Obj_A_FR2::DTR_Obj_A_StdDev_Dist_X);
	snprintf(buffer, elcount(buffer), "   0.000000 F1 LRR::DTR_Obj_A_FR2::DTR_Obj_A_StdDev_Dist_X = %d\n", intval);
	filePutString (buffer, elcount(buffer), hFile);
	intval = getSignal(CHASSIS::DTR_Obj_A_FR2::DTR_Obj_A_StdDev_Dist_Y);
	snprintf(buffer, elcount(buffer), "   0.000000 F1 LRR::DTR_Obj_A_FR2::DTR_Obj_A_StdDev_Dist_Y = %d\n", intval);
	filePutString (buffer, elcount(buffer), hFile);
	floatval = getSignal(CHASSIS::DTR_Obj_A_FR2::DTR_Obj_A_Dist_Y);
	snprintf(buffer, elcount(buffer), "   0.000000 F1 LRR::DTR_Obj_A_FR2::DTR_Obj_A_Dist_Y = %f\n", floatval);
	filePutString (buffer, elcount(buffer), hFile);
	intval = getSignal(CHASSIS::DTR_Obj_A_FR2::DTR_Obj_A_StdDev_RelSpd_X);
	snprintf(buffer, elcount(buffer), "   0.000000 F1 LRR::DTR_Obj_A_FR2::DTR_Obj_A_StdDev_RelSpd_X = %d\n", intval);
	filePutString (buffer, elcount(buffer), hFile);
	intval = getSignal(CHASSIS::DTR_Obj_A_FR2::DTR_Obj_A_StdDev_RelSpd_Y);
	snprintf(buffer, elcount(buffer), "   0.000000 F1 LRR::DTR_Obj_A_FR2::DTR_Obj_A_StdDev_RelSpd_Y = %d\n", intval);
	filePutString (buffer, elcount(buffer), hFile);
	floatval = getSignal(CHASSIS::DTR_Obj_A_FR2::DTR_Obj_A_RelAccel_X);
	snprintf(buffer, elcount(buffer), "   0.000000 F1 LRR::DTR_Obj_A_FR2::DTR_Obj_A_RelAccel_X = %f\n", floatval);
	filePutString (buffer, elcount(buffer), hFile);
	intval = getSignal(CHASSIS::DTR_Obj_A_FR2::DTR_Obj_A_ID_MX);
	snprintf(buffer, elcount(buffer), "   0.000000 F1 LRR::DTR_Obj_A_FR2::DTR_Obj_A_ID_MX = %d\n", intval);
	filePutString (buffer, elcount(buffer), hFile);
	floatval = getSignal(CHASSIS::DTR_Obj_A_FR2::DTR_Obj_A_RelSpd_X);
	snprintf(buffer, elcount(buffer), "   0.000000 F1 LRR::DTR_Obj_A_FR2::DTR_Obj_A_RelSpd_X = %f\n", floatval);
	filePutString (buffer, elcount(buffer), hFile);
	intval = getSignal(CHASSIS::DTR_Obj_A_FR2::DTR_Obj_A_ObjPreSelect);
	snprintf(buffer, elcount(buffer), "   0.000000 F1 LRR::DTR_Obj_A_FR2::DTR_Obj_A_ObjPreSelect = %d\n", intval);
	filePutString (buffer, elcount(buffer), hFile);
	floatval = getSignal(CHASSIS::DTR_Obj_A_FR2::DTR_Obj_A_RelSpd_Y);
	snprintf(buffer, elcount(buffer), "   0.000000 F1 LRR::DTR_Obj_A_FR2::DTR_Obj_A_RelSpd_Y = %f\n", floatval);
	filePutString (buffer, elcount(buffer), hFile);
	intval = getSignal(CHASSIS::DTR_Obj_A_FR2::DTR_Obj_A_PedestFunc_Qual);
	snprintf(buffer, elcount(buffer), "   0.000000 F1 LRR::DTR_Obj_A_FR2::DTR_Obj_A_PedestFunc_Qual = %d\n", intval);
	filePutString (buffer, elcount(buffer), hFile);
	intval = getSignal(CHASSIS::DTR_Obj_A_FR2::DTR_Obj_A_LtrlFunc_Qual);
	snprintf(buffer, elcount(buffer), "   0.000000 F1 LRR::DTR_Obj_A_FR2::DTR_Obj_A_LtrlFunc_Qual = %d\n", intval);
	filePutString (buffer, elcount(buffer), hFile);
	intval = getSignal(CHASSIS::DTR_Obj_A_FR2::DTR_Obj_A_Lane_V2);
	snprintf(buffer, elcount(buffer), "   0.000000 F1 LRR::DTR_Obj_A_FR2::DTR_Obj_A_Lane_V2 = %d\n", intval);
	filePutString (buffer, elcount(buffer), hFile);
	intval = getSignal(CHASSIS::DTR_Obj_A_FR2::DTR_Obj_A_CrossFusion_Qual);
	snprintf(buffer, elcount(buffer), "   0.000000 F1 LRR::DTR_Obj_A_FR2::DTR_Obj_A_CrossFusion_Qual = %d\n", intval);
	filePutString (buffer, elcount(buffer), hFile);
	intval = getSignal(CHASSIS::DTR_Obj_A_FR2::DTR_Obj_A_ID_Cnt);
	snprintf(buffer, elcount(buffer), "   0.000000 F1 LRR::DTR_Obj_A_FR2::DTR_Obj_A_ID_Cnt = %d\n", intval);
	filePutString (buffer, elcount(buffer), hFile);
	intval = getSignal(CHASSIS::DTR_Obj_A_FR2::DTR_Obj_A_CutInLvl_v2);
	snprintf(buffer, elcount(buffer), "   0.000000 F1 LRR::DTR_Obj_A_FR2::DTR_Obj_A_CutInLvl_v2 = %d\n", intval);
	filePutString (buffer, elcount(buffer), hFile);
	intval = getSignal(CHASSIS::DTR_Obj_A_FR2::DTR_Obj_A_OrientAngl);
	snprintf(buffer, elcount(buffer), "   0.000000 F1 LRR::DTR_Obj_A_FR2::DTR_Obj_A_OrientAngl = %d\n", intval);
	filePutString (buffer, elcount(buffer), hFile);
	intval = getSignal(CHASSIS::DTR_Obj_A_FR2::DTR_Obj_A_OrientAngl_Flt);
	snprintf(buffer, elcount(buffer), "   0.000000 F1 LRR::DTR_Obj_A_FR2::DTR_Obj_A_OrientAngl_Flt = %d\n", intval);
	filePutString (buffer, elcount(buffer), hFile);
	intval = getSignal(CHASSIS::DTR_Obj_A_FR2::DTR_Obj_A_OrientMov);
	snprintf(buffer, elcount(buffer), "   0.000000 F1 LRR::DTR_Obj_A_FR2::DTR_Obj_A_OrientMov = %d\n", intval);
	filePutString (buffer, elcount(buffer), hFile);
	intval = getSignal(CHASSIS::DTR_Obj_A_FR2::DTR_Obj_A_PedestFusion_Qual);
	snprintf(buffer, elcount(buffer), "   0.000000 F1 LRR::DTR_Obj_A_FR2::DTR_Obj_A_PedestFusion_Qual = %d\n", intval);
	filePutString (buffer, elcount(buffer), hFile);
	intval = getSignal(CHASSIS::DTR_Obj_A_FR2::DTR_Obj_A_ObstclDtct);
	snprintf(buffer, elcount(buffer), "   0.000000 F1 LRR::DTR_Obj_A_FR2::DTR_Obj_A_ObstclDtct = %d\n", intval);
	filePutString (buffer, elcount(buffer), hFile);
	intval = getSignal(CHASSIS::DTR_Obj_A_FR2::DTR_Obj_A_CollisionFunc_Qual);
	snprintf(buffer, elcount(buffer), "   0.000000 F1 LRR::DTR_Obj_A_FR2::DTR_Obj_A_CollisionFunc_Qual = %d\n", intval);
	filePutString (buffer, elcount(buffer), hFile);
	intval = getSignal(CHASSIS::DTR_Obj_A_FR2::DTR_Obj_A_ObsrvHistory);
	snprintf(buffer, elcount(buffer), "   0.000000 F1 LRR::DTR_Obj_A_FR2::DTR_Obj_A_ObsrvHistory = %d\n", intval);
	filePutString (buffer, elcount(buffer), hFile);
	intval = getSignal(CHASSIS::DTR_Obj_A_FR2::DTR_Obj_A_LineLngth);
	snprintf(buffer, elcount(buffer), "   0.000000 F1 LRR::DTR_Obj_A_FR2::DTR_Obj_A_LineLngth = %d\n", intval);
	filePutString (buffer, elcount(buffer), hFile);
	intval = getSignal(CHASSIS::DTR_Obj_A_FR2::DTR_Obj_A_LineOffset);
	snprintf(buffer, elcount(buffer), "   0.000000 F1 LRR::DTR_Obj_A_FR2::DTR_Obj_A_LineOffset = %d\n", intval);
	filePutString (buffer, elcount(buffer), hFile);
	intval = getSignal(CHASSIS::DTR_Obj_A_FR2::DTR_Obj_A_LongFunc_Qual);
	snprintf(buffer, elcount(buffer), "   0.000000 F1 LRR::DTR_Obj_A_FR2::DTR_Obj_A_LongFunc_Qual = %d\n", intval);
	filePutString (buffer, elcount(buffer), hFile);
}
/*@@end*/

/*@@caplFunc:saveVars_72(dword):*/
void saveVars_72(dword hFile)
{
	intval = getSignal(CHASSIS::DTR_Obj_A_FR2::DTR_Obj_A_LongFusion_Qual);
	snprintf(buffer, elcount(buffer), "   0.000000 F1 LRR::DTR_Obj_A_FR2::DTR_Obj_A_LongFusion_Qual = %d\n", intval);
	filePutString (buffer, elcount(buffer), hFile);
	intval = getSignal(CHASSIS::DTR_Obj_A_FR2::DTR_Obj_A_LineOrient);
	snprintf(buffer, elcount(buffer), "   0.000000 F1 LRR::DTR_Obj_A_FR2::DTR_Obj_A_LineOrient = %d\n", intval);
	filePutString (buffer, elcount(buffer), hFile);
	intval = getSignal(CHASSIS::DTR_Obj_A_FR2::DTR_Obj_A_LaneRangeLimit);
	snprintf(buffer, elcount(buffer), "   0.000000 F1 LRR::DTR_Obj_A_FR2::DTR_Obj_A_LaneRangeLimit = %d\n", intval);
	filePutString (buffer, elcount(buffer), hFile);
	intval = getSignal(CHASSIS::DTR_Obj_A_FR2::DTR_Obj_A_LaneDistTime);
	snprintf(buffer, elcount(buffer), "   0.000000 F1 LRR::DTR_Obj_A_FR2::DTR_Obj_A_LaneDistTime = %d\n", intval);
	filePutString (buffer, elcount(buffer), hFile);
	intval = getSignal(CHASSIS::DTR_Obj_A_FR2::DTR_Obj_A_Collision_Ovrlp);
	snprintf(buffer, elcount(buffer), "   0.000000 F1 LRR::DTR_Obj_A_FR2::DTR_Obj_A_Collision_Ovrlp = %d\n", intval);
	filePutString (buffer, elcount(buffer), hFile);
	floatval = getSignal(CHASSIS::DTR_Obj_A_FR2::DTR_Obj_A_RCS_V2);
	snprintf(buffer, elcount(buffer), "   0.000000 F1 LRR::DTR_Obj_A_FR2::DTR_Obj_A_RCS_V2 = %f\n", floatval);
	filePutString (buffer, elcount(buffer), hFile);
	intval = @sysvar::CH_Nodes::CH_LRRCRC_DTR_Obj_B_Pr2DTR__AUTO;
	snprintf(buffer, elcount(buffer), "   0.000000    SV: 2 0 0 ::CH_Nodes::CH_LRRCRC_DTR_Obj_B_Pr2DTR__AUTO = %d\n", intval);
	filePutString (buffer, elcount(buffer), hFile);
	intval = getSignal(CHASSIS::DTR_Obj_B_FR2::CRC_DTR_Obj_B_Pr2);
	snprintf(buffer, elcount(buffer), "   0.000000 F1 LRR::DTR_Obj_B_FR2::CRC_DTR_Obj_B_Pr2 = %d\n", intval);
	filePutString (buffer, elcount(buffer), hFile);
	intval = @sysvar::CH_Nodes::CH_LRRSQC_DTR_Obj_B_Pr2DTR__AUTO;
	snprintf(buffer, elcount(buffer), "   0.000000    SV: 2 0 0 ::CH_Nodes::CH_LRRSQC_DTR_Obj_B_Pr2DTR__AUTO = %d\n", intval);
	filePutString (buffer, elcount(buffer), hFile);
	intval = getSignal(CHASSIS::DTR_Obj_B_FR2::SQC_DTR_Obj_B_Pr2);
	snprintf(buffer, elcount(buffer), "   0.000000 F1 LRR::DTR_Obj_B_FR2::SQC_DTR_Obj_B_Pr2 = %d\n", intval);
	filePutString (buffer, elcount(buffer), hFile);
	intval = getSignal(CHASSIS::DTR_Obj_B_FR2::DTR_Obj_B_Class);
	snprintf(buffer, elcount(buffer), "   0.000000 F1 LRR::DTR_Obj_B_FR2::DTR_Obj_B_Class = %d\n", intval);
	filePutString (buffer, elcount(buffer), hFile);
	floatval = getSignal(CHASSIS::DTR_Obj_B_FR2::DTR_Obj_B_Dist_X);
	snprintf(buffer, elcount(buffer), "   0.000000 F1 LRR::DTR_Obj_B_FR2::DTR_Obj_B_Dist_X = %f\n", floatval);
	filePutString (buffer, elcount(buffer), hFile);
	intval = getSignal(CHASSIS::DTR_Obj_B_FR2::DTR_Obj_B_StdDev_Dist_X);
	snprintf(buffer, elcount(buffer), "   0.000000 F1 LRR::DTR_Obj_B_FR2::DTR_Obj_B_StdDev_Dist_X = %d\n", intval);
	filePutString (buffer, elcount(buffer), hFile);
	intval = getSignal(CHASSIS::DTR_Obj_B_FR2::DTR_Obj_B_StdDev_Dist_Y);
	snprintf(buffer, elcount(buffer), "   0.000000 F1 LRR::DTR_Obj_B_FR2::DTR_Obj_B_StdDev_Dist_Y = %d\n", intval);
	filePutString (buffer, elcount(buffer), hFile);
	floatval = getSignal(CHASSIS::DTR_Obj_B_FR2::DTR_Obj_B_Dist_Y);
	snprintf(buffer, elcount(buffer), "   0.000000 F1 LRR::DTR_Obj_B_FR2::DTR_Obj_B_Dist_Y = %f\n", floatval);
	filePutString (buffer, elcount(buffer), hFile);
	intval = getSignal(CHASSIS::DTR_Obj_B_FR2::DTR_Obj_B_StdDev_RelSpd_X);
	snprintf(buffer, elcount(buffer), "   0.000000 F1 LRR::DTR_Obj_B_FR2::DTR_Obj_B_StdDev_RelSpd_X = %d\n", intval);
	filePutString (buffer, elcount(buffer), hFile);
	intval = getSignal(CHASSIS::DTR_Obj_B_FR2::DTR_Obj_B_StdDev_RelSpd_Y);
	snprintf(buffer, elcount(buffer), "   0.000000 F1 LRR::DTR_Obj_B_FR2::DTR_Obj_B_StdDev_RelSpd_Y = %d\n", intval);
	filePutString (buffer, elcount(buffer), hFile);
	floatval = getSignal(CHASSIS::DTR_Obj_B_FR2::DTR_Obj_B_RelAccel_X);
	snprintf(buffer, elcount(buffer), "   0.000000 F1 LRR::DTR_Obj_B_FR2::DTR_Obj_B_RelAccel_X = %f\n", floatval);
	filePutString (buffer, elcount(buffer), hFile);
	intval = getSignal(CHASSIS::DTR_Obj_B_FR2::DTR_Obj_B_ID_MX);
	snprintf(buffer, elcount(buffer), "   0.000000 F1 LRR::DTR_Obj_B_FR2::DTR_Obj_B_ID_MX = %d\n", intval);
	filePutString (buffer, elcount(buffer), hFile);
	floatval = getSignal(CHASSIS::DTR_Obj_B_FR2::DTR_Obj_B_RelSpd_X);
	snprintf(buffer, elcount(buffer), "   0.000000 F1 LRR::DTR_Obj_B_FR2::DTR_Obj_B_RelSpd_X = %f\n", floatval);
	filePutString (buffer, elcount(buffer), hFile);
	intval = getSignal(CHASSIS::DTR_Obj_B_FR2::DTR_Obj_B_ObjPreSelect);
	snprintf(buffer, elcount(buffer), "   0.000000 F1 LRR::DTR_Obj_B_FR2::DTR_Obj_B_ObjPreSelect = %d\n", intval);
	filePutString (buffer, elcount(buffer), hFile);
	floatval = getSignal(CHASSIS::DTR_Obj_B_FR2::DTR_Obj_B_RelSpd_Y);
	snprintf(buffer, elcount(buffer), "   0.000000 F1 LRR::DTR_Obj_B_FR2::DTR_Obj_B_RelSpd_Y = %f\n", floatval);
	filePutString (buffer, elcount(buffer), hFile);
	intval = getSignal(CHASSIS::DTR_Obj_B_FR2::DTR_Obj_B_PedestFunc_Qual);
	snprintf(buffer, elcount(buffer), "   0.000000 F1 LRR::DTR_Obj_B_FR2::DTR_Obj_B_PedestFunc_Qual = %d\n", intval);
	filePutString (buffer, elcount(buffer), hFile);
	intval = getSignal(CHASSIS::DTR_Obj_B_FR2::DTR_Obj_B_LtrlFunc_Qual);
	snprintf(buffer, elcount(buffer), "   0.000000 F1 LRR::DTR_Obj_B_FR2::DTR_Obj_B_LtrlFunc_Qual = %d\n", intval);
	filePutString (buffer, elcount(buffer), hFile);
	intval = getSignal(CHASSIS::DTR_Obj_B_FR2::DTR_Obj_B_Lane_V2);
	snprintf(buffer, elcount(buffer), "   0.000000 F1 LRR::DTR_Obj_B_FR2::DTR_Obj_B_Lane_V2 = %d\n", intval);
	filePutString (buffer, elcount(buffer), hFile);
	intval = getSignal(CHASSIS::DTR_Obj_B_FR2::DTR_Obj_B_CrossFusion_Qual);
	snprintf(buffer, elcount(buffer), "   0.000000 F1 LRR::DTR_Obj_B_FR2::DTR_Obj_B_CrossFusion_Qual = %d\n", intval);
	filePutString (buffer, elcount(buffer), hFile);
	intval = getSignal(CHASSIS::DTR_Obj_B_FR2::DTR_Obj_B_ID_Cnt);
	snprintf(buffer, elcount(buffer), "   0.000000 F1 LRR::DTR_Obj_B_FR2::DTR_Obj_B_ID_Cnt = %d\n", intval);
	filePutString (buffer, elcount(buffer), hFile);
	intval = getSignal(CHASSIS::DTR_Obj_B_FR2::DTR_Obj_B_CutInLvl_v2);
	snprintf(buffer, elcount(buffer), "   0.000000 F1 LRR::DTR_Obj_B_FR2::DTR_Obj_B_CutInLvl_v2 = %d\n", intval);
	filePutString (buffer, elcount(buffer), hFile);
	intval = getSignal(CHASSIS::DTR_Obj_B_FR2::DTR_Obj_B_OrientAngl);
	snprintf(buffer, elcount(buffer), "   0.000000 F1 LRR::DTR_Obj_B_FR2::DTR_Obj_B_OrientAngl = %d\n", intval);
	filePutString (buffer, elcount(buffer), hFile);
	intval = getSignal(CHASSIS::DTR_Obj_B_FR2::DTR_Obj_B_OrientAngl_Flt);
	snprintf(buffer, elcount(buffer), "   0.000000 F1 LRR::DTR_Obj_B_FR2::DTR_Obj_B_OrientAngl_Flt = %d\n", intval);
	filePutString (buffer, elcount(buffer), hFile);
	intval = getSignal(CHASSIS::DTR_Obj_B_FR2::DTR_Obj_B_OrientMov);
	snprintf(buffer, elcount(buffer), "   0.000000 F1 LRR::DTR_Obj_B_FR2::DTR_Obj_B_OrientMov = %d\n", intval);
	filePutString (buffer, elcount(buffer), hFile);
	intval = getSignal(CHASSIS::DTR_Obj_B_FR2::DTR_Obj_B_PedestFusion_Qual);
	snprintf(buffer, elcount(buffer), "   0.000000 F1 LRR::DTR_Obj_B_FR2::DTR_Obj_B_PedestFusion_Qual = %d\n", intval);
	filePutString (buffer, elcount(buffer), hFile);
	intval = getSignal(CHASSIS::DTR_Obj_B_FR2::DTR_Obj_B_ObstclDtct);
	snprintf(buffer, elcount(buffer), "   0.000000 F1 LRR::DTR_Obj_B_FR2::DTR_Obj_B_ObstclDtct = %d\n", intval);
	filePutString (buffer, elcount(buffer), hFile);
	intval = getSignal(CHASSIS::DTR_Obj_B_FR2::DTR_Obj_B_CollisionFunc_Qual);
	snprintf(buffer, elcount(buffer), "   0.000000 F1 LRR::DTR_Obj_B_FR2::DTR_Obj_B_CollisionFunc_Qual = %d\n", intval);
	filePutString (buffer, elcount(buffer), hFile);
	intval = getSignal(CHASSIS::DTR_Obj_B_FR2::DTR_Obj_B_ObsrvHistory);
	snprintf(buffer, elcount(buffer), "   0.000000 F1 LRR::DTR_Obj_B_FR2::DTR_Obj_B_ObsrvHistory = %d\n", intval);
	filePutString (buffer, elcount(buffer), hFile);
	intval = getSignal(CHASSIS::DTR_Obj_B_FR2::DTR_Obj_B_LineLngth);
	snprintf(buffer, elcount(buffer), "   0.000000 F1 LRR::DTR_Obj_B_FR2::DTR_Obj_B_LineLngth = %d\n", intval);
	filePutString (buffer, elcount(buffer), hFile);
	intval = getSignal(CHASSIS::DTR_Obj_B_FR2::DTR_Obj_B_LineOffset);
	snprintf(buffer, elcount(buffer), "   0.000000 F1 LRR::DTR_Obj_B_FR2::DTR_Obj_B_LineOffset = %d\n", intval);
	filePutString (buffer, elcount(buffer), hFile);
	intval = getSignal(CHASSIS::DTR_Obj_B_FR2::DTR_Obj_B_LongFunc_Qual);
	snprintf(buffer, elcount(buffer), "   0.000000 F1 LRR::DTR_Obj_B_FR2::DTR_Obj_B_LongFunc_Qual = %d\n", intval);
	filePutString (buffer, elcount(buffer), hFile);
	intval = getSignal(CHASSIS::DTR_Obj_B_FR2::DTR_Obj_B_LongFusion_Qual);
	snprintf(buffer, elcount(buffer), "   0.000000 F1 LRR::DTR_Obj_B_FR2::DTR_Obj_B_LongFusion_Qual = %d\n", intval);
	filePutString (buffer, elcount(buffer), hFile);
	intval = getSignal(CHASSIS::DTR_Obj_B_FR2::DTR_Obj_B_LineOrient);
	snprintf(buffer, elcount(buffer), "   0.000000 F1 LRR::DTR_Obj_B_FR2::DTR_Obj_B_LineOrient = %d\n", intval);
	filePutString (buffer, elcount(buffer), hFile);
	intval = getSignal(CHASSIS::DTR_Obj_B_FR2::DTR_Obj_B_LaneRangeLimit);
	snprintf(buffer, elcount(buffer), "   0.000000 F1 LRR::DTR_Obj_B_FR2::DTR_Obj_B_LaneRangeLimit = %d\n", intval);
	filePutString (buffer, elcount(buffer), hFile);
	intval = getSignal(CHASSIS::DTR_Obj_B_FR2::DTR_Obj_B_LaneDistTime);
	snprintf(buffer, elcount(buffer), "   0.000000 F1 LRR::DTR_Obj_B_FR2::DTR_Obj_B_LaneDistTime = %d\n", intval);
	filePutString (buffer, elcount(buffer), hFile);
	intval = getSignal(CHASSIS::DTR_Obj_B_FR2::DTR_Obj_B_Collision_Ovrlp);
	snprintf(buffer, elcount(buffer), "   0.000000 F1 LRR::DTR_Obj_B_FR2::DTR_Obj_B_Collision_Ovrlp = %d\n", intval);
	filePutString (buffer, elcount(buffer), hFile);
	floatval = getSignal(CHASSIS::DTR_Obj_B_FR2::DTR_Obj_B_RCS_V2);
	snprintf(buffer, elcount(buffer), "   0.000000 F1 LRR::DTR_Obj_B_FR2::DTR_Obj_B_RCS_V2 = %f\n", floatval);
	filePutString (buffer, elcount(buffer), hFile);
	intval = @sysvar::CH_Nodes::CH_LRRCRC_DTR_Obj_C_Pr2DTR__AUTO;
	snprintf(buffer, elcount(buffer), "   0.000000    SV: 2 0 0 ::CH_Nodes::CH_LRRCRC_DTR_Obj_C_Pr2DTR__AUTO = %d\n", intval);
	filePutString (buffer, elcount(buffer), hFile);
	intval = getSignal(CHASSIS::DTR_Obj_C_FR2::CRC_DTR_Obj_C_Pr2);
	snprintf(buffer, elcount(buffer), "   0.000000 F1 LRR::DTR_Obj_C_FR2::CRC_DTR_Obj_C_Pr2 = %d\n", intval);
	filePutString (buffer, elcount(buffer), hFile);
	intval = @sysvar::CH_Nodes::CH_LRRSQC_DTR_Obj_C_Pr2DTR__AUTO;
	snprintf(buffer, elcount(buffer), "   0.000000    SV: 2 0 0 ::CH_Nodes::CH_LRRSQC_DTR_Obj_C_Pr2DTR__AUTO = %d\n", intval);
	filePutString (buffer, elcount(buffer), hFile);
	intval = getSignal(CHASSIS::DTR_Obj_C_FR2::SQC_DTR_Obj_C_Pr2);
	snprintf(buffer, elcount(buffer), "   0.000000 F1 LRR::DTR_Obj_C_FR2::SQC_DTR_Obj_C_Pr2 = %d\n", intval);
	filePutString (buffer, elcount(buffer), hFile);
	intval = getSignal(CHASSIS::DTR_Obj_C_FR2::DTR_Obj_C_Class);
	snprintf(buffer, elcount(buffer), "   0.000000 F1 LRR::DTR_Obj_C_FR2::DTR_Obj_C_Class = %d\n", intval);
	filePutString (buffer, elcount(buffer), hFile);
	floatval = getSignal(CHASSIS::DTR_Obj_C_FR2::DTR_Obj_C_Dist_X);
	snprintf(buffer, elcount(buffer), "   0.000000 F1 LRR::DTR_Obj_C_FR2::DTR_Obj_C_Dist_X = %f\n", floatval);
	filePutString (buffer, elcount(buffer), hFile);
	intval = getSignal(CHASSIS::DTR_Obj_C_FR2::DTR_Obj_C_StdDev_Dist_X);
	snprintf(buffer, elcount(buffer), "   0.000000 F1 LRR::DTR_Obj_C_FR2::DTR_Obj_C_StdDev_Dist_X = %d\n", intval);
	filePutString (buffer, elcount(buffer), hFile);
	intval = getSignal(CHASSIS::DTR_Obj_C_FR2::DTR_Obj_C_StdDev_Dist_Y);
	snprintf(buffer, elcount(buffer), "   0.000000 F1 LRR::DTR_Obj_C_FR2::DTR_Obj_C_StdDev_Dist_Y = %d\n", intval);
	filePutString (buffer, elcount(buffer), hFile);
	floatval = getSignal(CHASSIS::DTR_Obj_C_FR2::DTR_Obj_C_Dist_Y);
	snprintf(buffer, elcount(buffer), "   0.000000 F1 LRR::DTR_Obj_C_FR2::DTR_Obj_C_Dist_Y = %f\n", floatval);
	filePutString (buffer, elcount(buffer), hFile);
	intval = getSignal(CHASSIS::DTR_Obj_C_FR2::DTR_Obj_C_StdDev_RelSpd_X);
	snprintf(buffer, elcount(buffer), "   0.000000 F1 LRR::DTR_Obj_C_FR2::DTR_Obj_C_StdDev_RelSpd_X = %d\n", intval);
	filePutString (buffer, elcount(buffer), hFile);
	intval = getSignal(CHASSIS::DTR_Obj_C_FR2::DTR_Obj_C_StdDev_RelSpd_Y);
	snprintf(buffer, elcount(buffer), "   0.000000 F1 LRR::DTR_Obj_C_FR2::DTR_Obj_C_StdDev_RelSpd_Y = %d\n", intval);
	filePutString (buffer, elcount(buffer), hFile);
}
/*@@end*/

/*@@caplFunc:saveVars_73(dword):*/
void saveVars_73(dword hFile)
{
	floatval = getSignal(CHASSIS::DTR_Obj_C_FR2::DTR_Obj_C_RelAccel_X);
	snprintf(buffer, elcount(buffer), "   0.000000 F1 LRR::DTR_Obj_C_FR2::DTR_Obj_C_RelAccel_X = %f\n", floatval);
	filePutString (buffer, elcount(buffer), hFile);
	intval = getSignal(CHASSIS::DTR_Obj_C_FR2::DTR_Obj_C_ID_MX);
	snprintf(buffer, elcount(buffer), "   0.000000 F1 LRR::DTR_Obj_C_FR2::DTR_Obj_C_ID_MX = %d\n", intval);
	filePutString (buffer, elcount(buffer), hFile);
	floatval = getSignal(CHASSIS::DTR_Obj_C_FR2::DTR_Obj_C_RelSpd_X);
	snprintf(buffer, elcount(buffer), "   0.000000 F1 LRR::DTR_Obj_C_FR2::DTR_Obj_C_RelSpd_X = %f\n", floatval);
	filePutString (buffer, elcount(buffer), hFile);
	intval = getSignal(CHASSIS::DTR_Obj_C_FR2::DTR_Obj_C_ObjPreSelect);
	snprintf(buffer, elcount(buffer), "   0.000000 F1 LRR::DTR_Obj_C_FR2::DTR_Obj_C_ObjPreSelect = %d\n", intval);
	filePutString (buffer, elcount(buffer), hFile);
	floatval = getSignal(CHASSIS::DTR_Obj_C_FR2::DTR_Obj_C_RelSpd_Y);
	snprintf(buffer, elcount(buffer), "   0.000000 F1 LRR::DTR_Obj_C_FR2::DTR_Obj_C_RelSpd_Y = %f\n", floatval);
	filePutString (buffer, elcount(buffer), hFile);
	intval = getSignal(CHASSIS::DTR_Obj_C_FR2::DTR_Obj_C_PedestFunc_Qual);
	snprintf(buffer, elcount(buffer), "   0.000000 F1 LRR::DTR_Obj_C_FR2::DTR_Obj_C_PedestFunc_Qual = %d\n", intval);
	filePutString (buffer, elcount(buffer), hFile);
	intval = getSignal(CHASSIS::DTR_Obj_C_FR2::DTR_Obj_C_LtrlFunc_Qual);
	snprintf(buffer, elcount(buffer), "   0.000000 F1 LRR::DTR_Obj_C_FR2::DTR_Obj_C_LtrlFunc_Qual = %d\n", intval);
	filePutString (buffer, elcount(buffer), hFile);
	intval = getSignal(CHASSIS::DTR_Obj_C_FR2::DTR_Obj_C_Lane_V2);
	snprintf(buffer, elcount(buffer), "   0.000000 F1 LRR::DTR_Obj_C_FR2::DTR_Obj_C_Lane_V2 = %d\n", intval);
	filePutString (buffer, elcount(buffer), hFile);
	intval = getSignal(CHASSIS::DTR_Obj_C_FR2::DTR_Obj_C_CrossFusion_Qual);
	snprintf(buffer, elcount(buffer), "   0.000000 F1 LRR::DTR_Obj_C_FR2::DTR_Obj_C_CrossFusion_Qual = %d\n", intval);
	filePutString (buffer, elcount(buffer), hFile);
	intval = getSignal(CHASSIS::DTR_Obj_C_FR2::DTR_Obj_C_ID_Cnt);
	snprintf(buffer, elcount(buffer), "   0.000000 F1 LRR::DTR_Obj_C_FR2::DTR_Obj_C_ID_Cnt = %d\n", intval);
	filePutString (buffer, elcount(buffer), hFile);
	intval = getSignal(CHASSIS::DTR_Obj_C_FR2::DTR_Obj_C_CutInLvl_v2);
	snprintf(buffer, elcount(buffer), "   0.000000 F1 LRR::DTR_Obj_C_FR2::DTR_Obj_C_CutInLvl_v2 = %d\n", intval);
	filePutString (buffer, elcount(buffer), hFile);
	intval = getSignal(CHASSIS::DTR_Obj_C_FR2::DTR_Obj_C_OrientAngl);
	snprintf(buffer, elcount(buffer), "   0.000000 F1 LRR::DTR_Obj_C_FR2::DTR_Obj_C_OrientAngl = %d\n", intval);
	filePutString (buffer, elcount(buffer), hFile);
	intval = getSignal(CHASSIS::DTR_Obj_C_FR2::DTR_Obj_C_OrientAngl_Flt);
	snprintf(buffer, elcount(buffer), "   0.000000 F1 LRR::DTR_Obj_C_FR2::DTR_Obj_C_OrientAngl_Flt = %d\n", intval);
	filePutString (buffer, elcount(buffer), hFile);
	intval = getSignal(CHASSIS::DTR_Obj_C_FR2::DTR_Obj_C_OrientMov);
	snprintf(buffer, elcount(buffer), "   0.000000 F1 LRR::DTR_Obj_C_FR2::DTR_Obj_C_OrientMov = %d\n", intval);
	filePutString (buffer, elcount(buffer), hFile);
	intval = getSignal(CHASSIS::DTR_Obj_C_FR2::DTR_Obj_C_PedestFusion_Qual);
	snprintf(buffer, elcount(buffer), "   0.000000 F1 LRR::DTR_Obj_C_FR2::DTR_Obj_C_PedestFusion_Qual = %d\n", intval);
	filePutString (buffer, elcount(buffer), hFile);
	intval = getSignal(CHASSIS::DTR_Obj_C_FR2::DTR_Obj_C_ObstclDtct);
	snprintf(buffer, elcount(buffer), "   0.000000 F1 LRR::DTR_Obj_C_FR2::DTR_Obj_C_ObstclDtct = %d\n", intval);
	filePutString (buffer, elcount(buffer), hFile);
	intval = getSignal(CHASSIS::DTR_Obj_C_FR2::DTR_Obj_C_CollisionFunc_Qual);
	snprintf(buffer, elcount(buffer), "   0.000000 F1 LRR::DTR_Obj_C_FR2::DTR_Obj_C_CollisionFunc_Qual = %d\n", intval);
	filePutString (buffer, elcount(buffer), hFile);
	intval = getSignal(CHASSIS::DTR_Obj_C_FR2::DTR_Obj_C_ObsrvHistory);
	snprintf(buffer, elcount(buffer), "   0.000000 F1 LRR::DTR_Obj_C_FR2::DTR_Obj_C_ObsrvHistory = %d\n", intval);
	filePutString (buffer, elcount(buffer), hFile);
	intval = getSignal(CHASSIS::DTR_Obj_C_FR2::DTR_Obj_C_LineLngth);
	snprintf(buffer, elcount(buffer), "   0.000000 F1 LRR::DTR_Obj_C_FR2::DTR_Obj_C_LineLngth = %d\n", intval);
	filePutString (buffer, elcount(buffer), hFile);
	intval = getSignal(CHASSIS::DTR_Obj_C_FR2::DTR_Obj_C_LineOffset);
	snprintf(buffer, elcount(buffer), "   0.000000 F1 LRR::DTR_Obj_C_FR2::DTR_Obj_C_LineOffset = %d\n", intval);
	filePutString (buffer, elcount(buffer), hFile);
	intval = getSignal(CHASSIS::DTR_Obj_C_FR2::DTR_Obj_C_LongFunc_Qual);
	snprintf(buffer, elcount(buffer), "   0.000000 F1 LRR::DTR_Obj_C_FR2::DTR_Obj_C_LongFunc_Qual = %d\n", intval);
	filePutString (buffer, elcount(buffer), hFile);
	intval = getSignal(CHASSIS::DTR_Obj_C_FR2::DTR_Obj_C_LongFusion_Qual);
	snprintf(buffer, elcount(buffer), "   0.000000 F1 LRR::DTR_Obj_C_FR2::DTR_Obj_C_LongFusion_Qual = %d\n", intval);
	filePutString (buffer, elcount(buffer), hFile);
	intval = getSignal(CHASSIS::DTR_Obj_C_FR2::DTR_Obj_C_LineOrient);
	snprintf(buffer, elcount(buffer), "   0.000000 F1 LRR::DTR_Obj_C_FR2::DTR_Obj_C_LineOrient = %d\n", intval);
	filePutString (buffer, elcount(buffer), hFile);
	intval = getSignal(CHASSIS::DTR_Obj_C_FR2::DTR_Obj_C_LaneRangeLimit);
	snprintf(buffer, elcount(buffer), "   0.000000 F1 LRR::DTR_Obj_C_FR2::DTR_Obj_C_LaneRangeLimit = %d\n", intval);
	filePutString (buffer, elcount(buffer), hFile);
	intval = getSignal(CHASSIS::DTR_Obj_C_FR2::DTR_Obj_C_LaneDistTime);
	snprintf(buffer, elcount(buffer), "   0.000000 F1 LRR::DTR_Obj_C_FR2::DTR_Obj_C_LaneDistTime = %d\n", intval);
	filePutString (buffer, elcount(buffer), hFile);
	intval = getSignal(CHASSIS::DTR_Obj_C_FR2::DTR_Obj_C_Collision_Ovrlp);
	snprintf(buffer, elcount(buffer), "   0.000000 F1 LRR::DTR_Obj_C_FR2::DTR_Obj_C_Collision_Ovrlp = %d\n", intval);
	filePutString (buffer, elcount(buffer), hFile);
	floatval = getSignal(CHASSIS::DTR_Obj_C_FR2::DTR_Obj_C_RCS_V2);
	snprintf(buffer, elcount(buffer), "   0.000000 F1 LRR::DTR_Obj_C_FR2::DTR_Obj_C_RCS_V2 = %f\n", floatval);
	filePutString (buffer, elcount(buffer), hFile);
	intval = @sysvar::CH_Nodes::CH_LRRCRC_DTR_Obj_D_Pr2DTR__AUTO;
	snprintf(buffer, elcount(buffer), "   0.000000    SV: 2 0 0 ::CH_Nodes::CH_LRRCRC_DTR_Obj_D_Pr2DTR__AUTO = %d\n", intval);
	filePutString (buffer, elcount(buffer), hFile);
	intval = getSignal(CHASSIS::DTR_Obj_D_FR2::CRC_DTR_Obj_D_Pr2);
	snprintf(buffer, elcount(buffer), "   0.000000 F1 LRR::DTR_Obj_D_FR2::CRC_DTR_Obj_D_Pr2 = %d\n", intval);
	filePutString (buffer, elcount(buffer), hFile);
	intval = @sysvar::CH_Nodes::CH_LRRSQC_DTR_Obj_D_Pr2DTR__AUTO;
	snprintf(buffer, elcount(buffer), "   0.000000    SV: 2 0 0 ::CH_Nodes::CH_LRRSQC_DTR_Obj_D_Pr2DTR__AUTO = %d\n", intval);
	filePutString (buffer, elcount(buffer), hFile);
	intval = getSignal(CHASSIS::DTR_Obj_D_FR2::SQC_DTR_Obj_D_Pr2);
	snprintf(buffer, elcount(buffer), "   0.000000 F1 LRR::DTR_Obj_D_FR2::SQC_DTR_Obj_D_Pr2 = %d\n", intval);
	filePutString (buffer, elcount(buffer), hFile);
	intval = getSignal(CHASSIS::DTR_Obj_D_FR2::DTR_Obj_D_Class);
	snprintf(buffer, elcount(buffer), "   0.000000 F1 LRR::DTR_Obj_D_FR2::DTR_Obj_D_Class = %d\n", intval);
	filePutString (buffer, elcount(buffer), hFile);
	floatval = getSignal(CHASSIS::DTR_Obj_D_FR2::DTR_Obj_D_Dist_X);
	snprintf(buffer, elcount(buffer), "   0.000000 F1 LRR::DTR_Obj_D_FR2::DTR_Obj_D_Dist_X = %f\n", floatval);
	filePutString (buffer, elcount(buffer), hFile);
	intval = getSignal(CHASSIS::DTR_Obj_D_FR2::DTR_Obj_D_StdDev_Dist_X);
	snprintf(buffer, elcount(buffer), "   0.000000 F1 LRR::DTR_Obj_D_FR2::DTR_Obj_D_StdDev_Dist_X = %d\n", intval);
	filePutString (buffer, elcount(buffer), hFile);
	intval = getSignal(CHASSIS::DTR_Obj_D_FR2::DTR_Obj_D_StdDev_Dist_Y);
	snprintf(buffer, elcount(buffer), "   0.000000 F1 LRR::DTR_Obj_D_FR2::DTR_Obj_D_StdDev_Dist_Y = %d\n", intval);
	filePutString (buffer, elcount(buffer), hFile);
	floatval = getSignal(CHASSIS::DTR_Obj_D_FR2::DTR_Obj_D_Dist_Y);
	snprintf(buffer, elcount(buffer), "   0.000000 F1 LRR::DTR_Obj_D_FR2::DTR_Obj_D_Dist_Y = %f\n", floatval);
	filePutString (buffer, elcount(buffer), hFile);
	intval = getSignal(CHASSIS::DTR_Obj_D_FR2::DTR_Obj_D_StdDev_RelSpd_X);
	snprintf(buffer, elcount(buffer), "   0.000000 F1 LRR::DTR_Obj_D_FR2::DTR_Obj_D_StdDev_RelSpd_X = %d\n", intval);
	filePutString (buffer, elcount(buffer), hFile);
	intval = getSignal(CHASSIS::DTR_Obj_D_FR2::DTR_Obj_D_StdDev_RelSpd_Y);
	snprintf(buffer, elcount(buffer), "   0.000000 F1 LRR::DTR_Obj_D_FR2::DTR_Obj_D_StdDev_RelSpd_Y = %d\n", intval);
	filePutString (buffer, elcount(buffer), hFile);
	floatval = getSignal(CHASSIS::DTR_Obj_D_FR2::DTR_Obj_D_RelAccel_X);
	snprintf(buffer, elcount(buffer), "   0.000000 F1 LRR::DTR_Obj_D_FR2::DTR_Obj_D_RelAccel_X = %f\n", floatval);
	filePutString (buffer, elcount(buffer), hFile);
	intval = getSignal(CHASSIS::DTR_Obj_D_FR2::DTR_Obj_D_ID_MX);
	snprintf(buffer, elcount(buffer), "   0.000000 F1 LRR::DTR_Obj_D_FR2::DTR_Obj_D_ID_MX = %d\n", intval);
	filePutString (buffer, elcount(buffer), hFile);
	floatval = getSignal(CHASSIS::DTR_Obj_D_FR2::DTR_Obj_D_RelSpd_X);
	snprintf(buffer, elcount(buffer), "   0.000000 F1 LRR::DTR_Obj_D_FR2::DTR_Obj_D_RelSpd_X = %f\n", floatval);
	filePutString (buffer, elcount(buffer), hFile);
	intval = getSignal(CHASSIS::DTR_Obj_D_FR2::DTR_Obj_D_ObjPreSelect);
	snprintf(buffer, elcount(buffer), "   0.000000 F1 LRR::DTR_Obj_D_FR2::DTR_Obj_D_ObjPreSelect = %d\n", intval);
	filePutString (buffer, elcount(buffer), hFile);
	floatval = getSignal(CHASSIS::DTR_Obj_D_FR2::DTR_Obj_D_RelSpd_Y);
	snprintf(buffer, elcount(buffer), "   0.000000 F1 LRR::DTR_Obj_D_FR2::DTR_Obj_D_RelSpd_Y = %f\n", floatval);
	filePutString (buffer, elcount(buffer), hFile);
	intval = getSignal(CHASSIS::DTR_Obj_D_FR2::DTR_Obj_D_PedestFunc_Qual);
	snprintf(buffer, elcount(buffer), "   0.000000 F1 LRR::DTR_Obj_D_FR2::DTR_Obj_D_PedestFunc_Qual = %d\n", intval);
	filePutString (buffer, elcount(buffer), hFile);
	intval = getSignal(CHASSIS::DTR_Obj_D_FR2::DTR_Obj_D_LtrlFunc_Qual);
	snprintf(buffer, elcount(buffer), "   0.000000 F1 LRR::DTR_Obj_D_FR2::DTR_Obj_D_LtrlFunc_Qual = %d\n", intval);
	filePutString (buffer, elcount(buffer), hFile);
	intval = getSignal(CHASSIS::DTR_Obj_D_FR2::DTR_Obj_D_Lane_V2);
	snprintf(buffer, elcount(buffer), "   0.000000 F1 LRR::DTR_Obj_D_FR2::DTR_Obj_D_Lane_V2 = %d\n", intval);
	filePutString (buffer, elcount(buffer), hFile);
	intval = getSignal(CHASSIS::DTR_Obj_D_FR2::DTR_Obj_D_CrossFusion_Qual);
	snprintf(buffer, elcount(buffer), "   0.000000 F1 LRR::DTR_Obj_D_FR2::DTR_Obj_D_CrossFusion_Qual = %d\n", intval);
	filePutString (buffer, elcount(buffer), hFile);
	intval = getSignal(CHASSIS::DTR_Obj_D_FR2::DTR_Obj_D_ID_Cnt);
	snprintf(buffer, elcount(buffer), "   0.000000 F1 LRR::DTR_Obj_D_FR2::DTR_Obj_D_ID_Cnt = %d\n", intval);
	filePutString (buffer, elcount(buffer), hFile);
	intval = getSignal(CHASSIS::DTR_Obj_D_FR2::DTR_Obj_D_CutInLvl_v2);
	snprintf(buffer, elcount(buffer), "   0.000000 F1 LRR::DTR_Obj_D_FR2::DTR_Obj_D_CutInLvl_v2 = %d\n", intval);
	filePutString (buffer, elcount(buffer), hFile);
	intval = getSignal(CHASSIS::DTR_Obj_D_FR2::DTR_Obj_D_OrientAngl);
	snprintf(buffer, elcount(buffer), "   0.000000 F1 LRR::DTR_Obj_D_FR2::DTR_Obj_D_OrientAngl = %d\n", intval);
	filePutString (buffer, elcount(buffer), hFile);
	intval = getSignal(CHASSIS::DTR_Obj_D_FR2::DTR_Obj_D_OrientAngl_Flt);
	snprintf(buffer, elcount(buffer), "   0.000000 F1 LRR::DTR_Obj_D_FR2::DTR_Obj_D_OrientAngl_Flt = %d\n", intval);
	filePutString (buffer, elcount(buffer), hFile);
	intval = getSignal(CHASSIS::DTR_Obj_D_FR2::DTR_Obj_D_OrientMov);
	snprintf(buffer, elcount(buffer), "   0.000000 F1 LRR::DTR_Obj_D_FR2::DTR_Obj_D_OrientMov = %d\n", intval);
	filePutString (buffer, elcount(buffer), hFile);
	intval = getSignal(CHASSIS::DTR_Obj_D_FR2::DTR_Obj_D_PedestFusion_Qual);
	snprintf(buffer, elcount(buffer), "   0.000000 F1 LRR::DTR_Obj_D_FR2::DTR_Obj_D_PedestFusion_Qual = %d\n", intval);
	filePutString (buffer, elcount(buffer), hFile);
}
/*@@end*/

/*@@caplFunc:saveVars_74(dword):*/
void saveVars_74(dword hFile)
{
	intval = getSignal(CHASSIS::DTR_Obj_D_FR2::DTR_Obj_D_ObstclDtct);
	snprintf(buffer, elcount(buffer), "   0.000000 F1 LRR::DTR_Obj_D_FR2::DTR_Obj_D_ObstclDtct = %d\n", intval);
	filePutString (buffer, elcount(buffer), hFile);
	intval = getSignal(CHASSIS::DTR_Obj_D_FR2::DTR_Obj_D_CollisionFunc_Qual);
	snprintf(buffer, elcount(buffer), "   0.000000 F1 LRR::DTR_Obj_D_FR2::DTR_Obj_D_CollisionFunc_Qual = %d\n", intval);
	filePutString (buffer, elcount(buffer), hFile);
	intval = getSignal(CHASSIS::DTR_Obj_D_FR2::DTR_Obj_D_ObsrvHistory);
	snprintf(buffer, elcount(buffer), "   0.000000 F1 LRR::DTR_Obj_D_FR2::DTR_Obj_D_ObsrvHistory = %d\n", intval);
	filePutString (buffer, elcount(buffer), hFile);
	intval = getSignal(CHASSIS::DTR_Obj_D_FR2::DTR_Obj_D_LineLngth);
	snprintf(buffer, elcount(buffer), "   0.000000 F1 LRR::DTR_Obj_D_FR2::DTR_Obj_D_LineLngth = %d\n", intval);
	filePutString (buffer, elcount(buffer), hFile);
	intval = getSignal(CHASSIS::DTR_Obj_D_FR2::DTR_Obj_D_LineOffset);
	snprintf(buffer, elcount(buffer), "   0.000000 F1 LRR::DTR_Obj_D_FR2::DTR_Obj_D_LineOffset = %d\n", intval);
	filePutString (buffer, elcount(buffer), hFile);
	intval = getSignal(CHASSIS::DTR_Obj_D_FR2::DTR_Obj_D_LongFunc_Qual);
	snprintf(buffer, elcount(buffer), "   0.000000 F1 LRR::DTR_Obj_D_FR2::DTR_Obj_D_LongFunc_Qual = %d\n", intval);
	filePutString (buffer, elcount(buffer), hFile);
	intval = getSignal(CHASSIS::DTR_Obj_D_FR2::DTR_Obj_D_LongFusion_Qual);
	snprintf(buffer, elcount(buffer), "   0.000000 F1 LRR::DTR_Obj_D_FR2::DTR_Obj_D_LongFusion_Qual = %d\n", intval);
	filePutString (buffer, elcount(buffer), hFile);
	intval = getSignal(CHASSIS::DTR_Obj_D_FR2::DTR_Obj_D_LineOrient);
	snprintf(buffer, elcount(buffer), "   0.000000 F1 LRR::DTR_Obj_D_FR2::DTR_Obj_D_LineOrient = %d\n", intval);
	filePutString (buffer, elcount(buffer), hFile);
	intval = getSignal(CHASSIS::DTR_Obj_D_FR2::DTR_Obj_D_LaneRangeLimit);
	snprintf(buffer, elcount(buffer), "   0.000000 F1 LRR::DTR_Obj_D_FR2::DTR_Obj_D_LaneRangeLimit = %d\n", intval);
	filePutString (buffer, elcount(buffer), hFile);
	intval = getSignal(CHASSIS::DTR_Obj_D_FR2::DTR_Obj_D_LaneDistTime);
	snprintf(buffer, elcount(buffer), "   0.000000 F1 LRR::DTR_Obj_D_FR2::DTR_Obj_D_LaneDistTime = %d\n", intval);
	filePutString (buffer, elcount(buffer), hFile);
	intval = getSignal(CHASSIS::DTR_Obj_D_FR2::DTR_Obj_D_Collision_Ovrlp);
	snprintf(buffer, elcount(buffer), "   0.000000 F1 LRR::DTR_Obj_D_FR2::DTR_Obj_D_Collision_Ovrlp = %d\n", intval);
	filePutString (buffer, elcount(buffer), hFile);
	floatval = getSignal(CHASSIS::DTR_Obj_D_FR2::DTR_Obj_D_RCS_V2);
	snprintf(buffer, elcount(buffer), "   0.000000 F1 LRR::DTR_Obj_D_FR2::DTR_Obj_D_RCS_V2 = %f\n", floatval);
	filePutString (buffer, elcount(buffer), hFile);
	intval = @sysvar::CH_Nodes::CH_LRRCRC_DTR_Obj_E_Pr2DTR__AUTO;
	snprintf(buffer, elcount(buffer), "   0.000000    SV: 2 0 0 ::CH_Nodes::CH_LRRCRC_DTR_Obj_E_Pr2DTR__AUTO = %d\n", intval);
	filePutString (buffer, elcount(buffer), hFile);
	intval = getSignal(CHASSIS::DTR_Obj_E_FR2::CRC_DTR_Obj_E_Pr2);
	snprintf(buffer, elcount(buffer), "   0.000000 F1 LRR::DTR_Obj_E_FR2::CRC_DTR_Obj_E_Pr2 = %d\n", intval);
	filePutString (buffer, elcount(buffer), hFile);
	intval = @sysvar::CH_Nodes::CH_LRRSQC_DTR_Obj_E_Pr2DTR__AUTO;
	snprintf(buffer, elcount(buffer), "   0.000000    SV: 2 0 0 ::CH_Nodes::CH_LRRSQC_DTR_Obj_E_Pr2DTR__AUTO = %d\n", intval);
	filePutString (buffer, elcount(buffer), hFile);
	intval = getSignal(CHASSIS::DTR_Obj_E_FR2::SQC_DTR_Obj_E_Pr2);
	snprintf(buffer, elcount(buffer), "   0.000000 F1 LRR::DTR_Obj_E_FR2::SQC_DTR_Obj_E_Pr2 = %d\n", intval);
	filePutString (buffer, elcount(buffer), hFile);
	intval = getSignal(CHASSIS::DTR_Obj_E_FR2::DTR_Obj_E_Class);
	snprintf(buffer, elcount(buffer), "   0.000000 F1 LRR::DTR_Obj_E_FR2::DTR_Obj_E_Class = %d\n", intval);
	filePutString (buffer, elcount(buffer), hFile);
	floatval = getSignal(CHASSIS::DTR_Obj_E_FR2::DTR_Obj_E_Dist_X);
	snprintf(buffer, elcount(buffer), "   0.000000 F1 LRR::DTR_Obj_E_FR2::DTR_Obj_E_Dist_X = %f\n", floatval);
	filePutString (buffer, elcount(buffer), hFile);
	intval = getSignal(CHASSIS::DTR_Obj_E_FR2::DTR_Obj_E_StdDev_Dist_X);
	snprintf(buffer, elcount(buffer), "   0.000000 F1 LRR::DTR_Obj_E_FR2::DTR_Obj_E_StdDev_Dist_X = %d\n", intval);
	filePutString (buffer, elcount(buffer), hFile);
	intval = getSignal(CHASSIS::DTR_Obj_E_FR2::DTR_Obj_E_StdDev_Dist_Y);
	snprintf(buffer, elcount(buffer), "   0.000000 F1 LRR::DTR_Obj_E_FR2::DTR_Obj_E_StdDev_Dist_Y = %d\n", intval);
	filePutString (buffer, elcount(buffer), hFile);
	floatval = getSignal(CHASSIS::DTR_Obj_E_FR2::DTR_Obj_E_Dist_Y);
	snprintf(buffer, elcount(buffer), "   0.000000 F1 LRR::DTR_Obj_E_FR2::DTR_Obj_E_Dist_Y = %f\n", floatval);
	filePutString (buffer, elcount(buffer), hFile);
	intval = getSignal(CHASSIS::DTR_Obj_E_FR2::DTR_Obj_E_StdDev_RelSpd_X);
	snprintf(buffer, elcount(buffer), "   0.000000 F1 LRR::DTR_Obj_E_FR2::DTR_Obj_E_StdDev_RelSpd_X = %d\n", intval);
	filePutString (buffer, elcount(buffer), hFile);
	intval = getSignal(CHASSIS::DTR_Obj_E_FR2::DTR_Obj_E_StdDev_RelSpd_Y);
	snprintf(buffer, elcount(buffer), "   0.000000 F1 LRR::DTR_Obj_E_FR2::DTR_Obj_E_StdDev_RelSpd_Y = %d\n", intval);
	filePutString (buffer, elcount(buffer), hFile);
	floatval = getSignal(CHASSIS::DTR_Obj_E_FR2::DTR_Obj_E_RelAccel_X);
	snprintf(buffer, elcount(buffer), "   0.000000 F1 LRR::DTR_Obj_E_FR2::DTR_Obj_E_RelAccel_X = %f\n", floatval);
	filePutString (buffer, elcount(buffer), hFile);
	intval = getSignal(CHASSIS::DTR_Obj_E_FR2::DTR_Obj_E_ID_MX);
	snprintf(buffer, elcount(buffer), "   0.000000 F1 LRR::DTR_Obj_E_FR2::DTR_Obj_E_ID_MX = %d\n", intval);
	filePutString (buffer, elcount(buffer), hFile);
	floatval = getSignal(CHASSIS::DTR_Obj_E_FR2::DTR_Obj_E_RelSpd_X);
	snprintf(buffer, elcount(buffer), "   0.000000 F1 LRR::DTR_Obj_E_FR2::DTR_Obj_E_RelSpd_X = %f\n", floatval);
	filePutString (buffer, elcount(buffer), hFile);
	intval = getSignal(CHASSIS::DTR_Obj_E_FR2::DTR_Obj_E_ObjPreSelect);
	snprintf(buffer, elcount(buffer), "   0.000000 F1 LRR::DTR_Obj_E_FR2::DTR_Obj_E_ObjPreSelect = %d\n", intval);
	filePutString (buffer, elcount(buffer), hFile);
	floatval = getSignal(CHASSIS::DTR_Obj_E_FR2::DTR_Obj_E_RelSpd_Y);
	snprintf(buffer, elcount(buffer), "   0.000000 F1 LRR::DTR_Obj_E_FR2::DTR_Obj_E_RelSpd_Y = %f\n", floatval);
	filePutString (buffer, elcount(buffer), hFile);
	intval = getSignal(CHASSIS::DTR_Obj_E_FR2::DTR_Obj_E_PedestFunc_Qual);
	snprintf(buffer, elcount(buffer), "   0.000000 F1 LRR::DTR_Obj_E_FR2::DTR_Obj_E_PedestFunc_Qual = %d\n", intval);
	filePutString (buffer, elcount(buffer), hFile);
	intval = getSignal(CHASSIS::DTR_Obj_E_FR2::DTR_Obj_E_LtrlFunc_Qual);
	snprintf(buffer, elcount(buffer), "   0.000000 F1 LRR::DTR_Obj_E_FR2::DTR_Obj_E_LtrlFunc_Qual = %d\n", intval);
	filePutString (buffer, elcount(buffer), hFile);
	intval = getSignal(CHASSIS::DTR_Obj_E_FR2::DTR_Obj_E_Lane_V2);
	snprintf(buffer, elcount(buffer), "   0.000000 F1 LRR::DTR_Obj_E_FR2::DTR_Obj_E_Lane_V2 = %d\n", intval);
	filePutString (buffer, elcount(buffer), hFile);
	intval = getSignal(CHASSIS::DTR_Obj_E_FR2::DTR_Obj_E_CrossFusion_Qual);
	snprintf(buffer, elcount(buffer), "   0.000000 F1 LRR::DTR_Obj_E_FR2::DTR_Obj_E_CrossFusion_Qual = %d\n", intval);
	filePutString (buffer, elcount(buffer), hFile);
	intval = getSignal(CHASSIS::DTR_Obj_E_FR2::DTR_Obj_E_ID_Cnt);
	snprintf(buffer, elcount(buffer), "   0.000000 F1 LRR::DTR_Obj_E_FR2::DTR_Obj_E_ID_Cnt = %d\n", intval);
	filePutString (buffer, elcount(buffer), hFile);
	intval = getSignal(CHASSIS::DTR_Obj_E_FR2::DTR_Obj_E_CutInLvl_v2);
	snprintf(buffer, elcount(buffer), "   0.000000 F1 LRR::DTR_Obj_E_FR2::DTR_Obj_E_CutInLvl_v2 = %d\n", intval);
	filePutString (buffer, elcount(buffer), hFile);
	intval = getSignal(CHASSIS::DTR_Obj_E_FR2::DTR_Obj_E_OrientAngl);
	snprintf(buffer, elcount(buffer), "   0.000000 F1 LRR::DTR_Obj_E_FR2::DTR_Obj_E_OrientAngl = %d\n", intval);
	filePutString (buffer, elcount(buffer), hFile);
	intval = getSignal(CHASSIS::DTR_Obj_E_FR2::DTR_Obj_E_OrientAngl_Flt);
	snprintf(buffer, elcount(buffer), "   0.000000 F1 LRR::DTR_Obj_E_FR2::DTR_Obj_E_OrientAngl_Flt = %d\n", intval);
	filePutString (buffer, elcount(buffer), hFile);
	intval = getSignal(CHASSIS::DTR_Obj_E_FR2::DTR_Obj_E_OrientMov);
	snprintf(buffer, elcount(buffer), "   0.000000 F1 LRR::DTR_Obj_E_FR2::DTR_Obj_E_OrientMov = %d\n", intval);
	filePutString (buffer, elcount(buffer), hFile);
	intval = getSignal(CHASSIS::DTR_Obj_E_FR2::DTR_Obj_E_PedestFusion_Qual);
	snprintf(buffer, elcount(buffer), "   0.000000 F1 LRR::DTR_Obj_E_FR2::DTR_Obj_E_PedestFusion_Qual = %d\n", intval);
	filePutString (buffer, elcount(buffer), hFile);
	intval = getSignal(CHASSIS::DTR_Obj_E_FR2::DTR_Obj_E_ObstclDtct);
	snprintf(buffer, elcount(buffer), "   0.000000 F1 LRR::DTR_Obj_E_FR2::DTR_Obj_E_ObstclDtct = %d\n", intval);
	filePutString (buffer, elcount(buffer), hFile);
	intval = getSignal(CHASSIS::DTR_Obj_E_FR2::DTR_Obj_E_CollisionFunc_Qual);
	snprintf(buffer, elcount(buffer), "   0.000000 F1 LRR::DTR_Obj_E_FR2::DTR_Obj_E_CollisionFunc_Qual = %d\n", intval);
	filePutString (buffer, elcount(buffer), hFile);
	intval = getSignal(CHASSIS::DTR_Obj_E_FR2::DTR_Obj_E_ObsrvHistory);
	snprintf(buffer, elcount(buffer), "   0.000000 F1 LRR::DTR_Obj_E_FR2::DTR_Obj_E_ObsrvHistory = %d\n", intval);
	filePutString (buffer, elcount(buffer), hFile);
	intval = getSignal(CHASSIS::DTR_Obj_E_FR2::DTR_Obj_E_LineLngth);
	snprintf(buffer, elcount(buffer), "   0.000000 F1 LRR::DTR_Obj_E_FR2::DTR_Obj_E_LineLngth = %d\n", intval);
	filePutString (buffer, elcount(buffer), hFile);
	intval = getSignal(CHASSIS::DTR_Obj_E_FR2::DTR_Obj_E_LineOffset);
	snprintf(buffer, elcount(buffer), "   0.000000 F1 LRR::DTR_Obj_E_FR2::DTR_Obj_E_LineOffset = %d\n", intval);
	filePutString (buffer, elcount(buffer), hFile);
	intval = getSignal(CHASSIS::DTR_Obj_E_FR2::DTR_Obj_E_LongFunc_Qual);
	snprintf(buffer, elcount(buffer), "   0.000000 F1 LRR::DTR_Obj_E_FR2::DTR_Obj_E_LongFunc_Qual = %d\n", intval);
	filePutString (buffer, elcount(buffer), hFile);
	intval = getSignal(CHASSIS::DTR_Obj_E_FR2::DTR_Obj_E_LongFusion_Qual);
	snprintf(buffer, elcount(buffer), "   0.000000 F1 LRR::DTR_Obj_E_FR2::DTR_Obj_E_LongFusion_Qual = %d\n", intval);
	filePutString (buffer, elcount(buffer), hFile);
	intval = getSignal(CHASSIS::DTR_Obj_E_FR2::DTR_Obj_E_LineOrient);
	snprintf(buffer, elcount(buffer), "   0.000000 F1 LRR::DTR_Obj_E_FR2::DTR_Obj_E_LineOrient = %d\n", intval);
	filePutString (buffer, elcount(buffer), hFile);
	intval = getSignal(CHASSIS::DTR_Obj_E_FR2::DTR_Obj_E_LaneRangeLimit);
	snprintf(buffer, elcount(buffer), "   0.000000 F1 LRR::DTR_Obj_E_FR2::DTR_Obj_E_LaneRangeLimit = %d\n", intval);
	filePutString (buffer, elcount(buffer), hFile);
	intval = getSignal(CHASSIS::DTR_Obj_E_FR2::DTR_Obj_E_LaneDistTime);
	snprintf(buffer, elcount(buffer), "   0.000000 F1 LRR::DTR_Obj_E_FR2::DTR_Obj_E_LaneDistTime = %d\n", intval);
	filePutString (buffer, elcount(buffer), hFile);
	intval = getSignal(CHASSIS::DTR_Obj_E_FR2::DTR_Obj_E_Collision_Ovrlp);
	snprintf(buffer, elcount(buffer), "   0.000000 F1 LRR::DTR_Obj_E_FR2::DTR_Obj_E_Collision_Ovrlp = %d\n", intval);
	filePutString (buffer, elcount(buffer), hFile);
	floatval = getSignal(CHASSIS::DTR_Obj_E_FR2::DTR_Obj_E_RCS_V2);
	snprintf(buffer, elcount(buffer), "   0.000000 F1 LRR::DTR_Obj_E_FR2::DTR_Obj_E_RCS_V2 = %f\n", floatval);
	filePutString (buffer, elcount(buffer), hFile);
	intval = @sysvar::CH_Nodes::CH_LRRCRC_DTR_Obj_F_Pr2DTR__AUTO;
	snprintf(buffer, elcount(buffer), "   0.000000    SV: 2 0 0 ::CH_Nodes::CH_LRRCRC_DTR_Obj_F_Pr2DTR__AUTO = %d\n", intval);
	filePutString (buffer, elcount(buffer), hFile);
	intval = getSignal(CHASSIS::DTR_Obj_F_FR2::CRC_DTR_Obj_F_Pr2);
	snprintf(buffer, elcount(buffer), "   0.000000 F1 LRR::DTR_Obj_F_FR2::CRC_DTR_Obj_F_Pr2 = %d\n", intval);
	filePutString (buffer, elcount(buffer), hFile);
	intval = @sysvar::CH_Nodes::CH_LRRSQC_DTR_Obj_F_Pr2DTR__AUTO;
	snprintf(buffer, elcount(buffer), "   0.000000    SV: 2 0 0 ::CH_Nodes::CH_LRRSQC_DTR_Obj_F_Pr2DTR__AUTO = %d\n", intval);
	filePutString (buffer, elcount(buffer), hFile);
	intval = getSignal(CHASSIS::DTR_Obj_F_FR2::SQC_DTR_Obj_F_Pr2);
	snprintf(buffer, elcount(buffer), "   0.000000 F1 LRR::DTR_Obj_F_FR2::SQC_DTR_Obj_F_Pr2 = %d\n", intval);
	filePutString (buffer, elcount(buffer), hFile);
	intval = getSignal(CHASSIS::DTR_Obj_F_FR2::DTR_Obj_F_Class);
	snprintf(buffer, elcount(buffer), "   0.000000 F1 LRR::DTR_Obj_F_FR2::DTR_Obj_F_Class = %d\n", intval);
	filePutString (buffer, elcount(buffer), hFile);
}
/*@@end*/

/*@@caplFunc:saveVars_75(dword):*/
void saveVars_75(dword hFile)
{
	floatval = getSignal(CHASSIS::DTR_Obj_F_FR2::DTR_Obj_F_Dist_X);
	snprintf(buffer, elcount(buffer), "   0.000000 F1 LRR::DTR_Obj_F_FR2::DTR_Obj_F_Dist_X = %f\n", floatval);
	filePutString (buffer, elcount(buffer), hFile);
	intval = getSignal(CHASSIS::DTR_Obj_F_FR2::DTR_Obj_F_StdDev_Dist_X);
	snprintf(buffer, elcount(buffer), "   0.000000 F1 LRR::DTR_Obj_F_FR2::DTR_Obj_F_StdDev_Dist_X = %d\n", intval);
	filePutString (buffer, elcount(buffer), hFile);
	intval = getSignal(CHASSIS::DTR_Obj_F_FR2::DTR_Obj_F_StdDev_Dist_Y);
	snprintf(buffer, elcount(buffer), "   0.000000 F1 LRR::DTR_Obj_F_FR2::DTR_Obj_F_StdDev_Dist_Y = %d\n", intval);
	filePutString (buffer, elcount(buffer), hFile);
	floatval = getSignal(CHASSIS::DTR_Obj_F_FR2::DTR_Obj_F_Dist_Y);
	snprintf(buffer, elcount(buffer), "   0.000000 F1 LRR::DTR_Obj_F_FR2::DTR_Obj_F_Dist_Y = %f\n", floatval);
	filePutString (buffer, elcount(buffer), hFile);
	intval = getSignal(CHASSIS::DTR_Obj_F_FR2::DTR_Obj_F_StdDev_RelSpd_X);
	snprintf(buffer, elcount(buffer), "   0.000000 F1 LRR::DTR_Obj_F_FR2::DTR_Obj_F_StdDev_RelSpd_X = %d\n", intval);
	filePutString (buffer, elcount(buffer), hFile);
	intval = getSignal(CHASSIS::DTR_Obj_F_FR2::DTR_Obj_F_StdDev_RelSpd_Y);
	snprintf(buffer, elcount(buffer), "   0.000000 F1 LRR::DTR_Obj_F_FR2::DTR_Obj_F_StdDev_RelSpd_Y = %d\n", intval);
	filePutString (buffer, elcount(buffer), hFile);
	floatval = getSignal(CHASSIS::DTR_Obj_F_FR2::DTR_Obj_F_RelAccel_X);
	snprintf(buffer, elcount(buffer), "   0.000000 F1 LRR::DTR_Obj_F_FR2::DTR_Obj_F_RelAccel_X = %f\n", floatval);
	filePutString (buffer, elcount(buffer), hFile);
	intval = getSignal(CHASSIS::DTR_Obj_F_FR2::DTR_Obj_F_ID_MX);
	snprintf(buffer, elcount(buffer), "   0.000000 F1 LRR::DTR_Obj_F_FR2::DTR_Obj_F_ID_MX = %d\n", intval);
	filePutString (buffer, elcount(buffer), hFile);
	floatval = getSignal(CHASSIS::DTR_Obj_F_FR2::DTR_Obj_F_RelSpd_X);
	snprintf(buffer, elcount(buffer), "   0.000000 F1 LRR::DTR_Obj_F_FR2::DTR_Obj_F_RelSpd_X = %f\n", floatval);
	filePutString (buffer, elcount(buffer), hFile);
	intval = getSignal(CHASSIS::DTR_Obj_F_FR2::DTR_Obj_F_ObjPreSelect);
	snprintf(buffer, elcount(buffer), "   0.000000 F1 LRR::DTR_Obj_F_FR2::DTR_Obj_F_ObjPreSelect = %d\n", intval);
	filePutString (buffer, elcount(buffer), hFile);
	floatval = getSignal(CHASSIS::DTR_Obj_F_FR2::DTR_Obj_F_RelSpd_Y);
	snprintf(buffer, elcount(buffer), "   0.000000 F1 LRR::DTR_Obj_F_FR2::DTR_Obj_F_RelSpd_Y = %f\n", floatval);
	filePutString (buffer, elcount(buffer), hFile);
	intval = getSignal(CHASSIS::DTR_Obj_F_FR2::DTR_Obj_F_PedestFunc_Qual);
	snprintf(buffer, elcount(buffer), "   0.000000 F1 LRR::DTR_Obj_F_FR2::DTR_Obj_F_PedestFunc_Qual = %d\n", intval);
	filePutString (buffer, elcount(buffer), hFile);
	intval = getSignal(CHASSIS::DTR_Obj_F_FR2::DTR_Obj_F_LtrlFunc_Qual);
	snprintf(buffer, elcount(buffer), "   0.000000 F1 LRR::DTR_Obj_F_FR2::DTR_Obj_F_LtrlFunc_Qual = %d\n", intval);
	filePutString (buffer, elcount(buffer), hFile);
	intval = getSignal(CHASSIS::DTR_Obj_F_FR2::DTR_Obj_F_Lane_V2);
	snprintf(buffer, elcount(buffer), "   0.000000 F1 LRR::DTR_Obj_F_FR2::DTR_Obj_F_Lane_V2 = %d\n", intval);
	filePutString (buffer, elcount(buffer), hFile);
	intval = getSignal(CHASSIS::DTR_Obj_F_FR2::DTR_Obj_F_CrossFusion_Qual);
	snprintf(buffer, elcount(buffer), "   0.000000 F1 LRR::DTR_Obj_F_FR2::DTR_Obj_F_CrossFusion_Qual = %d\n", intval);
	filePutString (buffer, elcount(buffer), hFile);
	intval = getSignal(CHASSIS::DTR_Obj_F_FR2::DTR_Obj_F_ID_Cnt);
	snprintf(buffer, elcount(buffer), "   0.000000 F1 LRR::DTR_Obj_F_FR2::DTR_Obj_F_ID_Cnt = %d\n", intval);
	filePutString (buffer, elcount(buffer), hFile);
	intval = getSignal(CHASSIS::DTR_Obj_F_FR2::DTR_Obj_F_CutInLvl_v2);
	snprintf(buffer, elcount(buffer), "   0.000000 F1 LRR::DTR_Obj_F_FR2::DTR_Obj_F_CutInLvl_v2 = %d\n", intval);
	filePutString (buffer, elcount(buffer), hFile);
	intval = getSignal(CHASSIS::DTR_Obj_F_FR2::DTR_Obj_F_OrientAngl);
	snprintf(buffer, elcount(buffer), "   0.000000 F1 LRR::DTR_Obj_F_FR2::DTR_Obj_F_OrientAngl = %d\n", intval);
	filePutString (buffer, elcount(buffer), hFile);
	intval = getSignal(CHASSIS::DTR_Obj_F_FR2::DTR_Obj_F_OrientAngl_Flt);
	snprintf(buffer, elcount(buffer), "   0.000000 F1 LRR::DTR_Obj_F_FR2::DTR_Obj_F_OrientAngl_Flt = %d\n", intval);
	filePutString (buffer, elcount(buffer), hFile);
	intval = getSignal(CHASSIS::DTR_Obj_F_FR2::DTR_Obj_F_OrientMov);
	snprintf(buffer, elcount(buffer), "   0.000000 F1 LRR::DTR_Obj_F_FR2::DTR_Obj_F_OrientMov = %d\n", intval);
	filePutString (buffer, elcount(buffer), hFile);
	intval = getSignal(CHASSIS::DTR_Obj_F_FR2::DTR_Obj_F_PedestFusion_Qual);
	snprintf(buffer, elcount(buffer), "   0.000000 F1 LRR::DTR_Obj_F_FR2::DTR_Obj_F_PedestFusion_Qual = %d\n", intval);
	filePutString (buffer, elcount(buffer), hFile);
	intval = getSignal(CHASSIS::DTR_Obj_F_FR2::DTR_Obj_F_ObstclDtct);
	snprintf(buffer, elcount(buffer), "   0.000000 F1 LRR::DTR_Obj_F_FR2::DTR_Obj_F_ObstclDtct = %d\n", intval);
	filePutString (buffer, elcount(buffer), hFile);
	intval = getSignal(CHASSIS::DTR_Obj_F_FR2::DTR_Obj_F_CollisionFunc_Qual);
	snprintf(buffer, elcount(buffer), "   0.000000 F1 LRR::DTR_Obj_F_FR2::DTR_Obj_F_CollisionFunc_Qual = %d\n", intval);
	filePutString (buffer, elcount(buffer), hFile);
	intval = getSignal(CHASSIS::DTR_Obj_F_FR2::DTR_Obj_F_ObsrvHistory);
	snprintf(buffer, elcount(buffer), "   0.000000 F1 LRR::DTR_Obj_F_FR2::DTR_Obj_F_ObsrvHistory = %d\n", intval);
	filePutString (buffer, elcount(buffer), hFile);
	intval = getSignal(CHASSIS::DTR_Obj_F_FR2::DTR_Obj_F_LineLngth);
	snprintf(buffer, elcount(buffer), "   0.000000 F1 LRR::DTR_Obj_F_FR2::DTR_Obj_F_LineLngth = %d\n", intval);
	filePutString (buffer, elcount(buffer), hFile);
	intval = getSignal(CHASSIS::DTR_Obj_F_FR2::DTR_Obj_F_LineOffset);
	snprintf(buffer, elcount(buffer), "   0.000000 F1 LRR::DTR_Obj_F_FR2::DTR_Obj_F_LineOffset = %d\n", intval);
	filePutString (buffer, elcount(buffer), hFile);
	intval = getSignal(CHASSIS::DTR_Obj_F_FR2::DTR_Obj_F_LongFunc_Qual);
	snprintf(buffer, elcount(buffer), "   0.000000 F1 LRR::DTR_Obj_F_FR2::DTR_Obj_F_LongFunc_Qual = %d\n", intval);
	filePutString (buffer, elcount(buffer), hFile);
	intval = getSignal(CHASSIS::DTR_Obj_F_FR2::DTR_Obj_F_LongFusion_Qual);
	snprintf(buffer, elcount(buffer), "   0.000000 F1 LRR::DTR_Obj_F_FR2::DTR_Obj_F_LongFusion_Qual = %d\n", intval);
	filePutString (buffer, elcount(buffer), hFile);
	intval = getSignal(CHASSIS::DTR_Obj_F_FR2::DTR_Obj_F_LineOrient);
	snprintf(buffer, elcount(buffer), "   0.000000 F1 LRR::DTR_Obj_F_FR2::DTR_Obj_F_LineOrient = %d\n", intval);
	filePutString (buffer, elcount(buffer), hFile);
	intval = getSignal(CHASSIS::DTR_Obj_F_FR2::DTR_Obj_F_LaneRangeLimit);
	snprintf(buffer, elcount(buffer), "   0.000000 F1 LRR::DTR_Obj_F_FR2::DTR_Obj_F_LaneRangeLimit = %d\n", intval);
	filePutString (buffer, elcount(buffer), hFile);
	intval = getSignal(CHASSIS::DTR_Obj_F_FR2::DTR_Obj_F_LaneDistTime);
	snprintf(buffer, elcount(buffer), "   0.000000 F1 LRR::DTR_Obj_F_FR2::DTR_Obj_F_LaneDistTime = %d\n", intval);
	filePutString (buffer, elcount(buffer), hFile);
	intval = getSignal(CHASSIS::DTR_Obj_F_FR2::DTR_Obj_F_Collision_Ovrlp);
	snprintf(buffer, elcount(buffer), "   0.000000 F1 LRR::DTR_Obj_F_FR2::DTR_Obj_F_Collision_Ovrlp = %d\n", intval);
	filePutString (buffer, elcount(buffer), hFile);
	floatval = getSignal(CHASSIS::DTR_Obj_F_FR2::DTR_Obj_F_RCS_V2);
	snprintf(buffer, elcount(buffer), "   0.000000 F1 LRR::DTR_Obj_F_FR2::DTR_Obj_F_RCS_V2 = %f\n", floatval);
	filePutString (buffer, elcount(buffer), hFile);
	intval = @sysvar::CH_Nodes::CH_LRRCRC_DTR_Obj_G_Pr2DTR__AUTO;
	snprintf(buffer, elcount(buffer), "   0.000000    SV: 2 0 0 ::CH_Nodes::CH_LRRCRC_DTR_Obj_G_Pr2DTR__AUTO = %d\n", intval);
	filePutString (buffer, elcount(buffer), hFile);
	intval = getSignal(CHASSIS::DTR_Obj_G_FR2::CRC_DTR_Obj_G_Pr2);
	snprintf(buffer, elcount(buffer), "   0.000000 F1 LRR::DTR_Obj_G_FR2::CRC_DTR_Obj_G_Pr2 = %d\n", intval);
	filePutString (buffer, elcount(buffer), hFile);
	intval = @sysvar::CH_Nodes::CH_LRRSQC_DTR_Obj_G_Pr2DTR__AUTO;
	snprintf(buffer, elcount(buffer), "   0.000000    SV: 2 0 0 ::CH_Nodes::CH_LRRSQC_DTR_Obj_G_Pr2DTR__AUTO = %d\n", intval);
	filePutString (buffer, elcount(buffer), hFile);
	intval = getSignal(CHASSIS::DTR_Obj_G_FR2::SQC_DTR_Obj_G_Pr2);
	snprintf(buffer, elcount(buffer), "   0.000000 F1 LRR::DTR_Obj_G_FR2::SQC_DTR_Obj_G_Pr2 = %d\n", intval);
	filePutString (buffer, elcount(buffer), hFile);
	intval = getSignal(CHASSIS::DTR_Obj_G_FR2::DTR_Obj_G_Class);
	snprintf(buffer, elcount(buffer), "   0.000000 F1 LRR::DTR_Obj_G_FR2::DTR_Obj_G_Class = %d\n", intval);
	filePutString (buffer, elcount(buffer), hFile);
	floatval = getSignal(CHASSIS::DTR_Obj_G_FR2::DTR_Obj_G_Dist_X);
	snprintf(buffer, elcount(buffer), "   0.000000 F1 LRR::DTR_Obj_G_FR2::DTR_Obj_G_Dist_X = %f\n", floatval);
	filePutString (buffer, elcount(buffer), hFile);
	intval = getSignal(CHASSIS::DTR_Obj_G_FR2::DTR_Obj_G_StdDev_Dist_X);
	snprintf(buffer, elcount(buffer), "   0.000000 F1 LRR::DTR_Obj_G_FR2::DTR_Obj_G_StdDev_Dist_X = %d\n", intval);
	filePutString (buffer, elcount(buffer), hFile);
	intval = getSignal(CHASSIS::DTR_Obj_G_FR2::DTR_Obj_G_StdDev_Dist_Y);
	snprintf(buffer, elcount(buffer), "   0.000000 F1 LRR::DTR_Obj_G_FR2::DTR_Obj_G_StdDev_Dist_Y = %d\n", intval);
	filePutString (buffer, elcount(buffer), hFile);
	floatval = getSignal(CHASSIS::DTR_Obj_G_FR2::DTR_Obj_G_Dist_Y);
	snprintf(buffer, elcount(buffer), "   0.000000 F1 LRR::DTR_Obj_G_FR2::DTR_Obj_G_Dist_Y = %f\n", floatval);
	filePutString (buffer, elcount(buffer), hFile);
	intval = getSignal(CHASSIS::DTR_Obj_G_FR2::DTR_Obj_G_StdDev_RelSpd_X);
	snprintf(buffer, elcount(buffer), "   0.000000 F1 LRR::DTR_Obj_G_FR2::DTR_Obj_G_StdDev_RelSpd_X = %d\n", intval);
	filePutString (buffer, elcount(buffer), hFile);
	intval = getSignal(CHASSIS::DTR_Obj_G_FR2::DTR_Obj_G_StdDev_RelSpd_Y);
	snprintf(buffer, elcount(buffer), "   0.000000 F1 LRR::DTR_Obj_G_FR2::DTR_Obj_G_StdDev_RelSpd_Y = %d\n", intval);
	filePutString (buffer, elcount(buffer), hFile);
	floatval = getSignal(CHASSIS::DTR_Obj_G_FR2::DTR_Obj_G_RelAccel_X);
	snprintf(buffer, elcount(buffer), "   0.000000 F1 LRR::DTR_Obj_G_FR2::DTR_Obj_G_RelAccel_X = %f\n", floatval);
	filePutString (buffer, elcount(buffer), hFile);
	intval = getSignal(CHASSIS::DTR_Obj_G_FR2::DTR_Obj_G_ID_MX);
	snprintf(buffer, elcount(buffer), "   0.000000 F1 LRR::DTR_Obj_G_FR2::DTR_Obj_G_ID_MX = %d\n", intval);
	filePutString (buffer, elcount(buffer), hFile);
	floatval = getSignal(CHASSIS::DTR_Obj_G_FR2::DTR_Obj_G_RelSpd_X);
	snprintf(buffer, elcount(buffer), "   0.000000 F1 LRR::DTR_Obj_G_FR2::DTR_Obj_G_RelSpd_X = %f\n", floatval);
	filePutString (buffer, elcount(buffer), hFile);
	intval = getSignal(CHASSIS::DTR_Obj_G_FR2::DTR_Obj_G_ObjPreSelect);
	snprintf(buffer, elcount(buffer), "   0.000000 F1 LRR::DTR_Obj_G_FR2::DTR_Obj_G_ObjPreSelect = %d\n", intval);
	filePutString (buffer, elcount(buffer), hFile);
	floatval = getSignal(CHASSIS::DTR_Obj_G_FR2::DTR_Obj_G_RelSpd_Y);
	snprintf(buffer, elcount(buffer), "   0.000000 F1 LRR::DTR_Obj_G_FR2::DTR_Obj_G_RelSpd_Y = %f\n", floatval);
	filePutString (buffer, elcount(buffer), hFile);
	intval = getSignal(CHASSIS::DTR_Obj_G_FR2::DTR_Obj_G_PedestFunc_Qual);
	snprintf(buffer, elcount(buffer), "   0.000000 F1 LRR::DTR_Obj_G_FR2::DTR_Obj_G_PedestFunc_Qual = %d\n", intval);
	filePutString (buffer, elcount(buffer), hFile);
	intval = getSignal(CHASSIS::DTR_Obj_G_FR2::DTR_Obj_G_LtrlFunc_Qual);
	snprintf(buffer, elcount(buffer), "   0.000000 F1 LRR::DTR_Obj_G_FR2::DTR_Obj_G_LtrlFunc_Qual = %d\n", intval);
	filePutString (buffer, elcount(buffer), hFile);
	intval = getSignal(CHASSIS::DTR_Obj_G_FR2::DTR_Obj_G_Lane_V2);
	snprintf(buffer, elcount(buffer), "   0.000000 F1 LRR::DTR_Obj_G_FR2::DTR_Obj_G_Lane_V2 = %d\n", intval);
	filePutString (buffer, elcount(buffer), hFile);
	intval = getSignal(CHASSIS::DTR_Obj_G_FR2::DTR_Obj_G_CrossFusion_Qual);
	snprintf(buffer, elcount(buffer), "   0.000000 F1 LRR::DTR_Obj_G_FR2::DTR_Obj_G_CrossFusion_Qual = %d\n", intval);
	filePutString (buffer, elcount(buffer), hFile);
}
/*@@end*/

/*@@caplFunc:saveVars_76(dword):*/
void saveVars_76(dword hFile)
{
	intval = getSignal(CHASSIS::DTR_Obj_G_FR2::DTR_Obj_G_ID_Cnt);
	snprintf(buffer, elcount(buffer), "   0.000000 F1 LRR::DTR_Obj_G_FR2::DTR_Obj_G_ID_Cnt = %d\n", intval);
	filePutString (buffer, elcount(buffer), hFile);
	intval = getSignal(CHASSIS::DTR_Obj_G_FR2::DTR_Obj_G_CutInLvl_v2);
	snprintf(buffer, elcount(buffer), "   0.000000 F1 LRR::DTR_Obj_G_FR2::DTR_Obj_G_CutInLvl_v2 = %d\n", intval);
	filePutString (buffer, elcount(buffer), hFile);
	intval = getSignal(CHASSIS::DTR_Obj_G_FR2::DTR_Obj_G_OrientAngl);
	snprintf(buffer, elcount(buffer), "   0.000000 F1 LRR::DTR_Obj_G_FR2::DTR_Obj_G_OrientAngl = %d\n", intval);
	filePutString (buffer, elcount(buffer), hFile);
	intval = getSignal(CHASSIS::DTR_Obj_G_FR2::DTR_Obj_G_OrientAngl_Flt);
	snprintf(buffer, elcount(buffer), "   0.000000 F1 LRR::DTR_Obj_G_FR2::DTR_Obj_G_OrientAngl_Flt = %d\n", intval);
	filePutString (buffer, elcount(buffer), hFile);
	intval = getSignal(CHASSIS::DTR_Obj_G_FR2::DTR_Obj_G_OrientMov);
	snprintf(buffer, elcount(buffer), "   0.000000 F1 LRR::DTR_Obj_G_FR2::DTR_Obj_G_OrientMov = %d\n", intval);
	filePutString (buffer, elcount(buffer), hFile);
	intval = getSignal(CHASSIS::DTR_Obj_G_FR2::DTR_Obj_G_PedestFusion_Qual);
	snprintf(buffer, elcount(buffer), "   0.000000 F1 LRR::DTR_Obj_G_FR2::DTR_Obj_G_PedestFusion_Qual = %d\n", intval);
	filePutString (buffer, elcount(buffer), hFile);
	intval = getSignal(CHASSIS::DTR_Obj_G_FR2::DTR_Obj_G_ObstclDtct);
	snprintf(buffer, elcount(buffer), "   0.000000 F1 LRR::DTR_Obj_G_FR2::DTR_Obj_G_ObstclDtct = %d\n", intval);
	filePutString (buffer, elcount(buffer), hFile);
	intval = getSignal(CHASSIS::DTR_Obj_G_FR2::DTR_Obj_G_CollisionFunc_Qual);
	snprintf(buffer, elcount(buffer), "   0.000000 F1 LRR::DTR_Obj_G_FR2::DTR_Obj_G_CollisionFunc_Qual = %d\n", intval);
	filePutString (buffer, elcount(buffer), hFile);
	intval = getSignal(CHASSIS::DTR_Obj_G_FR2::DTR_Obj_G_ObsrvHistory);
	snprintf(buffer, elcount(buffer), "   0.000000 F1 LRR::DTR_Obj_G_FR2::DTR_Obj_G_ObsrvHistory = %d\n", intval);
	filePutString (buffer, elcount(buffer), hFile);
	intval = getSignal(CHASSIS::DTR_Obj_G_FR2::DTR_Obj_G_LineLngth);
	snprintf(buffer, elcount(buffer), "   0.000000 F1 LRR::DTR_Obj_G_FR2::DTR_Obj_G_LineLngth = %d\n", intval);
	filePutString (buffer, elcount(buffer), hFile);
	intval = getSignal(CHASSIS::DTR_Obj_G_FR2::DTR_Obj_G_LineOffset);
	snprintf(buffer, elcount(buffer), "   0.000000 F1 LRR::DTR_Obj_G_FR2::DTR_Obj_G_LineOffset = %d\n", intval);
	filePutString (buffer, elcount(buffer), hFile);
	intval = getSignal(CHASSIS::DTR_Obj_G_FR2::DTR_Obj_G_LongFunc_Qual);
	snprintf(buffer, elcount(buffer), "   0.000000 F1 LRR::DTR_Obj_G_FR2::DTR_Obj_G_LongFunc_Qual = %d\n", intval);
	filePutString (buffer, elcount(buffer), hFile);
	intval = getSignal(CHASSIS::DTR_Obj_G_FR2::DTR_Obj_G_LongFusion_Qual);
	snprintf(buffer, elcount(buffer), "   0.000000 F1 LRR::DTR_Obj_G_FR2::DTR_Obj_G_LongFusion_Qual = %d\n", intval);
	filePutString (buffer, elcount(buffer), hFile);
	intval = getSignal(CHASSIS::DTR_Obj_G_FR2::DTR_Obj_G_LineOrient);
	snprintf(buffer, elcount(buffer), "   0.000000 F1 LRR::DTR_Obj_G_FR2::DTR_Obj_G_LineOrient = %d\n", intval);
	filePutString (buffer, elcount(buffer), hFile);
	intval = getSignal(CHASSIS::DTR_Obj_G_FR2::DTR_Obj_G_LaneRangeLimit);
	snprintf(buffer, elcount(buffer), "   0.000000 F1 LRR::DTR_Obj_G_FR2::DTR_Obj_G_LaneRangeLimit = %d\n", intval);
	filePutString (buffer, elcount(buffer), hFile);
	intval = getSignal(CHASSIS::DTR_Obj_G_FR2::DTR_Obj_G_LaneDistTime);
	snprintf(buffer, elcount(buffer), "   0.000000 F1 LRR::DTR_Obj_G_FR2::DTR_Obj_G_LaneDistTime = %d\n", intval);
	filePutString (buffer, elcount(buffer), hFile);
	intval = getSignal(CHASSIS::DTR_Obj_G_FR2::DTR_Obj_G_Collision_Ovrlp);
	snprintf(buffer, elcount(buffer), "   0.000000 F1 LRR::DTR_Obj_G_FR2::DTR_Obj_G_Collision_Ovrlp = %d\n", intval);
	filePutString (buffer, elcount(buffer), hFile);
	floatval = getSignal(CHASSIS::DTR_Obj_G_FR2::DTR_Obj_G_RCS_V2);
	snprintf(buffer, elcount(buffer), "   0.000000 F1 LRR::DTR_Obj_G_FR2::DTR_Obj_G_RCS_V2 = %f\n", floatval);
	filePutString (buffer, elcount(buffer), hFile);
	intval = @sysvar::CH_Nodes::CH_LRRCRC_DTR_ObjStat_Pr2DT_AUTO;
	snprintf(buffer, elcount(buffer), "   0.000000    SV: 2 0 0 ::CH_Nodes::CH_LRRCRC_DTR_ObjStat_Pr2DT_AUTO = %d\n", intval);
	filePutString (buffer, elcount(buffer), hFile);
	intval = getSignal(CHASSIS::DTR_ObjStat_FR2::CRC_DTR_ObjStat_Pr2);
	snprintf(buffer, elcount(buffer), "   0.000000 F1 LRR::DTR_ObjStat_FR2::CRC_DTR_ObjStat_Pr2 = %d\n", intval);
	filePutString (buffer, elcount(buffer), hFile);
	intval = @sysvar::CH_Nodes::CH_LRRSQC_DTR_ObjStat_Pr2DT_AUTO;
	snprintf(buffer, elcount(buffer), "   0.000000    SV: 2 0 0 ::CH_Nodes::CH_LRRSQC_DTR_ObjStat_Pr2DT_AUTO = %d\n", intval);
	filePutString (buffer, elcount(buffer), hFile);
	intval = getSignal(CHASSIS::DTR_ObjStat_FR2::SQC_DTR_ObjStat_Pr2);
	snprintf(buffer, elcount(buffer), "   0.000000 F1 LRR::DTR_ObjStat_FR2::SQC_DTR_ObjStat_Pr2 = %d\n", intval);
	filePutString (buffer, elcount(buffer), hFile);
	intval = getSignal(CHASSIS::DTR_ObjStat_FR2::Rsrv1_DTR_ObjStat_Pr2);
	snprintf(buffer, elcount(buffer), "   0.000000 F1 LRR::DTR_ObjStat_FR2::Rsrv1_DTR_ObjStat_Pr2 = %d\n", intval);
	filePutString (buffer, elcount(buffer), hFile);
	floatval = getSignal(CHASSIS::DTR_ObjStat_FR2::DTR_TmStmpRef);
	snprintf(buffer, elcount(buffer), "   0.000000 F1 LRR::DTR_ObjStat_FR2::DTR_TmStmpRef = %f\n", floatval);
	filePutString (buffer, elcount(buffer), hFile);
	intval = getSignal(CHASSIS::DTR_ObjStat_FR2::DTR_LanePoly_Id);
	snprintf(buffer, elcount(buffer), "   0.000000 F1 LRR::DTR_ObjStat_FR2::DTR_LanePoly_Id = %d\n", intval);
	filePutString (buffer, elcount(buffer), hFile);
	intval = getSignal(CHASSIS::DTR_ObjStat_FR2::DTR_SWCycl);
	snprintf(buffer, elcount(buffer), "   0.000000 F1 LRR::DTR_ObjStat_FR2::DTR_SWCycl = %d\n", intval);
	filePutString (buffer, elcount(buffer), hFile);
	floatval = getSignal(CHASSIS::DTR_ObjStat_FR2::DTR_LanePoly_LtrlOffset);
	snprintf(buffer, elcount(buffer), "   0.000000 F1 LRR::DTR_ObjStat_FR2::DTR_LanePoly_LtrlOffset = %f\n", floatval);
	filePutString (buffer, elcount(buffer), hFile);
	floatval = getSignal(CHASSIS::DTR_ObjStat_FR2::DTR_Obj_TmDelay);
	snprintf(buffer, elcount(buffer), "   0.000000 F1 LRR::DTR_ObjStat_FR2::DTR_Obj_TmDelay = %f\n", floatval);
	filePutString (buffer, elcount(buffer), hFile);
	floatval = getSignal(CHASSIS::DTR_ObjStat_FR2::DTR_PolynmXOffst);
	snprintf(buffer, elcount(buffer), "   0.000000 F1 LRR::DTR_ObjStat_FR2::DTR_PolynmXOffst = %f\n", floatval);
	filePutString (buffer, elcount(buffer), hFile);
	floatval = getSignal(CHASSIS::DTR_ObjStat_FR2::DTR_LaneYawAngl);
	snprintf(buffer, elcount(buffer), "   0.000000 F1 LRR::DTR_ObjStat_FR2::DTR_LaneYawAngl = %f\n", floatval);
	filePutString (buffer, elcount(buffer), hFile);
	floatval = getSignal(CHASSIS::DTR_ObjStat_FR2::DTR_LaneHrztCrv);
	snprintf(buffer, elcount(buffer), "   0.000000 F1 LRR::DTR_ObjStat_FR2::DTR_LaneHrztCrv = %f\n", floatval);
	filePutString (buffer, elcount(buffer), hFile);
	floatval = getSignal(CHASSIS::DTR_ObjStat_FR2::DTR_LaneClothoidPara);
	snprintf(buffer, elcount(buffer), "   0.000000 F1 LRR::DTR_ObjStat_FR2::DTR_LaneClothoidPara = %f\n", floatval);
	filePutString (buffer, elcount(buffer), hFile);
	intval = getSignal(CHASSIS::DTR_ObjStat_FR2::DTR_LanePoly_Conf0);
	snprintf(buffer, elcount(buffer), "   0.000000 F1 LRR::DTR_ObjStat_FR2::DTR_LanePoly_Conf0 = %d\n", intval);
	filePutString (buffer, elcount(buffer), hFile);
	intval = getSignal(CHASSIS::DTR_ObjStat_FR2::DTR_LanePoly_Conf1);
	snprintf(buffer, elcount(buffer), "   0.000000 F1 LRR::DTR_ObjStat_FR2::DTR_LanePoly_Conf1 = %d\n", intval);
	filePutString (buffer, elcount(buffer), hFile);
	intval = getSignal(CHASSIS::DTR_ObjStat_FR2::DTR_LanePoly_Conf2);
	snprintf(buffer, elcount(buffer), "   0.000000 F1 LRR::DTR_ObjStat_FR2::DTR_LanePoly_Conf2 = %d\n", intval);
	filePutString (buffer, elcount(buffer), hFile);
	intval = getSignal(CHASSIS::DTR_ObjStat_FR2::DTR_LanePoly_Conf3);
	snprintf(buffer, elcount(buffer), "   0.000000 F1 LRR::DTR_ObjStat_FR2::DTR_LanePoly_Conf3 = %d\n", intval);
	filePutString (buffer, elcount(buffer), hFile);
	intval = @sysvar::CH_Nodes::CH_LRRCRC_DTR_Polyg_Lt_Pr2D_AUTO;
	snprintf(buffer, elcount(buffer), "   0.000000    SV: 2 0 0 ::CH_Nodes::CH_LRRCRC_DTR_Polyg_Lt_Pr2D_AUTO = %d\n", intval);
	filePutString (buffer, elcount(buffer), hFile);
	intval = getSignal(CHASSIS::DTR_Polyg_Lt_FR2::CRC_DTR_Polyg_Lt_Pr2);
	snprintf(buffer, elcount(buffer), "   0.000000 F1 LRR::DTR_Polyg_Lt_FR2::CRC_DTR_Polyg_Lt_Pr2 = %d\n", intval);
	filePutString (buffer, elcount(buffer), hFile);
	intval = @sysvar::CH_Nodes::CH_LRRSQC_DTR_Polyg_Lt_Pr2D_AUTO;
	snprintf(buffer, elcount(buffer), "   0.000000    SV: 2 0 0 ::CH_Nodes::CH_LRRSQC_DTR_Polyg_Lt_Pr2D_AUTO = %d\n", intval);
	filePutString (buffer, elcount(buffer), hFile);
	intval = getSignal(CHASSIS::DTR_Polyg_Lt_FR2::SQC_DTR_Polyg_Lt_Pr2);
	snprintf(buffer, elcount(buffer), "   0.000000 F1 LRR::DTR_Polyg_Lt_FR2::SQC_DTR_Polyg_Lt_Pr2 = %d\n", intval);
	filePutString (buffer, elcount(buffer), hFile);
	intval = getSignal(CHASSIS::DTR_Polyg_Lt_FR2::Rsrv1_DTR_Polyg_Lt_Pr2);
	snprintf(buffer, elcount(buffer), "   0.000000 F1 LRR::DTR_Polyg_Lt_FR2::Rsrv1_DTR_Polyg_Lt_Pr2 = %d\n", intval);
	filePutString (buffer, elcount(buffer), hFile);
	floatval = getSignal(CHASSIS::DTR_Polyg_Lt_FR2::DTR_Polyg_Lt_Y1);
	snprintf(buffer, elcount(buffer), "   0.000000 F1 LRR::DTR_Polyg_Lt_FR2::DTR_Polyg_Lt_Y1 = %f\n", floatval);
	filePutString (buffer, elcount(buffer), hFile);
	floatval = getSignal(CHASSIS::DTR_Polyg_Lt_FR2::DTR_Polyg_Lt_Y2);
	snprintf(buffer, elcount(buffer), "   0.000000 F1 LRR::DTR_Polyg_Lt_FR2::DTR_Polyg_Lt_Y2 = %f\n", floatval);
	filePutString (buffer, elcount(buffer), hFile);
	floatval = getSignal(CHASSIS::DTR_Polyg_Lt_FR2::DTR_Polyg_Lt_Y3);
	snprintf(buffer, elcount(buffer), "   0.000000 F1 LRR::DTR_Polyg_Lt_FR2::DTR_Polyg_Lt_Y3 = %f\n", floatval);
	filePutString (buffer, elcount(buffer), hFile);
	floatval = getSignal(CHASSIS::DTR_Polyg_Lt_FR2::DTR_Polyg_Lt_Y4);
	snprintf(buffer, elcount(buffer), "   0.000000 F1 LRR::DTR_Polyg_Lt_FR2::DTR_Polyg_Lt_Y4 = %f\n", floatval);
	filePutString (buffer, elcount(buffer), hFile);
	floatval = getSignal(CHASSIS::DTR_Polyg_Lt_FR2::DTR_Polyg_Lt_Y5);
	snprintf(buffer, elcount(buffer), "   0.000000 F1 LRR::DTR_Polyg_Lt_FR2::DTR_Polyg_Lt_Y5 = %f\n", floatval);
	filePutString (buffer, elcount(buffer), hFile);
	floatval = getSignal(CHASSIS::DTR_Polyg_Lt_FR2::DTR_Polyg_Lt_Y6);
	snprintf(buffer, elcount(buffer), "   0.000000 F1 LRR::DTR_Polyg_Lt_FR2::DTR_Polyg_Lt_Y6 = %f\n", floatval);
	filePutString (buffer, elcount(buffer), hFile);
	floatval = getSignal(CHASSIS::DTR_Polyg_Lt_FR2::DTR_Polyg_Lt_Y7);
	snprintf(buffer, elcount(buffer), "   0.000000 F1 LRR::DTR_Polyg_Lt_FR2::DTR_Polyg_Lt_Y7 = %f\n", floatval);
	filePutString (buffer, elcount(buffer), hFile);
	floatval = getSignal(CHASSIS::DTR_Polyg_Lt_FR2::DTR_Polyg_Lt_Y8);
	snprintf(buffer, elcount(buffer), "   0.000000 F1 LRR::DTR_Polyg_Lt_FR2::DTR_Polyg_Lt_Y8 = %f\n", floatval);
	filePutString (buffer, elcount(buffer), hFile);
	floatval = getSignal(CHASSIS::DTR_Polyg_Lt_FR2::DTR_Polyg_Lt_Y9);
	snprintf(buffer, elcount(buffer), "   0.000000 F1 LRR::DTR_Polyg_Lt_FR2::DTR_Polyg_Lt_Y9 = %f\n", floatval);
	filePutString (buffer, elcount(buffer), hFile);
	floatval = getSignal(CHASSIS::DTR_Polyg_Lt_FR2::DTR_Polyg_Lt_Y10);
	snprintf(buffer, elcount(buffer), "   0.000000 F1 LRR::DTR_Polyg_Lt_FR2::DTR_Polyg_Lt_Y10 = %f\n", floatval);
	filePutString (buffer, elcount(buffer), hFile);
	intval = getSignal(CHASSIS::DTR_Polyg_Lt_FR2::DTR_Polyg_Lt_Y1_Confdc);
	snprintf(buffer, elcount(buffer), "   0.000000 F1 LRR::DTR_Polyg_Lt_FR2::DTR_Polyg_Lt_Y1_Confdc = %d\n", intval);
	filePutString (buffer, elcount(buffer), hFile);
	intval = getSignal(CHASSIS::DTR_Polyg_Lt_FR2::DTR_Polyg_Lt_Y2_Confdc);
	snprintf(buffer, elcount(buffer), "   0.000000 F1 LRR::DTR_Polyg_Lt_FR2::DTR_Polyg_Lt_Y2_Confdc = %d\n", intval);
	filePutString (buffer, elcount(buffer), hFile);
	intval = getSignal(CHASSIS::DTR_Polyg_Lt_FR2::DTR_Polyg_Lt_Y3_Confdc);
	snprintf(buffer, elcount(buffer), "   0.000000 F1 LRR::DTR_Polyg_Lt_FR2::DTR_Polyg_Lt_Y3_Confdc = %d\n", intval);
	filePutString (buffer, elcount(buffer), hFile);
	intval = getSignal(CHASSIS::DTR_Polyg_Lt_FR2::DTR_Polyg_Lt_Y4_Confdc);
	snprintf(buffer, elcount(buffer), "   0.000000 F1 LRR::DTR_Polyg_Lt_FR2::DTR_Polyg_Lt_Y4_Confdc = %d\n", intval);
	filePutString (buffer, elcount(buffer), hFile);
}
/*@@end*/

/*@@caplFunc:saveVars_77(dword):*/
void saveVars_77(dword hFile)
{
	intval = getSignal(CHASSIS::DTR_Polyg_Lt_FR2::DTR_Polyg_Lt_Y5_Confdc);
	snprintf(buffer, elcount(buffer), "   0.000000 F1 LRR::DTR_Polyg_Lt_FR2::DTR_Polyg_Lt_Y5_Confdc = %d\n", intval);
	filePutString (buffer, elcount(buffer), hFile);
	intval = getSignal(CHASSIS::DTR_Polyg_Lt_FR2::DTR_Polyg_Lt_Y6_Confdc);
	snprintf(buffer, elcount(buffer), "   0.000000 F1 LRR::DTR_Polyg_Lt_FR2::DTR_Polyg_Lt_Y6_Confdc = %d\n", intval);
	filePutString (buffer, elcount(buffer), hFile);
	intval = getSignal(CHASSIS::DTR_Polyg_Lt_FR2::DTR_Polyg_Lt_Y7_Confdc);
	snprintf(buffer, elcount(buffer), "   0.000000 F1 LRR::DTR_Polyg_Lt_FR2::DTR_Polyg_Lt_Y7_Confdc = %d\n", intval);
	filePutString (buffer, elcount(buffer), hFile);
	intval = getSignal(CHASSIS::DTR_Polyg_Lt_FR2::DTR_Polyg_Lt_Y8_Confdc);
	snprintf(buffer, elcount(buffer), "   0.000000 F1 LRR::DTR_Polyg_Lt_FR2::DTR_Polyg_Lt_Y8_Confdc = %d\n", intval);
	filePutString (buffer, elcount(buffer), hFile);
	intval = getSignal(CHASSIS::DTR_Polyg_Lt_FR2::DTR_Polyg_Lt_Y9_Confdc);
	snprintf(buffer, elcount(buffer), "   0.000000 F1 LRR::DTR_Polyg_Lt_FR2::DTR_Polyg_Lt_Y9_Confdc = %d\n", intval);
	filePutString (buffer, elcount(buffer), hFile);
	intval = getSignal(CHASSIS::DTR_Polyg_Lt_FR2::DTR_Polyg_Lt_Y10_Confdc);
	snprintf(buffer, elcount(buffer), "   0.000000 F1 LRR::DTR_Polyg_Lt_FR2::DTR_Polyg_Lt_Y10_Confdc = %d\n", intval);
	filePutString (buffer, elcount(buffer), hFile);
	intval = getSignal(CHASSIS::DTR_Polyg_Lt_FR2::DTR_Polyg_Lt_Seg_ID);
	snprintf(buffer, elcount(buffer), "   0.000000 F1 LRR::DTR_Polyg_Lt_FR2::DTR_Polyg_Lt_Seg_ID = %d\n", intval);
	filePutString (buffer, elcount(buffer), hFile);
	floatval = getSignal(CHASSIS::DTR_Polyg_Lt_FR2::DTR_Polyg_Lt_Range_X_Max);
	snprintf(buffer, elcount(buffer), "   0.000000 F1 LRR::DTR_Polyg_Lt_FR2::DTR_Polyg_Lt_Range_X_Max = %f\n", floatval);
	filePutString (buffer, elcount(buffer), hFile);
	intval = getSignal(CHASSIS::DTR_Polyg_Lt_FR2::Rsrv2_DTR_Polyg_Lt_Pr2);
	snprintf(buffer, elcount(buffer), "   0.000000 F1 LRR::DTR_Polyg_Lt_FR2::Rsrv2_DTR_Polyg_Lt_Pr2 = %d\n", intval);
	filePutString (buffer, elcount(buffer), hFile);
	intval = @sysvar::CH_Nodes::CH_LRRCRC_DTR_Polyg_Rt_Pr2D_AUTO;
	snprintf(buffer, elcount(buffer), "   0.000000    SV: 2 0 0 ::CH_Nodes::CH_LRRCRC_DTR_Polyg_Rt_Pr2D_AUTO = %d\n", intval);
	filePutString (buffer, elcount(buffer), hFile);
	intval = getSignal(CHASSIS::DTR_Polyg_Rt_FR2::CRC_DTR_Polyg_Rt_Pr2);
	snprintf(buffer, elcount(buffer), "   0.000000 F1 LRR::DTR_Polyg_Rt_FR2::CRC_DTR_Polyg_Rt_Pr2 = %d\n", intval);
	filePutString (buffer, elcount(buffer), hFile);
	intval = @sysvar::CH_Nodes::CH_LRRSQC_DTR_Polyg_Rt_Pr2D_AUTO;
	snprintf(buffer, elcount(buffer), "   0.000000    SV: 2 0 0 ::CH_Nodes::CH_LRRSQC_DTR_Polyg_Rt_Pr2D_AUTO = %d\n", intval);
	filePutString (buffer, elcount(buffer), hFile);
	intval = getSignal(CHASSIS::DTR_Polyg_Rt_FR2::SQC_DTR_Polyg_Rt_Pr2);
	snprintf(buffer, elcount(buffer), "   0.000000 F1 LRR::DTR_Polyg_Rt_FR2::SQC_DTR_Polyg_Rt_Pr2 = %d\n", intval);
	filePutString (buffer, elcount(buffer), hFile);
	intval = getSignal(CHASSIS::DTR_Polyg_Rt_FR2::Rsrv1_DTR_Polyg_Rt_Pr2);
	snprintf(buffer, elcount(buffer), "   0.000000 F1 LRR::DTR_Polyg_Rt_FR2::Rsrv1_DTR_Polyg_Rt_Pr2 = %d\n", intval);
	filePutString (buffer, elcount(buffer), hFile);
	floatval = getSignal(CHASSIS::DTR_Polyg_Rt_FR2::DTR_Polyg_Rt_Y1);
	snprintf(buffer, elcount(buffer), "   0.000000 F1 LRR::DTR_Polyg_Rt_FR2::DTR_Polyg_Rt_Y1 = %f\n", floatval);
	filePutString (buffer, elcount(buffer), hFile);
	floatval = getSignal(CHASSIS::DTR_Polyg_Rt_FR2::DTR_Polyg_Rt_Y2);
	snprintf(buffer, elcount(buffer), "   0.000000 F1 LRR::DTR_Polyg_Rt_FR2::DTR_Polyg_Rt_Y2 = %f\n", floatval);
	filePutString (buffer, elcount(buffer), hFile);
	floatval = getSignal(CHASSIS::DTR_Polyg_Rt_FR2::DTR_Polyg_Rt_Y3);
	snprintf(buffer, elcount(buffer), "   0.000000 F1 LRR::DTR_Polyg_Rt_FR2::DTR_Polyg_Rt_Y3 = %f\n", floatval);
	filePutString (buffer, elcount(buffer), hFile);
	floatval = getSignal(CHASSIS::DTR_Polyg_Rt_FR2::DTR_Polyg_Rt_Y4);
	snprintf(buffer, elcount(buffer), "   0.000000 F1 LRR::DTR_Polyg_Rt_FR2::DTR_Polyg_Rt_Y4 = %f\n", floatval);
	filePutString (buffer, elcount(buffer), hFile);
	floatval = getSignal(CHASSIS::DTR_Polyg_Rt_FR2::DTR_Polyg_Rt_Y5);
	snprintf(buffer, elcount(buffer), "   0.000000 F1 LRR::DTR_Polyg_Rt_FR2::DTR_Polyg_Rt_Y5 = %f\n", floatval);
	filePutString (buffer, elcount(buffer), hFile);
	floatval = getSignal(CHASSIS::DTR_Polyg_Rt_FR2::DTR_Polyg_Rt_Y6);
	snprintf(buffer, elcount(buffer), "   0.000000 F1 LRR::DTR_Polyg_Rt_FR2::DTR_Polyg_Rt_Y6 = %f\n", floatval);
	filePutString (buffer, elcount(buffer), hFile);
	floatval = getSignal(CHASSIS::DTR_Polyg_Rt_FR2::DTR_Polyg_Rt_Y7);
	snprintf(buffer, elcount(buffer), "   0.000000 F1 LRR::DTR_Polyg_Rt_FR2::DTR_Polyg_Rt_Y7 = %f\n", floatval);
	filePutString (buffer, elcount(buffer), hFile);
	floatval = getSignal(CHASSIS::DTR_Polyg_Rt_FR2::DTR_Polyg_Rt_Y8);
	snprintf(buffer, elcount(buffer), "   0.000000 F1 LRR::DTR_Polyg_Rt_FR2::DTR_Polyg_Rt_Y8 = %f\n", floatval);
	filePutString (buffer, elcount(buffer), hFile);
	floatval = getSignal(CHASSIS::DTR_Polyg_Rt_FR2::DTR_Polyg_Rt_Y9);
	snprintf(buffer, elcount(buffer), "   0.000000 F1 LRR::DTR_Polyg_Rt_FR2::DTR_Polyg_Rt_Y9 = %f\n", floatval);
	filePutString (buffer, elcount(buffer), hFile);
	floatval = getSignal(CHASSIS::DTR_Polyg_Rt_FR2::DTR_Polyg_Rt_Y10);
	snprintf(buffer, elcount(buffer), "   0.000000 F1 LRR::DTR_Polyg_Rt_FR2::DTR_Polyg_Rt_Y10 = %f\n", floatval);
	filePutString (buffer, elcount(buffer), hFile);
	intval = getSignal(CHASSIS::DTR_Polyg_Rt_FR2::DTR_Polyg_Rt_Y1_Confdc);
	snprintf(buffer, elcount(buffer), "   0.000000 F1 LRR::DTR_Polyg_Rt_FR2::DTR_Polyg_Rt_Y1_Confdc = %d\n", intval);
	filePutString (buffer, elcount(buffer), hFile);
	intval = getSignal(CHASSIS::DTR_Polyg_Rt_FR2::DTR_Polyg_Rt_Y2_Confdc);
	snprintf(buffer, elcount(buffer), "   0.000000 F1 LRR::DTR_Polyg_Rt_FR2::DTR_Polyg_Rt_Y2_Confdc = %d\n", intval);
	filePutString (buffer, elcount(buffer), hFile);
	intval = getSignal(CHASSIS::DTR_Polyg_Rt_FR2::DTR_Polyg_Rt_Y3_Confdc);
	snprintf(buffer, elcount(buffer), "   0.000000 F1 LRR::DTR_Polyg_Rt_FR2::DTR_Polyg_Rt_Y3_Confdc = %d\n", intval);
	filePutString (buffer, elcount(buffer), hFile);
	intval = getSignal(CHASSIS::DTR_Polyg_Rt_FR2::DTR_Polyg_Rt_Y4_Confdc);
	snprintf(buffer, elcount(buffer), "   0.000000 F1 LRR::DTR_Polyg_Rt_FR2::DTR_Polyg_Rt_Y4_Confdc = %d\n", intval);
	filePutString (buffer, elcount(buffer), hFile);
	intval = getSignal(CHASSIS::DTR_Polyg_Rt_FR2::DTR_Polyg_Rt_Y5_Confdc);
	snprintf(buffer, elcount(buffer), "   0.000000 F1 LRR::DTR_Polyg_Rt_FR2::DTR_Polyg_Rt_Y5_Confdc = %d\n", intval);
	filePutString (buffer, elcount(buffer), hFile);
	intval = getSignal(CHASSIS::DTR_Polyg_Rt_FR2::DTR_Polyg_Rt_Y6_Confdc);
	snprintf(buffer, elcount(buffer), "   0.000000 F1 LRR::DTR_Polyg_Rt_FR2::DTR_Polyg_Rt_Y6_Confdc = %d\n", intval);
	filePutString (buffer, elcount(buffer), hFile);
	intval = getSignal(CHASSIS::DTR_Polyg_Rt_FR2::DTR_Polyg_Rt_Y7_Confdc);
	snprintf(buffer, elcount(buffer), "   0.000000 F1 LRR::DTR_Polyg_Rt_FR2::DTR_Polyg_Rt_Y7_Confdc = %d\n", intval);
	filePutString (buffer, elcount(buffer), hFile);
	intval = getSignal(CHASSIS::DTR_Polyg_Rt_FR2::DTR_Polyg_Rt_Y8_Confdc);
	snprintf(buffer, elcount(buffer), "   0.000000 F1 LRR::DTR_Polyg_Rt_FR2::DTR_Polyg_Rt_Y8_Confdc = %d\n", intval);
	filePutString (buffer, elcount(buffer), hFile);
	intval = getSignal(CHASSIS::DTR_Polyg_Rt_FR2::DTR_Polyg_Rt_Y9_Confdc);
	snprintf(buffer, elcount(buffer), "   0.000000 F1 LRR::DTR_Polyg_Rt_FR2::DTR_Polyg_Rt_Y9_Confdc = %d\n", intval);
	filePutString (buffer, elcount(buffer), hFile);
	intval = getSignal(CHASSIS::DTR_Polyg_Rt_FR2::DTR_Polyg_Rt_Y10_Confdc);
	snprintf(buffer, elcount(buffer), "   0.000000 F1 LRR::DTR_Polyg_Rt_FR2::DTR_Polyg_Rt_Y10_Confdc = %d\n", intval);
	filePutString (buffer, elcount(buffer), hFile);
	intval = getSignal(CHASSIS::DTR_Polyg_Rt_FR2::DTR_Polyg_Rt_Seg_ID);
	snprintf(buffer, elcount(buffer), "   0.000000 F1 LRR::DTR_Polyg_Rt_FR2::DTR_Polyg_Rt_Seg_ID = %d\n", intval);
	filePutString (buffer, elcount(buffer), hFile);
	floatval = getSignal(CHASSIS::DTR_Polyg_Rt_FR2::DTR_Polyg_Rt_Range_X_Max);
	snprintf(buffer, elcount(buffer), "   0.000000 F1 LRR::DTR_Polyg_Rt_FR2::DTR_Polyg_Rt_Range_X_Max = %f\n", floatval);
	filePutString (buffer, elcount(buffer), hFile);
	intval = getSignal(CHASSIS::DTR_Polyg_Rt_FR2::Rsrv2_DTR_Polyg_Rt_Pr2);
	snprintf(buffer, elcount(buffer), "   0.000000 F1 LRR::DTR_Polyg_Rt_FR2::Rsrv2_DTR_Polyg_Rt_Pr2 = %d\n", intval);
	filePutString (buffer, elcount(buffer), hFile);
	intval = @sysvar::CH_Nodes::CH_LRRCRC_DTR_Stat_Pr2DTR_S_AUTO;
	snprintf(buffer, elcount(buffer), "   0.000000    SV: 2 0 0 ::CH_Nodes::CH_LRRCRC_DTR_Stat_Pr2DTR_S_AUTO = %d\n", intval);
	filePutString (buffer, elcount(buffer), hFile);
	intval = getSignal(CHASSIS::DTR_Stat_FR2::CRC_DTR_Stat_Pr2);
	snprintf(buffer, elcount(buffer), "   0.000000 F1 LRR::DTR_Stat_FR2::CRC_DTR_Stat_Pr2 = %d\n", intval);
	filePutString (buffer, elcount(buffer), hFile);
	intval = @sysvar::CH_Nodes::CH_LRRSQC_DTR_Stat_Pr2DTR_S_AUTO;
	snprintf(buffer, elcount(buffer), "   0.000000    SV: 2 0 0 ::CH_Nodes::CH_LRRSQC_DTR_Stat_Pr2DTR_S_AUTO = %d\n", intval);
	filePutString (buffer, elcount(buffer), hFile);
	intval = getSignal(CHASSIS::DTR_Stat_FR2::SQC_DTR_Stat_Pr2);
	snprintf(buffer, elcount(buffer), "   0.000000 F1 LRR::DTR_Stat_FR2::SQC_DTR_Stat_Pr2 = %d\n", intval);
	filePutString (buffer, elcount(buffer), hFile);
	intval = getSignal(CHASSIS::DTR_Stat_FR2::DTR_ObjMeas);
	snprintf(buffer, elcount(buffer), "   0.000000 F1 LRR::DTR_Stat_FR2::DTR_ObjMeas = %d\n", intval);
	filePutString (buffer, elcount(buffer), hFile);
	intval = getSignal(CHASSIS::DTR_Stat_FR2::Rsrv4_DTR_Stat_Pr2);
	snprintf(buffer, elcount(buffer), "   0.000000 F1 LRR::DTR_Stat_FR2::Rsrv4_DTR_Stat_Pr2 = %d\n", intval);
	filePutString (buffer, elcount(buffer), hFile);
	floatval = getSignal(CHASSIS::DTR_Stat_FR2::DTR_AziAlignAnglDev_Max);
	snprintf(buffer, elcount(buffer), "   0.000000 F1 LRR::DTR_Stat_FR2::DTR_AziAlignAnglDev_Max = %f\n", floatval);
	filePutString (buffer, elcount(buffer), hFile);
	intval = getSignal(CHASSIS::DTR_Stat_FR2::DTR_SysDamp);
	snprintf(buffer, elcount(buffer), "   0.000000 F1 LRR::DTR_Stat_FR2::DTR_SysDamp = %d\n", intval);
	filePutString (buffer, elcount(buffer), hFile);
	floatval = getSignal(CHASSIS::DTR_Stat_FR2::DTR_DistRoadBoarder_Lt);
	snprintf(buffer, elcount(buffer), "   0.000000 F1 LRR::DTR_Stat_FR2::DTR_DistRoadBoarder_Lt = %f\n", floatval);
	filePutString (buffer, elcount(buffer), hFile);
	floatval = getSignal(CHASSIS::DTR_Stat_FR2::DTR_DistRoadBoarder_Rt);
	snprintf(buffer, elcount(buffer), "   0.000000 F1 LRR::DTR_Stat_FR2::DTR_DistRoadBoarder_Rt = %f\n", floatval);
	filePutString (buffer, elcount(buffer), hFile);
	floatval = getSignal(CHASSIS::DTR_Stat_FR2::DTR_DistRdBoard_Lt_MaxNegDev);
	snprintf(buffer, elcount(buffer), "   0.000000 F1 LRR::DTR_Stat_FR2::DTR_DistRdBoard_Lt_MaxNegDev = %f\n", floatval);
	filePutString (buffer, elcount(buffer), hFile);
	floatval = getSignal(CHASSIS::DTR_Stat_FR2::DTR_DistRdBoard_Rt_MaxNegDev);
	snprintf(buffer, elcount(buffer), "   0.000000 F1 LRR::DTR_Stat_FR2::DTR_DistRdBoard_Rt_MaxNegDev = %f\n", floatval);
	filePutString (buffer, elcount(buffer), hFile);
	intval = getSignal(CHASSIS::DTR_Stat_FR2::DTR_DtctDistMax);
	snprintf(buffer, elcount(buffer), "   0.000000 F1 LRR::DTR_Stat_FR2::DTR_DtctDistMax = %d\n", intval);
	filePutString (buffer, elcount(buffer), hFile);
	intval = getSignal(CHASSIS::DTR_Stat_FR2::Rsrv5_DTR_Stat_Pr2);
	snprintf(buffer, elcount(buffer), "   0.000000 F1 LRR::DTR_Stat_FR2::Rsrv5_DTR_Stat_Pr2 = %d\n", intval);
	filePutString (buffer, elcount(buffer), hFile);
	floatval = getSignal(CHASSIS::DTR_Stat_FR2::DTR_AziAlignAnglDev_Act);
	snprintf(buffer, elcount(buffer), "   0.000000 F1 LRR::DTR_Stat_FR2::DTR_AziAlignAnglDev_Act = %f\n", floatval);
	filePutString (buffer, elcount(buffer), hFile);
	intval = getSignal(CHASSIS::DTR_Stat_FR2::DTR_VehSpdCorrFctr_Qual);
	snprintf(buffer, elcount(buffer), "   0.000000 F1 LRR::DTR_Stat_FR2::DTR_VehSpdCorrFctr_Qual = %d\n", intval);
	filePutString (buffer, elcount(buffer), hFile);
	intval = getSignal(CHASSIS::DTR_Stat_FR2::DTR_LaneRadius_V3);
	snprintf(buffer, elcount(buffer), "   0.000000 F1 LRR::DTR_Stat_FR2::DTR_LaneRadius_V3 = %d\n", intval);
	filePutString (buffer, elcount(buffer), hFile);
	intval = getSignal(CHASSIS::DTR_Stat_FR2::DTR_TunnelDtct);
	snprintf(buffer, elcount(buffer), "   0.000000 F1 LRR::DTR_Stat_FR2::DTR_TunnelDtct = %d\n", intval);
	filePutString (buffer, elcount(buffer), hFile);
}
/*@@end*/

/*@@caplFunc:saveVars_78(dword):*/
void saveVars_78(dword hFile)
{
	intval = getSignal(CHASSIS::DTR_Stat_FR2::DTR_LaneRadiusConf);
	snprintf(buffer, elcount(buffer), "   0.000000 F1 LRR::DTR_Stat_FR2::DTR_LaneRadiusConf = %d\n", intval);
	filePutString (buffer, elcount(buffer), hFile);
	intval = getSignal(CHASSIS::DTR_Stat_FR2::DTR_SensDiagMd);
	snprintf(buffer, elcount(buffer), "   0.000000 F1 LRR::DTR_Stat_FR2::DTR_SensDiagMd = %d\n", intval);
	filePutString (buffer, elcount(buffer), hFile);
	intval = getSignal(CHASSIS::DTR_Stat_FR2::DTR_SupVolt_Lo);
	snprintf(buffer, elcount(buffer), "   0.000000 F1 LRR::DTR_Stat_FR2::DTR_SupVolt_Lo = %d\n", intval);
	filePutString (buffer, elcount(buffer), hFile);
	intval = getSignal(CHASSIS::DTR_Stat_FR2::DTR_SensOff_Temp);
	snprintf(buffer, elcount(buffer), "   0.000000 F1 LRR::DTR_Stat_FR2::DTR_SensOff_Temp = %d\n", intval);
	filePutString (buffer, elcount(buffer), hFile);
	intval = getSignal(CHASSIS::DTR_Stat_FR2::DTR_RxInv);
	snprintf(buffer, elcount(buffer), "   0.000000 F1 LRR::DTR_Stat_FR2::DTR_RxInv = %d\n", intval);
	filePutString (buffer, elcount(buffer), hFile);
	intval = getSignal(CHASSIS::DTR_Stat_FR2::DTR_SensDeadj);
	snprintf(buffer, elcount(buffer), "   0.000000 F1 LRR::DTR_Stat_FR2::DTR_SensDeadj = %d\n", intval);
	filePutString (buffer, elcount(buffer), hFile);
	intval = getSignal(CHASSIS::DTR_Stat_FR2::DTR_SensDef);
	snprintf(buffer, elcount(buffer), "   0.000000 F1 LRR::DTR_Stat_FR2::DTR_SensDef = %d\n", intval);
	filePutString (buffer, elcount(buffer), hFile);
	intval = getSignal(CHASSIS::DTR_Stat_FR2::DTR_SensExtDstrb);
	snprintf(buffer, elcount(buffer), "   0.000000 F1 LRR::DTR_Stat_FR2::DTR_SensExtDstrb = %d\n", intval);
	filePutString (buffer, elcount(buffer), hFile);
	intval = getSignal(CHASSIS::DTR_Stat_FR2::DTR_SensOut_Rdc);
	snprintf(buffer, elcount(buffer), "   0.000000 F1 LRR::DTR_Stat_FR2::DTR_SensOut_Rdc = %d\n", intval);
	filePutString (buffer, elcount(buffer), hFile);
	intval = getSignal(CHASSIS::DTR_Stat_FR2::Rsrv1_DTR_Stat_Pr2);
	snprintf(buffer, elcount(buffer), "   0.000000 F1 LRR::DTR_Stat_FR2::Rsrv1_DTR_Stat_Pr2 = %d\n", intval);
	filePutString (buffer, elcount(buffer), hFile);
	floatval = getSignal(CHASSIS::DTR_Stat_FR2::DTR_VehSpdCorrFctr);
	snprintf(buffer, elcount(buffer), "   0.000000 F1 LRR::DTR_Stat_FR2::DTR_VehSpdCorrFctr = %f\n", floatval);
	filePutString (buffer, elcount(buffer), hFile);
	floatval = getSignal(CHASSIS::DTR_Stat_FR2::DTR_EleAlignAnglDev_Act);
	snprintf(buffer, elcount(buffer), "   0.000000 F1 LRR::DTR_Stat_FR2::DTR_EleAlignAnglDev_Act = %f\n", floatval);
	filePutString (buffer, elcount(buffer), hFile);
	intval = getSignal(CHASSIS::DTR_Stat_FR2::DTR_VehYawRateOffsetType);
	snprintf(buffer, elcount(buffer), "   0.000000 F1 LRR::DTR_Stat_FR2::DTR_VehYawRateOffsetType = %d\n", intval);
	filePutString (buffer, elcount(buffer), hFile);
	floatval = getSignal(CHASSIS::DTR_Stat_FR2::DTR_VehYawRateOffset);
	snprintf(buffer, elcount(buffer), "   0.000000 F1 LRR::DTR_Stat_FR2::DTR_VehYawRateOffset = %f\n", floatval);
	filePutString (buffer, elcount(buffer), hFile);
	intval = getSignal(CHASSIS::DTR_Stat_FR2::Rsrv2_DTR_Stat_Pr2);
	snprintf(buffer, elcount(buffer), "   0.000000 F1 LRR::DTR_Stat_FR2::Rsrv2_DTR_Stat_Pr2 = %d\n", intval);
	filePutString (buffer, elcount(buffer), hFile);
	intval = getSignal(CHASSIS::DTR_Stat_FR2::Rsrv3_DTR_Stat_Pr2);
	snprintf(buffer, elcount(buffer), "   0.000000 F1 LRR::DTR_Stat_FR2::Rsrv3_DTR_Stat_Pr2 = %d\n", intval);
	filePutString (buffer, elcount(buffer), hFile);
	intval = getSignal(CHASSIS::ROE_LRR::ROE_Header_LRR);
	snprintf(buffer, elcount(buffer), "   0.000000 F1 LRR::ROE_LRR::ROE_Header_LRR = %d\n", intval);
	filePutString (buffer, elcount(buffer), hFile);
	intval = getSignal(CHASSIS::ROE_LRR::ROE_DTC_LRR);
	snprintf(buffer, elcount(buffer), "   0.000000 F1 LRR::ROE_LRR::ROE_DTC_LRR = %d\n", intval);
	filePutString (buffer, elcount(buffer), hFile);
	intval = getSignal(CHASSIS::ROE_LRR::ROE_DTC_Stat_LRR);
	snprintf(buffer, elcount(buffer), "   0.000000 F1 LRR::ROE_LRR::ROE_DTC_Stat_LRR = %d\n", intval);
	filePutString (buffer, elcount(buffer), hFile);
	snprintf(buffer, elcount(buffer), "   0.000000    SV: 2 0 0 ::CH_Nodes::CH__NMActive_MPC = %X\n", @sysvar::CH_Nodes::CH__NMActive_MPC);
	filePutString (buffer, elcount(buffer), hFile);
	snprintf(buffer, elcount(buffer), "   0.000000    SV: 2 0 0 ::CH_Nodes::CH__NMAwake_MPC = %X\n", @sysvar::CH_Nodes::CH__NMAwake_MPC);
	filePutString (buffer, elcount(buffer), hFile);
	intval = @sysvar::CH_Nodes::CH_MPCCRC_Cam_Stat_Pr2Cam_S_AUTO;
	snprintf(buffer, elcount(buffer), "   0.000000    SV: 2 0 0 ::CH_Nodes::CH_MPCCRC_Cam_Stat_Pr2Cam_S_AUTO = %d\n", intval);
	filePutString (buffer, elcount(buffer), hFile);
	intval = getSignal(CHASSIS::Cam_Stat_AR2::CRC_Cam_Stat_Pr2);
	snprintf(buffer, elcount(buffer), "   0.000000 F1 MPC::Cam_Stat_AR2::CRC_Cam_Stat_Pr2 = %d\n", intval);
	filePutString (buffer, elcount(buffer), hFile);
	intval = @sysvar::CH_Nodes::CH_MPCSQC_Cam_Stat_Pr2Cam_S_AUTO;
	snprintf(buffer, elcount(buffer), "   0.000000    SV: 2 0 0 ::CH_Nodes::CH_MPCSQC_Cam_Stat_Pr2Cam_S_AUTO = %d\n", intval);
	filePutString (buffer, elcount(buffer), hFile);
	intval = getSignal(CHASSIS::Cam_Stat_AR2::SQC_Cam_Stat_Pr2);
	snprintf(buffer, elcount(buffer), "   0.000000 F1 MPC::Cam_Stat_AR2::SQC_Cam_Stat_Pr2 = %d\n", intval);
	filePutString (buffer, elcount(buffer), hFile);
	intval = getSignal(CHASSIS::Cam_Stat_AR2::Cam_Stat_StereoObjDtct_Stat);
	snprintf(buffer, elcount(buffer), "   0.000000 F1 MPC::Cam_Stat_AR2::Cam_Stat_StereoObjDtct_Stat = %d\n", intval);
	filePutString (buffer, elcount(buffer), hFile);
	intval = getSignal(CHASSIS::Cam_Stat_AR2::Rsrv5_Cam_Stat_Pr2);
	snprintf(buffer, elcount(buffer), "   0.000000 F1 MPC::Cam_Stat_AR2::Rsrv5_Cam_Stat_Pr2 = %d\n", intval);
	filePutString (buffer, elcount(buffer), hFile);
	floatval = getSignal(CHASSIS::Cam_Stat_AR2::Cam_Stat_EgoMtn_Spd);
	snprintf(buffer, elcount(buffer), "   0.000000 F1 MPC::Cam_Stat_AR2::Cam_Stat_EgoMtn_Spd = %f\n", floatval);
	filePutString (buffer, elcount(buffer), hFile);
	floatval = getSignal(CHASSIS::Cam_Stat_AR2::Cam_Stat_EgoMtn_YawRate);
	snprintf(buffer, elcount(buffer), "   0.000000 F1 MPC::Cam_Stat_AR2::Cam_Stat_EgoMtn_YawRate = %f\n", floatval);
	filePutString (buffer, elcount(buffer), hFile);
	intval = getSignal(CHASSIS::Cam_Stat_AR2::Cam_Stat_List_Id);
	snprintf(buffer, elcount(buffer), "   0.000000 F1 MPC::Cam_Stat_AR2::Cam_Stat_List_Id = %d\n", intval);
	filePutString (buffer, elcount(buffer), hFile);
	intval = getSignal(CHASSIS::Cam_Stat_AR2::Cam_Stat_OprtnCnt);
	snprintf(buffer, elcount(buffer), "   0.000000 F1 MPC::Cam_Stat_AR2::Cam_Stat_OprtnCnt = %d\n", intval);
	filePutString (buffer, elcount(buffer), hFile);
	intval = getSignal(CHASSIS::Cam_Stat_AR2::Cam_Stat_ListCnt);
	snprintf(buffer, elcount(buffer), "   0.000000 F1 MPC::Cam_Stat_AR2::Cam_Stat_ListCnt = %d\n", intval);
	filePutString (buffer, elcount(buffer), hFile);
	floatval = getSignal(CHASSIS::Cam_Stat_AR2::Cam_Stat_FR_TmStmp);
	snprintf(buffer, elcount(buffer), "   0.000000 F1 MPC::Cam_Stat_AR2::Cam_Stat_FR_TmStmp = %f\n", floatval);
	filePutString (buffer, elcount(buffer), hFile);
	floatval = getSignal(CHASSIS::Cam_Stat_AR2::Cam_Stat_FR_TmDiff);
	snprintf(buffer, elcount(buffer), "   0.000000 F1 MPC::Cam_Stat_AR2::Cam_Stat_FR_TmDiff = %f\n", floatval);
	filePutString (buffer, elcount(buffer), hFile);
	intval = getSignal(CHASSIS::Cam_Stat_AR2::Rsrv7_Cam_Stat_Pr2);
	snprintf(buffer, elcount(buffer), "   0.000000 F1 MPC::Cam_Stat_AR2::Rsrv7_Cam_Stat_Pr2 = %d\n", intval);
	filePutString (buffer, elcount(buffer), hFile);
	intval = getSignal(CHASSIS::Cam_Stat_AR2::Cam_Stat_Calib_SOC);
	snprintf(buffer, elcount(buffer), "   0.000000 F1 MPC::Cam_Stat_AR2::Cam_Stat_Calib_SOC = %d\n", intval);
	filePutString (buffer, elcount(buffer), hFile);
	intval = getSignal(CHASSIS::Cam_Stat_AR2::Cam_Stat_Block_Stat);
	snprintf(buffer, elcount(buffer), "   0.000000 F1 MPC::Cam_Stat_AR2::Cam_Stat_Block_Stat = %d\n", intval);
	filePutString (buffer, elcount(buffer), hFile);
	intval = getSignal(CHASSIS::Cam_Stat_AR2::Cam_Stat_Calib_Stereo);
	snprintf(buffer, elcount(buffer), "   0.000000 F1 MPC::Cam_Stat_AR2::Cam_Stat_Calib_Stereo = %d\n", intval);
	filePutString (buffer, elcount(buffer), hFile);
	intval = getSignal(CHASSIS::Cam_Stat_AR2::Cam_Stat_RefSurf_Lgth);
	snprintf(buffer, elcount(buffer), "   0.000000 F1 MPC::Cam_Stat_AR2::Cam_Stat_RefSurf_Lgth = %d\n", intval);
	filePutString (buffer, elcount(buffer), hFile);
	intval = getSignal(CHASSIS::Cam_Stat_AR2::Cam_Stat_Calib_Mono);
	snprintf(buffer, elcount(buffer), "   0.000000 F1 MPC::Cam_Stat_AR2::Cam_Stat_Calib_Mono = %d\n", intval);
	filePutString (buffer, elcount(buffer), hFile);
	intval = getSignal(CHASSIS::Cam_Stat_AR2::Cam_Stat_RiskArea_Type);
	snprintf(buffer, elcount(buffer), "   0.000000 F1 MPC::Cam_Stat_AR2::Cam_Stat_RiskArea_Type = %d\n", intval);
	filePutString (buffer, elcount(buffer), hFile);
	intval = getSignal(CHASSIS::Cam_Stat_AR2::Cam_Stat_RiskPoint_Dist);
	snprintf(buffer, elcount(buffer), "   0.000000 F1 MPC::Cam_Stat_AR2::Cam_Stat_RiskPoint_Dist = %d\n", intval);
	filePutString (buffer, elcount(buffer), hFile);
	intval = getSignal(CHASSIS::Cam_Stat_AR2::Rsrv2_Cam_Stat_Pr2);
	snprintf(buffer, elcount(buffer), "   0.000000 F1 MPC::Cam_Stat_AR2::Rsrv2_Cam_Stat_Pr2 = %d\n", intval);
	filePutString (buffer, elcount(buffer), hFile);
	intval = getSignal(CHASSIS::Cam_Stat_AR2::Rsrv3_Cam_Stat_Pr2);
	snprintf(buffer, elcount(buffer), "   0.000000 F1 MPC::Cam_Stat_AR2::Rsrv3_Cam_Stat_Pr2 = %d\n", intval);
	filePutString (buffer, elcount(buffer), hFile);
	intval = getSignal(CHASSIS::Cam_Stat_AR2::Rsrv4_Cam_Stat_Pr2);
	snprintf(buffer, elcount(buffer), "   0.000000 F1 MPC::Cam_Stat_AR2::Rsrv4_Cam_Stat_Pr2 = %d\n", intval);
	filePutString (buffer, elcount(buffer), hFile);
	intval = @sysvar::CH_Nodes::CH_MPCCRC_CamLane_Disp_Warn_AUTO;
	snprintf(buffer, elcount(buffer), "   0.000000    SV: 2 0 0 ::CH_Nodes::CH_MPCCRC_CamLane_Disp_Warn_AUTO = %d\n", intval);
	filePutString (buffer, elcount(buffer), hFile);
	intval = getSignal(CHASSIS::CamLane_Disp_Warn_Rq_Gw_AR2::CRC_CamLane_Disp_Warn_Rq_Pr2);
	snprintf(buffer, elcount(buffer), "   0.000000 F1 MPC::CamLane_Disp_Warn_Rq_Gw_AR2::CRC_CamLane_Disp_Warn_Rq_Pr2 = %d\n", intval);
	filePutString (buffer, elcount(buffer), hFile);
	intval = @sysvar::CH_Nodes::CH_MPCSQC_CamLane_Disp_Warn_AUTO;
	snprintf(buffer, elcount(buffer), "   0.000000    SV: 2 0 0 ::CH_Nodes::CH_MPCSQC_CamLane_Disp_Warn_AUTO = %d\n", intval);
	filePutString (buffer, elcount(buffer), hFile);
	intval = getSignal(CHASSIS::CamLane_Disp_Warn_Rq_Gw_AR2::SQC_CamLane_Disp_Warn_Rq_Pr2);
	snprintf(buffer, elcount(buffer), "   0.000000 F1 MPC::CamLane_Disp_Warn_Rq_Gw_AR2::SQC_CamLane_Disp_Warn_Rq_Pr2 = %d\n", intval);
	filePutString (buffer, elcount(buffer), hFile);
	intval = getSignal(CHASSIS::CamLane_Disp_Warn_Rq_Gw_AR2::PavemntSign_Type_EgoLane);
	snprintf(buffer, elcount(buffer), "   0.000000 F1 MPC::CamLane_Disp_Warn_Rq_Gw_AR2::PavemntSign_Type_EgoLane = %d\n", intval);
	filePutString (buffer, elcount(buffer), hFile);
	floatval = getSignal(CHASSIS::CamLane_Disp_Warn_Rq_Gw_AR2::CrossWalk_Dist);
	snprintf(buffer, elcount(buffer), "   0.000000 F1 MPC::CamLane_Disp_Warn_Rq_Gw_AR2::CrossWalk_Dist = %f\n", floatval);
	filePutString (buffer, elcount(buffer), hFile);
	intval = getSignal(CHASSIS::CamLane_Disp_Warn_Rq_Gw_AR2::CrossWalk_Stat);
	snprintf(buffer, elcount(buffer), "   0.000000 F1 MPC::CamLane_Disp_Warn_Rq_Gw_AR2::CrossWalk_Stat = %d\n", intval);
	filePutString (buffer, elcount(buffer), hFile);
	intval = getSignal(CHASSIS::CamLane_Disp_Warn_Rq_Gw_AR2::LDP_IndLmp_SwLED_HU_Rq_MPC);
	snprintf(buffer, elcount(buffer), "   0.000000 F1 MPC::CamLane_Disp_Warn_Rq_Gw_AR2::LDP_IndLmp_SwLED_HU_Rq_MPC = %d\n", intval);
	filePutString (buffer, elcount(buffer), hFile);
	intval = getSignal(CHASSIS::CamLane_Disp_Warn_Rq_Gw_AR2::LDP_MPC_MsgDisp_Rq);
	snprintf(buffer, elcount(buffer), "   0.000000 F1 MPC::CamLane_Disp_Warn_Rq_Gw_AR2::LDP_MPC_MsgDisp_Rq = %d\n", intval);
	filePutString (buffer, elcount(buffer), hFile);
	floatval = getSignal(CHASSIS::CamLane_Disp_Warn_Rq_Gw_AR2::PavemntSign_LtrlDist_EgoLane);
	snprintf(buffer, elcount(buffer), "   0.000000 F1 MPC::CamLane_Disp_Warn_Rq_Gw_AR2::PavemntSign_LtrlDist_EgoLane = %f\n", floatval);
	filePutString (buffer, elcount(buffer), hFile);
}
/*@@end*/

/*@@caplFunc:saveVars_79(dword):*/
void saveVars_79(dword hFile)
{
	floatval = getSignal(CHASSIS::CamLane_Disp_Warn_Rq_Gw_AR2::PavemntSign_LtrlDist_NghbrLane);
	snprintf(buffer, elcount(buffer), "   0.000000 F1 MPC::CamLane_Disp_Warn_Rq_Gw_AR2::PavemntSign_LtrlDist_NghbrLane = %f\n", floatval);
	filePutString (buffer, elcount(buffer), hFile);
	intval = getSignal(CHASSIS::CamLane_Disp_Warn_Rq_Gw_AR2::PavemntSign_Type_NghbrLane);
	snprintf(buffer, elcount(buffer), "   0.000000 F1 MPC::CamLane_Disp_Warn_Rq_Gw_AR2::PavemntSign_Type_NghbrLane = %d\n", intval);
	filePutString (buffer, elcount(buffer), hFile);
	intval = getSignal(CHASSIS::CamLane_Disp_Warn_Rq_Gw_AR2::Rsrv3_CamLane_Disp_Warn_Rq_Pr2);
	snprintf(buffer, elcount(buffer), "   0.000000 F1 MPC::CamLane_Disp_Warn_Rq_Gw_AR2::Rsrv3_CamLane_Disp_Warn_Rq_Pr2 = %d\n", intval);
	filePutString (buffer, elcount(buffer), hFile);
	intval = getSignal(CHASSIS::CamLane_Disp_Warn_Rq_Gw_AR2::LDP_MPC_Md_Stat);
	snprintf(buffer, elcount(buffer), "   0.000000 F1 MPC::CamLane_Disp_Warn_Rq_Gw_AR2::LDP_MPC_Md_Stat = %d\n", intval);
	filePutString (buffer, elcount(buffer), hFile);
	intval = getSignal(CHASSIS::CamLane_Disp_Warn_Rq_Gw_AR2::Rsrv4_CamLane_Disp_Warn_Rq_Pr2);
	snprintf(buffer, elcount(buffer), "   0.000000 F1 MPC::CamLane_Disp_Warn_Rq_Gw_AR2::Rsrv4_CamLane_Disp_Warn_Rq_Pr2 = %d\n", intval);
	filePutString (buffer, elcount(buffer), hFile);
	intval = getSignal(CHASSIS::CamLane_Disp_Warn_Rq_Gw_AR2::Rsrv2_CamLane_Disp_Warn_Rq_Pr2);
	snprintf(buffer, elcount(buffer), "   0.000000 F1 MPC::CamLane_Disp_Warn_Rq_Gw_AR2::Rsrv2_CamLane_Disp_Warn_Rq_Pr2 = %d\n", intval);
	filePutString (buffer, elcount(buffer), hFile);
	intval = @sysvar::CH_Nodes::CH_MPCCRC_CamLane_FastAttr1_AUTO;
	snprintf(buffer, elcount(buffer), "   0.000000    SV: 2 0 0 ::CH_Nodes::CH_MPCCRC_CamLane_FastAttr1_AUTO = %d\n", intval);
	filePutString (buffer, elcount(buffer), hFile);
	intval = getSignal(CHASSIS::CamLane_FastAttr1_FR2::CRC_CamLane_FastAttr1_Pr2);
	snprintf(buffer, elcount(buffer), "   0.000000 F1 MPC::CamLane_FastAttr1_FR2::CRC_CamLane_FastAttr1_Pr2 = %d\n", intval);
	filePutString (buffer, elcount(buffer), hFile);
	intval = @sysvar::CH_Nodes::CH_MPCSQC_CamLane_FastAttr1_AUTO;
	snprintf(buffer, elcount(buffer), "   0.000000    SV: 2 0 0 ::CH_Nodes::CH_MPCSQC_CamLane_FastAttr1_AUTO = %d\n", intval);
	filePutString (buffer, elcount(buffer), hFile);
	intval = getSignal(CHASSIS::CamLane_FastAttr1_FR2::SQC_CamLane_FastAttr1_Pr2);
	snprintf(buffer, elcount(buffer), "   0.000000 F1 MPC::CamLane_FastAttr1_FR2::SQC_CamLane_FastAttr1_Pr2 = %d\n", intval);
	filePutString (buffer, elcount(buffer), hFile);
	intval = getSignal(CHASSIS::CamLane_FastAttr1_FR2::CamLane_FastAttr1_Sync);
	snprintf(buffer, elcount(buffer), "   0.000000 F1 MPC::CamLane_FastAttr1_FR2::CamLane_FastAttr1_Sync = %d\n", intval);
	filePutString (buffer, elcount(buffer), hFile);
	floatval = getSignal(CHASSIS::CamLane_FastAttr1_FR2::CamLane_TmStmp_V2);
	snprintf(buffer, elcount(buffer), "   0.000000 F1 MPC::CamLane_FastAttr1_FR2::CamLane_TmStmp_V2 = %f\n", floatval);
	filePutString (buffer, elcount(buffer), hFile);
	floatval = getSignal(CHASSIS::CamLane_FastAttr1_FR2::CamLane_TmDiff);
	snprintf(buffer, elcount(buffer), "   0.000000 F1 MPC::CamLane_FastAttr1_FR2::CamLane_TmDiff = %f\n", floatval);
	filePutString (buffer, elcount(buffer), hFile);
	intval = getSignal(CHASSIS::CamLane_FastAttr1_FR2::Rsrv3_CamLane_FastAttr1_Pr2);
	snprintf(buffer, elcount(buffer), "   0.000000 F1 MPC::CamLane_FastAttr1_FR2::Rsrv3_CamLane_FastAttr1_Pr2 = %d\n", intval);
	filePutString (buffer, elcount(buffer), hFile);
	floatval = getSignal(CHASSIS::CamLane_FastAttr1_FR2::CamLane_YawRate);
	snprintf(buffer, elcount(buffer), "   0.000000 F1 MPC::CamLane_FastAttr1_FR2::CamLane_YawRate = %f\n", floatval);
	filePutString (buffer, elcount(buffer), hFile);
	intval = getSignal(CHASSIS::CamLane_FastAttr1_FR2::CamLane_YawRate_Qual);
	snprintf(buffer, elcount(buffer), "   0.000000 F1 MPC::CamLane_FastAttr1_FR2::CamLane_YawRate_Qual = %d\n", intval);
	filePutString (buffer, elcount(buffer), hFile);
	intval = getSignal(CHASSIS::CamLane_FastAttr1_FR2::CamLane_LaneChg_Stat);
	snprintf(buffer, elcount(buffer), "   0.000000 F1 MPC::CamLane_FastAttr1_FR2::CamLane_LaneChg_Stat = %d\n", intval);
	filePutString (buffer, elcount(buffer), hFile);
	intval = getSignal(CHASSIS::CamLane_FastAttr1_FR2::CamLane_LaneDscrbSide);
	snprintf(buffer, elcount(buffer), "   0.000000 F1 MPC::CamLane_FastAttr1_FR2::CamLane_LaneDscrbSide = %d\n", intval);
	filePutString (buffer, elcount(buffer), hFile);
	intval = getSignal(CHASSIS::CamLane_FastAttr1_FR2::LaneLkChg_Lt);
	snprintf(buffer, elcount(buffer), "   0.000000 F1 MPC::CamLane_FastAttr1_FR2::LaneLkChg_Lt = %d\n", intval);
	filePutString (buffer, elcount(buffer), hFile);
	intval = getSignal(CHASSIS::CamLane_FastAttr1_FR2::CamLane_LaneMark_DtctDist_Lt);
	snprintf(buffer, elcount(buffer), "   0.000000 F1 MPC::CamLane_FastAttr1_FR2::CamLane_LaneMark_DtctDist_Lt = %d\n", intval);
	filePutString (buffer, elcount(buffer), hFile);
	intval = getSignal(CHASSIS::CamLane_FastAttr1_FR2::CamLane_LaneMark_DtctDist_Rt);
	snprintf(buffer, elcount(buffer), "   0.000000 F1 MPC::CamLane_FastAttr1_FR2::CamLane_LaneMark_DtctDist_Rt = %d\n", intval);
	filePutString (buffer, elcount(buffer), hFile);
	intval = getSignal(CHASSIS::CamLane_FastAttr1_FR2::LaneLkChg_Rt);
	snprintf(buffer, elcount(buffer), "   0.000000 F1 MPC::CamLane_FastAttr1_FR2::LaneLkChg_Rt = %d\n", intval);
	filePutString (buffer, elcount(buffer), hFile);
	floatval = getSignal(CHASSIS::CamLane_FastAttr1_FR2::CamLane_2ndClothoid_C1_Lt);
	snprintf(buffer, elcount(buffer), "   0.000000 F1 MPC::CamLane_FastAttr1_FR2::CamLane_2ndClothoid_C1_Lt = %f\n", floatval);
	filePutString (buffer, elcount(buffer), hFile);
	floatval = getSignal(CHASSIS::CamLane_FastAttr1_FR2::CamLane_2ndClothoid_C1_Rt);
	snprintf(buffer, elcount(buffer), "   0.000000 F1 MPC::CamLane_FastAttr1_FR2::CamLane_2ndClothoid_C1_Rt = %f\n", floatval);
	filePutString (buffer, elcount(buffer), hFile);
	intval = getSignal(CHASSIS::CamLane_FastAttr1_FR2::CamLane_2ndClothoid_Stat_Lt);
	snprintf(buffer, elcount(buffer), "   0.000000 F1 MPC::CamLane_FastAttr1_FR2::CamLane_2ndClothoid_Stat_Lt = %d\n", intval);
	filePutString (buffer, elcount(buffer), hFile);
	intval = getSignal(CHASSIS::CamLane_FastAttr1_FR2::CamLane_2ndClothoid_Stat_Rt);
	snprintf(buffer, elcount(buffer), "   0.000000 F1 MPC::CamLane_FastAttr1_FR2::CamLane_2ndClothoid_Stat_Rt = %d\n", intval);
	filePutString (buffer, elcount(buffer), hFile);
	intval = getSignal(CHASSIS::CamLane_FastAttr1_FR2::CamLane_LaneMarkType_Lt);
	snprintf(buffer, elcount(buffer), "   0.000000 F1 MPC::CamLane_FastAttr1_FR2::CamLane_LaneMarkType_Lt = %d\n", intval);
	filePutString (buffer, elcount(buffer), hFile);
	intval = getSignal(CHASSIS::CamLane_FastAttr1_FR2::CamLane_LaneMarkType_Rt);
	snprintf(buffer, elcount(buffer), "   0.000000 F1 MPC::CamLane_FastAttr1_FR2::CamLane_LaneMarkType_Rt = %d\n", intval);
	filePutString (buffer, elcount(buffer), hFile);
	floatval = getSignal(CHASSIS::CamLane_FastAttr1_FR2::CamLane_LaneDataQual_Lt);
	snprintf(buffer, elcount(buffer), "   0.000000 F1 MPC::CamLane_FastAttr1_FR2::CamLane_LaneDataQual_Lt = %f\n", floatval);
	filePutString (buffer, elcount(buffer), hFile);
	floatval = getSignal(CHASSIS::CamLane_FastAttr1_FR2::CamLane_LaneDataQual_Rt);
	snprintf(buffer, elcount(buffer), "   0.000000 F1 MPC::CamLane_FastAttr1_FR2::CamLane_LaneDataQual_Rt = %f\n", floatval);
	filePutString (buffer, elcount(buffer), hFile);
	floatval = getSignal(CHASSIS::CamLane_FastAttr1_FR2::CamLane_LaneMarkWidth_Lt);
	snprintf(buffer, elcount(buffer), "   0.000000 F1 MPC::CamLane_FastAttr1_FR2::CamLane_LaneMarkWidth_Lt = %f\n", floatval);
	filePutString (buffer, elcount(buffer), hFile);
	floatval = getSignal(CHASSIS::CamLane_FastAttr1_FR2::CamLane_LaneMarkWidth_Rt);
	snprintf(buffer, elcount(buffer), "   0.000000 F1 MPC::CamLane_FastAttr1_FR2::CamLane_LaneMarkWidth_Rt = %f\n", floatval);
	filePutString (buffer, elcount(buffer), hFile);
	intval = getSignal(CHASSIS::CamLane_FastAttr1_FR2::CamLane_Stat);
	snprintf(buffer, elcount(buffer), "   0.000000 F1 MPC::CamLane_FastAttr1_FR2::CamLane_Stat = %d\n", intval);
	filePutString (buffer, elcount(buffer), hFile);
	intval = getSignal(CHASSIS::CamLane_FastAttr1_FR2::CamLane_LaneMarkCol_Lt);
	snprintf(buffer, elcount(buffer), "   0.000000 F1 MPC::CamLane_FastAttr1_FR2::CamLane_LaneMarkCol_Lt = %d\n", intval);
	filePutString (buffer, elcount(buffer), hFile);
	intval = getSignal(CHASSIS::CamLane_FastAttr1_FR2::CamLane_LaneMarkCol_Rt);
	snprintf(buffer, elcount(buffer), "   0.000000 F1 MPC::CamLane_FastAttr1_FR2::CamLane_LaneMarkCol_Rt = %d\n", intval);
	filePutString (buffer, elcount(buffer), hFile);
	intval = getSignal(CHASSIS::CamLane_FastAttr1_FR2::Rsrv1_CamLane_FastAttr1_Pr2);
	snprintf(buffer, elcount(buffer), "   0.000000 F1 MPC::CamLane_FastAttr1_FR2::Rsrv1_CamLane_FastAttr1_Pr2 = %d\n", intval);
	filePutString (buffer, elcount(buffer), hFile);
	intval = getSignal(CHASSIS::CamLane_FastAttr1_FR2::Rsrv2_CamLane_FastAttr1_Pr2);
	snprintf(buffer, elcount(buffer), "   0.000000 F1 MPC::CamLane_FastAttr1_FR2::Rsrv2_CamLane_FastAttr1_Pr2 = %d\n", intval);
	filePutString (buffer, elcount(buffer), hFile);
	intval = @sysvar::CH_Nodes::CH_MPCCRC_CamLane_FastAttr2_AUTO;
	snprintf(buffer, elcount(buffer), "   0.000000    SV: 2 0 0 ::CH_Nodes::CH_MPCCRC_CamLane_FastAttr2_AUTO = %d\n", intval);
	filePutString (buffer, elcount(buffer), hFile);
	intval = getSignal(CHASSIS::CamLane_FastAttr2_FR2::CRC_CamLane_FastAttr2_Pr2);
	snprintf(buffer, elcount(buffer), "   0.000000 F1 MPC::CamLane_FastAttr2_FR2::CRC_CamLane_FastAttr2_Pr2 = %d\n", intval);
	filePutString (buffer, elcount(buffer), hFile);
	intval = @sysvar::CH_Nodes::CH_MPCSQC_CamLane_FastAttr2_AUTO;
	snprintf(buffer, elcount(buffer), "   0.000000    SV: 2 0 0 ::CH_Nodes::CH_MPCSQC_CamLane_FastAttr2_AUTO = %d\n", intval);
	filePutString (buffer, elcount(buffer), hFile);
	intval = getSignal(CHASSIS::CamLane_FastAttr2_FR2::SQC_CamLane_FastAttr2_Pr2);
	snprintf(buffer, elcount(buffer), "   0.000000 F1 MPC::CamLane_FastAttr2_FR2::SQC_CamLane_FastAttr2_Pr2 = %d\n", intval);
	filePutString (buffer, elcount(buffer), hFile);
	intval = getSignal(CHASSIS::CamLane_FastAttr2_FR2::CamLane_FastAttr2_Sync);
	snprintf(buffer, elcount(buffer), "   0.000000 F1 MPC::CamLane_FastAttr2_FR2::CamLane_FastAttr2_Sync = %d\n", intval);
	filePutString (buffer, elcount(buffer), hFile);
	floatval = getSignal(CHASSIS::CamLane_FastAttr2_FR2::CamLane_2ndClothoid_InitDist_Lt);
	snprintf(buffer, elcount(buffer), "   0.000000 F1 MPC::CamLane_FastAttr2_FR2::CamLane_2ndClothoid_InitDist_Lt = %f\n", floatval);
	filePutString (buffer, elcount(buffer), hFile);
	floatval = getSignal(CHASSIS::CamLane_FastAttr2_FR2::CamLane_2ndClothoid_InitDist_Rt);
	snprintf(buffer, elcount(buffer), "   0.000000 F1 MPC::CamLane_FastAttr2_FR2::CamLane_2ndClothoid_InitDist_Rt = %f\n", floatval);
	filePutString (buffer, elcount(buffer), hFile);
	floatval = getSignal(CHASSIS::CamLane_FastAttr2_FR2::CamLane_LaneClothoidPara_Lt);
	snprintf(buffer, elcount(buffer), "   0.000000 F1 MPC::CamLane_FastAttr2_FR2::CamLane_LaneClothoidPara_Lt = %f\n", floatval);
	filePutString (buffer, elcount(buffer), hFile);
	floatval = getSignal(CHASSIS::CamLane_FastAttr2_FR2::CamLane_LaneClothoidPara_Rt);
	snprintf(buffer, elcount(buffer), "   0.000000 F1 MPC::CamLane_FastAttr2_FR2::CamLane_LaneClothoidPara_Rt = %f\n", floatval);
	filePutString (buffer, elcount(buffer), hFile);
	floatval = getSignal(CHASSIS::CamLane_FastAttr2_FR2::CamLane_LaneHrztCrv_Lt);
	snprintf(buffer, elcount(buffer), "   0.000000 F1 MPC::CamLane_FastAttr2_FR2::CamLane_LaneHrztCrv_Lt = %f\n", floatval);
	filePutString (buffer, elcount(buffer), hFile);
	floatval = getSignal(CHASSIS::CamLane_FastAttr2_FR2::CamLane_LaneHrztCrv_Rt);
	snprintf(buffer, elcount(buffer), "   0.000000 F1 MPC::CamLane_FastAttr2_FR2::CamLane_LaneHrztCrv_Rt = %f\n", floatval);
	filePutString (buffer, elcount(buffer), hFile);
	floatval = getSignal(CHASSIS::CamLane_FastAttr2_FR2::CamLane_LaneYawAngl_Lt);
	snprintf(buffer, elcount(buffer), "   0.000000 F1 MPC::CamLane_FastAttr2_FR2::CamLane_LaneYawAngl_Lt = %f\n", floatval);
	filePutString (buffer, elcount(buffer), hFile);
	floatval = getSignal(CHASSIS::CamLane_FastAttr2_FR2::CamLane_LaneYawAngl_Rt);
	snprintf(buffer, elcount(buffer), "   0.000000 F1 MPC::CamLane_FastAttr2_FR2::CamLane_LaneYawAngl_Rt = %f\n", floatval);
	filePutString (buffer, elcount(buffer), hFile);
	floatval = getSignal(CHASSIS::CamLane_FastAttr2_FR2::CamLane_LaneLtrlDist_Lt);
	snprintf(buffer, elcount(buffer), "   0.000000 F1 MPC::CamLane_FastAttr2_FR2::CamLane_LaneLtrlDist_Lt = %f\n", floatval);
	filePutString (buffer, elcount(buffer), hFile);
	floatval = getSignal(CHASSIS::CamLane_FastAttr2_FR2::CamLane_LaneLtrlDist_Rt);
	snprintf(buffer, elcount(buffer), "   0.000000 F1 MPC::CamLane_FastAttr2_FR2::CamLane_LaneLtrlDist_Rt = %f\n", floatval);
	filePutString (buffer, elcount(buffer), hFile);
	floatval = getSignal(CHASSIS::CamLane_FastAttr2_FR2::VLN_DtctDist_Lt);
	snprintf(buffer, elcount(buffer), "   0.000000 F1 MPC::CamLane_FastAttr2_FR2::VLN_DtctDist_Lt = %f\n", floatval);
	filePutString (buffer, elcount(buffer), hFile);
	floatval = getSignal(CHASSIS::CamLane_FastAttr2_FR2::VLN_DtctDist_Rt);
	snprintf(buffer, elcount(buffer), "   0.000000 F1 MPC::CamLane_FastAttr2_FR2::VLN_DtctDist_Rt = %f\n", floatval);
	filePutString (buffer, elcount(buffer), hFile);
	intval = getSignal(CHASSIS::CamLane_FastAttr2_FR2::Rsrv1_CamLane_FastAttr2_Pr2);
	snprintf(buffer, elcount(buffer), "   0.000000 F1 MPC::CamLane_FastAttr2_FR2::Rsrv1_CamLane_FastAttr2_Pr2 = %d\n", intval);
	filePutString (buffer, elcount(buffer), hFile);
}
/*@@end*/

/*@@caplFunc:saveVars_80(dword):*/
void saveVars_80(dword hFile)
{
	intval = @sysvar::CH_Nodes::CH_MPCCRC_CamLane_LaneAttr1_AUTO;
	snprintf(buffer, elcount(buffer), "   0.000000    SV: 2 0 0 ::CH_Nodes::CH_MPCCRC_CamLane_LaneAttr1_AUTO = %d\n", intval);
	filePutString (buffer, elcount(buffer), hFile);
	intval = getSignal(CHASSIS::CamLane_LaneAttr1_Gw_AR2::CRC_CamLane_LaneAttr1_Pr2);
	snprintf(buffer, elcount(buffer), "   0.000000 F1 MPC::CamLane_LaneAttr1_Gw_AR2::CRC_CamLane_LaneAttr1_Pr2 = %d\n", intval);
	filePutString (buffer, elcount(buffer), hFile);
	intval = @sysvar::CH_Nodes::CH_MPCSQC_CamLane_LaneAttr1_AUTO;
	snprintf(buffer, elcount(buffer), "   0.000000    SV: 2 0 0 ::CH_Nodes::CH_MPCSQC_CamLane_LaneAttr1_AUTO = %d\n", intval);
	filePutString (buffer, elcount(buffer), hFile);
	intval = getSignal(CHASSIS::CamLane_LaneAttr1_Gw_AR2::SQC_CamLane_LaneAttr1_Pr2);
	snprintf(buffer, elcount(buffer), "   0.000000 F1 MPC::CamLane_LaneAttr1_Gw_AR2::SQC_CamLane_LaneAttr1_Pr2 = %d\n", intval);
	filePutString (buffer, elcount(buffer), hFile);
	floatval = getSignal(CHASSIS::CamLane_LaneAttr1_Gw_AR2::CamLane_LaneDataQual_Lt);
	snprintf(buffer, elcount(buffer), "   0.000000 F1 MPC::CamLane_LaneAttr1_Gw_AR2::CamLane_LaneDataQual_Lt = %f\n", floatval);
	filePutString (buffer, elcount(buffer), hFile);
	intval = getSignal(CHASSIS::CamLane_LaneAttr1_Gw_AR2::CamLane_DrvActv_LDP);
	snprintf(buffer, elcount(buffer), "   0.000000 F1 MPC::CamLane_LaneAttr1_Gw_AR2::CamLane_DrvActv_LDP = %d\n", intval);
	filePutString (buffer, elcount(buffer), hFile);
	floatval = getSignal(CHASSIS::CamLane_LaneAttr1_Gw_AR2::NghbrLane_Lt_Width);
	snprintf(buffer, elcount(buffer), "   0.000000 F1 MPC::CamLane_LaneAttr1_Gw_AR2::NghbrLane_Lt_Width = %f\n", floatval);
	filePutString (buffer, elcount(buffer), hFile);
	intval = getSignal(CHASSIS::CamLane_LaneAttr1_Gw_AR2::CamLane_LaneDscrbSide);
	snprintf(buffer, elcount(buffer), "   0.000000 F1 MPC::CamLane_LaneAttr1_Gw_AR2::CamLane_LaneDscrbSide = %d\n", intval);
	filePutString (buffer, elcount(buffer), hFile);
	floatval = getSignal(CHASSIS::CamLane_LaneAttr1_Gw_AR2::NghbrLane_Rt_Width);
	snprintf(buffer, elcount(buffer), "   0.000000 F1 MPC::CamLane_LaneAttr1_Gw_AR2::NghbrLane_Rt_Width = %f\n", floatval);
	filePutString (buffer, elcount(buffer), hFile);
	intval = getSignal(CHASSIS::CamLane_LaneAttr1_Gw_AR2::CamLane_LaneAttr1_Sync);
	snprintf(buffer, elcount(buffer), "   0.000000 F1 MPC::CamLane_LaneAttr1_Gw_AR2::CamLane_LaneAttr1_Sync = %d\n", intval);
	filePutString (buffer, elcount(buffer), hFile);
	floatval = getSignal(CHASSIS::CamLane_LaneAttr1_Gw_AR2::CamLane_LaneLtrlDist_Lt);
	snprintf(buffer, elcount(buffer), "   0.000000 F1 MPC::CamLane_LaneAttr1_Gw_AR2::CamLane_LaneLtrlDist_Lt = %f\n", floatval);
	filePutString (buffer, elcount(buffer), hFile);
	floatval = getSignal(CHASSIS::CamLane_LaneAttr1_Gw_AR2::CamLane_LaneDataQual_Rt);
	snprintf(buffer, elcount(buffer), "   0.000000 F1 MPC::CamLane_LaneAttr1_Gw_AR2::CamLane_LaneDataQual_Rt = %f\n", floatval);
	filePutString (buffer, elcount(buffer), hFile);
	intval = getSignal(CHASSIS::CamLane_LaneAttr1_Gw_AR2::CamLane_RoadExit_Stat);
	snprintf(buffer, elcount(buffer), "   0.000000 F1 MPC::CamLane_LaneAttr1_Gw_AR2::CamLane_RoadExit_Stat = %d\n", intval);
	filePutString (buffer, elcount(buffer), hFile);
	floatval = getSignal(CHASSIS::CamLane_LaneAttr1_Gw_AR2::CamLane_LaneLtrlDist_Rt);
	snprintf(buffer, elcount(buffer), "   0.000000 F1 MPC::CamLane_LaneAttr1_Gw_AR2::CamLane_LaneLtrlDist_Rt = %f\n", floatval);
	filePutString (buffer, elcount(buffer), hFile);
	intval = getSignal(CHASSIS::CamLane_LaneAttr1_Gw_AR2::CamLane_LaneChg_Stat);
	snprintf(buffer, elcount(buffer), "   0.000000 F1 MPC::CamLane_LaneAttr1_Gw_AR2::CamLane_LaneChg_Stat = %d\n", intval);
	filePutString (buffer, elcount(buffer), hFile);
	intval = getSignal(CHASSIS::CamLane_LaneAttr1_Gw_AR2::NghbrLane_Lt_Stat);
	snprintf(buffer, elcount(buffer), "   0.000000 F1 MPC::CamLane_LaneAttr1_Gw_AR2::NghbrLane_Lt_Stat = %d\n", intval);
	filePutString (buffer, elcount(buffer), hFile);
	intval = getSignal(CHASSIS::CamLane_LaneAttr1_Gw_AR2::NghbrLane_Rt_Stat);
	snprintf(buffer, elcount(buffer), "   0.000000 F1 MPC::CamLane_LaneAttr1_Gw_AR2::NghbrLane_Rt_Stat = %d\n", intval);
	filePutString (buffer, elcount(buffer), hFile);
	intval = @sysvar::CH_Nodes::CH_MPCCRC_CamLane_LaneAttr2_AUTO;
	snprintf(buffer, elcount(buffer), "   0.000000    SV: 2 0 0 ::CH_Nodes::CH_MPCCRC_CamLane_LaneAttr2_AUTO = %d\n", intval);
	filePutString (buffer, elcount(buffer), hFile);
	intval = getSignal(CHASSIS::CamLane_LaneAttr2_Gw_AR2::CRC_CamLane_LaneAttr2_Pr2);
	snprintf(buffer, elcount(buffer), "   0.000000 F1 MPC::CamLane_LaneAttr2_Gw_AR2::CRC_CamLane_LaneAttr2_Pr2 = %d\n", intval);
	filePutString (buffer, elcount(buffer), hFile);
	intval = @sysvar::CH_Nodes::CH_MPCSQC_CamLane_LaneAttr2_AUTO;
	snprintf(buffer, elcount(buffer), "   0.000000    SV: 2 0 0 ::CH_Nodes::CH_MPCSQC_CamLane_LaneAttr2_AUTO = %d\n", intval);
	filePutString (buffer, elcount(buffer), hFile);
	intval = getSignal(CHASSIS::CamLane_LaneAttr2_Gw_AR2::SQC_CamLane_LaneAttr2_Pr2);
	snprintf(buffer, elcount(buffer), "   0.000000 F1 MPC::CamLane_LaneAttr2_Gw_AR2::SQC_CamLane_LaneAttr2_Pr2 = %d\n", intval);
	filePutString (buffer, elcount(buffer), hFile);
	floatval = getSignal(CHASSIS::CamLane_LaneAttr2_Gw_AR2::CamLane_2ndClothoid_C1_Lt);
	snprintf(buffer, elcount(buffer), "   0.000000 F1 MPC::CamLane_LaneAttr2_Gw_AR2::CamLane_2ndClothoid_C1_Lt = %f\n", floatval);
	filePutString (buffer, elcount(buffer), hFile);
	intval = getSignal(CHASSIS::CamLane_LaneAttr2_Gw_AR2::CamLane_2ndClothoid_Stat_Lt);
	snprintf(buffer, elcount(buffer), "   0.000000 F1 MPC::CamLane_LaneAttr2_Gw_AR2::CamLane_2ndClothoid_Stat_Lt = %d\n", intval);
	filePutString (buffer, elcount(buffer), hFile);
	intval = getSignal(CHASSIS::CamLane_LaneAttr2_Gw_AR2::NghbrLaneMarkType_Lt);
	snprintf(buffer, elcount(buffer), "   0.000000 F1 MPC::CamLane_LaneAttr2_Gw_AR2::NghbrLaneMarkType_Lt = %d\n", intval);
	filePutString (buffer, elcount(buffer), hFile);
	intval = getSignal(CHASSIS::CamLane_LaneAttr2_Gw_AR2::Rsrv2_CAMLane_LaneAttr2_Pr2);
	snprintf(buffer, elcount(buffer), "   0.000000 F1 MPC::CamLane_LaneAttr2_Gw_AR2::Rsrv2_CAMLane_LaneAttr2_Pr2 = %d\n", intval);
	filePutString (buffer, elcount(buffer), hFile);
	floatval = getSignal(CHASSIS::CamLane_LaneAttr2_Gw_AR2::VLN_DtctDist_Lt);
	snprintf(buffer, elcount(buffer), "   0.000000 F1 MPC::CamLane_LaneAttr2_Gw_AR2::VLN_DtctDist_Lt = %f\n", floatval);
	filePutString (buffer, elcount(buffer), hFile);
	floatval = getSignal(CHASSIS::CamLane_LaneAttr2_Gw_AR2::CamLane_2ndClothoid_InitDist_Lt);
	snprintf(buffer, elcount(buffer), "   0.000000 F1 MPC::CamLane_LaneAttr2_Gw_AR2::CamLane_2ndClothoid_InitDist_Lt = %f\n", floatval);
	filePutString (buffer, elcount(buffer), hFile);
	floatval = getSignal(CHASSIS::CamLane_LaneAttr2_Gw_AR2::CamLane_LaneHrztCrv_Lt);
	snprintf(buffer, elcount(buffer), "   0.000000 F1 MPC::CamLane_LaneAttr2_Gw_AR2::CamLane_LaneHrztCrv_Lt = %f\n", floatval);
	filePutString (buffer, elcount(buffer), hFile);
	intval = getSignal(CHASSIS::CamLane_LaneAttr2_Gw_AR2::CamLane_LaneMarkType_Lt);
	snprintf(buffer, elcount(buffer), "   0.000000 F1 MPC::CamLane_LaneAttr2_Gw_AR2::CamLane_LaneMarkType_Lt = %d\n", intval);
	filePutString (buffer, elcount(buffer), hFile);
	intval = getSignal(CHASSIS::CamLane_LaneAttr2_Gw_AR2::CamLane_LaneAttr2_Sync);
	snprintf(buffer, elcount(buffer), "   0.000000 F1 MPC::CamLane_LaneAttr2_Gw_AR2::CamLane_LaneAttr2_Sync = %d\n", intval);
	filePutString (buffer, elcount(buffer), hFile);
	intval = @sysvar::CH_Nodes::CH_MPCCRC_CamLane_LaneAttr3_AUTO;
	snprintf(buffer, elcount(buffer), "   0.000000    SV: 2 0 0 ::CH_Nodes::CH_MPCCRC_CamLane_LaneAttr3_AUTO = %d\n", intval);
	filePutString (buffer, elcount(buffer), hFile);
	intval = getSignal(CHASSIS::CamLane_LaneAttr3_Gw_AR2::CRC_CamLane_LaneAttr3_Pr2);
	snprintf(buffer, elcount(buffer), "   0.000000 F1 MPC::CamLane_LaneAttr3_Gw_AR2::CRC_CamLane_LaneAttr3_Pr2 = %d\n", intval);
	filePutString (buffer, elcount(buffer), hFile);
	intval = @sysvar::CH_Nodes::CH_MPCSQC_CamLane_LaneAttr3_AUTO;
	snprintf(buffer, elcount(buffer), "   0.000000    SV: 2 0 0 ::CH_Nodes::CH_MPCSQC_CamLane_LaneAttr3_AUTO = %d\n", intval);
	filePutString (buffer, elcount(buffer), hFile);
	intval = getSignal(CHASSIS::CamLane_LaneAttr3_Gw_AR2::SQC_CamLane_LaneAttr3_Pr2);
	snprintf(buffer, elcount(buffer), "   0.000000 F1 MPC::CamLane_LaneAttr3_Gw_AR2::SQC_CamLane_LaneAttr3_Pr2 = %d\n", intval);
	filePutString (buffer, elcount(buffer), hFile);
	floatval = getSignal(CHASSIS::CamLane_LaneAttr3_Gw_AR2::CamLane_LaneClothoidPara_Lt);
	snprintf(buffer, elcount(buffer), "   0.000000 F1 MPC::CamLane_LaneAttr3_Gw_AR2::CamLane_LaneClothoidPara_Lt = %f\n", floatval);
	filePutString (buffer, elcount(buffer), hFile);
	floatval = getSignal(CHASSIS::CamLane_LaneAttr3_Gw_AR2::CamLane_LaneClothoidPara_Rt);
	snprintf(buffer, elcount(buffer), "   0.000000 F1 MPC::CamLane_LaneAttr3_Gw_AR2::CamLane_LaneClothoidPara_Rt = %f\n", floatval);
	filePutString (buffer, elcount(buffer), hFile);
	floatval = getSignal(CHASSIS::CamLane_LaneAttr3_Gw_AR2::CamLane_LaneYawAngl_Lt);
	snprintf(buffer, elcount(buffer), "   0.000000 F1 MPC::CamLane_LaneAttr3_Gw_AR2::CamLane_LaneYawAngl_Lt = %f\n", floatval);
	filePutString (buffer, elcount(buffer), hFile);
	floatval = getSignal(CHASSIS::CamLane_LaneAttr3_Gw_AR2::CamLane_LaneYawAngl_Rt);
	snprintf(buffer, elcount(buffer), "   0.000000 F1 MPC::CamLane_LaneAttr3_Gw_AR2::CamLane_LaneYawAngl_Rt = %f\n", floatval);
	filePutString (buffer, elcount(buffer), hFile);
	intval = @sysvar::CH_Nodes::CH_MPCCRC_CamLane_LaneAttr4_AUTO;
	snprintf(buffer, elcount(buffer), "   0.000000    SV: 2 0 0 ::CH_Nodes::CH_MPCCRC_CamLane_LaneAttr4_AUTO = %d\n", intval);
	filePutString (buffer, elcount(buffer), hFile);
	intval = getSignal(CHASSIS::CamLane_LaneAttr4_FR2::CRC_CamLane_LaneAttr4_Pr2);
	snprintf(buffer, elcount(buffer), "   0.000000 F1 MPC::CamLane_LaneAttr4_FR2::CRC_CamLane_LaneAttr4_Pr2 = %d\n", intval);
	filePutString (buffer, elcount(buffer), hFile);
	intval = @sysvar::CH_Nodes::CH_MPCSQC_CamLane_LaneAttr4_AUTO;
	snprintf(buffer, elcount(buffer), "   0.000000    SV: 2 0 0 ::CH_Nodes::CH_MPCSQC_CamLane_LaneAttr4_AUTO = %d\n", intval);
	filePutString (buffer, elcount(buffer), hFile);
	intval = getSignal(CHASSIS::CamLane_LaneAttr4_FR2::SQC_CamLane_LaneAttr4_Pr2);
	snprintf(buffer, elcount(buffer), "   0.000000 F1 MPC::CamLane_LaneAttr4_FR2::SQC_CamLane_LaneAttr4_Pr2 = %d\n", intval);
	filePutString (buffer, elcount(buffer), hFile);
	intval = getSignal(CHASSIS::CamLane_LaneAttr4_FR2::ALDW_LDP_WarnSupp_Stat);
	snprintf(buffer, elcount(buffer), "   0.000000 F1 MPC::CamLane_LaneAttr4_FR2::ALDW_LDP_WarnSupp_Stat = %d\n", intval);
	filePutString (buffer, elcount(buffer), hFile);
	intval = getSignal(CHASSIS::CamLane_LaneAttr4_FR2::RoadBound_InitDist_Rt);
	snprintf(buffer, elcount(buffer), "   0.000000 F1 MPC::CamLane_LaneAttr4_FR2::RoadBound_InitDist_Rt = %d\n", intval);
	filePutString (buffer, elcount(buffer), hFile);
	intval = getSignal(CHASSIS::CamLane_LaneAttr4_FR2::VLN_YawAngl_Vld);
	snprintf(buffer, elcount(buffer), "   0.000000 F1 MPC::CamLane_LaneAttr4_FR2::VLN_YawAngl_Vld = %d\n", intval);
	filePutString (buffer, elcount(buffer), hFile);
	intval = getSignal(CHASSIS::CamLane_LaneAttr4_FR2::RoadBound_Type_Lt);
	snprintf(buffer, elcount(buffer), "   0.000000 F1 MPC::CamLane_LaneAttr4_FR2::RoadBound_Type_Lt = %d\n", intval);
	filePutString (buffer, elcount(buffer), hFile);
	intval = getSignal(CHASSIS::CamLane_LaneAttr4_FR2::RoadBound_Type_Rt);
	snprintf(buffer, elcount(buffer), "   0.000000 F1 MPC::CamLane_LaneAttr4_FR2::RoadBound_Type_Rt = %d\n", intval);
	filePutString (buffer, elcount(buffer), hFile);
	intval = getSignal(CHASSIS::CamLane_LaneAttr4_FR2::CamLane_NumParallelStruct);
	snprintf(buffer, elcount(buffer), "   0.000000 F1 MPC::CamLane_LaneAttr4_FR2::CamLane_NumParallelStruct = %d\n", intval);
	filePutString (buffer, elcount(buffer), hFile);
	intval = getSignal(CHASSIS::CamLane_LaneAttr4_FR2::CamLane_LaneEvent_Lt);
	snprintf(buffer, elcount(buffer), "   0.000000 F1 MPC::CamLane_LaneAttr4_FR2::CamLane_LaneEvent_Lt = %d\n", intval);
	filePutString (buffer, elcount(buffer), hFile);
	intval = getSignal(CHASSIS::CamLane_LaneAttr4_FR2::CamLane_LaneEvent_Rt);
	snprintf(buffer, elcount(buffer), "   0.000000 F1 MPC::CamLane_LaneAttr4_FR2::CamLane_LaneEvent_Rt = %d\n", intval);
	filePutString (buffer, elcount(buffer), hFile);
	intval = getSignal(CHASSIS::CamLane_LaneAttr4_FR2::CamLane_LaneEventPosX_Lt);
	snprintf(buffer, elcount(buffer), "   0.000000 F1 MPC::CamLane_LaneAttr4_FR2::CamLane_LaneEventPosX_Lt = %d\n", intval);
	filePutString (buffer, elcount(buffer), hFile);
	intval = getSignal(CHASSIS::CamLane_LaneAttr4_FR2::CamLane_LaneMarkCol_Lt);
	snprintf(buffer, elcount(buffer), "   0.000000 F1 MPC::CamLane_LaneAttr4_FR2::CamLane_LaneMarkCol_Lt = %d\n", intval);
	filePutString (buffer, elcount(buffer), hFile);
	intval = getSignal(CHASSIS::CamLane_LaneAttr4_FR2::CamLane_LaneEventPosX_Rt);
	snprintf(buffer, elcount(buffer), "   0.000000 F1 MPC::CamLane_LaneAttr4_FR2::CamLane_LaneEventPosX_Rt = %d\n", intval);
	filePutString (buffer, elcount(buffer), hFile);
	intval = getSignal(CHASSIS::CamLane_LaneAttr4_FR2::CamLane_LaneMarkCol_Rt);
	snprintf(buffer, elcount(buffer), "   0.000000 F1 MPC::CamLane_LaneAttr4_FR2::CamLane_LaneMarkCol_Rt = %d\n", intval);
	filePutString (buffer, elcount(buffer), hFile);
	intval = getSignal(CHASSIS::CamLane_LaneAttr4_FR2::RoadBound_InitDist_Lt);
	snprintf(buffer, elcount(buffer), "   0.000000 F1 MPC::CamLane_LaneAttr4_FR2::RoadBound_InitDist_Lt = %d\n", intval);
	filePutString (buffer, elcount(buffer), hFile);
	intval = getSignal(CHASSIS::CamLane_LaneAttr4_FR2::CamLane_RoadWork_Type);
	snprintf(buffer, elcount(buffer), "   0.000000 F1 MPC::CamLane_LaneAttr4_FR2::CamLane_RoadWork_Type = %d\n", intval);
	filePutString (buffer, elcount(buffer), hFile);
	floatval = getSignal(CHASSIS::CamLane_LaneAttr4_FR2::RoadBound_LtrDist_Lt);
	snprintf(buffer, elcount(buffer), "   0.000000 F1 MPC::CamLane_LaneAttr4_FR2::RoadBound_LtrDist_Lt = %f\n", floatval);
	filePutString (buffer, elcount(buffer), hFile);
	floatval = getSignal(CHASSIS::CamLane_LaneAttr4_FR2::RoadBound_LtrDist_Rt);
	snprintf(buffer, elcount(buffer), "   0.000000 F1 MPC::CamLane_LaneAttr4_FR2::RoadBound_LtrDist_Rt = %f\n", floatval);
	filePutString (buffer, elcount(buffer), hFile);
	intval = getSignal(CHASSIS::CamLane_LaneAttr4_FR2::RoadBound_Lt_Stat);
	snprintf(buffer, elcount(buffer), "   0.000000 F1 MPC::CamLane_LaneAttr4_FR2::RoadBound_Lt_Stat = %d\n", intval);
	filePutString (buffer, elcount(buffer), hFile);
}
/*@@end*/

/*@@caplFunc:saveVars_81(dword):*/
void saveVars_81(dword hFile)
{
	intval = getSignal(CHASSIS::CamLane_LaneAttr4_FR2::RoadBound_Rt_Stat);
	snprintf(buffer, elcount(buffer), "   0.000000 F1 MPC::CamLane_LaneAttr4_FR2::RoadBound_Rt_Stat = %d\n", intval);
	filePutString (buffer, elcount(buffer), hFile);
	floatval = getSignal(CHASSIS::CamLane_LaneAttr4_FR2::CamLane_YawRate);
	snprintf(buffer, elcount(buffer), "   0.000000 F1 MPC::CamLane_LaneAttr4_FR2::CamLane_YawRate = %f\n", floatval);
	filePutString (buffer, elcount(buffer), hFile);
	intval = getSignal(CHASSIS::CamLane_LaneAttr4_FR2::Rsrv5_CamLane_LaneAttr4_Pr2);
	snprintf(buffer, elcount(buffer), "   0.000000 F1 MPC::CamLane_LaneAttr4_FR2::Rsrv5_CamLane_LaneAttr4_Pr2 = %d\n", intval);
	filePutString (buffer, elcount(buffer), hFile);
	floatval = getSignal(CHASSIS::CamLane_LaneAttr4_FR2::RoadBound_ChkDist_Lt);
	snprintf(buffer, elcount(buffer), "   0.000000 F1 MPC::CamLane_LaneAttr4_FR2::RoadBound_ChkDist_Lt = %f\n", floatval);
	filePutString (buffer, elcount(buffer), hFile);
	intval = getSignal(CHASSIS::CamLane_LaneAttr4_FR2::Rsrv3_CamLane_LaneAttr4_Pr2);
	snprintf(buffer, elcount(buffer), "   0.000000 F1 MPC::CamLane_LaneAttr4_FR2::Rsrv3_CamLane_LaneAttr4_Pr2 = %d\n", intval);
	filePutString (buffer, elcount(buffer), hFile);
	intval = getSignal(CHASSIS::CamLane_LaneAttr4_FR2::Rsrv2_CamLane_LaneAttr4_Pr2);
	snprintf(buffer, elcount(buffer), "   0.000000 F1 MPC::CamLane_LaneAttr4_FR2::Rsrv2_CamLane_LaneAttr4_Pr2 = %d\n", intval);
	filePutString (buffer, elcount(buffer), hFile);
	floatval = getSignal(CHASSIS::CamLane_LaneAttr4_FR2::ALDW_LDP_WarnDelay_Rt);
	snprintf(buffer, elcount(buffer), "   0.000000 F1 MPC::CamLane_LaneAttr4_FR2::ALDW_LDP_WarnDelay_Rt = %f\n", floatval);
	filePutString (buffer, elcount(buffer), hFile);
	floatval = getSignal(CHASSIS::CamLane_LaneAttr4_FR2::ALDW_LDP_WarnDelay_Lt);
	snprintf(buffer, elcount(buffer), "   0.000000 F1 MPC::CamLane_LaneAttr4_FR2::ALDW_LDP_WarnDelay_Lt = %f\n", floatval);
	filePutString (buffer, elcount(buffer), hFile);
	intval = getSignal(CHASSIS::CamLane_LaneAttr4_FR2::CamLane_YawRate_Qual);
	snprintf(buffer, elcount(buffer), "   0.000000 F1 MPC::CamLane_LaneAttr4_FR2::CamLane_YawRate_Qual = %d\n", intval);
	filePutString (buffer, elcount(buffer), hFile);
	floatval = getSignal(CHASSIS::CamLane_LaneAttr4_FR2::CamLane_TmDiff);
	snprintf(buffer, elcount(buffer), "   0.000000 F1 MPC::CamLane_LaneAttr4_FR2::CamLane_TmDiff = %f\n", floatval);
	filePutString (buffer, elcount(buffer), hFile);
	floatval = getSignal(CHASSIS::CamLane_LaneAttr4_FR2::RoadBound_ChkDist_Rt);
	snprintf(buffer, elcount(buffer), "   0.000000 F1 MPC::CamLane_LaneAttr4_FR2::RoadBound_ChkDist_Rt = %f\n", floatval);
	filePutString (buffer, elcount(buffer), hFile);
	intval = getSignal(CHASSIS::CamLane_LaneAttr4_FR2::LaneLkChg_Lt);
	snprintf(buffer, elcount(buffer), "   0.000000 F1 MPC::CamLane_LaneAttr4_FR2::LaneLkChg_Lt = %d\n", intval);
	filePutString (buffer, elcount(buffer), hFile);
	intval = getSignal(CHASSIS::CamLane_LaneAttr4_FR2::LaneLkChg_Rt);
	snprintf(buffer, elcount(buffer), "   0.000000 F1 MPC::CamLane_LaneAttr4_FR2::LaneLkChg_Rt = %d\n", intval);
	filePutString (buffer, elcount(buffer), hFile);
	intval = getSignal(CHASSIS::CamLane_LaneAttr4_FR2::CamLane_LaneAttr4_Sync);
	snprintf(buffer, elcount(buffer), "   0.000000 F1 MPC::CamLane_LaneAttr4_FR2::CamLane_LaneAttr4_Sync = %d\n", intval);
	filePutString (buffer, elcount(buffer), hFile);
	intval = @sysvar::CH_Nodes::CH_MPCCRC_CamLane_LaneAttr5_AUTO;
	snprintf(buffer, elcount(buffer), "   0.000000    SV: 2 0 0 ::CH_Nodes::CH_MPCCRC_CamLane_LaneAttr5_AUTO = %d\n", intval);
	filePutString (buffer, elcount(buffer), hFile);
	intval = getSignal(CHASSIS::CamLane_LaneAttr5_FR2::CRC_CamLane_LaneAttr5_Pr2);
	snprintf(buffer, elcount(buffer), "   0.000000 F1 MPC::CamLane_LaneAttr5_FR2::CRC_CamLane_LaneAttr5_Pr2 = %d\n", intval);
	filePutString (buffer, elcount(buffer), hFile);
	intval = @sysvar::CH_Nodes::CH_MPCSQC_CamLane_LaneAttr5_AUTO;
	snprintf(buffer, elcount(buffer), "   0.000000    SV: 2 0 0 ::CH_Nodes::CH_MPCSQC_CamLane_LaneAttr5_AUTO = %d\n", intval);
	filePutString (buffer, elcount(buffer), hFile);
	intval = getSignal(CHASSIS::CamLane_LaneAttr5_FR2::SQC_CamLane_LaneAttr5_Pr2);
	snprintf(buffer, elcount(buffer), "   0.000000 F1 MPC::CamLane_LaneAttr5_FR2::SQC_CamLane_LaneAttr5_Pr2 = %d\n", intval);
	filePutString (buffer, elcount(buffer), hFile);
	intval = getSignal(CHASSIS::CamLane_LaneAttr5_FR2::RoadBound_Dist_Lt);
	snprintf(buffer, elcount(buffer), "   0.000000 F1 MPC::CamLane_LaneAttr5_FR2::RoadBound_Dist_Lt = %d\n", intval);
	filePutString (buffer, elcount(buffer), hFile);
	intval = getSignal(CHASSIS::CamLane_LaneAttr5_FR2::RoadBound_Dist_Rt);
	snprintf(buffer, elcount(buffer), "   0.000000 F1 MPC::CamLane_LaneAttr5_FR2::RoadBound_Dist_Rt = %d\n", intval);
	filePutString (buffer, elcount(buffer), hFile);
	intval = getSignal(CHASSIS::CamLane_LaneAttr5_FR2::Rsrv1_CAMLane_LaneAttr5_Pr2);
	snprintf(buffer, elcount(buffer), "   0.000000 F1 MPC::CamLane_LaneAttr5_FR2::Rsrv1_CAMLane_LaneAttr5_Pr2 = %d\n", intval);
	filePutString (buffer, elcount(buffer), hFile);
	floatval = getSignal(CHASSIS::CamLane_LaneAttr5_FR2::FSA_BetaAngl_Lt);
	snprintf(buffer, elcount(buffer), "   0.000000 F1 MPC::CamLane_LaneAttr5_FR2::FSA_BetaAngl_Lt = %f\n", floatval);
	filePutString (buffer, elcount(buffer), hFile);
	floatval = getSignal(CHASSIS::CamLane_LaneAttr5_FR2::FSA_BetaAngl_Rt);
	snprintf(buffer, elcount(buffer), "   0.000000 F1 MPC::CamLane_LaneAttr5_FR2::FSA_BetaAngl_Rt = %f\n", floatval);
	filePutString (buffer, elcount(buffer), hFile);
	floatval = getSignal(CHASSIS::CamLane_LaneAttr5_FR2::FSA_AlphaAngl_Lt);
	snprintf(buffer, elcount(buffer), "   0.000000 F1 MPC::CamLane_LaneAttr5_FR2::FSA_AlphaAngl_Lt = %f\n", floatval);
	filePutString (buffer, elcount(buffer), hFile);
	floatval = getSignal(CHASSIS::CamLane_LaneAttr5_FR2::FSA_AlphaAngl_Rt);
	snprintf(buffer, elcount(buffer), "   0.000000 F1 MPC::CamLane_LaneAttr5_FR2::FSA_AlphaAngl_Rt = %f\n", floatval);
	filePutString (buffer, elcount(buffer), hFile);
	floatval = getSignal(CHASSIS::CamLane_LaneAttr5_FR2::FSA_LtrlDist_Lt);
	snprintf(buffer, elcount(buffer), "   0.000000 F1 MPC::CamLane_LaneAttr5_FR2::FSA_LtrlDist_Lt = %f\n", floatval);
	filePutString (buffer, elcount(buffer), hFile);
	intval = getSignal(CHASSIS::CamLane_LaneAttr5_FR2::FSA_Obstcl_Stat);
	snprintf(buffer, elcount(buffer), "   0.000000 F1 MPC::CamLane_LaneAttr5_FR2::FSA_Obstcl_Stat = %d\n", intval);
	filePutString (buffer, elcount(buffer), hFile);
	floatval = getSignal(CHASSIS::CamLane_LaneAttr5_FR2::FSA_LtrlDist_Rt);
	snprintf(buffer, elcount(buffer), "   0.000000 F1 MPC::CamLane_LaneAttr5_FR2::FSA_LtrlDist_Rt = %f\n", floatval);
	filePutString (buffer, elcount(buffer), hFile);
	intval = getSignal(CHASSIS::CamLane_LaneAttr5_FR2::FSA_Stat);
	snprintf(buffer, elcount(buffer), "   0.000000 F1 MPC::CamLane_LaneAttr5_FR2::FSA_Stat = %d\n", intval);
	filePutString (buffer, elcount(buffer), hFile);
	floatval = getSignal(CHASSIS::CamLane_LaneAttr5_FR2::FSA_ObstclDist);
	snprintf(buffer, elcount(buffer), "   0.000000 F1 MPC::CamLane_LaneAttr5_FR2::FSA_ObstclDist = %f\n", floatval);
	filePutString (buffer, elcount(buffer), hFile);
	floatval = getSignal(CHASSIS::CamLane_LaneAttr5_FR2::RoadBound_YawAngl_Lt);
	snprintf(buffer, elcount(buffer), "   0.000000 F1 MPC::CamLane_LaneAttr5_FR2::RoadBound_YawAngl_Lt = %f\n", floatval);
	filePutString (buffer, elcount(buffer), hFile);
	floatval = getSignal(CHASSIS::CamLane_LaneAttr5_FR2::RoadBound_YawAngl_Rt);
	snprintf(buffer, elcount(buffer), "   0.000000 F1 MPC::CamLane_LaneAttr5_FR2::RoadBound_YawAngl_Rt = %f\n", floatval);
	filePutString (buffer, elcount(buffer), hFile);
	floatval = getSignal(CHASSIS::CamLane_LaneAttr5_FR2::RoadBound_HrztCrv_Lt);
	snprintf(buffer, elcount(buffer), "   0.000000 F1 MPC::CamLane_LaneAttr5_FR2::RoadBound_HrztCrv_Lt = %f\n", floatval);
	filePutString (buffer, elcount(buffer), hFile);
	floatval = getSignal(CHASSIS::CamLane_LaneAttr5_FR2::RoadBound_HrztCrv_Rt);
	snprintf(buffer, elcount(buffer), "   0.000000 F1 MPC::CamLane_LaneAttr5_FR2::RoadBound_HrztCrv_Rt = %f\n", floatval);
	filePutString (buffer, elcount(buffer), hFile);
	intval = getSignal(CHASSIS::CamLane_LaneAttr5_FR2::CamLane_LaneAttr5_Sync);
	snprintf(buffer, elcount(buffer), "   0.000000 F1 MPC::CamLane_LaneAttr5_FR2::CamLane_LaneAttr5_Sync = %d\n", intval);
	filePutString (buffer, elcount(buffer), hFile);
	intval = @sysvar::CH_Nodes::CH_MPCCRC_CamLane_LaneAttr6_AUTO;
	snprintf(buffer, elcount(buffer), "   0.000000    SV: 2 0 0 ::CH_Nodes::CH_MPCCRC_CamLane_LaneAttr6_AUTO = %d\n", intval);
	filePutString (buffer, elcount(buffer), hFile);
	intval = getSignal(CHASSIS::CamLane_LaneAttr6_Gw_AR2::CRC_CamLane_LaneAttr6_Pr2);
	snprintf(buffer, elcount(buffer), "   0.000000 F1 MPC::CamLane_LaneAttr6_Gw_AR2::CRC_CamLane_LaneAttr6_Pr2 = %d\n", intval);
	filePutString (buffer, elcount(buffer), hFile);
	intval = @sysvar::CH_Nodes::CH_MPCSQC_CamLane_LaneAttr6_AUTO;
	snprintf(buffer, elcount(buffer), "   0.000000    SV: 2 0 0 ::CH_Nodes::CH_MPCSQC_CamLane_LaneAttr6_AUTO = %d\n", intval);
	filePutString (buffer, elcount(buffer), hFile);
	intval = getSignal(CHASSIS::CamLane_LaneAttr6_Gw_AR2::SQC_CamLane_LaneAttr6_Pr2);
	snprintf(buffer, elcount(buffer), "   0.000000 F1 MPC::CamLane_LaneAttr6_Gw_AR2::SQC_CamLane_LaneAttr6_Pr2 = %d\n", intval);
	filePutString (buffer, elcount(buffer), hFile);
	floatval = getSignal(CHASSIS::CamLane_LaneAttr6_Gw_AR2::CamLane_2ndClothoid_C1_Rt);
	snprintf(buffer, elcount(buffer), "   0.000000 F1 MPC::CamLane_LaneAttr6_Gw_AR2::CamLane_2ndClothoid_C1_Rt = %f\n", floatval);
	filePutString (buffer, elcount(buffer), hFile);
	intval = getSignal(CHASSIS::CamLane_LaneAttr6_Gw_AR2::CamLane_2ndClothoid_Stat_Rt);
	snprintf(buffer, elcount(buffer), "   0.000000 F1 MPC::CamLane_LaneAttr6_Gw_AR2::CamLane_2ndClothoid_Stat_Rt = %d\n", intval);
	filePutString (buffer, elcount(buffer), hFile);
	intval = getSignal(CHASSIS::CamLane_LaneAttr6_Gw_AR2::NghbrLaneMarkType_Rt);
	snprintf(buffer, elcount(buffer), "   0.000000 F1 MPC::CamLane_LaneAttr6_Gw_AR2::NghbrLaneMarkType_Rt = %d\n", intval);
	filePutString (buffer, elcount(buffer), hFile);
	intval = getSignal(CHASSIS::CamLane_LaneAttr6_Gw_AR2::Rsrv2_CAMLane_LaneAttr6_Pr2);
	snprintf(buffer, elcount(buffer), "   0.000000 F1 MPC::CamLane_LaneAttr6_Gw_AR2::Rsrv2_CAMLane_LaneAttr6_Pr2 = %d\n", intval);
	filePutString (buffer, elcount(buffer), hFile);
	floatval = getSignal(CHASSIS::CamLane_LaneAttr6_Gw_AR2::VLN_DtctDist_Rt);
	snprintf(buffer, elcount(buffer), "   0.000000 F1 MPC::CamLane_LaneAttr6_Gw_AR2::VLN_DtctDist_Rt = %f\n", floatval);
	filePutString (buffer, elcount(buffer), hFile);
	floatval = getSignal(CHASSIS::CamLane_LaneAttr6_Gw_AR2::CamLane_2ndClothoid_InitDist_Rt);
	snprintf(buffer, elcount(buffer), "   0.000000 F1 MPC::CamLane_LaneAttr6_Gw_AR2::CamLane_2ndClothoid_InitDist_Rt = %f\n", floatval);
	filePutString (buffer, elcount(buffer), hFile);
	floatval = getSignal(CHASSIS::CamLane_LaneAttr6_Gw_AR2::CamLane_LaneHrztCrv_Rt);
	snprintf(buffer, elcount(buffer), "   0.000000 F1 MPC::CamLane_LaneAttr6_Gw_AR2::CamLane_LaneHrztCrv_Rt = %f\n", floatval);
	filePutString (buffer, elcount(buffer), hFile);
	intval = getSignal(CHASSIS::CamLane_LaneAttr6_Gw_AR2::CamLane_LaneMarkType_Rt);
	snprintf(buffer, elcount(buffer), "   0.000000 F1 MPC::CamLane_LaneAttr6_Gw_AR2::CamLane_LaneMarkType_Rt = %d\n", intval);
	filePutString (buffer, elcount(buffer), hFile);
	intval = getSignal(CHASSIS::CamLane_LaneAttr6_Gw_AR2::CamLane_LaneAttr6_Sync);
	snprintf(buffer, elcount(buffer), "   0.000000 F1 MPC::CamLane_LaneAttr6_Gw_AR2::CamLane_LaneAttr6_Sync = %d\n", intval);
	filePutString (buffer, elcount(buffer), hFile);
	intval = @sysvar::CH_Nodes::CH_MPCCRC_CamLane_LaneAttr7_AUTO;
	snprintf(buffer, elcount(buffer), "   0.000000    SV: 2 0 0 ::CH_Nodes::CH_MPCCRC_CamLane_LaneAttr7_AUTO = %d\n", intval);
	filePutString (buffer, elcount(buffer), hFile);
	intval = getSignal(CHASSIS::CamLane_LaneAttr7_Gw_AR2::CRC_CamLane_LaneAttr7_Pr2);
	snprintf(buffer, elcount(buffer), "   0.000000 F1 MPC::CamLane_LaneAttr7_Gw_AR2::CRC_CamLane_LaneAttr7_Pr2 = %d\n", intval);
	filePutString (buffer, elcount(buffer), hFile);
	intval = @sysvar::CH_Nodes::CH_MPCSQC_CamLane_LaneAttr7_AUTO;
	snprintf(buffer, elcount(buffer), "   0.000000    SV: 2 0 0 ::CH_Nodes::CH_MPCSQC_CamLane_LaneAttr7_AUTO = %d\n", intval);
	filePutString (buffer, elcount(buffer), hFile);
	intval = getSignal(CHASSIS::CamLane_LaneAttr7_Gw_AR2::SQC_CamLane_LaneAttr7_Pr2);
	snprintf(buffer, elcount(buffer), "   0.000000 F1 MPC::CamLane_LaneAttr7_Gw_AR2::SQC_CamLane_LaneAttr7_Pr2 = %d\n", intval);
	filePutString (buffer, elcount(buffer), hFile);
	floatval = getSignal(CHASSIS::CamLane_LaneAttr7_Gw_AR2::CamLane_LaneMarkWidth_Rt);
	snprintf(buffer, elcount(buffer), "   0.000000 F1 MPC::CamLane_LaneAttr7_Gw_AR2::CamLane_LaneMarkWidth_Rt = %f\n", floatval);
	filePutString (buffer, elcount(buffer), hFile);
	intval = getSignal(CHASSIS::CamLane_LaneAttr7_Gw_AR2::CamLane_LaneMark_DtctDist_Lt);
	snprintf(buffer, elcount(buffer), "   0.000000 F1 MPC::CamLane_LaneAttr7_Gw_AR2::CamLane_LaneMark_DtctDist_Lt = %d\n", intval);
	filePutString (buffer, elcount(buffer), hFile);
	intval = getSignal(CHASSIS::CamLane_LaneAttr7_Gw_AR2::CamLane_LaneMark_DtctDist_Rt);
	snprintf(buffer, elcount(buffer), "   0.000000 F1 MPC::CamLane_LaneAttr7_Gw_AR2::CamLane_LaneMark_DtctDist_Rt = %d\n", intval);
	filePutString (buffer, elcount(buffer), hFile);
	intval = getSignal(CHASSIS::CamLane_LaneAttr7_Gw_AR2::CamLane_Stat);
	snprintf(buffer, elcount(buffer), "   0.000000 F1 MPC::CamLane_LaneAttr7_Gw_AR2::CamLane_Stat = %d\n", intval);
	filePutString (buffer, elcount(buffer), hFile);
	intval = getSignal(CHASSIS::CamLane_LaneAttr7_Gw_AR2::ALDW_LDP_PulseTm_Rq);
	snprintf(buffer, elcount(buffer), "   0.000000 F1 MPC::CamLane_LaneAttr7_Gw_AR2::ALDW_LDP_PulseTm_Rq = %d\n", intval);
	filePutString (buffer, elcount(buffer), hFile);
}
/*@@end*/

/*@@caplFunc:saveVars_82(dword):*/
void saveVars_82(dword hFile)
{
	intval = getSignal(CHASSIS::CamLane_LaneAttr7_Gw_AR2::ALDW_LDP_VibTm_Rq);
	snprintf(buffer, elcount(buffer), "   0.000000 F1 MPC::CamLane_LaneAttr7_Gw_AR2::ALDW_LDP_VibTm_Rq = %d\n", intval);
	filePutString (buffer, elcount(buffer), hFile);
	intval = getSignal(CHASSIS::CamLane_LaneAttr7_Gw_AR2::ALDW_LDP_Warn_Rq);
	snprintf(buffer, elcount(buffer), "   0.000000 F1 MPC::CamLane_LaneAttr7_Gw_AR2::ALDW_LDP_Warn_Rq = %d\n", intval);
	filePutString (buffer, elcount(buffer), hFile);
	intval = getSignal(CHASSIS::CamLane_LaneAttr7_Gw_AR2::LDP_BrkMsgDisp_Rq_MPC);
	snprintf(buffer, elcount(buffer), "   0.000000 F1 MPC::CamLane_LaneAttr7_Gw_AR2::LDP_BrkMsgDisp_Rq_MPC = %d\n", intval);
	filePutString (buffer, elcount(buffer), hFile);
	intval = getSignal(CHASSIS::CamLane_LaneAttr7_Gw_AR2::CamLane_LaneSiteDtct_Stat);
	snprintf(buffer, elcount(buffer), "   0.000000 F1 MPC::CamLane_LaneAttr7_Gw_AR2::CamLane_LaneSiteDtct_Stat = %d\n", intval);
	filePutString (buffer, elcount(buffer), hFile);
	intval = getSignal(CHASSIS::CamLane_LaneAttr7_Gw_AR2::Rsrv2_ALDW_LaneAttr7);
	snprintf(buffer, elcount(buffer), "   0.000000 F1 MPC::CamLane_LaneAttr7_Gw_AR2::Rsrv2_ALDW_LaneAttr7 = %d\n", intval);
	filePutString (buffer, elcount(buffer), hFile);
	floatval = getSignal(CHASSIS::CamLane_LaneAttr7_Gw_AR2::CamLane_LaneMarkWidth_Lt);
	snprintf(buffer, elcount(buffer), "   0.000000 F1 MPC::CamLane_LaneAttr7_Gw_AR2::CamLane_LaneMarkWidth_Lt = %f\n", floatval);
	filePutString (buffer, elcount(buffer), hFile);
	floatval = getSignal(CHASSIS::CamLane_LaneAttr7_Gw_AR2::CamLane_LaneAttr7_TmStmp);
	snprintf(buffer, elcount(buffer), "   0.000000 F1 MPC::CamLane_LaneAttr7_Gw_AR2::CamLane_LaneAttr7_TmStmp = %f\n", floatval);
	filePutString (buffer, elcount(buffer), hFile);
	intval = @sysvar::CH_Nodes::CH_MPCCRC_CamObj_A_Mtn_Pr2C_AUTO;
	snprintf(buffer, elcount(buffer), "   0.000000    SV: 2 0 0 ::CH_Nodes::CH_MPCCRC_CamObj_A_Mtn_Pr2C_AUTO = %d\n", intval);
	filePutString (buffer, elcount(buffer), hFile);
	intval = getSignal(CHASSIS::CamObj_A_Mtn_FR2::CRC_CamObj_A_Mtn_Pr2);
	snprintf(buffer, elcount(buffer), "   0.000000 F1 MPC::CamObj_A_Mtn_FR2::CRC_CamObj_A_Mtn_Pr2 = %d\n", intval);
	filePutString (buffer, elcount(buffer), hFile);
	intval = @sysvar::CH_Nodes::CH_MPCSQC_CamObj_A_Mtn_Pr2C_AUTO;
	snprintf(buffer, elcount(buffer), "   0.000000    SV: 2 0 0 ::CH_Nodes::CH_MPCSQC_CamObj_A_Mtn_Pr2C_AUTO = %d\n", intval);
	filePutString (buffer, elcount(buffer), hFile);
	intval = getSignal(CHASSIS::CamObj_A_Mtn_FR2::SQC_CamObj_A_Mtn_Pr2);
	snprintf(buffer, elcount(buffer), "   0.000000 F1 MPC::CamObj_A_Mtn_FR2::SQC_CamObj_A_Mtn_Pr2 = %d\n", intval);
	filePutString (buffer, elcount(buffer), hFile);
	intval = getSignal(CHASSIS::CamObj_A_Mtn_FR2::CamObj_A_Mtn_Stat);
	snprintf(buffer, elcount(buffer), "   0.000000 F1 MPC::CamObj_A_Mtn_FR2::CamObj_A_Mtn_Stat = %d\n", intval);
	filePutString (buffer, elcount(buffer), hFile);
	intval = getSignal(CHASSIS::CamObj_A_Mtn_FR2::CamObj_A_ObjQual_ASIL_Chk);
	snprintf(buffer, elcount(buffer), "   0.000000 F1 MPC::CamObj_A_Mtn_FR2::CamObj_A_ObjQual_ASIL_Chk = %d\n", intval);
	filePutString (buffer, elcount(buffer), hFile);
	intval = getSignal(CHASSIS::CamObj_A_Mtn_FR2::CamObj_A_Track_Stat);
	snprintf(buffer, elcount(buffer), "   0.000000 F1 MPC::CamObj_A_Mtn_FR2::CamObj_A_Track_Stat = %d\n", intval);
	filePutString (buffer, elcount(buffer), hFile);
	intval = getSignal(CHASSIS::CamObj_A_Mtn_FR2::CamObj_A_Mtn_TrackTm);
	snprintf(buffer, elcount(buffer), "   0.000000 F1 MPC::CamObj_A_Mtn_FR2::CamObj_A_Mtn_TrackTm = %d\n", intval);
	filePutString (buffer, elcount(buffer), hFile);
	floatval = getSignal(CHASSIS::CamObj_A_Mtn_FR2::CamObj_A_Mtn_YawRate);
	snprintf(buffer, elcount(buffer), "   0.000000 F1 MPC::CamObj_A_Mtn_FR2::CamObj_A_Mtn_YawRate = %f\n", floatval);
	filePutString (buffer, elcount(buffer), hFile);
	floatval = getSignal(CHASSIS::CamObj_A_Mtn_FR2::CamObj_A_Mtn_LtrlSpd_StdDev);
	snprintf(buffer, elcount(buffer), "   0.000000 F1 MPC::CamObj_A_Mtn_FR2::CamObj_A_Mtn_LtrlSpd_StdDev = %f\n", floatval);
	filePutString (buffer, elcount(buffer), hFile);
	floatval = getSignal(CHASSIS::CamObj_A_Mtn_FR2::CamObj_A_Mtn_LtrlSpd_Lt);
	snprintf(buffer, elcount(buffer), "   0.000000 F1 MPC::CamObj_A_Mtn_FR2::CamObj_A_Mtn_LtrlSpd_Lt = %f\n", floatval);
	filePutString (buffer, elcount(buffer), hFile);
	floatval = getSignal(CHASSIS::CamObj_A_Mtn_FR2::CamObj_A_Mtn_LtrlSpd_Mid);
	snprintf(buffer, elcount(buffer), "   0.000000 F1 MPC::CamObj_A_Mtn_FR2::CamObj_A_Mtn_LtrlSpd_Mid = %f\n", floatval);
	filePutString (buffer, elcount(buffer), hFile);
	floatval = getSignal(CHASSIS::CamObj_A_Mtn_FR2::CamObj_A_Mtn_LtrlSpd_Rt);
	snprintf(buffer, elcount(buffer), "   0.000000 F1 MPC::CamObj_A_Mtn_FR2::CamObj_A_Mtn_LtrlSpd_Rt = %f\n", floatval);
	filePutString (buffer, elcount(buffer), hFile);
	intval = getSignal(CHASSIS::CamObj_A_Mtn_FR2::CamObj_A_Collision_Dtct);
	snprintf(buffer, elcount(buffer), "   0.000000 F1 MPC::CamObj_A_Mtn_FR2::CamObj_A_Collision_Dtct = %d\n", intval);
	filePutString (buffer, elcount(buffer), hFile);
	floatval = getSignal(CHASSIS::CamObj_A_Mtn_FR2::CamObj_A_Mtn_LongSpd_StdDev);
	snprintf(buffer, elcount(buffer), "   0.000000 F1 MPC::CamObj_A_Mtn_FR2::CamObj_A_Mtn_LongSpd_StdDev = %f\n", floatval);
	filePutString (buffer, elcount(buffer), hFile);
	floatval = getSignal(CHASSIS::CamObj_A_Mtn_FR2::CamObj_A_Mtn_LongSpd_Lt);
	snprintf(buffer, elcount(buffer), "   0.000000 F1 MPC::CamObj_A_Mtn_FR2::CamObj_A_Mtn_LongSpd_Lt = %f\n", floatval);
	filePutString (buffer, elcount(buffer), hFile);
	floatval = getSignal(CHASSIS::CamObj_A_Mtn_FR2::CamObj_A_Mtn_LongSpd_Mid);
	snprintf(buffer, elcount(buffer), "   0.000000 F1 MPC::CamObj_A_Mtn_FR2::CamObj_A_Mtn_LongSpd_Mid = %f\n", floatval);
	filePutString (buffer, elcount(buffer), hFile);
	floatval = getSignal(CHASSIS::CamObj_A_Mtn_FR2::CamObj_A_Mtn_LongSpd_Rt);
	snprintf(buffer, elcount(buffer), "   0.000000 F1 MPC::CamObj_A_Mtn_FR2::CamObj_A_Mtn_LongSpd_Rt = %f\n", floatval);
	filePutString (buffer, elcount(buffer), hFile);
	intval = getSignal(CHASSIS::CamObj_A_Mtn_FR2::CamObj_A_BorderFlg_Lt);
	snprintf(buffer, elcount(buffer), "   0.000000 F1 MPC::CamObj_A_Mtn_FR2::CamObj_A_BorderFlg_Lt = %d\n", intval);
	filePutString (buffer, elcount(buffer), hFile);
	intval = getSignal(CHASSIS::CamObj_A_Mtn_FR2::CamObj_A_BorderFlg_Rt);
	snprintf(buffer, elcount(buffer), "   0.000000 F1 MPC::CamObj_A_Mtn_FR2::CamObj_A_BorderFlg_Rt = %d\n", intval);
	filePutString (buffer, elcount(buffer), hFile);
	intval = getSignal(CHASSIS::CamObj_A_Mtn_FR2::CamObj_A_BorderObsrvFlg_Lt);
	snprintf(buffer, elcount(buffer), "   0.000000 F1 MPC::CamObj_A_Mtn_FR2::CamObj_A_BorderObsrvFlg_Lt = %d\n", intval);
	filePutString (buffer, elcount(buffer), hFile);
	intval = getSignal(CHASSIS::CamObj_A_Mtn_FR2::CamObj_A_BorderObsrvFlg_Rt);
	snprintf(buffer, elcount(buffer), "   0.000000 F1 MPC::CamObj_A_Mtn_FR2::CamObj_A_BorderObsrvFlg_Rt = %d\n", intval);
	filePutString (buffer, elcount(buffer), hFile);
	intval = getSignal(CHASSIS::CamObj_A_Mtn_FR2::CamObj_A_Lane_Alloc);
	snprintf(buffer, elcount(buffer), "   0.000000 F1 MPC::CamObj_A_Mtn_FR2::CamObj_A_Lane_Alloc = %d\n", intval);
	filePutString (buffer, elcount(buffer), hFile);
	intval = getSignal(CHASSIS::CamObj_A_Mtn_FR2::CamObj_A_RefSurf_Rng);
	snprintf(buffer, elcount(buffer), "   0.000000 F1 MPC::CamObj_A_Mtn_FR2::CamObj_A_RefSurf_Rng = %d\n", intval);
	filePutString (buffer, elcount(buffer), hFile);
	intval = getSignal(CHASSIS::CamObj_A_Mtn_FR2::CamObj_A_ObjQual_GeneralObj_Track);
	snprintf(buffer, elcount(buffer), "   0.000000 F1 MPC::CamObj_A_Mtn_FR2::CamObj_A_ObjQual_GeneralObj_Track = %d\n", intval);
	filePutString (buffer, elcount(buffer), hFile);
	intval = getSignal(CHASSIS::CamObj_A_Mtn_FR2::CamObj_A_ObjQual_VehObj_Track);
	snprintf(buffer, elcount(buffer), "   0.000000 F1 MPC::CamObj_A_Mtn_FR2::CamObj_A_ObjQual_VehObj_Track = %d\n", intval);
	filePutString (buffer, elcount(buffer), hFile);
	intval = getSignal(CHASSIS::CamObj_A_Mtn_FR2::CamObj_A_ObjQual_FeatApprox);
	snprintf(buffer, elcount(buffer), "   0.000000 F1 MPC::CamObj_A_Mtn_FR2::CamObj_A_ObjQual_FeatApprox = %d\n", intval);
	filePutString (buffer, elcount(buffer), hFile);
	intval = getSignal(CHASSIS::CamObj_A_Mtn_FR2::CamObj_A_ObjQual_FeatDensity);
	snprintf(buffer, elcount(buffer), "   0.000000 F1 MPC::CamObj_A_Mtn_FR2::CamObj_A_ObjQual_FeatDensity = %d\n", intval);
	filePutString (buffer, elcount(buffer), hFile);
	intval = getSignal(CHASSIS::CamObj_A_Mtn_FR2::CamObj_A_ObjQual_ShapeApprox);
	snprintf(buffer, elcount(buffer), "   0.000000 F1 MPC::CamObj_A_Mtn_FR2::CamObj_A_ObjQual_ShapeApprox = %d\n", intval);
	filePutString (buffer, elcount(buffer), hFile);
	intval = getSignal(CHASSIS::CamObj_A_Mtn_FR2::CamObj_A_ObjQual_VehTrack_Qual);
	snprintf(buffer, elcount(buffer), "   0.000000 F1 MPC::CamObj_A_Mtn_FR2::CamObj_A_ObjQual_VehTrack_Qual = %d\n", intval);
	filePutString (buffer, elcount(buffer), hFile);
	intval = getSignal(CHASSIS::CamObj_A_Mtn_FR2::CamObj_A_ObjQual_PedClass_Conf);
	snprintf(buffer, elcount(buffer), "   0.000000 F1 MPC::CamObj_A_Mtn_FR2::CamObj_A_ObjQual_PedClass_Conf = %d\n", intval);
	filePutString (buffer, elcount(buffer), hFile);
	intval = getSignal(CHASSIS::CamObj_A_Mtn_FR2::CamObj_A_ObjQual_VehClass_Conf);
	snprintf(buffer, elcount(buffer), "   0.000000 F1 MPC::CamObj_A_Mtn_FR2::CamObj_A_ObjQual_VehClass_Conf = %d\n", intval);
	filePutString (buffer, elcount(buffer), hFile);
	intval = getSignal(CHASSIS::CamObj_A_Mtn_FR2::CamObj_A_ObjQual_ClassSw);
	snprintf(buffer, elcount(buffer), "   0.000000 F1 MPC::CamObj_A_Mtn_FR2::CamObj_A_ObjQual_ClassSw = %d\n", intval);
	filePutString (buffer, elcount(buffer), hFile);
	intval = getSignal(CHASSIS::CamObj_A_Mtn_FR2::CamObj_A_ObjQual_Stereo_Dtct);
	snprintf(buffer, elcount(buffer), "   0.000000 F1 MPC::CamObj_A_Mtn_FR2::CamObj_A_ObjQual_Stereo_Dtct = %d\n", intval);
	filePutString (buffer, elcount(buffer), hFile);
	intval = @sysvar::CH_Nodes::CH_MPCCRC_CamObj_A_Posn_Pr2_AUTO;
	snprintf(buffer, elcount(buffer), "   0.000000    SV: 2 0 0 ::CH_Nodes::CH_MPCCRC_CamObj_A_Posn_Pr2_AUTO = %d\n", intval);
	filePutString (buffer, elcount(buffer), hFile);
	intval = getSignal(CHASSIS::CamObj_A_Posn_FR2::CRC_CamObj_A_Posn_Pr2);
	snprintf(buffer, elcount(buffer), "   0.000000 F1 MPC::CamObj_A_Posn_FR2::CRC_CamObj_A_Posn_Pr2 = %d\n", intval);
	filePutString (buffer, elcount(buffer), hFile);
	intval = @sysvar::CH_Nodes::CH_MPCSQC_CamObj_A_Posn_Pr2_AUTO;
	snprintf(buffer, elcount(buffer), "   0.000000    SV: 2 0 0 ::CH_Nodes::CH_MPCSQC_CamObj_A_Posn_Pr2_AUTO = %d\n", intval);
	filePutString (buffer, elcount(buffer), hFile);
	intval = getSignal(CHASSIS::CamObj_A_Posn_FR2::SQC_CamObj_A_Posn_Pr2);
	snprintf(buffer, elcount(buffer), "   0.000000 F1 MPC::CamObj_A_Posn_FR2::SQC_CamObj_A_Posn_Pr2 = %d\n", intval);
	filePutString (buffer, elcount(buffer), hFile);
	intval = getSignal(CHASSIS::CamObj_A_Posn_FR2::CamObj_A_Class);
	snprintf(buffer, elcount(buffer), "   0.000000 F1 MPC::CamObj_A_Posn_FR2::CamObj_A_Class = %d\n", intval);
	filePutString (buffer, elcount(buffer), hFile);
	intval = getSignal(CHASSIS::CamObj_A_Posn_FR2::CamObj_A_Posn_Angl_Idx);
	snprintf(buffer, elcount(buffer), "   0.000000 F1 MPC::CamObj_A_Posn_FR2::CamObj_A_Posn_Angl_Idx = %d\n", intval);
	filePutString (buffer, elcount(buffer), hFile);
	floatval = getSignal(CHASSIS::CamObj_A_Posn_FR2::CamObj_A_ObjWidth);
	snprintf(buffer, elcount(buffer), "   0.000000 F1 MPC::CamObj_A_Posn_FR2::CamObj_A_ObjWidth = %f\n", floatval);
	filePutString (buffer, elcount(buffer), hFile);
	intval = getSignal(CHASSIS::CamObj_A_Posn_FR2::CamObj_A_RiskArea_Type);
	snprintf(buffer, elcount(buffer), "   0.000000 F1 MPC::CamObj_A_Posn_FR2::CamObj_A_RiskArea_Type = %d\n", intval);
	filePutString (buffer, elcount(buffer), hFile);
	intval = getSignal(CHASSIS::CamObj_A_Posn_FR2::CamObj_A_Id);
	snprintf(buffer, elcount(buffer), "   0.000000 F1 MPC::CamObj_A_Posn_FR2::CamObj_A_Id = %d\n", intval);
	filePutString (buffer, elcount(buffer), hFile);
	intval = getSignal(CHASSIS::CamObj_A_Posn_FR2::CamObj_A_List_Id);
	snprintf(buffer, elcount(buffer), "   0.000000 F1 MPC::CamObj_A_Posn_FR2::CamObj_A_List_Id = %d\n", intval);
	filePutString (buffer, elcount(buffer), hFile);
	intval = getSignal(CHASSIS::CamObj_A_Posn_FR2::CamObj_A_List_Elem);
	snprintf(buffer, elcount(buffer), "   0.000000 F1 MPC::CamObj_A_Posn_FR2::CamObj_A_List_Elem = %d\n", intval);
	filePutString (buffer, elcount(buffer), hFile);
	floatval = getSignal(CHASSIS::CamObj_A_Posn_FR2::CamObj_A_Posn_X_Lt);
	snprintf(buffer, elcount(buffer), "   0.000000 F1 MPC::CamObj_A_Posn_FR2::CamObj_A_Posn_X_Lt = %f\n", floatval);
	filePutString (buffer, elcount(buffer), hFile);
	floatval = getSignal(CHASSIS::CamObj_A_Posn_FR2::CamObj_A_Posn_X_Mid);
	snprintf(buffer, elcount(buffer), "   0.000000 F1 MPC::CamObj_A_Posn_FR2::CamObj_A_Posn_X_Mid = %f\n", floatval);
	filePutString (buffer, elcount(buffer), hFile);
	floatval = getSignal(CHASSIS::CamObj_A_Posn_FR2::CamObj_A_Posn_X_Rt);
	snprintf(buffer, elcount(buffer), "   0.000000 F1 MPC::CamObj_A_Posn_FR2::CamObj_A_Posn_X_Rt = %f\n", floatval);
	filePutString (buffer, elcount(buffer), hFile);
}
/*@@end*/

/*@@caplFunc:saveVars_83(dword):*/
void saveVars_83(dword hFile)
{
	floatval = getSignal(CHASSIS::CamObj_A_Posn_FR2::CamObj_A_Posn_X_StdDev);
	snprintf(buffer, elcount(buffer), "   0.000000 F1 MPC::CamObj_A_Posn_FR2::CamObj_A_Posn_X_StdDev = %f\n", floatval);
	filePutString (buffer, elcount(buffer), hFile);
	floatval = getSignal(CHASSIS::CamObj_A_Posn_FR2::CamObj_A_Posn_Y_Lt);
	snprintf(buffer, elcount(buffer), "   0.000000 F1 MPC::CamObj_A_Posn_FR2::CamObj_A_Posn_Y_Lt = %f\n", floatval);
	filePutString (buffer, elcount(buffer), hFile);
	floatval = getSignal(CHASSIS::CamObj_A_Posn_FR2::CamObj_A_Posn_Y_Mid);
	snprintf(buffer, elcount(buffer), "   0.000000 F1 MPC::CamObj_A_Posn_FR2::CamObj_A_Posn_Y_Mid = %f\n", floatval);
	filePutString (buffer, elcount(buffer), hFile);
	floatval = getSignal(CHASSIS::CamObj_A_Posn_FR2::CamObj_A_Posn_Y_Rt);
	snprintf(buffer, elcount(buffer), "   0.000000 F1 MPC::CamObj_A_Posn_FR2::CamObj_A_Posn_Y_Rt = %f\n", floatval);
	filePutString (buffer, elcount(buffer), hFile);
	floatval = getSignal(CHASSIS::CamObj_A_Posn_FR2::CamObj_A_Posn_Y_StdDev);
	snprintf(buffer, elcount(buffer), "   0.000000 F1 MPC::CamObj_A_Posn_FR2::CamObj_A_Posn_Y_StdDev = %f\n", floatval);
	filePutString (buffer, elcount(buffer), hFile);
	floatval = getSignal(CHASSIS::CamObj_A_Posn_FR2::CamObj_A_Posn_Hght_LowBound);
	snprintf(buffer, elcount(buffer), "   0.000000 F1 MPC::CamObj_A_Posn_FR2::CamObj_A_Posn_Hght_LowBound = %f\n", floatval);
	filePutString (buffer, elcount(buffer), hFile);
	floatval = getSignal(CHASSIS::CamObj_A_Posn_FR2::CamObj_A_Posn_Hght_UpBound);
	snprintf(buffer, elcount(buffer), "   0.000000 F1 MPC::CamObj_A_Posn_FR2::CamObj_A_Posn_Hght_UpBound = %f\n", floatval);
	filePutString (buffer, elcount(buffer), hFile);
	intval = @sysvar::CH_Nodes::CH_MPCCRC_CamObj_B_Mtn_Pr2C_AUTO;
	snprintf(buffer, elcount(buffer), "   0.000000    SV: 2 0 0 ::CH_Nodes::CH_MPCCRC_CamObj_B_Mtn_Pr2C_AUTO = %d\n", intval);
	filePutString (buffer, elcount(buffer), hFile);
	intval = getSignal(CHASSIS::CamObj_B_Mtn_FR2::CRC_CamObj_B_Mtn_Pr2);
	snprintf(buffer, elcount(buffer), "   0.000000 F1 MPC::CamObj_B_Mtn_FR2::CRC_CamObj_B_Mtn_Pr2 = %d\n", intval);
	filePutString (buffer, elcount(buffer), hFile);
	intval = @sysvar::CH_Nodes::CH_MPCSQC_CamObj_B_Mtn_Pr2C_AUTO;
	snprintf(buffer, elcount(buffer), "   0.000000    SV: 2 0 0 ::CH_Nodes::CH_MPCSQC_CamObj_B_Mtn_Pr2C_AUTO = %d\n", intval);
	filePutString (buffer, elcount(buffer), hFile);
	intval = getSignal(CHASSIS::CamObj_B_Mtn_FR2::SQC_CamObj_B_Mtn_Pr2);
	snprintf(buffer, elcount(buffer), "   0.000000 F1 MPC::CamObj_B_Mtn_FR2::SQC_CamObj_B_Mtn_Pr2 = %d\n", intval);
	filePutString (buffer, elcount(buffer), hFile);
	intval = getSignal(CHASSIS::CamObj_B_Mtn_FR2::CamObj_B_Mtn_Stat);
	snprintf(buffer, elcount(buffer), "   0.000000 F1 MPC::CamObj_B_Mtn_FR2::CamObj_B_Mtn_Stat = %d\n", intval);
	filePutString (buffer, elcount(buffer), hFile);
	intval = getSignal(CHASSIS::CamObj_B_Mtn_FR2::CamObj_B_ObjQual_ASIL_Chk);
	snprintf(buffer, elcount(buffer), "   0.000000 F1 MPC::CamObj_B_Mtn_FR2::CamObj_B_ObjQual_ASIL_Chk = %d\n", intval);
	filePutString (buffer, elcount(buffer), hFile);
	intval = getSignal(CHASSIS::CamObj_B_Mtn_FR2::CamObj_B_Track_Stat);
	snprintf(buffer, elcount(buffer), "   0.000000 F1 MPC::CamObj_B_Mtn_FR2::CamObj_B_Track_Stat = %d\n", intval);
	filePutString (buffer, elcount(buffer), hFile);
	intval = getSignal(CHASSIS::CamObj_B_Mtn_FR2::CamObj_B_Mtn_TrackTm);
	snprintf(buffer, elcount(buffer), "   0.000000 F1 MPC::CamObj_B_Mtn_FR2::CamObj_B_Mtn_TrackTm = %d\n", intval);
	filePutString (buffer, elcount(buffer), hFile);
	floatval = getSignal(CHASSIS::CamObj_B_Mtn_FR2::CamObj_B_Mtn_YawRate);
	snprintf(buffer, elcount(buffer), "   0.000000 F1 MPC::CamObj_B_Mtn_FR2::CamObj_B_Mtn_YawRate = %f\n", floatval);
	filePutString (buffer, elcount(buffer), hFile);
	floatval = getSignal(CHASSIS::CamObj_B_Mtn_FR2::CamObj_B_Mtn_LtrlSpd_StdDev);
	snprintf(buffer, elcount(buffer), "   0.000000 F1 MPC::CamObj_B_Mtn_FR2::CamObj_B_Mtn_LtrlSpd_StdDev = %f\n", floatval);
	filePutString (buffer, elcount(buffer), hFile);
	floatval = getSignal(CHASSIS::CamObj_B_Mtn_FR2::CamObj_B_Mtn_LtrlSpd_Lt);
	snprintf(buffer, elcount(buffer), "   0.000000 F1 MPC::CamObj_B_Mtn_FR2::CamObj_B_Mtn_LtrlSpd_Lt = %f\n", floatval);
	filePutString (buffer, elcount(buffer), hFile);
	floatval = getSignal(CHASSIS::CamObj_B_Mtn_FR2::CamObj_B_Mtn_LtrlSpd_Mid);
	snprintf(buffer, elcount(buffer), "   0.000000 F1 MPC::CamObj_B_Mtn_FR2::CamObj_B_Mtn_LtrlSpd_Mid = %f\n", floatval);
	filePutString (buffer, elcount(buffer), hFile);
	floatval = getSignal(CHASSIS::CamObj_B_Mtn_FR2::CamObj_B_Mtn_LtrlSpd_Rt);
	snprintf(buffer, elcount(buffer), "   0.000000 F1 MPC::CamObj_B_Mtn_FR2::CamObj_B_Mtn_LtrlSpd_Rt = %f\n", floatval);
	filePutString (buffer, elcount(buffer), hFile);
	intval = getSignal(CHASSIS::CamObj_B_Mtn_FR2::CamObj_B_Collision_Dtct);
	snprintf(buffer, elcount(buffer), "   0.000000 F1 MPC::CamObj_B_Mtn_FR2::CamObj_B_Collision_Dtct = %d\n", intval);
	filePutString (buffer, elcount(buffer), hFile);
	floatval = getSignal(CHASSIS::CamObj_B_Mtn_FR2::CamObj_B_Mtn_LongSpd_StdDev);
	snprintf(buffer, elcount(buffer), "   0.000000 F1 MPC::CamObj_B_Mtn_FR2::CamObj_B_Mtn_LongSpd_StdDev = %f\n", floatval);
	filePutString (buffer, elcount(buffer), hFile);
	floatval = getSignal(CHASSIS::CamObj_B_Mtn_FR2::CamObj_B_Mtn_LongSpd_Lt);
	snprintf(buffer, elcount(buffer), "   0.000000 F1 MPC::CamObj_B_Mtn_FR2::CamObj_B_Mtn_LongSpd_Lt = %f\n", floatval);
	filePutString (buffer, elcount(buffer), hFile);
	floatval = getSignal(CHASSIS::CamObj_B_Mtn_FR2::CamObj_B_Mtn_LongSpd_Mid);
	snprintf(buffer, elcount(buffer), "   0.000000 F1 MPC::CamObj_B_Mtn_FR2::CamObj_B_Mtn_LongSpd_Mid = %f\n", floatval);
	filePutString (buffer, elcount(buffer), hFile);
	floatval = getSignal(CHASSIS::CamObj_B_Mtn_FR2::CamObj_B_Mtn_LongSpd_Rt);
	snprintf(buffer, elcount(buffer), "   0.000000 F1 MPC::CamObj_B_Mtn_FR2::CamObj_B_Mtn_LongSpd_Rt = %f\n", floatval);
	filePutString (buffer, elcount(buffer), hFile);
	intval = getSignal(CHASSIS::CamObj_B_Mtn_FR2::CamObj_B_BorderFlg_Lt);
	snprintf(buffer, elcount(buffer), "   0.000000 F1 MPC::CamObj_B_Mtn_FR2::CamObj_B_BorderFlg_Lt = %d\n", intval);
	filePutString (buffer, elcount(buffer), hFile);
	intval = getSignal(CHASSIS::CamObj_B_Mtn_FR2::CamObj_B_BorderFlg_Rt);
	snprintf(buffer, elcount(buffer), "   0.000000 F1 MPC::CamObj_B_Mtn_FR2::CamObj_B_BorderFlg_Rt = %d\n", intval);
	filePutString (buffer, elcount(buffer), hFile);
	intval = getSignal(CHASSIS::CamObj_B_Mtn_FR2::CamObj_B_BorderObsrvFlg_Lt);
	snprintf(buffer, elcount(buffer), "   0.000000 F1 MPC::CamObj_B_Mtn_FR2::CamObj_B_BorderObsrvFlg_Lt = %d\n", intval);
	filePutString (buffer, elcount(buffer), hFile);
	intval = getSignal(CHASSIS::CamObj_B_Mtn_FR2::CamObj_B_BorderObsrvFlg_Rt);
	snprintf(buffer, elcount(buffer), "   0.000000 F1 MPC::CamObj_B_Mtn_FR2::CamObj_B_BorderObsrvFlg_Rt = %d\n", intval);
	filePutString (buffer, elcount(buffer), hFile);
	intval = getSignal(CHASSIS::CamObj_B_Mtn_FR2::CamObj_B_Lane_Alloc);
	snprintf(buffer, elcount(buffer), "   0.000000 F1 MPC::CamObj_B_Mtn_FR2::CamObj_B_Lane_Alloc = %d\n", intval);
	filePutString (buffer, elcount(buffer), hFile);
	intval = getSignal(CHASSIS::CamObj_B_Mtn_FR2::CamObj_B_RefSurf_Rng);
	snprintf(buffer, elcount(buffer), "   0.000000 F1 MPC::CamObj_B_Mtn_FR2::CamObj_B_RefSurf_Rng = %d\n", intval);
	filePutString (buffer, elcount(buffer), hFile);
	intval = getSignal(CHASSIS::CamObj_B_Mtn_FR2::CamObj_B_ObjQual_GeneralObj_Track);
	snprintf(buffer, elcount(buffer), "   0.000000 F1 MPC::CamObj_B_Mtn_FR2::CamObj_B_ObjQual_GeneralObj_Track = %d\n", intval);
	filePutString (buffer, elcount(buffer), hFile);
	intval = getSignal(CHASSIS::CamObj_B_Mtn_FR2::CamObj_B_ObjQual_VehObj_Track);
	snprintf(buffer, elcount(buffer), "   0.000000 F1 MPC::CamObj_B_Mtn_FR2::CamObj_B_ObjQual_VehObj_Track = %d\n", intval);
	filePutString (buffer, elcount(buffer), hFile);
	intval = getSignal(CHASSIS::CamObj_B_Mtn_FR2::CamObj_B_ObjQual_FeatApprox);
	snprintf(buffer, elcount(buffer), "   0.000000 F1 MPC::CamObj_B_Mtn_FR2::CamObj_B_ObjQual_FeatApprox = %d\n", intval);
	filePutString (buffer, elcount(buffer), hFile);
	intval = getSignal(CHASSIS::CamObj_B_Mtn_FR2::CamObj_B_ObjQual_FeatDensity);
	snprintf(buffer, elcount(buffer), "   0.000000 F1 MPC::CamObj_B_Mtn_FR2::CamObj_B_ObjQual_FeatDensity = %d\n", intval);
	filePutString (buffer, elcount(buffer), hFile);
	intval = getSignal(CHASSIS::CamObj_B_Mtn_FR2::CamObj_B_ObjQual_ShapeApprox);
	snprintf(buffer, elcount(buffer), "   0.000000 F1 MPC::CamObj_B_Mtn_FR2::CamObj_B_ObjQual_ShapeApprox = %d\n", intval);
	filePutString (buffer, elcount(buffer), hFile);
	intval = getSignal(CHASSIS::CamObj_B_Mtn_FR2::CamObj_B_ObjQual_VehTrack_Qual);
	snprintf(buffer, elcount(buffer), "   0.000000 F1 MPC::CamObj_B_Mtn_FR2::CamObj_B_ObjQual_VehTrack_Qual = %d\n", intval);
	filePutString (buffer, elcount(buffer), hFile);
	intval = getSignal(CHASSIS::CamObj_B_Mtn_FR2::CamObj_B_ObjQual_PedClass_Conf);
	snprintf(buffer, elcount(buffer), "   0.000000 F1 MPC::CamObj_B_Mtn_FR2::CamObj_B_ObjQual_PedClass_Conf = %d\n", intval);
	filePutString (buffer, elcount(buffer), hFile);
	intval = getSignal(CHASSIS::CamObj_B_Mtn_FR2::CamObj_B_ObjQual_VehClass_Conf);
	snprintf(buffer, elcount(buffer), "   0.000000 F1 MPC::CamObj_B_Mtn_FR2::CamObj_B_ObjQual_VehClass_Conf = %d\n", intval);
	filePutString (buffer, elcount(buffer), hFile);
	intval = getSignal(CHASSIS::CamObj_B_Mtn_FR2::CamObj_B_ObjQual_ClassSw);
	snprintf(buffer, elcount(buffer), "   0.000000 F1 MPC::CamObj_B_Mtn_FR2::CamObj_B_ObjQual_ClassSw = %d\n", intval);
	filePutString (buffer, elcount(buffer), hFile);
	intval = getSignal(CHASSIS::CamObj_B_Mtn_FR2::CamObj_B_ObjQual_Stereo_Dtct);
	snprintf(buffer, elcount(buffer), "   0.000000 F1 MPC::CamObj_B_Mtn_FR2::CamObj_B_ObjQual_Stereo_Dtct = %d\n", intval);
	filePutString (buffer, elcount(buffer), hFile);
	intval = @sysvar::CH_Nodes::CH_MPCCRC_CamObj_B_Posn_Pr2_AUTO;
	snprintf(buffer, elcount(buffer), "   0.000000    SV: 2 0 0 ::CH_Nodes::CH_MPCCRC_CamObj_B_Posn_Pr2_AUTO = %d\n", intval);
	filePutString (buffer, elcount(buffer), hFile);
	intval = getSignal(CHASSIS::CamObj_B_Posn_FR2::CRC_CamObj_B_Posn_Pr2);
	snprintf(buffer, elcount(buffer), "   0.000000 F1 MPC::CamObj_B_Posn_FR2::CRC_CamObj_B_Posn_Pr2 = %d\n", intval);
	filePutString (buffer, elcount(buffer), hFile);
	intval = @sysvar::CH_Nodes::CH_MPCSQC_CamObj_B_Posn_Pr2_AUTO;
	snprintf(buffer, elcount(buffer), "   0.000000    SV: 2 0 0 ::CH_Nodes::CH_MPCSQC_CamObj_B_Posn_Pr2_AUTO = %d\n", intval);
	filePutString (buffer, elcount(buffer), hFile);
	intval = getSignal(CHASSIS::CamObj_B_Posn_FR2::SQC_CamObj_B_Posn_Pr2);
	snprintf(buffer, elcount(buffer), "   0.000000 F1 MPC::CamObj_B_Posn_FR2::SQC_CamObj_B_Posn_Pr2 = %d\n", intval);
	filePutString (buffer, elcount(buffer), hFile);
	intval = getSignal(CHASSIS::CamObj_B_Posn_FR2::CamObj_B_Class);
	snprintf(buffer, elcount(buffer), "   0.000000 F1 MPC::CamObj_B_Posn_FR2::CamObj_B_Class = %d\n", intval);
	filePutString (buffer, elcount(buffer), hFile);
	intval = getSignal(CHASSIS::CamObj_B_Posn_FR2::CamObj_B_Posn_Angl_Idx);
	snprintf(buffer, elcount(buffer), "   0.000000 F1 MPC::CamObj_B_Posn_FR2::CamObj_B_Posn_Angl_Idx = %d\n", intval);
	filePutString (buffer, elcount(buffer), hFile);
	floatval = getSignal(CHASSIS::CamObj_B_Posn_FR2::CamObj_B_ObjWidth);
	snprintf(buffer, elcount(buffer), "   0.000000 F1 MPC::CamObj_B_Posn_FR2::CamObj_B_ObjWidth = %f\n", floatval);
	filePutString (buffer, elcount(buffer), hFile);
	intval = getSignal(CHASSIS::CamObj_B_Posn_FR2::CamObj_B_RiskArea_Type);
	snprintf(buffer, elcount(buffer), "   0.000000 F1 MPC::CamObj_B_Posn_FR2::CamObj_B_RiskArea_Type = %d\n", intval);
	filePutString (buffer, elcount(buffer), hFile);
	intval = getSignal(CHASSIS::CamObj_B_Posn_FR2::CamObj_B_Id);
	snprintf(buffer, elcount(buffer), "   0.000000 F1 MPC::CamObj_B_Posn_FR2::CamObj_B_Id = %d\n", intval);
	filePutString (buffer, elcount(buffer), hFile);
	intval = getSignal(CHASSIS::CamObj_B_Posn_FR2::CamObj_B_List_Id);
	snprintf(buffer, elcount(buffer), "   0.000000 F1 MPC::CamObj_B_Posn_FR2::CamObj_B_List_Id = %d\n", intval);
	filePutString (buffer, elcount(buffer), hFile);
	intval = getSignal(CHASSIS::CamObj_B_Posn_FR2::CamObj_B_List_Elem);
	snprintf(buffer, elcount(buffer), "   0.000000 F1 MPC::CamObj_B_Posn_FR2::CamObj_B_List_Elem = %d\n", intval);
	filePutString (buffer, elcount(buffer), hFile);
	floatval = getSignal(CHASSIS::CamObj_B_Posn_FR2::CamObj_B_Posn_X_Lt);
	snprintf(buffer, elcount(buffer), "   0.000000 F1 MPC::CamObj_B_Posn_FR2::CamObj_B_Posn_X_Lt = %f\n", floatval);
	filePutString (buffer, elcount(buffer), hFile);
	floatval = getSignal(CHASSIS::CamObj_B_Posn_FR2::CamObj_B_Posn_X_Mid);
	snprintf(buffer, elcount(buffer), "   0.000000 F1 MPC::CamObj_B_Posn_FR2::CamObj_B_Posn_X_Mid = %f\n", floatval);
	filePutString (buffer, elcount(buffer), hFile);
	floatval = getSignal(CHASSIS::CamObj_B_Posn_FR2::CamObj_B_Posn_X_Rt);
	snprintf(buffer, elcount(buffer), "   0.000000 F1 MPC::CamObj_B_Posn_FR2::CamObj_B_Posn_X_Rt = %f\n", floatval);
	filePutString (buffer, elcount(buffer), hFile);
}
/*@@end*/

/*@@caplFunc:saveVars_84(dword):*/
void saveVars_84(dword hFile)
{
	floatval = getSignal(CHASSIS::CamObj_B_Posn_FR2::CamObj_B_Posn_X_StdDev);
	snprintf(buffer, elcount(buffer), "   0.000000 F1 MPC::CamObj_B_Posn_FR2::CamObj_B_Posn_X_StdDev = %f\n", floatval);
	filePutString (buffer, elcount(buffer), hFile);
	floatval = getSignal(CHASSIS::CamObj_B_Posn_FR2::CamObj_B_Posn_Y_Lt);
	snprintf(buffer, elcount(buffer), "   0.000000 F1 MPC::CamObj_B_Posn_FR2::CamObj_B_Posn_Y_Lt = %f\n", floatval);
	filePutString (buffer, elcount(buffer), hFile);
	floatval = getSignal(CHASSIS::CamObj_B_Posn_FR2::CamObj_B_Posn_Y_Mid);
	snprintf(buffer, elcount(buffer), "   0.000000 F1 MPC::CamObj_B_Posn_FR2::CamObj_B_Posn_Y_Mid = %f\n", floatval);
	filePutString (buffer, elcount(buffer), hFile);
	floatval = getSignal(CHASSIS::CamObj_B_Posn_FR2::CamObj_B_Posn_Y_Rt);
	snprintf(buffer, elcount(buffer), "   0.000000 F1 MPC::CamObj_B_Posn_FR2::CamObj_B_Posn_Y_Rt = %f\n", floatval);
	filePutString (buffer, elcount(buffer), hFile);
	floatval = getSignal(CHASSIS::CamObj_B_Posn_FR2::CamObj_B_Posn_Y_StdDev);
	snprintf(buffer, elcount(buffer), "   0.000000 F1 MPC::CamObj_B_Posn_FR2::CamObj_B_Posn_Y_StdDev = %f\n", floatval);
	filePutString (buffer, elcount(buffer), hFile);
	floatval = getSignal(CHASSIS::CamObj_B_Posn_FR2::CamObj_B_Posn_Hght_LowBound);
	snprintf(buffer, elcount(buffer), "   0.000000 F1 MPC::CamObj_B_Posn_FR2::CamObj_B_Posn_Hght_LowBound = %f\n", floatval);
	filePutString (buffer, elcount(buffer), hFile);
	floatval = getSignal(CHASSIS::CamObj_B_Posn_FR2::CamObj_B_Posn_Hght_UpBound);
	snprintf(buffer, elcount(buffer), "   0.000000 F1 MPC::CamObj_B_Posn_FR2::CamObj_B_Posn_Hght_UpBound = %f\n", floatval);
	filePutString (buffer, elcount(buffer), hFile);
	intval = @sysvar::CH_Nodes::CH_MPCCRC_CamObj_C_Mtn_Pr2C_AUTO;
	snprintf(buffer, elcount(buffer), "   0.000000    SV: 2 0 0 ::CH_Nodes::CH_MPCCRC_CamObj_C_Mtn_Pr2C_AUTO = %d\n", intval);
	filePutString (buffer, elcount(buffer), hFile);
	intval = getSignal(CHASSIS::CamObj_C_Mtn_FR2::CRC_CamObj_C_Mtn_Pr2);
	snprintf(buffer, elcount(buffer), "   0.000000 F1 MPC::CamObj_C_Mtn_FR2::CRC_CamObj_C_Mtn_Pr2 = %d\n", intval);
	filePutString (buffer, elcount(buffer), hFile);
	intval = @sysvar::CH_Nodes::CH_MPCSQC_CamObj_C_Mtn_Pr2C_AUTO;
	snprintf(buffer, elcount(buffer), "   0.000000    SV: 2 0 0 ::CH_Nodes::CH_MPCSQC_CamObj_C_Mtn_Pr2C_AUTO = %d\n", intval);
	filePutString (buffer, elcount(buffer), hFile);
	intval = getSignal(CHASSIS::CamObj_C_Mtn_FR2::SQC_CamObj_C_Mtn_Pr2);
	snprintf(buffer, elcount(buffer), "   0.000000 F1 MPC::CamObj_C_Mtn_FR2::SQC_CamObj_C_Mtn_Pr2 = %d\n", intval);
	filePutString (buffer, elcount(buffer), hFile);
	intval = getSignal(CHASSIS::CamObj_C_Mtn_FR2::CamObj_C_Mtn_Stat);
	snprintf(buffer, elcount(buffer), "   0.000000 F1 MPC::CamObj_C_Mtn_FR2::CamObj_C_Mtn_Stat = %d\n", intval);
	filePutString (buffer, elcount(buffer), hFile);
	intval = getSignal(CHASSIS::CamObj_C_Mtn_FR2::CamObj_C_ObjQual_ASIL_Chk);
	snprintf(buffer, elcount(buffer), "   0.000000 F1 MPC::CamObj_C_Mtn_FR2::CamObj_C_ObjQual_ASIL_Chk = %d\n", intval);
	filePutString (buffer, elcount(buffer), hFile);
	intval = getSignal(CHASSIS::CamObj_C_Mtn_FR2::CamObj_C_Track_Stat);
	snprintf(buffer, elcount(buffer), "   0.000000 F1 MPC::CamObj_C_Mtn_FR2::CamObj_C_Track_Stat = %d\n", intval);
	filePutString (buffer, elcount(buffer), hFile);
	intval = getSignal(CHASSIS::CamObj_C_Mtn_FR2::CamObj_C_Mtn_TrackTm);
	snprintf(buffer, elcount(buffer), "   0.000000 F1 MPC::CamObj_C_Mtn_FR2::CamObj_C_Mtn_TrackTm = %d\n", intval);
	filePutString (buffer, elcount(buffer), hFile);
	floatval = getSignal(CHASSIS::CamObj_C_Mtn_FR2::CamObj_C_Mtn_YawRate);
	snprintf(buffer, elcount(buffer), "   0.000000 F1 MPC::CamObj_C_Mtn_FR2::CamObj_C_Mtn_YawRate = %f\n", floatval);
	filePutString (buffer, elcount(buffer), hFile);
	floatval = getSignal(CHASSIS::CamObj_C_Mtn_FR2::CamObj_C_Mtn_LtrlSpd_StdDev);
	snprintf(buffer, elcount(buffer), "   0.000000 F1 MPC::CamObj_C_Mtn_FR2::CamObj_C_Mtn_LtrlSpd_StdDev = %f\n", floatval);
	filePutString (buffer, elcount(buffer), hFile);
	floatval = getSignal(CHASSIS::CamObj_C_Mtn_FR2::CamObj_C_Mtn_LtrlSpd_Lt);
	snprintf(buffer, elcount(buffer), "   0.000000 F1 MPC::CamObj_C_Mtn_FR2::CamObj_C_Mtn_LtrlSpd_Lt = %f\n", floatval);
	filePutString (buffer, elcount(buffer), hFile);
	floatval = getSignal(CHASSIS::CamObj_C_Mtn_FR2::CamObj_C_Mtn_LtrlSpd_Mid);
	snprintf(buffer, elcount(buffer), "   0.000000 F1 MPC::CamObj_C_Mtn_FR2::CamObj_C_Mtn_LtrlSpd_Mid = %f\n", floatval);
	filePutString (buffer, elcount(buffer), hFile);
	floatval = getSignal(CHASSIS::CamObj_C_Mtn_FR2::CamObj_C_Mtn_LtrlSpd_Rt);
	snprintf(buffer, elcount(buffer), "   0.000000 F1 MPC::CamObj_C_Mtn_FR2::CamObj_C_Mtn_LtrlSpd_Rt = %f\n", floatval);
	filePutString (buffer, elcount(buffer), hFile);
	intval = getSignal(CHASSIS::CamObj_C_Mtn_FR2::CamObj_C_Collision_Dtct);
	snprintf(buffer, elcount(buffer), "   0.000000 F1 MPC::CamObj_C_Mtn_FR2::CamObj_C_Collision_Dtct = %d\n", intval);
	filePutString (buffer, elcount(buffer), hFile);
	floatval = getSignal(CHASSIS::CamObj_C_Mtn_FR2::CamObj_C_Mtn_LongSpd_StdDev);
	snprintf(buffer, elcount(buffer), "   0.000000 F1 MPC::CamObj_C_Mtn_FR2::CamObj_C_Mtn_LongSpd_StdDev = %f\n", floatval);
	filePutString (buffer, elcount(buffer), hFile);
	floatval = getSignal(CHASSIS::CamObj_C_Mtn_FR2::CamObj_C_Mtn_LongSpd_Lt);
	snprintf(buffer, elcount(buffer), "   0.000000 F1 MPC::CamObj_C_Mtn_FR2::CamObj_C_Mtn_LongSpd_Lt = %f\n", floatval);
	filePutString (buffer, elcount(buffer), hFile);
	floatval = getSignal(CHASSIS::CamObj_C_Mtn_FR2::CamObj_C_Mtn_LongSpd_Mid);
	snprintf(buffer, elcount(buffer), "   0.000000 F1 MPC::CamObj_C_Mtn_FR2::CamObj_C_Mtn_LongSpd_Mid = %f\n", floatval);
	filePutString (buffer, elcount(buffer), hFile);
	floatval = getSignal(CHASSIS::CamObj_C_Mtn_FR2::CamObj_C_Mtn_LongSpd_Rt);
	snprintf(buffer, elcount(buffer), "   0.000000 F1 MPC::CamObj_C_Mtn_FR2::CamObj_C_Mtn_LongSpd_Rt = %f\n", floatval);
	filePutString (buffer, elcount(buffer), hFile);
	intval = getSignal(CHASSIS::CamObj_C_Mtn_FR2::CamObj_C_BorderFlg_Lt);
	snprintf(buffer, elcount(buffer), "   0.000000 F1 MPC::CamObj_C_Mtn_FR2::CamObj_C_BorderFlg_Lt = %d\n", intval);
	filePutString (buffer, elcount(buffer), hFile);
	intval = getSignal(CHASSIS::CamObj_C_Mtn_FR2::CamObj_C_BorderFlg_Rt);
	snprintf(buffer, elcount(buffer), "   0.000000 F1 MPC::CamObj_C_Mtn_FR2::CamObj_C_BorderFlg_Rt = %d\n", intval);
	filePutString (buffer, elcount(buffer), hFile);
	intval = getSignal(CHASSIS::CamObj_C_Mtn_FR2::CamObj_C_BorderObsrvFlg_Lt);
	snprintf(buffer, elcount(buffer), "   0.000000 F1 MPC::CamObj_C_Mtn_FR2::CamObj_C_BorderObsrvFlg_Lt = %d\n", intval);
	filePutString (buffer, elcount(buffer), hFile);
	intval = getSignal(CHASSIS::CamObj_C_Mtn_FR2::CamObj_C_BorderObsrvFlg_Rt);
	snprintf(buffer, elcount(buffer), "   0.000000 F1 MPC::CamObj_C_Mtn_FR2::CamObj_C_BorderObsrvFlg_Rt = %d\n", intval);
	filePutString (buffer, elcount(buffer), hFile);
	intval = getSignal(CHASSIS::CamObj_C_Mtn_FR2::CamObj_C_Lane_Alloc);
	snprintf(buffer, elcount(buffer), "   0.000000 F1 MPC::CamObj_C_Mtn_FR2::CamObj_C_Lane_Alloc = %d\n", intval);
	filePutString (buffer, elcount(buffer), hFile);
	intval = getSignal(CHASSIS::CamObj_C_Mtn_FR2::CamObj_C_RefSurf_Rng);
	snprintf(buffer, elcount(buffer), "   0.000000 F1 MPC::CamObj_C_Mtn_FR2::CamObj_C_RefSurf_Rng = %d\n", intval);
	filePutString (buffer, elcount(buffer), hFile);
	intval = getSignal(CHASSIS::CamObj_C_Mtn_FR2::CamObj_C_ObjQual_GeneralObj_Track);
	snprintf(buffer, elcount(buffer), "   0.000000 F1 MPC::CamObj_C_Mtn_FR2::CamObj_C_ObjQual_GeneralObj_Track = %d\n", intval);
	filePutString (buffer, elcount(buffer), hFile);
	intval = getSignal(CHASSIS::CamObj_C_Mtn_FR2::CamObj_C_ObjQual_VehObj_Track);
	snprintf(buffer, elcount(buffer), "   0.000000 F1 MPC::CamObj_C_Mtn_FR2::CamObj_C_ObjQual_VehObj_Track = %d\n", intval);
	filePutString (buffer, elcount(buffer), hFile);
	intval = getSignal(CHASSIS::CamObj_C_Mtn_FR2::CamObj_C_ObjQual_FeatApprox);
	snprintf(buffer, elcount(buffer), "   0.000000 F1 MPC::CamObj_C_Mtn_FR2::CamObj_C_ObjQual_FeatApprox = %d\n", intval);
	filePutString (buffer, elcount(buffer), hFile);
	intval = getSignal(CHASSIS::CamObj_C_Mtn_FR2::CamObj_C_ObjQual_FeatDensity);
	snprintf(buffer, elcount(buffer), "   0.000000 F1 MPC::CamObj_C_Mtn_FR2::CamObj_C_ObjQual_FeatDensity = %d\n", intval);
	filePutString (buffer, elcount(buffer), hFile);
	intval = getSignal(CHASSIS::CamObj_C_Mtn_FR2::CamObj_C_ObjQual_ShapeApprox);
	snprintf(buffer, elcount(buffer), "   0.000000 F1 MPC::CamObj_C_Mtn_FR2::CamObj_C_ObjQual_ShapeApprox = %d\n", intval);
	filePutString (buffer, elcount(buffer), hFile);
	intval = getSignal(CHASSIS::CamObj_C_Mtn_FR2::CamObj_C_ObjQual_VehTrack_Qual);
	snprintf(buffer, elcount(buffer), "   0.000000 F1 MPC::CamObj_C_Mtn_FR2::CamObj_C_ObjQual_VehTrack_Qual = %d\n", intval);
	filePutString (buffer, elcount(buffer), hFile);
	intval = getSignal(CHASSIS::CamObj_C_Mtn_FR2::CamObj_C_ObjQual_PedClass_Conf);
	snprintf(buffer, elcount(buffer), "   0.000000 F1 MPC::CamObj_C_Mtn_FR2::CamObj_C_ObjQual_PedClass_Conf = %d\n", intval);
	filePutString (buffer, elcount(buffer), hFile);
	intval = getSignal(CHASSIS::CamObj_C_Mtn_FR2::CamObj_C_ObjQual_VehClass_Conf);
	snprintf(buffer, elcount(buffer), "   0.000000 F1 MPC::CamObj_C_Mtn_FR2::CamObj_C_ObjQual_VehClass_Conf = %d\n", intval);
	filePutString (buffer, elcount(buffer), hFile);
	intval = getSignal(CHASSIS::CamObj_C_Mtn_FR2::CamObj_C_ObjQual_ClassSw);
	snprintf(buffer, elcount(buffer), "   0.000000 F1 MPC::CamObj_C_Mtn_FR2::CamObj_C_ObjQual_ClassSw = %d\n", intval);
	filePutString (buffer, elcount(buffer), hFile);
	intval = getSignal(CHASSIS::CamObj_C_Mtn_FR2::CamObj_C_ObjQual_Stereo_Dtct);
	snprintf(buffer, elcount(buffer), "   0.000000 F1 MPC::CamObj_C_Mtn_FR2::CamObj_C_ObjQual_Stereo_Dtct = %d\n", intval);
	filePutString (buffer, elcount(buffer), hFile);
	intval = @sysvar::CH_Nodes::CH_MPCCRC_CamObj_C_Posn_Pr2_AUTO;
	snprintf(buffer, elcount(buffer), "   0.000000    SV: 2 0 0 ::CH_Nodes::CH_MPCCRC_CamObj_C_Posn_Pr2_AUTO = %d\n", intval);
	filePutString (buffer, elcount(buffer), hFile);
	intval = getSignal(CHASSIS::CamObj_C_Posn_FR2::CRC_CamObj_C_Posn_Pr2);
	snprintf(buffer, elcount(buffer), "   0.000000 F1 MPC::CamObj_C_Posn_FR2::CRC_CamObj_C_Posn_Pr2 = %d\n", intval);
	filePutString (buffer, elcount(buffer), hFile);
	intval = @sysvar::CH_Nodes::CH_MPCSQC_CamObj_C_Posn_Pr2_AUTO;
	snprintf(buffer, elcount(buffer), "   0.000000    SV: 2 0 0 ::CH_Nodes::CH_MPCSQC_CamObj_C_Posn_Pr2_AUTO = %d\n", intval);
	filePutString (buffer, elcount(buffer), hFile);
	intval = getSignal(CHASSIS::CamObj_C_Posn_FR2::SQC_CamObj_C_Posn_Pr2);
	snprintf(buffer, elcount(buffer), "   0.000000 F1 MPC::CamObj_C_Posn_FR2::SQC_CamObj_C_Posn_Pr2 = %d\n", intval);
	filePutString (buffer, elcount(buffer), hFile);
	intval = getSignal(CHASSIS::CamObj_C_Posn_FR2::CamObj_C_Class);
	snprintf(buffer, elcount(buffer), "   0.000000 F1 MPC::CamObj_C_Posn_FR2::CamObj_C_Class = %d\n", intval);
	filePutString (buffer, elcount(buffer), hFile);
	intval = getSignal(CHASSIS::CamObj_C_Posn_FR2::CamObj_C_Posn_Angl_Idx);
	snprintf(buffer, elcount(buffer), "   0.000000 F1 MPC::CamObj_C_Posn_FR2::CamObj_C_Posn_Angl_Idx = %d\n", intval);
	filePutString (buffer, elcount(buffer), hFile);
	floatval = getSignal(CHASSIS::CamObj_C_Posn_FR2::CamObj_C_ObjWidth);
	snprintf(buffer, elcount(buffer), "   0.000000 F1 MPC::CamObj_C_Posn_FR2::CamObj_C_ObjWidth = %f\n", floatval);
	filePutString (buffer, elcount(buffer), hFile);
	intval = getSignal(CHASSIS::CamObj_C_Posn_FR2::CamObj_C_RiskArea_Type);
	snprintf(buffer, elcount(buffer), "   0.000000 F1 MPC::CamObj_C_Posn_FR2::CamObj_C_RiskArea_Type = %d\n", intval);
	filePutString (buffer, elcount(buffer), hFile);
	intval = getSignal(CHASSIS::CamObj_C_Posn_FR2::CamObj_C_Id);
	snprintf(buffer, elcount(buffer), "   0.000000 F1 MPC::CamObj_C_Posn_FR2::CamObj_C_Id = %d\n", intval);
	filePutString (buffer, elcount(buffer), hFile);
	intval = getSignal(CHASSIS::CamObj_C_Posn_FR2::CamObj_C_List_Id);
	snprintf(buffer, elcount(buffer), "   0.000000 F1 MPC::CamObj_C_Posn_FR2::CamObj_C_List_Id = %d\n", intval);
	filePutString (buffer, elcount(buffer), hFile);
	intval = getSignal(CHASSIS::CamObj_C_Posn_FR2::CamObj_C_List_Elem);
	snprintf(buffer, elcount(buffer), "   0.000000 F1 MPC::CamObj_C_Posn_FR2::CamObj_C_List_Elem = %d\n", intval);
	filePutString (buffer, elcount(buffer), hFile);
	floatval = getSignal(CHASSIS::CamObj_C_Posn_FR2::CamObj_C_Posn_X_Lt);
	snprintf(buffer, elcount(buffer), "   0.000000 F1 MPC::CamObj_C_Posn_FR2::CamObj_C_Posn_X_Lt = %f\n", floatval);
	filePutString (buffer, elcount(buffer), hFile);
	floatval = getSignal(CHASSIS::CamObj_C_Posn_FR2::CamObj_C_Posn_X_Mid);
	snprintf(buffer, elcount(buffer), "   0.000000 F1 MPC::CamObj_C_Posn_FR2::CamObj_C_Posn_X_Mid = %f\n", floatval);
	filePutString (buffer, elcount(buffer), hFile);
	floatval = getSignal(CHASSIS::CamObj_C_Posn_FR2::CamObj_C_Posn_X_Rt);
	snprintf(buffer, elcount(buffer), "   0.000000 F1 MPC::CamObj_C_Posn_FR2::CamObj_C_Posn_X_Rt = %f\n", floatval);
	filePutString (buffer, elcount(buffer), hFile);
}
/*@@end*/

/*@@caplFunc:saveVars_85(dword):*/
void saveVars_85(dword hFile)
{
	floatval = getSignal(CHASSIS::CamObj_C_Posn_FR2::CamObj_C_Posn_X_StdDev);
	snprintf(buffer, elcount(buffer), "   0.000000 F1 MPC::CamObj_C_Posn_FR2::CamObj_C_Posn_X_StdDev = %f\n", floatval);
	filePutString (buffer, elcount(buffer), hFile);
	floatval = getSignal(CHASSIS::CamObj_C_Posn_FR2::CamObj_C_Posn_Y_Lt);
	snprintf(buffer, elcount(buffer), "   0.000000 F1 MPC::CamObj_C_Posn_FR2::CamObj_C_Posn_Y_Lt = %f\n", floatval);
	filePutString (buffer, elcount(buffer), hFile);
	floatval = getSignal(CHASSIS::CamObj_C_Posn_FR2::CamObj_C_Posn_Y_Mid);
	snprintf(buffer, elcount(buffer), "   0.000000 F1 MPC::CamObj_C_Posn_FR2::CamObj_C_Posn_Y_Mid = %f\n", floatval);
	filePutString (buffer, elcount(buffer), hFile);
	floatval = getSignal(CHASSIS::CamObj_C_Posn_FR2::CamObj_C_Posn_Y_Rt);
	snprintf(buffer, elcount(buffer), "   0.000000 F1 MPC::CamObj_C_Posn_FR2::CamObj_C_Posn_Y_Rt = %f\n", floatval);
	filePutString (buffer, elcount(buffer), hFile);
	floatval = getSignal(CHASSIS::CamObj_C_Posn_FR2::CamObj_C_Posn_Y_StdDev);
	snprintf(buffer, elcount(buffer), "   0.000000 F1 MPC::CamObj_C_Posn_FR2::CamObj_C_Posn_Y_StdDev = %f\n", floatval);
	filePutString (buffer, elcount(buffer), hFile);
	floatval = getSignal(CHASSIS::CamObj_C_Posn_FR2::CamObj_C_Posn_Hght_LowBound);
	snprintf(buffer, elcount(buffer), "   0.000000 F1 MPC::CamObj_C_Posn_FR2::CamObj_C_Posn_Hght_LowBound = %f\n", floatval);
	filePutString (buffer, elcount(buffer), hFile);
	floatval = getSignal(CHASSIS::CamObj_C_Posn_FR2::CamObj_C_Posn_Hght_UpBound);
	snprintf(buffer, elcount(buffer), "   0.000000 F1 MPC::CamObj_C_Posn_FR2::CamObj_C_Posn_Hght_UpBound = %f\n", floatval);
	filePutString (buffer, elcount(buffer), hFile);
	intval = @sysvar::CH_Nodes::CH_MPCCRC_IHC_Lgt_Stat_MPC__AUTO;
	snprintf(buffer, elcount(buffer), "   0.000000    SV: 2 0 0 ::CH_Nodes::CH_MPCCRC_IHC_Lgt_Stat_MPC__AUTO = %d\n", intval);
	filePutString (buffer, elcount(buffer), hFile);
	intval = getSignal(CHASSIS::IHC_Lgt_Stat_MPC_Gw_AR2::CRC_IHC_Lgt_Stat_MPC_Pr2);
	snprintf(buffer, elcount(buffer), "   0.000000 F1 MPC::IHC_Lgt_Stat_MPC_Gw_AR2::CRC_IHC_Lgt_Stat_MPC_Pr2 = %d\n", intval);
	filePutString (buffer, elcount(buffer), hFile);
	intval = @sysvar::CH_Nodes::CH_MPCSQC_IHC_Lgt_Stat_MPC__AUTO;
	snprintf(buffer, elcount(buffer), "   0.000000    SV: 2 0 0 ::CH_Nodes::CH_MPCSQC_IHC_Lgt_Stat_MPC__AUTO = %d\n", intval);
	filePutString (buffer, elcount(buffer), hFile);
	intval = getSignal(CHASSIS::IHC_Lgt_Stat_MPC_Gw_AR2::SQC_IHC_Lgt_Stat_MPC_Pr2);
	snprintf(buffer, elcount(buffer), "   0.000000 F1 MPC::IHC_Lgt_Stat_MPC_Gw_AR2::SQC_IHC_Lgt_Stat_MPC_Pr2 = %d\n", intval);
	filePutString (buffer, elcount(buffer), hFile);
	intval = getSignal(CHASSIS::IHC_Lgt_Stat_MPC_Gw_AR2::IHC_ChgovrLvl_V2);
	snprintf(buffer, elcount(buffer), "   0.000000 F1 MPC::IHC_Lgt_Stat_MPC_Gw_AR2::IHC_ChgovrLvl_V2 = %d\n", intval);
	filePutString (buffer, elcount(buffer), hFile);
	intval = getSignal(CHASSIS::IHC_Lgt_Stat_MPC_Gw_AR2::IHC_Plus_HL_Lt_LgtOut_V2);
	snprintf(buffer, elcount(buffer), "   0.000000 F1 MPC::IHC_Lgt_Stat_MPC_Gw_AR2::IHC_Plus_HL_Lt_LgtOut_V2 = %d\n", intval);
	filePutString (buffer, elcount(buffer), hFile);
	intval = getSignal(CHASSIS::IHC_Lgt_Stat_MPC_Gw_AR2::IHC_Brt_Outsd);
	snprintf(buffer, elcount(buffer), "   0.000000 F1 MPC::IHC_Lgt_Stat_MPC_Gw_AR2::IHC_Brt_Outsd = %d\n", intval);
	filePutString (buffer, elcount(buffer), hFile);
	floatval = getSignal(CHASSIS::IHC_Lgt_Stat_MPC_Gw_AR2::IHC_LgtDist_Rq);
	snprintf(buffer, elcount(buffer), "   0.000000 F1 MPC::IHC_Lgt_Stat_MPC_Gw_AR2::IHC_LgtDist_Rq = %f\n", floatval);
	filePutString (buffer, elcount(buffer), hFile);
	floatval = getSignal(CHASSIS::IHC_Lgt_Stat_MPC_Gw_AR2::IHC_ObjAngl);
	snprintf(buffer, elcount(buffer), "   0.000000 F1 MPC::IHC_Lgt_Stat_MPC_Gw_AR2::IHC_ObjAngl = %f\n", floatval);
	filePutString (buffer, elcount(buffer), hFile);
	intval = getSignal(CHASSIS::IHC_Lgt_Stat_MPC_Gw_AR2::IHC_WShHt_Rq_Stat);
	snprintf(buffer, elcount(buffer), "   0.000000 F1 MPC::IHC_Lgt_Stat_MPC_Gw_AR2::IHC_WShHt_Rq_Stat = %d\n", intval);
	filePutString (buffer, elcount(buffer), hFile);
	intval = getSignal(CHASSIS::IHC_Lgt_Stat_MPC_Gw_AR2::IHC_TrffcStyle);
	snprintf(buffer, elcount(buffer), "   0.000000 F1 MPC::IHC_Lgt_Stat_MPC_Gw_AR2::IHC_TrffcStyle = %d\n", intval);
	filePutString (buffer, elcount(buffer), hFile);
	intval = getSignal(CHASSIS::IHC_Lgt_Stat_MPC_Gw_AR2::IHC_Tunnel);
	snprintf(buffer, elcount(buffer), "   0.000000 F1 MPC::IHC_Lgt_Stat_MPC_Gw_AR2::IHC_Tunnel = %d\n", intval);
	filePutString (buffer, elcount(buffer), hFile);
	intval = getSignal(CHASSIS::IHC_Lgt_Stat_MPC_Gw_AR2::IHC_Stat_MPC);
	snprintf(buffer, elcount(buffer), "   0.000000 F1 MPC::IHC_Lgt_Stat_MPC_Gw_AR2::IHC_Stat_MPC = %d\n", intval);
	filePutString (buffer, elcount(buffer), hFile);
	intval = getSignal(CHASSIS::IHC_Lgt_Stat_MPC_Gw_AR2::IHC_City_Dtct);
	snprintf(buffer, elcount(buffer), "   0.000000 F1 MPC::IHC_Lgt_Stat_MPC_Gw_AR2::IHC_City_Dtct = %d\n", intval);
	filePutString (buffer, elcount(buffer), hFile);
	intval = getSignal(CHASSIS::IHC_Lgt_Stat_MPC_Gw_AR2::IHC_HiBm_Stat);
	snprintf(buffer, elcount(buffer), "   0.000000 F1 MPC::IHC_Lgt_Stat_MPC_Gw_AR2::IHC_HiBm_Stat = %d\n", intval);
	filePutString (buffer, elcount(buffer), hFile);
	intval = getSignal(CHASSIS::IHC_Lgt_Stat_MPC_Gw_AR2::IHC_OptHdLgtLvl_Stat);
	snprintf(buffer, elcount(buffer), "   0.000000 F1 MPC::IHC_Lgt_Stat_MPC_Gw_AR2::IHC_OptHdLgtLvl_Stat = %d\n", intval);
	filePutString (buffer, elcount(buffer), hFile);
	intval = getSignal(CHASSIS::IHC_Lgt_Stat_MPC_Gw_AR2::IHC_Wthr_Dtct);
	snprintf(buffer, elcount(buffer), "   0.000000 F1 MPC::IHC_Lgt_Stat_MPC_Gw_AR2::IHC_Wthr_Dtct = %d\n", intval);
	filePutString (buffer, elcount(buffer), hFile);
	intval = getSignal(CHASSIS::IHC_Lgt_Stat_MPC_Gw_AR2::IHC_DrvDir);
	snprintf(buffer, elcount(buffer), "   0.000000 F1 MPC::IHC_Lgt_Stat_MPC_Gw_AR2::IHC_DrvDir = %d\n", intval);
	filePutString (buffer, elcount(buffer), hFile);
	intval = getSignal(CHASSIS::IHC_Lgt_Stat_MPC_Gw_AR2::IHC_MotorWay_Dtct);
	snprintf(buffer, elcount(buffer), "   0.000000 F1 MPC::IHC_Lgt_Stat_MPC_Gw_AR2::IHC_MotorWay_Dtct = %d\n", intval);
	filePutString (buffer, elcount(buffer), hFile);
	intval = getSignal(CHASSIS::IHC_Lgt_Stat_MPC_Gw_AR2::IHC_Block_Disp_Rq);
	snprintf(buffer, elcount(buffer), "   0.000000 F1 MPC::IHC_Lgt_Stat_MPC_Gw_AR2::IHC_Block_Disp_Rq = %d\n", intval);
	filePutString (buffer, elcount(buffer), hFile);
	intval = getSignal(CHASSIS::IHC_Lgt_Stat_MPC_Gw_AR2::IHC_Plus_HL_Rt_LgtOut_V2);
	snprintf(buffer, elcount(buffer), "   0.000000 F1 MPC::IHC_Lgt_Stat_MPC_Gw_AR2::IHC_Plus_HL_Rt_LgtOut_V2 = %d\n", intval);
	filePutString (buffer, elcount(buffer), hFile);
	intval = @sysvar::CH_Nodes::CH_MPCCRC_IHC_Plus_HL_Stat__AUTO;
	snprintf(buffer, elcount(buffer), "   0.000000    SV: 2 0 0 ::CH_Nodes::CH_MPCCRC_IHC_Plus_HL_Stat__AUTO = %d\n", intval);
	filePutString (buffer, elcount(buffer), hFile);
	intval = getSignal(CHASSIS::IHC_Plus_HL_Stat_AR2::CRC_IHC_Plus_HL_Stat_Pr2);
	snprintf(buffer, elcount(buffer), "   0.000000 F1 MPC::IHC_Plus_HL_Stat_AR2::CRC_IHC_Plus_HL_Stat_Pr2 = %d\n", intval);
	filePutString (buffer, elcount(buffer), hFile);
	intval = @sysvar::CH_Nodes::CH_MPCSQC_IHC_Plus_HL_Stat__AUTO;
	snprintf(buffer, elcount(buffer), "   0.000000    SV: 2 0 0 ::CH_Nodes::CH_MPCSQC_IHC_Plus_HL_Stat__AUTO = %d\n", intval);
	filePutString (buffer, elcount(buffer), hFile);
	intval = getSignal(CHASSIS::IHC_Plus_HL_Stat_AR2::SQC_IHC_Plus_HL_Stat_Pr2);
	snprintf(buffer, elcount(buffer), "   0.000000 F1 MPC::IHC_Plus_HL_Stat_AR2::SQC_IHC_Plus_HL_Stat_Pr2 = %d\n", intval);
	filePutString (buffer, elcount(buffer), hFile);
	intval = getSignal(CHASSIS::IHC_Plus_HL_Stat_AR2::Rsrv4_IHC_Plus_HL_Stat_Pr2);
	snprintf(buffer, elcount(buffer), "   0.000000 F1 MPC::IHC_Plus_HL_Stat_AR2::Rsrv4_IHC_Plus_HL_Stat_Pr2 = %d\n", intval);
	filePutString (buffer, elcount(buffer), hFile);
	floatval = getSignal(CHASSIS::IHC_Plus_HL_Stat_AR2::IHC_Plus_HL_Lt_Angl_Min);
	snprintf(buffer, elcount(buffer), "   0.000000 F1 MPC::IHC_Plus_HL_Stat_AR2::IHC_Plus_HL_Lt_Angl_Min = %f\n", floatval);
	filePutString (buffer, elcount(buffer), hFile);
	intval = getSignal(CHASSIS::IHC_Plus_HL_Stat_AR2::IHC_Plus_HL_Lt_LgtOut);
	snprintf(buffer, elcount(buffer), "   0.000000 F1 MPC::IHC_Plus_HL_Stat_AR2::IHC_Plus_HL_Lt_LgtOut = %d\n", intval);
	filePutString (buffer, elcount(buffer), hFile);
	intval = getSignal(CHASSIS::IHC_Plus_HL_Stat_AR2::IHC_Plus_HiBm_Lt_Stat_V2);
	snprintf(buffer, elcount(buffer), "   0.000000 F1 MPC::IHC_Plus_HL_Stat_AR2::IHC_Plus_HiBm_Lt_Stat_V2 = %d\n", intval);
	filePutString (buffer, elcount(buffer), hFile);
	floatval = getSignal(CHASSIS::IHC_Plus_HL_Stat_AR2::IHC_Plus_HL_Rt_Angl_Min);
	snprintf(buffer, elcount(buffer), "   0.000000 F1 MPC::IHC_Plus_HL_Stat_AR2::IHC_Plus_HL_Rt_Angl_Min = %f\n", floatval);
	filePutString (buffer, elcount(buffer), hFile);
	intval = getSignal(CHASSIS::IHC_Plus_HL_Stat_AR2::IHC_Plus_HL_Rt_LgtOut);
	snprintf(buffer, elcount(buffer), "   0.000000 F1 MPC::IHC_Plus_HL_Stat_AR2::IHC_Plus_HL_Rt_LgtOut = %d\n", intval);
	filePutString (buffer, elcount(buffer), hFile);
	intval = getSignal(CHASSIS::IHC_Plus_HL_Stat_AR2::IHC_Plus_HiBm_Rt_Stat_V2);
	snprintf(buffer, elcount(buffer), "   0.000000 F1 MPC::IHC_Plus_HL_Stat_AR2::IHC_Plus_HiBm_Rt_Stat_V2 = %d\n", intval);
	filePutString (buffer, elcount(buffer), hFile);
	intval = getSignal(CHASSIS::IHC_Plus_HL_Stat_AR2::IHC_Plus_HL_Lt_ChgovrLvl);
	snprintf(buffer, elcount(buffer), "   0.000000 F1 MPC::IHC_Plus_HL_Stat_AR2::IHC_Plus_HL_Lt_ChgovrLvl = %d\n", intval);
	filePutString (buffer, elcount(buffer), hFile);
	intval = getSignal(CHASSIS::IHC_Plus_HL_Stat_AR2::Rsrv2_IHC_Plus_HL_Stat_Pr2);
	snprintf(buffer, elcount(buffer), "   0.000000 F1 MPC::IHC_Plus_HL_Stat_AR2::Rsrv2_IHC_Plus_HL_Stat_Pr2 = %d\n", intval);
	filePutString (buffer, elcount(buffer), hFile);
	intval = getSignal(CHASSIS::IHC_Plus_HL_Stat_AR2::IHC_Plus_HL_Rt_ChgovrLvl);
	snprintf(buffer, elcount(buffer), "   0.000000 F1 MPC::IHC_Plus_HL_Stat_AR2::IHC_Plus_HL_Rt_ChgovrLvl = %d\n", intval);
	filePutString (buffer, elcount(buffer), hFile);
	intval = getSignal(CHASSIS::IHC_Plus_HL_Stat_AR2::Rsrv3_IHC_Plus_HL_Stat_Pr2);
	snprintf(buffer, elcount(buffer), "   0.000000 F1 MPC::IHC_Plus_HL_Stat_AR2::Rsrv3_IHC_Plus_HL_Stat_Pr2 = %d\n", intval);
	filePutString (buffer, elcount(buffer), hFile);
	floatval = getSignal(CHASSIS::IHC_Plus_HL_Stat_AR2::IHC_Plus_VertAngl_Max);
	snprintf(buffer, elcount(buffer), "   0.000000 F1 MPC::IHC_Plus_HL_Stat_AR2::IHC_Plus_VertAngl_Max = %f\n", floatval);
	filePutString (buffer, elcount(buffer), hFile);
	intval = getSignal(CHASSIS::IHC_Plus_HL_Stat_AR2::Rsrv5_IHC_Plus_HL_Stat_Pr2);
	snprintf(buffer, elcount(buffer), "   0.000000 F1 MPC::IHC_Plus_HL_Stat_AR2::Rsrv5_IHC_Plus_HL_Stat_Pr2 = %d\n", intval);
	filePutString (buffer, elcount(buffer), hFile);
	intval = @sysvar::CH_Nodes::CH_MPCCRC_IHC_Plus_Tunnel_3_AUTO;
	snprintf(buffer, elcount(buffer), "   0.000000    SV: 2 0 0 ::CH_Nodes::CH_MPCCRC_IHC_Plus_Tunnel_3_AUTO = %d\n", intval);
	filePutString (buffer, elcount(buffer), hFile);
	intval = getSignal(CHASSIS::IHC_Plus_Tunnel_3_4_AR2::CRC_IHC_Plus_Tunnel_3_4_Pr2);
	snprintf(buffer, elcount(buffer), "   0.000000 F1 MPC::IHC_Plus_Tunnel_3_4_AR2::CRC_IHC_Plus_Tunnel_3_4_Pr2 = %d\n", intval);
	filePutString (buffer, elcount(buffer), hFile);
	intval = @sysvar::CH_Nodes::CH_MPCSQC_IHC_Plus_Tunnel_3_AUTO;
	snprintf(buffer, elcount(buffer), "   0.000000    SV: 2 0 0 ::CH_Nodes::CH_MPCSQC_IHC_Plus_Tunnel_3_AUTO = %d\n", intval);
	filePutString (buffer, elcount(buffer), hFile);
	intval = getSignal(CHASSIS::IHC_Plus_Tunnel_3_4_AR2::SQC_IHC_Plus_Tunnel_3_4_Pr2);
	snprintf(buffer, elcount(buffer), "   0.000000 F1 MPC::IHC_Plus_Tunnel_3_4_AR2::SQC_IHC_Plus_Tunnel_3_4_Pr2 = %d\n", intval);
	filePutString (buffer, elcount(buffer), hFile);
	intval = getSignal(CHASSIS::IHC_Plus_Tunnel_3_4_AR2::IHC_Tunnel3_Stat);
	snprintf(buffer, elcount(buffer), "   0.000000 F1 MPC::IHC_Plus_Tunnel_3_4_AR2::IHC_Tunnel3_Stat = %d\n", intval);
	filePutString (buffer, elcount(buffer), hFile);
	intval = getSignal(CHASSIS::IHC_Plus_Tunnel_3_4_AR2::IHC_Tunnel4_Stat);
	snprintf(buffer, elcount(buffer), "   0.000000 F1 MPC::IHC_Plus_Tunnel_3_4_AR2::IHC_Tunnel4_Stat = %d\n", intval);
	filePutString (buffer, elcount(buffer), hFile);
	floatval = getSignal(CHASSIS::IHC_Plus_Tunnel_3_4_AR2::IHC_Tunnel3_AnglLmt_Lt);
	snprintf(buffer, elcount(buffer), "   0.000000 F1 MPC::IHC_Plus_Tunnel_3_4_AR2::IHC_Tunnel3_AnglLmt_Lt = %f\n", floatval);
	filePutString (buffer, elcount(buffer), hFile);
	intval = getSignal(CHASSIS::IHC_Plus_Tunnel_3_4_AR2::IHC_Tunnel3_AnglLmt_Vert);
	snprintf(buffer, elcount(buffer), "   0.000000 F1 MPC::IHC_Plus_Tunnel_3_4_AR2::IHC_Tunnel3_AnglLmt_Vert = %d\n", intval);
	filePutString (buffer, elcount(buffer), hFile);
	intval = getSignal(CHASSIS::IHC_Plus_Tunnel_3_4_AR2::IHC_Tunnel3_ChgovrSpd);
	snprintf(buffer, elcount(buffer), "   0.000000 F1 MPC::IHC_Plus_Tunnel_3_4_AR2::IHC_Tunnel3_ChgovrSpd = %d\n", intval);
	filePutString (buffer, elcount(buffer), hFile);
	floatval = getSignal(CHASSIS::IHC_Plus_Tunnel_3_4_AR2::IHC_Tunnel3_AnglLmt_Rt);
	snprintf(buffer, elcount(buffer), "   0.000000 F1 MPC::IHC_Plus_Tunnel_3_4_AR2::IHC_Tunnel3_AnglLmt_Rt = %f\n", floatval);
	filePutString (buffer, elcount(buffer), hFile);
	floatval = getSignal(CHASSIS::IHC_Plus_Tunnel_3_4_AR2::IHC_Tunnel4_AnglLmt_Lt);
	snprintf(buffer, elcount(buffer), "   0.000000 F1 MPC::IHC_Plus_Tunnel_3_4_AR2::IHC_Tunnel4_AnglLmt_Lt = %f\n", floatval);
	filePutString (buffer, elcount(buffer), hFile);
	intval = getSignal(CHASSIS::IHC_Plus_Tunnel_3_4_AR2::IHC_Tunnel4_AnglLmt_Vert);
	snprintf(buffer, elcount(buffer), "   0.000000 F1 MPC::IHC_Plus_Tunnel_3_4_AR2::IHC_Tunnel4_AnglLmt_Vert = %d\n", intval);
	filePutString (buffer, elcount(buffer), hFile);
}
/*@@end*/

/*@@caplFunc:saveVars_86(dword):*/
void saveVars_86(dword hFile)
{
	intval = getSignal(CHASSIS::IHC_Plus_Tunnel_3_4_AR2::IHC_Tunnel4_ChgovrSpd);
	snprintf(buffer, elcount(buffer), "   0.000000 F1 MPC::IHC_Plus_Tunnel_3_4_AR2::IHC_Tunnel4_ChgovrSpd = %d\n", intval);
	filePutString (buffer, elcount(buffer), hFile);
	floatval = getSignal(CHASSIS::IHC_Plus_Tunnel_3_4_AR2::IHC_Tunnel4_AnglLmt_Rt);
	snprintf(buffer, elcount(buffer), "   0.000000 F1 MPC::IHC_Plus_Tunnel_3_4_AR2::IHC_Tunnel4_AnglLmt_Rt = %f\n", floatval);
	filePutString (buffer, elcount(buffer), hFile);
	intval = @sysvar::CH_Nodes::CH_MPCCRC_IHC_Plus_Tunnel_P_AUTO;
	snprintf(buffer, elcount(buffer), "   0.000000    SV: 2 0 0 ::CH_Nodes::CH_MPCCRC_IHC_Plus_Tunnel_P_AUTO = %d\n", intval);
	filePutString (buffer, elcount(buffer), hFile);
	intval = getSignal(CHASSIS::IHC_Plus_Tunnel_AR2::CRC_IHC_Plus_Tunnel_Pr2);
	snprintf(buffer, elcount(buffer), "   0.000000 F1 MPC::IHC_Plus_Tunnel_AR2::CRC_IHC_Plus_Tunnel_Pr2 = %d\n", intval);
	filePutString (buffer, elcount(buffer), hFile);
	intval = @sysvar::CH_Nodes::CH_MPCSQC_IHC_Plus_Tunnel_P_AUTO;
	snprintf(buffer, elcount(buffer), "   0.000000    SV: 2 0 0 ::CH_Nodes::CH_MPCSQC_IHC_Plus_Tunnel_P_AUTO = %d\n", intval);
	filePutString (buffer, elcount(buffer), hFile);
	intval = getSignal(CHASSIS::IHC_Plus_Tunnel_AR2::SQC_IHC_Plus_Tunnel_Pr2);
	snprintf(buffer, elcount(buffer), "   0.000000 F1 MPC::IHC_Plus_Tunnel_AR2::SQC_IHC_Plus_Tunnel_Pr2 = %d\n", intval);
	filePutString (buffer, elcount(buffer), hFile);
	intval = getSignal(CHASSIS::IHC_Plus_Tunnel_AR2::IHC_Tunnel1_Stat);
	snprintf(buffer, elcount(buffer), "   0.000000 F1 MPC::IHC_Plus_Tunnel_AR2::IHC_Tunnel1_Stat = %d\n", intval);
	filePutString (buffer, elcount(buffer), hFile);
	intval = getSignal(CHASSIS::IHC_Plus_Tunnel_AR2::IHC_Tunnel2_Stat);
	snprintf(buffer, elcount(buffer), "   0.000000 F1 MPC::IHC_Plus_Tunnel_AR2::IHC_Tunnel2_Stat = %d\n", intval);
	filePutString (buffer, elcount(buffer), hFile);
	floatval = getSignal(CHASSIS::IHC_Plus_Tunnel_AR2::IHC_Tunnel1_AnglLmt_Lt);
	snprintf(buffer, elcount(buffer), "   0.000000 F1 MPC::IHC_Plus_Tunnel_AR2::IHC_Tunnel1_AnglLmt_Lt = %f\n", floatval);
	filePutString (buffer, elcount(buffer), hFile);
	intval = getSignal(CHASSIS::IHC_Plus_Tunnel_AR2::IHC_Tunnel1_AnglLmt_Vert);
	snprintf(buffer, elcount(buffer), "   0.000000 F1 MPC::IHC_Plus_Tunnel_AR2::IHC_Tunnel1_AnglLmt_Vert = %d\n", intval);
	filePutString (buffer, elcount(buffer), hFile);
	intval = getSignal(CHASSIS::IHC_Plus_Tunnel_AR2::IHC_Tunnel1_ChgovrSpd);
	snprintf(buffer, elcount(buffer), "   0.000000 F1 MPC::IHC_Plus_Tunnel_AR2::IHC_Tunnel1_ChgovrSpd = %d\n", intval);
	filePutString (buffer, elcount(buffer), hFile);
	floatval = getSignal(CHASSIS::IHC_Plus_Tunnel_AR2::IHC_Tunnel1_AnglLmt_Rt);
	snprintf(buffer, elcount(buffer), "   0.000000 F1 MPC::IHC_Plus_Tunnel_AR2::IHC_Tunnel1_AnglLmt_Rt = %f\n", floatval);
	filePutString (buffer, elcount(buffer), hFile);
	floatval = getSignal(CHASSIS::IHC_Plus_Tunnel_AR2::IHC_Tunnel2_AnglLmt_Lt);
	snprintf(buffer, elcount(buffer), "   0.000000 F1 MPC::IHC_Plus_Tunnel_AR2::IHC_Tunnel2_AnglLmt_Lt = %f\n", floatval);
	filePutString (buffer, elcount(buffer), hFile);
	intval = getSignal(CHASSIS::IHC_Plus_Tunnel_AR2::IHC_Tunnel2_AnglLmt_Vert);
	snprintf(buffer, elcount(buffer), "   0.000000 F1 MPC::IHC_Plus_Tunnel_AR2::IHC_Tunnel2_AnglLmt_Vert = %d\n", intval);
	filePutString (buffer, elcount(buffer), hFile);
	intval = getSignal(CHASSIS::IHC_Plus_Tunnel_AR2::IHC_Tunnel2_ChgovrSpd);
	snprintf(buffer, elcount(buffer), "   0.000000 F1 MPC::IHC_Plus_Tunnel_AR2::IHC_Tunnel2_ChgovrSpd = %d\n", intval);
	filePutString (buffer, elcount(buffer), hFile);
	floatval = getSignal(CHASSIS::IHC_Plus_Tunnel_AR2::IHC_Tunnel2_AnglLmt_Rt);
	snprintf(buffer, elcount(buffer), "   0.000000 F1 MPC::IHC_Plus_Tunnel_AR2::IHC_Tunnel2_AnglLmt_Rt = %f\n", floatval);
	filePutString (buffer, elcount(buffer), hFile);
	intval = @sysvar::CH_Nodes::CH_MPCCRC_Preview_Header1_P_AUTO;
	snprintf(buffer, elcount(buffer), "   0.000000    SV: 2 0 0 ::CH_Nodes::CH_MPCCRC_Preview_Header1_P_AUTO = %d\n", intval);
	filePutString (buffer, elcount(buffer), hFile);
	intval = getSignal(CHASSIS::Preview_Header1_FR2::CRC_Preview_Header1_Pr2);
	snprintf(buffer, elcount(buffer), "   0.000000 F1 MPC::Preview_Header1_FR2::CRC_Preview_Header1_Pr2 = %d\n", intval);
	filePutString (buffer, elcount(buffer), hFile);
	intval = @sysvar::CH_Nodes::CH_MPCSQC_Preview_Header1_P_AUTO;
	snprintf(buffer, elcount(buffer), "   0.000000    SV: 2 0 0 ::CH_Nodes::CH_MPCSQC_Preview_Header1_P_AUTO = %d\n", intval);
	filePutString (buffer, elcount(buffer), hFile);
	intval = getSignal(CHASSIS::Preview_Header1_FR2::SQC_Preview_Header1_Pr2);
	snprintf(buffer, elcount(buffer), "   0.000000 F1 MPC::Preview_Header1_FR2::SQC_Preview_Header1_Pr2 = %d\n", intval);
	filePutString (buffer, elcount(buffer), hFile);
	intval = getSignal(CHASSIS::Preview_Header1_FR2::Preview_Trk_Stat);
	snprintf(buffer, elcount(buffer), "   0.000000 F1 MPC::Preview_Header1_FR2::Preview_Trk_Stat = %d\n", intval);
	filePutString (buffer, elcount(buffer), hFile);
	intval = getSignal(CHASSIS::Preview_Header1_FR2::Rsrv1_Preview_Header1_Pr2);
	snprintf(buffer, elcount(buffer), "   0.000000 F1 MPC::Preview_Header1_FR2::Rsrv1_Preview_Header1_Pr2 = %d\n", intval);
	filePutString (buffer, elcount(buffer), hFile);
	intval = getSignal(CHASSIS::Preview_Header1_FR2::Preview_HeaderCnt_Header1);
	snprintf(buffer, elcount(buffer), "   0.000000 F1 MPC::Preview_Header1_FR2::Preview_HeaderCnt_Header1 = %d\n", intval);
	filePutString (buffer, elcount(buffer), hFile);
	intval = getSignal(CHASSIS::Preview_Header1_FR2::Preview_Prof_TmStmp);
	snprintf(buffer, elcount(buffer), "   0.000000 F1 MPC::Preview_Header1_FR2::Preview_Prof_TmStmp = %d\n", intval);
	filePutString (buffer, elcount(buffer), hFile);
	floatval = getSignal(CHASSIS::Preview_Header1_FR2::Preview_LtTrk_P0_Dist);
	snprintf(buffer, elcount(buffer), "   0.000000 F1 MPC::Preview_Header1_FR2::Preview_LtTrk_P0_Dist = %f\n", floatval);
	filePutString (buffer, elcount(buffer), hFile);
	floatval = getSignal(CHASSIS::Preview_Header1_FR2::Preview_LtTrk_P0_Hgt);
	snprintf(buffer, elcount(buffer), "   0.000000 F1 MPC::Preview_Header1_FR2::Preview_LtTrk_P0_Hgt = %f\n", floatval);
	filePutString (buffer, elcount(buffer), hFile);
	floatval = getSignal(CHASSIS::Preview_Header1_FR2::Preview_RtTrk_P0_Dist);
	snprintf(buffer, elcount(buffer), "   0.000000 F1 MPC::Preview_Header1_FR2::Preview_RtTrk_P0_Dist = %f\n", floatval);
	filePutString (buffer, elcount(buffer), hFile);
	floatval = getSignal(CHASSIS::Preview_Header1_FR2::Preview_RtTrk_P0_Hgt);
	snprintf(buffer, elcount(buffer), "   0.000000 F1 MPC::Preview_Header1_FR2::Preview_RtTrk_P0_Hgt = %f\n", floatval);
	filePutString (buffer, elcount(buffer), hFile);
	floatval = getSignal(CHASSIS::Preview_Header1_FR2::Preview_LtTrk_P0_Qual);
	snprintf(buffer, elcount(buffer), "   0.000000 F1 MPC::Preview_Header1_FR2::Preview_LtTrk_P0_Qual = %f\n", floatval);
	filePutString (buffer, elcount(buffer), hFile);
	floatval = getSignal(CHASSIS::Preview_Header1_FR2::Preview_RtTrk_P0_Qual);
	snprintf(buffer, elcount(buffer), "   0.000000 F1 MPC::Preview_Header1_FR2::Preview_RtTrk_P0_Qual = %f\n", floatval);
	filePutString (buffer, elcount(buffer), hFile);
	intval = getSignal(CHASSIS::Preview_Header1_FR2::Rsrv2_Preview_Header1_Pr2);
	snprintf(buffer, elcount(buffer), "   0.000000 F1 MPC::Preview_Header1_FR2::Rsrv2_Preview_Header1_Pr2 = %d\n", intval);
	filePutString (buffer, elcount(buffer), hFile);
	intval = getSignal(CHASSIS::Preview_Header1_FR2::Rsrv3_Preview_Header1_Pr2);
	snprintf(buffer, elcount(buffer), "   0.000000 F1 MPC::Preview_Header1_FR2::Rsrv3_Preview_Header1_Pr2 = %d\n", intval);
	filePutString (buffer, elcount(buffer), hFile);
	intval = @sysvar::CH_Nodes::CH_MPCCRC_Preview_Header2_P_AUTO;
	snprintf(buffer, elcount(buffer), "   0.000000    SV: 2 0 0 ::CH_Nodes::CH_MPCCRC_Preview_Header2_P_AUTO = %d\n", intval);
	filePutString (buffer, elcount(buffer), hFile);
	intval = getSignal(CHASSIS::Preview_Header2_FR2::CRC_Preview_Header2_Pr2);
	snprintf(buffer, elcount(buffer), "   0.000000 F1 MPC::Preview_Header2_FR2::CRC_Preview_Header2_Pr2 = %d\n", intval);
	filePutString (buffer, elcount(buffer), hFile);
	intval = @sysvar::CH_Nodes::CH_MPCSQC_Preview_Header2_P_AUTO;
	snprintf(buffer, elcount(buffer), "   0.000000    SV: 2 0 0 ::CH_Nodes::CH_MPCSQC_Preview_Header2_P_AUTO = %d\n", intval);
	filePutString (buffer, elcount(buffer), hFile);
	intval = getSignal(CHASSIS::Preview_Header2_FR2::SQC_Preview_Header2_Pr2);
	snprintf(buffer, elcount(buffer), "   0.000000 F1 MPC::Preview_Header2_FR2::SQC_Preview_Header2_Pr2 = %d\n", intval);
	filePutString (buffer, elcount(buffer), hFile);
	intval = getSignal(CHASSIS::Preview_Header2_FR2::Rsrv1_Preview_Header2_Pr2);
	snprintf(buffer, elcount(buffer), "   0.000000 F1 MPC::Preview_Header2_FR2::Rsrv1_Preview_Header2_Pr2 = %d\n", intval);
	filePutString (buffer, elcount(buffer), hFile);
	intval = getSignal(CHASSIS::Preview_Header2_FR2::Rsrv2_Preview_Header2_Pr2);
	snprintf(buffer, elcount(buffer), "   0.000000 F1 MPC::Preview_Header2_FR2::Rsrv2_Preview_Header2_Pr2 = %d\n", intval);
	filePutString (buffer, elcount(buffer), hFile);
	intval = getSignal(CHASSIS::Preview_Header2_FR2::Preview_HeaderCnt_Header2);
	snprintf(buffer, elcount(buffer), "   0.000000 F1 MPC::Preview_Header2_FR2::Preview_HeaderCnt_Header2 = %d\n", intval);
	filePutString (buffer, elcount(buffer), hFile);
	floatval = getSignal(CHASSIS::Preview_Header2_FR2::Preview_ShiftDelta_X);
	snprintf(buffer, elcount(buffer), "   0.000000 F1 MPC::Preview_Header2_FR2::Preview_ShiftDelta_X = %f\n", floatval);
	filePutString (buffer, elcount(buffer), hFile);
	floatval = getSignal(CHASSIS::Preview_Header2_FR2::Preview_ShiftDelta_Y);
	snprintf(buffer, elcount(buffer), "   0.000000 F1 MPC::Preview_Header2_FR2::Preview_ShiftDelta_Y = %f\n", floatval);
	filePutString (buffer, elcount(buffer), hFile);
	floatval = getSignal(CHASSIS::Preview_Header2_FR2::Preview_ShiftDelta_Z);
	snprintf(buffer, elcount(buffer), "   0.000000 F1 MPC::Preview_Header2_FR2::Preview_ShiftDelta_Z = %f\n", floatval);
	filePutString (buffer, elcount(buffer), hFile);
	floatval = getSignal(CHASSIS::Preview_Header2_FR2::Preview_YawAngleDelta);
	snprintf(buffer, elcount(buffer), "   0.000000 F1 MPC::Preview_Header2_FR2::Preview_YawAngleDelta = %f\n", floatval);
	filePutString (buffer, elcount(buffer), hFile);
	floatval = getSignal(CHASSIS::Preview_Header2_FR2::Preview_RollAngleDelta);
	snprintf(buffer, elcount(buffer), "   0.000000 F1 MPC::Preview_Header2_FR2::Preview_RollAngleDelta = %f\n", floatval);
	filePutString (buffer, elcount(buffer), hFile);
	floatval = getSignal(CHASSIS::Preview_Header2_FR2::Preview_PitchAngleDelta);
	snprintf(buffer, elcount(buffer), "   0.000000 F1 MPC::Preview_Header2_FR2::Preview_PitchAngleDelta = %f\n", floatval);
	filePutString (buffer, elcount(buffer), hFile);
	intval = getSignal(CHASSIS::Preview_Header2_FR2::Rsrv3_Preview_Header2_Pr2);
	snprintf(buffer, elcount(buffer), "   0.000000 F1 MPC::Preview_Header2_FR2::Rsrv3_Preview_Header2_Pr2 = %d\n", intval);
	filePutString (buffer, elcount(buffer), hFile);
	intval = @sysvar::CH_Nodes::CH_MPCCRC_Preview_ProfData1_AUTO;
	snprintf(buffer, elcount(buffer), "   0.000000    SV: 2 0 0 ::CH_Nodes::CH_MPCCRC_Preview_ProfData1_AUTO = %d\n", intval);
	filePutString (buffer, elcount(buffer), hFile);
	intval = getSignal(CHASSIS::Preview_ProfData1_FR2::CRC_Preview_ProfData1_Pr2);
	snprintf(buffer, elcount(buffer), "   0.000000 F1 MPC::Preview_ProfData1_FR2::CRC_Preview_ProfData1_Pr2 = %d\n", intval);
	filePutString (buffer, elcount(buffer), hFile);
	intval = @sysvar::CH_Nodes::CH_MPCSQC_Preview_ProfData1_AUTO;
	snprintf(buffer, elcount(buffer), "   0.000000    SV: 2 0 0 ::CH_Nodes::CH_MPCSQC_Preview_ProfData1_AUTO = %d\n", intval);
	filePutString (buffer, elcount(buffer), hFile);
	intval = getSignal(CHASSIS::Preview_ProfData1_FR2::SQC_Preview_ProfData1_Pr2);
	snprintf(buffer, elcount(buffer), "   0.000000 F1 MPC::Preview_ProfData1_FR2::SQC_Preview_ProfData1_Pr2 = %d\n", intval);
	filePutString (buffer, elcount(buffer), hFile);
	intval = getSignal(CHASSIS::Preview_ProfData1_FR2::Preview_ProfDataCnt_Data1);
	snprintf(buffer, elcount(buffer), "   0.000000 F1 MPC::Preview_ProfData1_FR2::Preview_ProfDataCnt_Data1 = %d\n", intval);
	filePutString (buffer, elcount(buffer), hFile);
	intval = getSignal(CHASSIS::Preview_ProfData1_FR2::Preview_HeaderCnt_Data1);
	snprintf(buffer, elcount(buffer), "   0.000000 F1 MPC::Preview_ProfData1_FR2::Preview_HeaderCnt_Data1 = %d\n", intval);
	filePutString (buffer, elcount(buffer), hFile);
	floatval = getSignal(CHASSIS::Preview_ProfData1_FR2::Preview_RelHgt1);
	snprintf(buffer, elcount(buffer), "   0.000000 F1 MPC::Preview_ProfData1_FR2::Preview_RelHgt1 = %f\n", floatval);
	filePutString (buffer, elcount(buffer), hFile);
	floatval = getSignal(CHASSIS::Preview_ProfData1_FR2::Preview_RelHgt2);
	snprintf(buffer, elcount(buffer), "   0.000000 F1 MPC::Preview_ProfData1_FR2::Preview_RelHgt2 = %f\n", floatval);
	filePutString (buffer, elcount(buffer), hFile);
	floatval = getSignal(CHASSIS::Preview_ProfData1_FR2::Preview_RelHgt3);
	snprintf(buffer, elcount(buffer), "   0.000000 F1 MPC::Preview_ProfData1_FR2::Preview_RelHgt3 = %f\n", floatval);
	filePutString (buffer, elcount(buffer), hFile);
	floatval = getSignal(CHASSIS::Preview_ProfData1_FR2::Preview_RelHgt4);
	snprintf(buffer, elcount(buffer), "   0.000000 F1 MPC::Preview_ProfData1_FR2::Preview_RelHgt4 = %f\n", floatval);
	filePutString (buffer, elcount(buffer), hFile);
	floatval = getSignal(CHASSIS::Preview_ProfData1_FR2::Preview_RelHgt5);
	snprintf(buffer, elcount(buffer), "   0.000000 F1 MPC::Preview_ProfData1_FR2::Preview_RelHgt5 = %f\n", floatval);
	filePutString (buffer, elcount(buffer), hFile);
	floatval = getSignal(CHASSIS::Preview_ProfData1_FR2::Preview_RelHgt6);
	snprintf(buffer, elcount(buffer), "   0.000000 F1 MPC::Preview_ProfData1_FR2::Preview_RelHgt6 = %f\n", floatval);
	filePutString (buffer, elcount(buffer), hFile);
	floatval = getSignal(CHASSIS::Preview_ProfData1_FR2::Preview_RelHgt7);
	snprintf(buffer, elcount(buffer), "   0.000000 F1 MPC::Preview_ProfData1_FR2::Preview_RelHgt7 = %f\n", floatval);
	filePutString (buffer, elcount(buffer), hFile);
}
/*@@end*/

/*@@caplFunc:saveVars_87(dword):*/
void saveVars_87(dword hFile)
{
	floatval = getSignal(CHASSIS::Preview_ProfData1_FR2::Preview_RelHgt8);
	snprintf(buffer, elcount(buffer), "   0.000000 F1 MPC::Preview_ProfData1_FR2::Preview_RelHgt8 = %f\n", floatval);
	filePutString (buffer, elcount(buffer), hFile);
	floatval = getSignal(CHASSIS::Preview_ProfData1_FR2::Preview_RelHgt9);
	snprintf(buffer, elcount(buffer), "   0.000000 F1 MPC::Preview_ProfData1_FR2::Preview_RelHgt9 = %f\n", floatval);
	filePutString (buffer, elcount(buffer), hFile);
	intval = getSignal(CHASSIS::Preview_ProfData1_FR2::Preview_Qual1);
	snprintf(buffer, elcount(buffer), "   0.000000 F1 MPC::Preview_ProfData1_FR2::Preview_Qual1 = %d\n", intval);
	filePutString (buffer, elcount(buffer), hFile);
	intval = getSignal(CHASSIS::Preview_ProfData1_FR2::Preview_Qual2);
	snprintf(buffer, elcount(buffer), "   0.000000 F1 MPC::Preview_ProfData1_FR2::Preview_Qual2 = %d\n", intval);
	filePutString (buffer, elcount(buffer), hFile);
	intval = getSignal(CHASSIS::Preview_ProfData1_FR2::Preview_Qual3);
	snprintf(buffer, elcount(buffer), "   0.000000 F1 MPC::Preview_ProfData1_FR2::Preview_Qual3 = %d\n", intval);
	filePutString (buffer, elcount(buffer), hFile);
	intval = getSignal(CHASSIS::Preview_ProfData1_FR2::Preview_Qual4);
	snprintf(buffer, elcount(buffer), "   0.000000 F1 MPC::Preview_ProfData1_FR2::Preview_Qual4 = %d\n", intval);
	filePutString (buffer, elcount(buffer), hFile);
	intval = getSignal(CHASSIS::Preview_ProfData1_FR2::Preview_Qual5);
	snprintf(buffer, elcount(buffer), "   0.000000 F1 MPC::Preview_ProfData1_FR2::Preview_Qual5 = %d\n", intval);
	filePutString (buffer, elcount(buffer), hFile);
	intval = getSignal(CHASSIS::Preview_ProfData1_FR2::Preview_Qual6);
	snprintf(buffer, elcount(buffer), "   0.000000 F1 MPC::Preview_ProfData1_FR2::Preview_Qual6 = %d\n", intval);
	filePutString (buffer, elcount(buffer), hFile);
	intval = getSignal(CHASSIS::Preview_ProfData1_FR2::Preview_Qual7);
	snprintf(buffer, elcount(buffer), "   0.000000 F1 MPC::Preview_ProfData1_FR2::Preview_Qual7 = %d\n", intval);
	filePutString (buffer, elcount(buffer), hFile);
	intval = getSignal(CHASSIS::Preview_ProfData1_FR2::Preview_Qual8);
	snprintf(buffer, elcount(buffer), "   0.000000 F1 MPC::Preview_ProfData1_FR2::Preview_Qual8 = %d\n", intval);
	filePutString (buffer, elcount(buffer), hFile);
	intval = getSignal(CHASSIS::Preview_ProfData1_FR2::Preview_Qual9);
	snprintf(buffer, elcount(buffer), "   0.000000 F1 MPC::Preview_ProfData1_FR2::Preview_Qual9 = %d\n", intval);
	filePutString (buffer, elcount(buffer), hFile);
	intval = @sysvar::CH_Nodes::CH_MPCCRC_Preview_ProfData2_AUTO;
	snprintf(buffer, elcount(buffer), "   0.000000    SV: 2 0 0 ::CH_Nodes::CH_MPCCRC_Preview_ProfData2_AUTO = %d\n", intval);
	filePutString (buffer, elcount(buffer), hFile);
	intval = getSignal(CHASSIS::Preview_ProfData2_FR2::CRC_Preview_ProfData2_Pr2);
	snprintf(buffer, elcount(buffer), "   0.000000 F1 MPC::Preview_ProfData2_FR2::CRC_Preview_ProfData2_Pr2 = %d\n", intval);
	filePutString (buffer, elcount(buffer), hFile);
	intval = @sysvar::CH_Nodes::CH_MPCSQC_Preview_ProfData2_AUTO;
	snprintf(buffer, elcount(buffer), "   0.000000    SV: 2 0 0 ::CH_Nodes::CH_MPCSQC_Preview_ProfData2_AUTO = %d\n", intval);
	filePutString (buffer, elcount(buffer), hFile);
	intval = getSignal(CHASSIS::Preview_ProfData2_FR2::SQC_Preview_ProfData2_Pr2);
	snprintf(buffer, elcount(buffer), "   0.000000 F1 MPC::Preview_ProfData2_FR2::SQC_Preview_ProfData2_Pr2 = %d\n", intval);
	filePutString (buffer, elcount(buffer), hFile);
	intval = getSignal(CHASSIS::Preview_ProfData2_FR2::Preview_ProfDataCnt_Data2);
	snprintf(buffer, elcount(buffer), "   0.000000 F1 MPC::Preview_ProfData2_FR2::Preview_ProfDataCnt_Data2 = %d\n", intval);
	filePutString (buffer, elcount(buffer), hFile);
	intval = getSignal(CHASSIS::Preview_ProfData2_FR2::Preview_HeaderCnt_Data2);
	snprintf(buffer, elcount(buffer), "   0.000000 F1 MPC::Preview_ProfData2_FR2::Preview_HeaderCnt_Data2 = %d\n", intval);
	filePutString (buffer, elcount(buffer), hFile);
	floatval = getSignal(CHASSIS::Preview_ProfData2_FR2::Preview_RelHgt10);
	snprintf(buffer, elcount(buffer), "   0.000000 F1 MPC::Preview_ProfData2_FR2::Preview_RelHgt10 = %f\n", floatval);
	filePutString (buffer, elcount(buffer), hFile);
	floatval = getSignal(CHASSIS::Preview_ProfData2_FR2::Preview_RelHgt11);
	snprintf(buffer, elcount(buffer), "   0.000000 F1 MPC::Preview_ProfData2_FR2::Preview_RelHgt11 = %f\n", floatval);
	filePutString (buffer, elcount(buffer), hFile);
	floatval = getSignal(CHASSIS::Preview_ProfData2_FR2::Preview_RelHgt12);
	snprintf(buffer, elcount(buffer), "   0.000000 F1 MPC::Preview_ProfData2_FR2::Preview_RelHgt12 = %f\n", floatval);
	filePutString (buffer, elcount(buffer), hFile);
	floatval = getSignal(CHASSIS::Preview_ProfData2_FR2::Preview_RelHgt13);
	snprintf(buffer, elcount(buffer), "   0.000000 F1 MPC::Preview_ProfData2_FR2::Preview_RelHgt13 = %f\n", floatval);
	filePutString (buffer, elcount(buffer), hFile);
	floatval = getSignal(CHASSIS::Preview_ProfData2_FR2::Preview_RelHgt14);
	snprintf(buffer, elcount(buffer), "   0.000000 F1 MPC::Preview_ProfData2_FR2::Preview_RelHgt14 = %f\n", floatval);
	filePutString (buffer, elcount(buffer), hFile);
	floatval = getSignal(CHASSIS::Preview_ProfData2_FR2::Preview_RelHgt15);
	snprintf(buffer, elcount(buffer), "   0.000000 F1 MPC::Preview_ProfData2_FR2::Preview_RelHgt15 = %f\n", floatval);
	filePutString (buffer, elcount(buffer), hFile);
	floatval = getSignal(CHASSIS::Preview_ProfData2_FR2::Preview_RelHgt16);
	snprintf(buffer, elcount(buffer), "   0.000000 F1 MPC::Preview_ProfData2_FR2::Preview_RelHgt16 = %f\n", floatval);
	filePutString (buffer, elcount(buffer), hFile);
	floatval = getSignal(CHASSIS::Preview_ProfData2_FR2::Preview_RelHgt17);
	snprintf(buffer, elcount(buffer), "   0.000000 F1 MPC::Preview_ProfData2_FR2::Preview_RelHgt17 = %f\n", floatval);
	filePutString (buffer, elcount(buffer), hFile);
	floatval = getSignal(CHASSIS::Preview_ProfData2_FR2::Preview_RelHgt18);
	snprintf(buffer, elcount(buffer), "   0.000000 F1 MPC::Preview_ProfData2_FR2::Preview_RelHgt18 = %f\n", floatval);
	filePutString (buffer, elcount(buffer), hFile);
	intval = getSignal(CHASSIS::Preview_ProfData2_FR2::Preview_Qual10);
	snprintf(buffer, elcount(buffer), "   0.000000 F1 MPC::Preview_ProfData2_FR2::Preview_Qual10 = %d\n", intval);
	filePutString (buffer, elcount(buffer), hFile);
	intval = getSignal(CHASSIS::Preview_ProfData2_FR2::Preview_Qual11);
	snprintf(buffer, elcount(buffer), "   0.000000 F1 MPC::Preview_ProfData2_FR2::Preview_Qual11 = %d\n", intval);
	filePutString (buffer, elcount(buffer), hFile);
	intval = getSignal(CHASSIS::Preview_ProfData2_FR2::Preview_Qual12);
	snprintf(buffer, elcount(buffer), "   0.000000 F1 MPC::Preview_ProfData2_FR2::Preview_Qual12 = %d\n", intval);
	filePutString (buffer, elcount(buffer), hFile);
	intval = getSignal(CHASSIS::Preview_ProfData2_FR2::Preview_Qual13);
	snprintf(buffer, elcount(buffer), "   0.000000 F1 MPC::Preview_ProfData2_FR2::Preview_Qual13 = %d\n", intval);
	filePutString (buffer, elcount(buffer), hFile);
	intval = getSignal(CHASSIS::Preview_ProfData2_FR2::Preview_Qual14);
	snprintf(buffer, elcount(buffer), "   0.000000 F1 MPC::Preview_ProfData2_FR2::Preview_Qual14 = %d\n", intval);
	filePutString (buffer, elcount(buffer), hFile);
	intval = getSignal(CHASSIS::Preview_ProfData2_FR2::Preview_Qual15);
	snprintf(buffer, elcount(buffer), "   0.000000 F1 MPC::Preview_ProfData2_FR2::Preview_Qual15 = %d\n", intval);
	filePutString (buffer, elcount(buffer), hFile);
	intval = getSignal(CHASSIS::Preview_ProfData2_FR2::Preview_Qual16);
	snprintf(buffer, elcount(buffer), "   0.000000 F1 MPC::Preview_ProfData2_FR2::Preview_Qual16 = %d\n", intval);
	filePutString (buffer, elcount(buffer), hFile);
	intval = getSignal(CHASSIS::Preview_ProfData2_FR2::Preview_Qual17);
	snprintf(buffer, elcount(buffer), "   0.000000 F1 MPC::Preview_ProfData2_FR2::Preview_Qual17 = %d\n", intval);
	filePutString (buffer, elcount(buffer), hFile);
	intval = getSignal(CHASSIS::Preview_ProfData2_FR2::Preview_Qual18);
	snprintf(buffer, elcount(buffer), "   0.000000 F1 MPC::Preview_ProfData2_FR2::Preview_Qual18 = %d\n", intval);
	filePutString (buffer, elcount(buffer), hFile);
	intval = getSignal(CHASSIS::ROE_SMPC::ROE_Header_SMPC);
	snprintf(buffer, elcount(buffer), "   0.000000 F1 MPC::ROE_SMPC::ROE_Header_SMPC = %d\n", intval);
	filePutString (buffer, elcount(buffer), hFile);
	intval = getSignal(CHASSIS::ROE_SMPC::ROE_DTC_SMPC);
	snprintf(buffer, elcount(buffer), "   0.000000 F1 MPC::ROE_SMPC::ROE_DTC_SMPC = %d\n", intval);
	filePutString (buffer, elcount(buffer), hFile);
	intval = getSignal(CHASSIS::ROE_SMPC::ROE_DTC_Stat_SMPC);
	snprintf(buffer, elcount(buffer), "   0.000000 F1 MPC::ROE_SMPC::ROE_DTC_Stat_SMPC = %d\n", intval);
	filePutString (buffer, elcount(buffer), hFile);
	intval = @sysvar::CH_Nodes::CH_MPCCRC_SPL_Obj1_Obj2_MPC_AUTO;
	snprintf(buffer, elcount(buffer), "   0.000000    SV: 2 0 0 ::CH_Nodes::CH_MPCCRC_SPL_Obj1_Obj2_MPC_AUTO = %d\n", intval);
	filePutString (buffer, elcount(buffer), hFile);
	intval = getSignal(CHASSIS::SPL_Obj1_Obj2_MPC_AR2::CRC_SPL_Obj1_Obj2_MPC_Pr2);
	snprintf(buffer, elcount(buffer), "   0.000000 F1 MPC::SPL_Obj1_Obj2_MPC_AR2::CRC_SPL_Obj1_Obj2_MPC_Pr2 = %d\n", intval);
	filePutString (buffer, elcount(buffer), hFile);
	intval = @sysvar::CH_Nodes::CH_MPCSQC_SPL_Obj1_Obj2_MPC_AUTO;
	snprintf(buffer, elcount(buffer), "   0.000000    SV: 2 0 0 ::CH_Nodes::CH_MPCSQC_SPL_Obj1_Obj2_MPC_AUTO = %d\n", intval);
	filePutString (buffer, elcount(buffer), hFile);
	intval = getSignal(CHASSIS::SPL_Obj1_Obj2_MPC_AR2::SQC_SPL_Obj1_Obj2_MPC_Pr2);
	snprintf(buffer, elcount(buffer), "   0.000000 F1 MPC::SPL_Obj1_Obj2_MPC_AR2::SQC_SPL_Obj1_Obj2_MPC_Pr2 = %d\n", intval);
	filePutString (buffer, elcount(buffer), hFile);
	intval = getSignal(CHASSIS::SPL_Obj1_Obj2_MPC_AR2::Rsrv1_SPL_Obj1_Obj2_MPC_Pr2);
	snprintf(buffer, elcount(buffer), "   0.000000 F1 MPC::SPL_Obj1_Obj2_MPC_AR2::Rsrv1_SPL_Obj1_Obj2_MPC_Pr2 = %d\n", intval);
	filePutString (buffer, elcount(buffer), hFile);
	intval = getSignal(CHASSIS::SPL_Obj1_Obj2_MPC_AR2::SPL_Obj1_Id_MPC);
	snprintf(buffer, elcount(buffer), "   0.000000 F1 MPC::SPL_Obj1_Obj2_MPC_AR2::SPL_Obj1_Id_MPC = %d\n", intval);
	filePutString (buffer, elcount(buffer), hFile);
	intval = getSignal(CHASSIS::SPL_Obj1_Obj2_MPC_AR2::SPL_Obj1_Dist_MPC);
	snprintf(buffer, elcount(buffer), "   0.000000 F1 MPC::SPL_Obj1_Obj2_MPC_AR2::SPL_Obj1_Dist_MPC = %d\n", intval);
	filePutString (buffer, elcount(buffer), hFile);
	floatval = getSignal(CHASSIS::SPL_Obj1_Obj2_MPC_AR2::SPL_Obj1_HrztAngl_MPC);
	snprintf(buffer, elcount(buffer), "   0.000000 F1 MPC::SPL_Obj1_Obj2_MPC_AR2::SPL_Obj1_HrztAngl_MPC = %f\n", floatval);
	filePutString (buffer, elcount(buffer), hFile);
	intval = getSignal(CHASSIS::SPL_Obj1_Obj2_MPC_AR2::Rsrv2_SPL_Obj1_Obj2_MPC_Pr2);
	snprintf(buffer, elcount(buffer), "   0.000000 F1 MPC::SPL_Obj1_Obj2_MPC_AR2::Rsrv2_SPL_Obj1_Obj2_MPC_Pr2 = %d\n", intval);
	filePutString (buffer, elcount(buffer), hFile);
	intval = getSignal(CHASSIS::SPL_Obj1_Obj2_MPC_AR2::SPL_Obj1_Type_MPC);
	snprintf(buffer, elcount(buffer), "   0.000000 F1 MPC::SPL_Obj1_Obj2_MPC_AR2::SPL_Obj1_Type_MPC = %d\n", intval);
	filePutString (buffer, elcount(buffer), hFile);
	intval = getSignal(CHASSIS::SPL_Obj1_Obj2_MPC_AR2::SPL_Obj1_Ill_Rq_MPC);
	snprintf(buffer, elcount(buffer), "   0.000000 F1 MPC::SPL_Obj1_Obj2_MPC_AR2::SPL_Obj1_Ill_Rq_MPC = %d\n", intval);
	filePutString (buffer, elcount(buffer), hFile);
	intval = getSignal(CHASSIS::SPL_Obj1_Obj2_MPC_AR2::SPL_Obj2_Id_MPC);
	snprintf(buffer, elcount(buffer), "   0.000000 F1 MPC::SPL_Obj1_Obj2_MPC_AR2::SPL_Obj2_Id_MPC = %d\n", intval);
	filePutString (buffer, elcount(buffer), hFile);
	intval = getSignal(CHASSIS::SPL_Obj1_Obj2_MPC_AR2::SPL_Obj2_Dist_MPC);
	snprintf(buffer, elcount(buffer), "   0.000000 F1 MPC::SPL_Obj1_Obj2_MPC_AR2::SPL_Obj2_Dist_MPC = %d\n", intval);
	filePutString (buffer, elcount(buffer), hFile);
	floatval = getSignal(CHASSIS::SPL_Obj1_Obj2_MPC_AR2::SPL_Obj2_HrztAngl_MPC);
	snprintf(buffer, elcount(buffer), "   0.000000 F1 MPC::SPL_Obj1_Obj2_MPC_AR2::SPL_Obj2_HrztAngl_MPC = %f\n", floatval);
	filePutString (buffer, elcount(buffer), hFile);
	intval = getSignal(CHASSIS::SPL_Obj1_Obj2_MPC_AR2::Rsrv3_SPL_Obj1_Obj2_MPC_Pr2);
	snprintf(buffer, elcount(buffer), "   0.000000 F1 MPC::SPL_Obj1_Obj2_MPC_AR2::Rsrv3_SPL_Obj1_Obj2_MPC_Pr2 = %d\n", intval);
	filePutString (buffer, elcount(buffer), hFile);
	intval = getSignal(CHASSIS::SPL_Obj1_Obj2_MPC_AR2::SPL_Obj2_Type_MPC);
	snprintf(buffer, elcount(buffer), "   0.000000 F1 MPC::SPL_Obj1_Obj2_MPC_AR2::SPL_Obj2_Type_MPC = %d\n", intval);
	filePutString (buffer, elcount(buffer), hFile);
	intval = getSignal(CHASSIS::SPL_Obj1_Obj2_MPC_AR2::SPL_Obj2_Ill_Rq_MPC);
	snprintf(buffer, elcount(buffer), "   0.000000 F1 MPC::SPL_Obj1_Obj2_MPC_AR2::SPL_Obj2_Ill_Rq_MPC = %d\n", intval);
	filePutString (buffer, elcount(buffer), hFile);
}
/*@@end*/

/*@@caplFunc:saveVars_88(dword):*/
void saveVars_88(dword hFile)
{
	intval = getSignal(CHASSIS::TSA_Disp_Rq1_Gw_AR2::TSA_SpdWarnOffset);
	snprintf(buffer, elcount(buffer), "   0.000000 F1 MPC::TSA_Disp_Rq1_Gw_AR2::TSA_SpdWarnOffset = %d\n", intval);
	filePutString (buffer, elcount(buffer), hFile);
	intval = getSignal(CHASSIS::TSA_Disp_Rq1_Gw_AR2::TSA_SpdWarnMd_Stat);
	snprintf(buffer, elcount(buffer), "   0.000000 F1 MPC::TSA_Disp_Rq1_Gw_AR2::TSA_SpdWarnMd_Stat = %d\n", intval);
	filePutString (buffer, elcount(buffer), hFile);
	intval = getSignal(CHASSIS::TSA_Disp_Rq1_Gw_AR2::TSA_HU_DispMd_Stat);
	snprintf(buffer, elcount(buffer), "   0.000000 F1 MPC::TSA_Disp_Rq1_Gw_AR2::TSA_HU_DispMd_Stat = %d\n", intval);
	filePutString (buffer, elcount(buffer), hFile);
	intval = getSignal(CHASSIS::TSA_Disp_Rq1_Gw_AR2::TSA_IC_DispMd_Stat);
	snprintf(buffer, elcount(buffer), "   0.000000 F1 MPC::TSA_Disp_Rq1_Gw_AR2::TSA_IC_DispMd_Stat = %d\n", intval);
	filePutString (buffer, elcount(buffer), hFile);
	intval = getSignal(CHASSIS::TSA_Disp_Rq1_Gw_AR2::SLA_SpdWarn_Rq_V2);
	snprintf(buffer, elcount(buffer), "   0.000000 F1 MPC::TSA_Disp_Rq1_Gw_AR2::SLA_SpdWarn_Rq_V2 = %d\n", intval);
	filePutString (buffer, elcount(buffer), hFile);
	intval = getSignal(CHASSIS::TSA_Disp_Rq1_Gw_AR2::SLA_SpdWarn_IconDisp_Rq);
	snprintf(buffer, elcount(buffer), "   0.000000 F1 MPC::TSA_Disp_Rq1_Gw_AR2::SLA_SpdWarn_IconDisp_Rq = %d\n", intval);
	filePutString (buffer, elcount(buffer), hFile);
	intval = getSignal(CHASSIS::TSA_Disp_Rq1_Gw_AR2::SLA_WarnSpd_Val_V2);
	snprintf(buffer, elcount(buffer), "   0.000000 F1 MPC::TSA_Disp_Rq1_Gw_AR2::SLA_WarnSpd_Val_V2 = %d\n", intval);
	filePutString (buffer, elcount(buffer), hFile);
	intval = getSignal(CHASSIS::TSA_Disp_Rq1_Gw_AR2::SLA_SpdWarn_DispType);
	snprintf(buffer, elcount(buffer), "   0.000000 F1 MPC::TSA_Disp_Rq1_Gw_AR2::SLA_SpdWarn_DispType = %d\n", intval);
	filePutString (buffer, elcount(buffer), hFile);
	intval = getSignal(CHASSIS::TSA_Disp_Rq1_Gw_AR2::SLA_WarnSpd_Unit);
	snprintf(buffer, elcount(buffer), "   0.000000 F1 MPC::TSA_Disp_Rq1_Gw_AR2::SLA_WarnSpd_Unit = %d\n", intval);
	filePutString (buffer, elcount(buffer), hFile);
	intval = getSignal(CHASSIS::TSA_Disp_Rq1_Gw_AR2::TSA_Stat);
	snprintf(buffer, elcount(buffer), "   0.000000 F1 MPC::TSA_Disp_Rq1_Gw_AR2::TSA_Stat = %d\n", intval);
	filePutString (buffer, elcount(buffer), hFile);
	intval = getSignal(CHASSIS::TSA_Disp_Rq1_Gw_AR2::SLA_Warn_Rq);
	snprintf(buffer, elcount(buffer), "   0.000000 F1 MPC::TSA_Disp_Rq1_Gw_AR2::SLA_Warn_Rq = %d\n", intval);
	filePutString (buffer, elcount(buffer), hFile);
	intval = getSignal(CHASSIS::TSA_Disp_Rq1_Gw_AR2::PMA_Warn_Rq);
	snprintf(buffer, elcount(buffer), "   0.000000 F1 MPC::TSA_Disp_Rq1_Gw_AR2::PMA_Warn_Rq = %d\n", intval);
	filePutString (buffer, elcount(buffer), hFile);
	intval = getSignal(CHASSIS::TSA_Disp_Rq1_Gw_AR2::PMA_Pass_Warn_Rq);
	snprintf(buffer, elcount(buffer), "   0.000000 F1 MPC::TSA_Disp_Rq1_Gw_AR2::PMA_Pass_Warn_Rq = %d\n", intval);
	filePutString (buffer, elcount(buffer), hFile);
	intval = getSignal(CHASSIS::TSA_Disp_Rq1_Gw_AR2::WWA_Warn_Rq);
	snprintf(buffer, elcount(buffer), "   0.000000 F1 MPC::TSA_Disp_Rq1_Gw_AR2::WWA_Warn_Rq = %d\n", intval);
	filePutString (buffer, elcount(buffer), hFile);
	intval = getSignal(CHASSIS::TSA_Disp_Rq1_Gw_AR2::RoadWork_Warn_Rq);
	snprintf(buffer, elcount(buffer), "   0.000000 F1 MPC::TSA_Disp_Rq1_Gw_AR2::RoadWork_Warn_Rq = %d\n", intval);
	filePutString (buffer, elcount(buffer), hFile);
	intval = getSignal(CHASSIS::TSA_Disp_Rq1_Gw_AR2::CrossWalk_Warn_Rq);
	snprintf(buffer, elcount(buffer), "   0.000000 F1 MPC::TSA_Disp_Rq1_Gw_AR2::CrossWalk_Warn_Rq = %d\n", intval);
	filePutString (buffer, elcount(buffer), hFile);
	intval = getSignal(CHASSIS::TSA_Disp_Rq1_Gw_AR2::TSA_WarnMd_Stat);
	snprintf(buffer, elcount(buffer), "   0.000000 F1 MPC::TSA_Disp_Rq1_Gw_AR2::TSA_WarnMd_Stat = %d\n", intval);
	filePutString (buffer, elcount(buffer), hFile);
	intval = getSignal(CHASSIS::TSA_Disp_Rq1_Gw_AR2::SLA_WarnSpdNxt_Dist);
	snprintf(buffer, elcount(buffer), "   0.000000 F1 MPC::TSA_Disp_Rq1_Gw_AR2::SLA_WarnSpdNxt_Dist = %d\n", intval);
	filePutString (buffer, elcount(buffer), hFile);
	intval = getSignal(CHASSIS::TSA_Disp_Rq1_Gw_AR2::SLA_WarnSpdNxt_Type);
	snprintf(buffer, elcount(buffer), "   0.000000 F1 MPC::TSA_Disp_Rq1_Gw_AR2::SLA_WarnSpdNxt_Type = %d\n", intval);
	filePutString (buffer, elcount(buffer), hFile);
	intval = getSignal(CHASSIS::TSA_Disp_Rq1_Gw_AR2::SLA_WarnSpdNxt_Val);
	snprintf(buffer, elcount(buffer), "   0.000000 F1 MPC::TSA_Disp_Rq1_Gw_AR2::SLA_WarnSpdNxt_Val = %d\n", intval);
	filePutString (buffer, elcount(buffer), hFile);
	intval = getSignal(CHASSIS::TSA_Disp_Rq2_Gw_AR::TSA_Disp_Rq2_Data1);
	snprintf(buffer, elcount(buffer), "   0.000000 F1 MPC::TSA_Disp_Rq2_Gw_AR::TSA_Disp_Rq2_Data1 = %d\n", intval);
	filePutString (buffer, elcount(buffer), hFile);
	intval = getSignal(CHASSIS::TSA_Disp_Rq2_Gw_AR::TSA_Disp_Rq2_Data2);
	snprintf(buffer, elcount(buffer), "   0.000000 F1 MPC::TSA_Disp_Rq2_Gw_AR::TSA_Disp_Rq2_Data2 = %d\n", intval);
	filePutString (buffer, elcount(buffer), hFile);
	intval = getSignal(CHASSIS::TSA_Disp_Rq2_Gw_AR::TSA_Disp_Rq2_Data3);
	snprintf(buffer, elcount(buffer), "   0.000000 F1 MPC::TSA_Disp_Rq2_Gw_AR::TSA_Disp_Rq2_Data3 = %d\n", intval);
	filePutString (buffer, elcount(buffer), hFile);
	intval = getSignal(CHASSIS::TSA_Disp_Rq2_Gw_AR::TSA_Disp_Rq2_Data4);
	snprintf(buffer, elcount(buffer), "   0.000000 F1 MPC::TSA_Disp_Rq2_Gw_AR::TSA_Disp_Rq2_Data4 = %d\n", intval);
	filePutString (buffer, elcount(buffer), hFile);
	intval = getSignal(CHASSIS::TSA_Disp_Rq2_Gw_AR::TSA_Disp_Rq2_Data5);
	snprintf(buffer, elcount(buffer), "   0.000000 F1 MPC::TSA_Disp_Rq2_Gw_AR::TSA_Disp_Rq2_Data5 = %d\n", intval);
	filePutString (buffer, elcount(buffer), hFile);
	intval = getSignal(CHASSIS::TSA_Disp_Rq2_Gw_AR::TSA_Disp_Rq2_Data6);
	snprintf(buffer, elcount(buffer), "   0.000000 F1 MPC::TSA_Disp_Rq2_Gw_AR::TSA_Disp_Rq2_Data6 = %d\n", intval);
	filePutString (buffer, elcount(buffer), hFile);
	intval = getSignal(CHASSIS::TSA_Disp_Rq2_Gw_AR::TSA_Disp_Rq2_Data7);
	snprintf(buffer, elcount(buffer), "   0.000000 F1 MPC::TSA_Disp_Rq2_Gw_AR::TSA_Disp_Rq2_Data7 = %d\n", intval);
	filePutString (buffer, elcount(buffer), hFile);
	intval = getSignal(CHASSIS::TSA_Disp_Rq2_Gw_AR::TSA_Disp_Rq2_Data8);
	snprintf(buffer, elcount(buffer), "   0.000000 F1 MPC::TSA_Disp_Rq2_Gw_AR::TSA_Disp_Rq2_Data8 = %d\n", intval);
	filePutString (buffer, elcount(buffer), hFile);
	intval = getSignal(CHASSIS::TSA_Disp_Rq3_Gw_AR::TSA_StopSign_Dist);
	snprintf(buffer, elcount(buffer), "   0.000000 F1 MPC::TSA_Disp_Rq3_Gw_AR::TSA_StopSign_Dist = %d\n", intval);
	filePutString (buffer, elcount(buffer), hFile);
	intval = getSignal(CHASSIS::TSA_Disp_Rq3_Gw_AR::TSA_StopSignStyle);
	snprintf(buffer, elcount(buffer), "   0.000000 F1 MPC::TSA_Disp_Rq3_Gw_AR::TSA_StopSignStyle = %d\n", intval);
	filePutString (buffer, elcount(buffer), hFile);
	intval = @sysvar::CH_Nodes::CH_MPCCRC_YMAS_Rq_MPC_Pr2YM_AUTO;
	snprintf(buffer, elcount(buffer), "   0.000000    SV: 2 0 0 ::CH_Nodes::CH_MPCCRC_YMAS_Rq_MPC_Pr2YM_AUTO = %d\n", intval);
	filePutString (buffer, elcount(buffer), hFile);
	intval = getSignal(CHASSIS::YMAS_Rq_MPC_Gw_AR2::CRC_YMAS_Rq_MPC_Pr2);
	snprintf(buffer, elcount(buffer), "   0.000000 F1 MPC::YMAS_Rq_MPC_Gw_AR2::CRC_YMAS_Rq_MPC_Pr2 = %d\n", intval);
	filePutString (buffer, elcount(buffer), hFile);
	intval = @sysvar::CH_Nodes::CH_MPCSQC_YMAS_Rq_MPC_Pr2YM_AUTO;
	snprintf(buffer, elcount(buffer), "   0.000000    SV: 2 0 0 ::CH_Nodes::CH_MPCSQC_YMAS_Rq_MPC_Pr2YM_AUTO = %d\n", intval);
	filePutString (buffer, elcount(buffer), hFile);
	intval = getSignal(CHASSIS::YMAS_Rq_MPC_Gw_AR2::SQC_YMAS_Rq_MPC_Pr2);
	snprintf(buffer, elcount(buffer), "   0.000000 F1 MPC::YMAS_Rq_MPC_Gw_AR2::SQC_YMAS_Rq_MPC_Pr2 = %d\n", intval);
	filePutString (buffer, elcount(buffer), hFile);
	intval = getSignal(CHASSIS::YMAS_Rq_MPC_Gw_AR2::YMAS_BrkSrc_MPC);
	snprintf(buffer, elcount(buffer), "   0.000000 F1 MPC::YMAS_Rq_MPC_Gw_AR2::YMAS_BrkSrc_MPC = %d\n", intval);
	filePutString (buffer, elcount(buffer), hFile);
	floatval = getSignal(CHASSIS::YMAS_Rq_MPC_Gw_AR2::VehYawRate_Rq_MPC);
	snprintf(buffer, elcount(buffer), "   0.000000 F1 MPC::YMAS_Rq_MPC_Gw_AR2::VehYawRate_Rq_MPC = %f\n", floatval);
	filePutString (buffer, elcount(buffer), hFile);
	intval = getSignal(CHASSIS::YMAS_Rq_MPC_Gw_AR2::VehYawMoment_Ft_Rq_MPC);
	snprintf(buffer, elcount(buffer), "   0.000000 F1 MPC::YMAS_Rq_MPC_Gw_AR2::VehYawMoment_Ft_Rq_MPC = %d\n", intval);
	filePutString (buffer, elcount(buffer), hFile);
	intval = getSignal(CHASSIS::YMAS_Rq_MPC_Gw_AR2::Rsrv1_YMAS_Rq_MPC_Pr2);
	snprintf(buffer, elcount(buffer), "   0.000000 F1 MPC::YMAS_Rq_MPC_Gw_AR2::Rsrv1_YMAS_Rq_MPC_Pr2 = %d\n", intval);
	filePutString (buffer, elcount(buffer), hFile);
	intval = getSignal(CHASSIS::YMAS_Rq_MPC_Gw_AR2::VehYawMoment_R_Rq_MPC);
	snprintf(buffer, elcount(buffer), "   0.000000 F1 MPC::YMAS_Rq_MPC_Gw_AR2::VehYawMoment_R_Rq_MPC = %d\n", intval);
	filePutString (buffer, elcount(buffer), hFile);
	intval = getSignal(CHASSIS::YMAS_Rq_MPC_Gw_AR2::Rsrv2_YMAS_Rq_MPC_Pr2);
	snprintf(buffer, elcount(buffer), "   0.000000 F1 MPC::YMAS_Rq_MPC_Gw_AR2::Rsrv2_YMAS_Rq_MPC_Pr2 = %d\n", intval);
	filePutString (buffer, elcount(buffer), hFile);
	intval = getSignal(CHASSIS::YMAS_Rq_MPC_Gw_AR2::YMAS_Ok_MPC);
	snprintf(buffer, elcount(buffer), "   0.000000 F1 MPC::YMAS_Rq_MPC_Gw_AR2::YMAS_Ok_MPC = %d\n", intval);
	filePutString (buffer, elcount(buffer), hFile);
	snprintf(buffer, elcount(buffer), "   0.000000    SV: 2 0 0 ::CH_Nodes::CH__NMActive_PARK = %X\n", @sysvar::CH_Nodes::CH__NMActive_PARK);
	filePutString (buffer, elcount(buffer), hFile);
	snprintf(buffer, elcount(buffer), "   0.000000    SV: 2 0 0 ::CH_Nodes::CH__NMAwake_PARK = %X\n", @sysvar::CH_Nodes::CH__NMAwake_PARK);
	filePutString (buffer, elcount(buffer), hFile);
	intval = @sysvar::CH_Nodes::CH_PARKCRC_Brk_Rq_PARK_Pr2B_AUTO;
	snprintf(buffer, elcount(buffer), "   0.000000    SV: 2 0 0 ::CH_Nodes::CH_PARKCRC_Brk_Rq_PARK_Pr2B_AUTO = %d\n", intval);
	filePutString (buffer, elcount(buffer), hFile);
	intval = getSignal(CHASSIS::Brk_Rq_PARK_AR2::CRC_Brk_Rq_PARK_Pr2);
	snprintf(buffer, elcount(buffer), "   0.000000 F1 PARK::Brk_Rq_PARK_AR2::CRC_Brk_Rq_PARK_Pr2 = %d\n", intval);
	filePutString (buffer, elcount(buffer), hFile);
	intval = @sysvar::CH_Nodes::CH_PARKSQC_Brk_Rq_PARK_Pr2B_AUTO;
	snprintf(buffer, elcount(buffer), "   0.000000    SV: 2 0 0 ::CH_Nodes::CH_PARKSQC_Brk_Rq_PARK_Pr2B_AUTO = %d\n", intval);
	filePutString (buffer, elcount(buffer), hFile);
	intval = getSignal(CHASSIS::Brk_Rq_PARK_AR2::SQC_Brk_Rq_PARK_Pr2);
	snprintf(buffer, elcount(buffer), "   0.000000 F1 PARK::Brk_Rq_PARK_AR2::SQC_Brk_Rq_PARK_Pr2 = %d\n", intval);
	filePutString (buffer, elcount(buffer), hFile);
	intval = getSignal(CHASSIS::Brk_Rq_PARK_AR2::PARK_Brk_Stat);
	snprintf(buffer, elcount(buffer), "   0.000000 F1 PARK::Brk_Rq_PARK_AR2::PARK_Brk_Stat = %d\n", intval);
	filePutString (buffer, elcount(buffer), hFile);
	intval = getSignal(CHASSIS::Brk_Rq_PARK_AR2::PARK_Park_Stat);
	snprintf(buffer, elcount(buffer), "   0.000000 F1 PARK::Brk_Rq_PARK_AR2::PARK_Park_Stat = %d\n", intval);
	filePutString (buffer, elcount(buffer), hFile);
	intval = getSignal(CHASSIS::Brk_Rq_PARK_AR2::PARK_ParkType);
	snprintf(buffer, elcount(buffer), "   0.000000 F1 PARK::Brk_Rq_PARK_AR2::PARK_ParkType = %d\n", intval);
	filePutString (buffer, elcount(buffer), hFile);
	intval = getSignal(CHASSIS::Brk_Rq_PARK_AR2::PARK_DangerMd_Rq);
	snprintf(buffer, elcount(buffer), "   0.000000 F1 PARK::Brk_Rq_PARK_AR2::PARK_DangerMd_Rq = %d\n", intval);
	filePutString (buffer, elcount(buffer), hFile);
	intval = getSignal(CHASSIS::Brk_Rq_PARK_AR2::PARK_RemainDist);
	snprintf(buffer, elcount(buffer), "   0.000000 F1 PARK::Brk_Rq_PARK_AR2::PARK_RemainDist = %d\n", intval);
	filePutString (buffer, elcount(buffer), hFile);
	intval = getSignal(CHASSIS::Brk_Rq_PARK_AR2::PARK_BrkMd_Rq);
	snprintf(buffer, elcount(buffer), "   0.000000 F1 PARK::Brk_Rq_PARK_AR2::PARK_BrkMd_Rq = %d\n", intval);
	filePutString (buffer, elcount(buffer), hFile);
	floatval = getSignal(CHASSIS::Brk_Rq_PARK_AR2::PARK_VehSpd_Rq);
	snprintf(buffer, elcount(buffer), "   0.000000 F1 PARK::Brk_Rq_PARK_AR2::PARK_VehSpd_Rq = %f\n", floatval);
	filePutString (buffer, elcount(buffer), hFile);
	intval = getSignal(CHASSIS::Brk_Rq_PARK_AR2::PARK_RemainDist_Stat);
	snprintf(buffer, elcount(buffer), "   0.000000 F1 PARK::Brk_Rq_PARK_AR2::PARK_RemainDist_Stat = %d\n", intval);
	filePutString (buffer, elcount(buffer), hFile);
}
/*@@end*/

/*@@caplFunc:saveVars_89(dword):*/
void saveVars_89(dword hFile)
{
	intval = getSignal(CHASSIS::Brk_Rq_PARK_AR2::Rsrv1_Brk_Rq_PARK_Pr2);
	snprintf(buffer, elcount(buffer), "   0.000000 F1 PARK::Brk_Rq_PARK_AR2::Rsrv1_Brk_Rq_PARK_Pr2 = %d\n", intval);
	filePutString (buffer, elcount(buffer), hFile);
	intval = getSignal(CHASSIS::Brk_Rq_PARK_AR2::PARK_CtrlMd_Rq);
	snprintf(buffer, elcount(buffer), "   0.000000 F1 PARK::Brk_Rq_PARK_AR2::PARK_CtrlMd_Rq = %d\n", intval);
	filePutString (buffer, elcount(buffer), hFile);
	intval = getSignal(CHASSIS::Brk_Rq_PARK_AR2::PARK_TxDrvPosn_Rq);
	snprintf(buffer, elcount(buffer), "   0.000000 F1 PARK::Brk_Rq_PARK_AR2::PARK_TxDrvPosn_Rq = %d\n", intval);
	filePutString (buffer, elcount(buffer), hFile);
	intval = getSignal(CHASSIS::Brk_Rq_PARK_AR2::Rsrv2_Brk_Rq_PARK_Pr2);
	snprintf(buffer, elcount(buffer), "   0.000000 F1 PARK::Brk_Rq_PARK_AR2::Rsrv2_Brk_Rq_PARK_Pr2 = %d\n", intval);
	filePutString (buffer, elcount(buffer), hFile);
	intval = getSignal(CHASSIS::Brk_Rq_PARK_AR2::Rsrv3_Brk_Rq_PARK_Pr2);
	snprintf(buffer, elcount(buffer), "   0.000000 F1 PARK::Brk_Rq_PARK_AR2::Rsrv3_Brk_Rq_PARK_Pr2 = %d\n", intval);
	filePutString (buffer, elcount(buffer), hFile);
	intval = getSignal(CHASSIS::ECU_INFO_RVC_AR::ECU_DATA_RVC_AR1);
	snprintf(buffer, elcount(buffer), "   0.000000 F1 PARK::ECU_INFO_RVC_AR::ECU_DATA_RVC_AR1 = %d\n", intval);
	filePutString (buffer, elcount(buffer), hFile);
	intval = getSignal(CHASSIS::ECU_INFO_RVC_AR::ECU_DATA_RVC_AR2);
	snprintf(buffer, elcount(buffer), "   0.000000 F1 PARK::ECU_INFO_RVC_AR::ECU_DATA_RVC_AR2 = %d\n", intval);
	filePutString (buffer, elcount(buffer), hFile);
	intval = getSignal(CHASSIS::ECU_INFO_RVC_AR::ECU_DATA_RVC_AR3);
	snprintf(buffer, elcount(buffer), "   0.000000 F1 PARK::ECU_INFO_RVC_AR::ECU_DATA_RVC_AR3 = %d\n", intval);
	filePutString (buffer, elcount(buffer), hFile);
	intval = getSignal(CHASSIS::ECU_INFO_RVC_AR::ECU_DATA_RVC_AR4);
	snprintf(buffer, elcount(buffer), "   0.000000 F1 PARK::ECU_INFO_RVC_AR::ECU_DATA_RVC_AR4 = %d\n", intval);
	filePutString (buffer, elcount(buffer), hFile);
	intval = getSignal(CHASSIS::ECU_INFO_RVC_AR::ECU_DATA_RVC_AR5);
	snprintf(buffer, elcount(buffer), "   0.000000 F1 PARK::ECU_INFO_RVC_AR::ECU_DATA_RVC_AR5 = %d\n", intval);
	filePutString (buffer, elcount(buffer), hFile);
	intval = getSignal(CHASSIS::ECU_INFO_RVC_AR::ECU_DATA_RVC_AR6);
	snprintf(buffer, elcount(buffer), "   0.000000 F1 PARK::ECU_INFO_RVC_AR::ECU_DATA_RVC_AR6 = %d\n", intval);
	filePutString (buffer, elcount(buffer), hFile);
	intval = getSignal(CHASSIS::ECU_INFO_RVC_AR::ECU_DATA_RVC_AR7);
	snprintf(buffer, elcount(buffer), "   0.000000 F1 PARK::ECU_INFO_RVC_AR::ECU_DATA_RVC_AR7 = %d\n", intval);
	filePutString (buffer, elcount(buffer), hFile);
	intval = getSignal(CHASSIS::ECU_INFO_RVC_AR::ECU_INFO_RVC_MsgPart);
	snprintf(buffer, elcount(buffer), "   0.000000 F1 PARK::ECU_INFO_RVC_AR::ECU_INFO_RVC_MsgPart = %d\n", intval);
	filePutString (buffer, elcount(buffer), hFile);
	intval = getSignal(CHASSIS::ECU_INFO_RVC_AR::ECU_INFO_RVC_DiagProt);
	snprintf(buffer, elcount(buffer), "   0.000000 F1 PARK::ECU_INFO_RVC_AR::ECU_INFO_RVC_DiagProt = %d\n", intval);
	filePutString (buffer, elcount(buffer), hFile);
	intval = @sysvar::CH_Nodes::CH_PARKCRC_Park_Disp_Rq_Pr2_AUTO;
	snprintf(buffer, elcount(buffer), "   0.000000    SV: 2 0 0 ::CH_Nodes::CH_PARKCRC_Park_Disp_Rq_Pr2_AUTO = %d\n", intval);
	filePutString (buffer, elcount(buffer), hFile);
	intval = getSignal(CHASSIS::Park_Disp_Rq_AR2::CRC_Park_Disp_Rq_Pr2);
	snprintf(buffer, elcount(buffer), "   0.000000 F1 PARK::Park_Disp_Rq_AR2::CRC_Park_Disp_Rq_Pr2 = %d\n", intval);
	filePutString (buffer, elcount(buffer), hFile);
	intval = @sysvar::CH_Nodes::CH_PARKSQC_Park_Disp_Rq_Pr2_AUTO;
	snprintf(buffer, elcount(buffer), "   0.000000    SV: 2 0 0 ::CH_Nodes::CH_PARKSQC_Park_Disp_Rq_Pr2_AUTO = %d\n", intval);
	filePutString (buffer, elcount(buffer), hFile);
	intval = getSignal(CHASSIS::Park_Disp_Rq_AR2::SQC_Park_Disp_Rq_Pr2);
	snprintf(buffer, elcount(buffer), "   0.000000 F1 PARK::Park_Disp_Rq_AR2::SQC_Park_Disp_Rq_Pr2 = %d\n", intval);
	filePutString (buffer, elcount(buffer), hFile);
	intval = getSignal(CHASSIS::Park_Disp_Rq_AR2::PARK_Pilot_Md);
	snprintf(buffer, elcount(buffer), "   0.000000 F1 PARK::Park_Disp_Rq_AR2::PARK_Pilot_Md = %d\n", intval);
	filePutString (buffer, elcount(buffer), hFile);
	intval = getSignal(CHASSIS::Park_Disp_Rq_AR2::Park_Sound_Rq);
	snprintf(buffer, elcount(buffer), "   0.000000 F1 PARK::Park_Disp_Rq_AR2::Park_Sound_Rq = %d\n", intval);
	filePutString (buffer, elcount(buffer), hFile);
	intval = getSignal(CHASSIS::Park_Disp_Rq_AR2::Park_IconDisp_Rq);
	snprintf(buffer, elcount(buffer), "   0.000000 F1 PARK::Park_Disp_Rq_AR2::Park_IconDisp_Rq = %d\n", intval);
	filePutString (buffer, elcount(buffer), hFile);
	intval = getSignal(CHASSIS::Park_Disp_Rq_AR2::PARK_Hitch_Instrct_Disp_Rq);
	snprintf(buffer, elcount(buffer), "   0.000000 F1 PARK::Park_Disp_Rq_AR2::PARK_Hitch_Instrct_Disp_Rq = %d\n", intval);
	filePutString (buffer, elcount(buffer), hFile);
	intval = getSignal(CHASSIS::Park_Disp_Rq_AR2::Rsrv1_Park_Disp_Rq_Pr2);
	snprintf(buffer, elcount(buffer), "   0.000000 F1 PARK::Park_Disp_Rq_AR2::Rsrv1_Park_Disp_Rq_Pr2 = %d\n", intval);
	filePutString (buffer, elcount(buffer), hFile);
	intval = getSignal(CHASSIS::Park_Disp_Rq_AR2::Rsrv2_Park_Disp_Rq_Pr2);
	snprintf(buffer, elcount(buffer), "   0.000000 F1 PARK::Park_Disp_Rq_AR2::Rsrv2_Park_Disp_Rq_Pr2 = %d\n", intval);
	filePutString (buffer, elcount(buffer), hFile);
	intval = getSignal(CHASSIS::Park_Disp_Rq_AR2::Park_Warn1_Disp_Rq);
	snprintf(buffer, elcount(buffer), "   0.000000 F1 PARK::Park_Disp_Rq_AR2::Park_Warn1_Disp_Rq = %d\n", intval);
	filePutString (buffer, elcount(buffer), hFile);
	intval = getSignal(CHASSIS::Park_Disp_Rq_AR2::Rsrv3_Park_Disp_Rq_Pr2);
	snprintf(buffer, elcount(buffer), "   0.000000 F1 PARK::Park_Disp_Rq_AR2::Rsrv3_Park_Disp_Rq_Pr2 = %d\n", intval);
	filePutString (buffer, elcount(buffer), hFile);
	intval = getSignal(CHASSIS::Park_Disp_Rq_AR2::Rsrv4_Park_Disp_Rq_Pr2);
	snprintf(buffer, elcount(buffer), "   0.000000 F1 PARK::Park_Disp_Rq_AR2::Rsrv4_Park_Disp_Rq_Pr2 = %d\n", intval);
	filePutString (buffer, elcount(buffer), hFile);
	intval = getSignal(CHASSIS::Park_Disp_Rq_AR2::PARK_Hitch_KinkAngl);
	snprintf(buffer, elcount(buffer), "   0.000000 F1 PARK::Park_Disp_Rq_AR2::PARK_Hitch_KinkAngl = %d\n", intval);
	filePutString (buffer, elcount(buffer), hFile);
	intval = getSignal(CHASSIS::Park_Disp_Rq_AR2::PARK_Hitch_KinkAngl_Rng);
	snprintf(buffer, elcount(buffer), "   0.000000 F1 PARK::Park_Disp_Rq_AR2::PARK_Hitch_KinkAngl_Rng = %d\n", intval);
	filePutString (buffer, elcount(buffer), hFile);
	intval = getSignal(CHASSIS::Park_Set_Stat_AR2::Park_WarnFreq_Ft_Stat);
	snprintf(buffer, elcount(buffer), "   0.000000 F1 PARK::Park_Set_Stat_AR2::Park_WarnFreq_Ft_Stat = %d\n", intval);
	filePutString (buffer, elcount(buffer), hFile);
	intval = getSignal(CHASSIS::Park_Set_Stat_AR2::Park_WarnFreq_R_Stat);
	snprintf(buffer, elcount(buffer), "   0.000000 F1 PARK::Park_Set_Stat_AR2::Park_WarnFreq_R_Stat = %d\n", intval);
	filePutString (buffer, elcount(buffer), hFile);
	intval = getSignal(CHASSIS::Park_Set_Stat_AR2::Park_WarnVol_Ft_Stat);
	snprintf(buffer, elcount(buffer), "   0.000000 F1 PARK::Park_Set_Stat_AR2::Park_WarnVol_Ft_Stat = %d\n", intval);
	filePutString (buffer, elcount(buffer), hFile);
	intval = getSignal(CHASSIS::Park_Set_Stat_AR2::Park_WarnVol_R_Stat);
	snprintf(buffer, elcount(buffer), "   0.000000 F1 PARK::Park_Set_Stat_AR2::Park_WarnVol_R_Stat = %d\n", intval);
	filePutString (buffer, elcount(buffer), hFile);
	intval = getSignal(CHASSIS::Park_Set_Stat_AR2::Park_Sonar_Ft_Md_Stat);
	snprintf(buffer, elcount(buffer), "   0.000000 F1 PARK::Park_Set_Stat_AR2::Park_Sonar_Ft_Md_Stat = %d\n", intval);
	filePutString (buffer, elcount(buffer), hFile);
	intval = getSignal(CHASSIS::Park_Set_Stat_AR2::Park_Sonar_R_Md_Stat);
	snprintf(buffer, elcount(buffer), "   0.000000 F1 PARK::Park_Set_Stat_AR2::Park_Sonar_R_Md_Stat = %d\n", intval);
	filePutString (buffer, elcount(buffer), hFile);
	intval = getSignal(CHASSIS::Park_Set_Stat_AR2::Park_AccelMd_Stat);
	snprintf(buffer, elcount(buffer), "   0.000000 F1 PARK::Park_Set_Stat_AR2::Park_AccelMd_Stat = %d\n", intval);
	filePutString (buffer, elcount(buffer), hFile);
	intval = getSignal(CHASSIS::Park_Set_Stat_AR2::Park_AttenuatMd_Stat);
	snprintf(buffer, elcount(buffer), "   0.000000 F1 PARK::Park_Set_Stat_AR2::Park_AttenuatMd_Stat = %d\n", intval);
	filePutString (buffer, elcount(buffer), hFile);
	intval = getSignal(CHASSIS::Park_Set_Stat_AR2::Park_BrkMd_Stat);
	snprintf(buffer, elcount(buffer), "   0.000000 F1 PARK::Park_Set_Stat_AR2::Park_BrkMd_Stat = %d\n", intval);
	filePutString (buffer, elcount(buffer), hFile);
	intval = getSignal(CHASSIS::Park_Set_Stat_AR2::Park_CTA_Md_Stat);
	snprintf(buffer, elcount(buffer), "   0.000000 F1 PARK::Park_Set_Stat_AR2::Park_CTA_Md_Stat = %d\n", intval);
	filePutString (buffer, elcount(buffer), hFile);
	intval = getSignal(CHASSIS::Park_Set_Stat_AR2::Park_ObjDtctMd_Stat);
	snprintf(buffer, elcount(buffer), "   0.000000 F1 PARK::Park_Set_Stat_AR2::Park_ObjDtctMd_Stat = %d\n", intval);
	filePutString (buffer, elcount(buffer), hFile);
	intval = getSignal(CHASSIS::Park_Set_Stat_AR2::Park_RevGrMd_Stat);
	snprintf(buffer, elcount(buffer), "   0.000000 F1 PARK::Park_Set_Stat_AR2::Park_RevGrMd_Stat = %d\n", intval);
	filePutString (buffer, elcount(buffer), hFile);
	intval = getSignal(CHASSIS::Park_Set_Stat_AR2::Park_StMd_Stat);
	snprintf(buffer, elcount(buffer), "   0.000000 F1 PARK::Park_Set_Stat_AR2::Park_StMd_Stat = %d\n", intval);
	filePutString (buffer, elcount(buffer), hFile);
	intval = getSignal(CHASSIS::Park_Set_Stat_AR2::Park_StyleMd_State);
	snprintf(buffer, elcount(buffer), "   0.000000 F1 PARK::Park_Set_Stat_AR2::Park_StyleMd_State = %d\n", intval);
	filePutString (buffer, elcount(buffer), hFile);
	intval = getSignal(CHASSIS::Park_Set_Stat_AR2::Park_Attenuat_Rq);
	snprintf(buffer, elcount(buffer), "   0.000000 F1 PARK::Park_Set_Stat_AR2::Park_Attenuat_Rq = %d\n", intval);
	filePutString (buffer, elcount(buffer), hFile);
	intval = @sysvar::CH_Nodes::CH_PARKCRC_ParkCfg_Stat_Pr2_AUTO;
	snprintf(buffer, elcount(buffer), "   0.000000    SV: 2 0 0 ::CH_Nodes::CH_PARKCRC_ParkCfg_Stat_Pr2_AUTO = %d\n", intval);
	filePutString (buffer, elcount(buffer), hFile);
	intval = getSignal(CHASSIS::Park_Stat_AR2::CRC_ParkCfg_Stat_Pr2);
	snprintf(buffer, elcount(buffer), "   0.000000 F1 PARK::Park_Stat_AR2::CRC_ParkCfg_Stat_Pr2 = %d\n", intval);
	filePutString (buffer, elcount(buffer), hFile);
	intval = @sysvar::CH_Nodes::CH_PARKSQC_ParkCfg_Stat_Pr2_AUTO;
	snprintf(buffer, elcount(buffer), "   0.000000    SV: 2 0 0 ::CH_Nodes::CH_PARKSQC_ParkCfg_Stat_Pr2_AUTO = %d\n", intval);
	filePutString (buffer, elcount(buffer), hFile);
	intval = getSignal(CHASSIS::Park_Stat_AR2::SQC_ParkCfg_Stat_Pr2);
	snprintf(buffer, elcount(buffer), "   0.000000 F1 PARK::Park_Stat_AR2::SQC_ParkCfg_Stat_Pr2 = %d\n", intval);
	filePutString (buffer, elcount(buffer), hFile);
	intval = getSignal(CHASSIS::Park_Stat_AR2::ParkGuid_Stat);
	snprintf(buffer, elcount(buffer), "   0.000000 F1 PARK::Park_Stat_AR2::ParkGuid_Stat = %d\n", intval);
	filePutString (buffer, elcount(buffer), hFile);
	intval = getSignal(CHASSIS::Park_Stat_AR2::Rsrv1_ParkCfg_Stat_Pr2);
	snprintf(buffer, elcount(buffer), "   0.000000 F1 PARK::Park_Stat_AR2::Rsrv1_ParkCfg_Stat_Pr2 = %d\n", intval);
	filePutString (buffer, elcount(buffer), hFile);
	intval = getSignal(CHASSIS::Park_Stat_AR2::Rsrv2_ParkCfg_Stat_Pr2);
	snprintf(buffer, elcount(buffer), "   0.000000 F1 PARK::Park_Stat_AR2::Rsrv2_ParkCfg_Stat_Pr2 = %d\n", intval);
	filePutString (buffer, elcount(buffer), hFile);
	intval = getSignal(CHASSIS::Park_Stat_AR2::ParkStyle_V2);
	snprintf(buffer, elcount(buffer), "   0.000000 F1 PARK::Park_Stat_AR2::ParkStyle_V2 = %d\n", intval);
	filePutString (buffer, elcount(buffer), hFile);
	intval = @sysvar::CH_Nodes::CH_PARKCRC_ParkSensObj_Stat_AUTO;
	snprintf(buffer, elcount(buffer), "   0.000000    SV: 2 0 0 ::CH_Nodes::CH_PARKCRC_ParkSensObj_Stat_AUTO = %d\n", intval);
	filePutString (buffer, elcount(buffer), hFile);
	intval = getSignal(CHASSIS::ParkSensObj_Stat1_FR2::CRC_ParkSensObj_Stat1_Pr2);
	snprintf(buffer, elcount(buffer), "   0.000000 F1 PARK::ParkSensObj_Stat1_FR2::CRC_ParkSensObj_Stat1_Pr2 = %d\n", intval);
	filePutString (buffer, elcount(buffer), hFile);
	intval = @sysvar::CH_Nodes::CH_PARKSQC_ParkSensObj_Stat_AUTO;
	snprintf(buffer, elcount(buffer), "   0.000000    SV: 2 0 0 ::CH_Nodes::CH_PARKSQC_ParkSensObj_Stat_AUTO = %d\n", intval);
	filePutString (buffer, elcount(buffer), hFile);
	intval = getSignal(CHASSIS::ParkSensObj_Stat1_FR2::SQC_ParkSensObj_Stat1_Pr2);
	snprintf(buffer, elcount(buffer), "   0.000000 F1 PARK::ParkSensObj_Stat1_FR2::SQC_ParkSensObj_Stat1_Pr2 = %d\n", intval);
	filePutString (buffer, elcount(buffer), hFile);
	intval = getSignal(CHASSIS::ParkSensObj_Stat1_FR2::ParkSensObj_Radius0_ConfdcLvl);
	snprintf(buffer, elcount(buffer), "   0.000000 F1 PARK::ParkSensObj_Stat1_FR2::ParkSensObj_Radius0_ConfdcLvl = %d\n", intval);
	filePutString (buffer, elcount(buffer), hFile);
}
/*@@end*/

/*@@caplFunc:saveVars_90(dword):*/
void saveVars_90(dword hFile)
{
	intval = getSignal(CHASSIS::ParkSensObj_Stat1_FR2::ParkSensObj_Radius0);
	snprintf(buffer, elcount(buffer), "   0.000000 F1 PARK::ParkSensObj_Stat1_FR2::ParkSensObj_Radius0 = %d\n", intval);
	filePutString (buffer, elcount(buffer), hFile);
	intval = getSignal(CHASSIS::ParkSensObj_Stat1_FR2::ParkSensObj_Radius01);
	snprintf(buffer, elcount(buffer), "   0.000000 F1 PARK::ParkSensObj_Stat1_FR2::ParkSensObj_Radius01 = %d\n", intval);
	filePutString (buffer, elcount(buffer), hFile);
	intval = getSignal(CHASSIS::ParkSensObj_Stat1_FR2::ParkSensObj_Radius01_ConfdcLvl);
	snprintf(buffer, elcount(buffer), "   0.000000 F1 PARK::ParkSensObj_Stat1_FR2::ParkSensObj_Radius01_ConfdcLvl = %d\n", intval);
	filePutString (buffer, elcount(buffer), hFile);
	intval = getSignal(CHASSIS::ParkSensObj_Stat1_FR2::ParkSensObj_Radius10_ConfdcLvl);
	snprintf(buffer, elcount(buffer), "   0.000000 F1 PARK::ParkSensObj_Stat1_FR2::ParkSensObj_Radius10_ConfdcLvl = %d\n", intval);
	filePutString (buffer, elcount(buffer), hFile);
	intval = getSignal(CHASSIS::ParkSensObj_Stat1_FR2::ParkSensObj_Radius10);
	snprintf(buffer, elcount(buffer), "   0.000000 F1 PARK::ParkSensObj_Stat1_FR2::ParkSensObj_Radius10 = %d\n", intval);
	filePutString (buffer, elcount(buffer), hFile);
	intval = getSignal(CHASSIS::ParkSensObj_Stat1_FR2::ParkSensObj_Radius1);
	snprintf(buffer, elcount(buffer), "   0.000000 F1 PARK::ParkSensObj_Stat1_FR2::ParkSensObj_Radius1 = %d\n", intval);
	filePutString (buffer, elcount(buffer), hFile);
	intval = getSignal(CHASSIS::ParkSensObj_Stat1_FR2::ParkSensObj_Radius1_ConfdcLvl);
	snprintf(buffer, elcount(buffer), "   0.000000 F1 PARK::ParkSensObj_Stat1_FR2::ParkSensObj_Radius1_ConfdcLvl = %d\n", intval);
	filePutString (buffer, elcount(buffer), hFile);
	intval = getSignal(CHASSIS::ParkSensObj_Stat1_FR2::ParkSensObj_Radius12_ConfdcLvl);
	snprintf(buffer, elcount(buffer), "   0.000000 F1 PARK::ParkSensObj_Stat1_FR2::ParkSensObj_Radius12_ConfdcLvl = %d\n", intval);
	filePutString (buffer, elcount(buffer), hFile);
	intval = getSignal(CHASSIS::ParkSensObj_Stat1_FR2::ParkSensObj_Radius12);
	snprintf(buffer, elcount(buffer), "   0.000000 F1 PARK::ParkSensObj_Stat1_FR2::ParkSensObj_Radius12 = %d\n", intval);
	filePutString (buffer, elcount(buffer), hFile);
	intval = getSignal(CHASSIS::ParkSensObj_Stat1_FR2::ParkSensObj_Radius21);
	snprintf(buffer, elcount(buffer), "   0.000000 F1 PARK::ParkSensObj_Stat1_FR2::ParkSensObj_Radius21 = %d\n", intval);
	filePutString (buffer, elcount(buffer), hFile);
	intval = getSignal(CHASSIS::ParkSensObj_Stat1_FR2::ParkSensObj_Radius21_ConfdcLvl);
	snprintf(buffer, elcount(buffer), "   0.000000 F1 PARK::ParkSensObj_Stat1_FR2::ParkSensObj_Radius21_ConfdcLvl = %d\n", intval);
	filePutString (buffer, elcount(buffer), hFile);
	intval = getSignal(CHASSIS::ParkSensObj_Stat1_FR2::ParkSensObj_Radius2_ConfdcLvl);
	snprintf(buffer, elcount(buffer), "   0.000000 F1 PARK::ParkSensObj_Stat1_FR2::ParkSensObj_Radius2_ConfdcLvl = %d\n", intval);
	filePutString (buffer, elcount(buffer), hFile);
	intval = getSignal(CHASSIS::ParkSensObj_Stat1_FR2::ParkSensObj_Radius2);
	snprintf(buffer, elcount(buffer), "   0.000000 F1 PARK::ParkSensObj_Stat1_FR2::ParkSensObj_Radius2 = %d\n", intval);
	filePutString (buffer, elcount(buffer), hFile);
	intval = getSignal(CHASSIS::ParkSensObj_Stat1_FR2::ParkSensObj_Radius23);
	snprintf(buffer, elcount(buffer), "   0.000000 F1 PARK::ParkSensObj_Stat1_FR2::ParkSensObj_Radius23 = %d\n", intval);
	filePutString (buffer, elcount(buffer), hFile);
	intval = getSignal(CHASSIS::ParkSensObj_Stat1_FR2::ParkSensObj_Radius23_ConfdcLvl);
	snprintf(buffer, elcount(buffer), "   0.000000 F1 PARK::ParkSensObj_Stat1_FR2::ParkSensObj_Radius23_ConfdcLvl = %d\n", intval);
	filePutString (buffer, elcount(buffer), hFile);
	intval = getSignal(CHASSIS::ParkSensObj_Stat1_FR2::Rsrv1_ParkSensObj_Stat1_Pr2);
	snprintf(buffer, elcount(buffer), "   0.000000 F1 PARK::ParkSensObj_Stat1_FR2::Rsrv1_ParkSensObj_Stat1_Pr2 = %d\n", intval);
	filePutString (buffer, elcount(buffer), hFile);
	intval = getSignal(CHASSIS::ParkSensObj_Stat1_FR2::Rsrv2_ParkSensObj_Stat1_Pr2);
	snprintf(buffer, elcount(buffer), "   0.000000 F1 PARK::ParkSensObj_Stat1_FR2::Rsrv2_ParkSensObj_Stat1_Pr2 = %d\n", intval);
	filePutString (buffer, elcount(buffer), hFile);
	intval = @sysvar::CH_Nodes::CH_PARKCRC_ParkSensObj_Stat_A_01;
	snprintf(buffer, elcount(buffer), "   0.000000    SV: 2 0 0 ::CH_Nodes::CH_PARKCRC_ParkSensObj_Stat_A_01 = %d\n", intval);
	filePutString (buffer, elcount(buffer), hFile);
	intval = getSignal(CHASSIS::ParkSensObj_Stat2_FR2::CRC_ParkSensObj_Stat2_Pr2);
	snprintf(buffer, elcount(buffer), "   0.000000 F1 PARK::ParkSensObj_Stat2_FR2::CRC_ParkSensObj_Stat2_Pr2 = %d\n", intval);
	filePutString (buffer, elcount(buffer), hFile);
	intval = @sysvar::CH_Nodes::CH_PARKSQC_ParkSensObj_Stat_A_01;
	snprintf(buffer, elcount(buffer), "   0.000000    SV: 2 0 0 ::CH_Nodes::CH_PARKSQC_ParkSensObj_Stat_A_01 = %d\n", intval);
	filePutString (buffer, elcount(buffer), hFile);
	intval = getSignal(CHASSIS::ParkSensObj_Stat2_FR2::SQC_ParkSensObj_Stat2_Pr2);
	snprintf(buffer, elcount(buffer), "   0.000000 F1 PARK::ParkSensObj_Stat2_FR2::SQC_ParkSensObj_Stat2_Pr2 = %d\n", intval);
	filePutString (buffer, elcount(buffer), hFile);
	intval = getSignal(CHASSIS::ParkSensObj_Stat2_FR2::ParkSensObj_Radius32_ConfdcLvl);
	snprintf(buffer, elcount(buffer), "   0.000000 F1 PARK::ParkSensObj_Stat2_FR2::ParkSensObj_Radius32_ConfdcLvl = %d\n", intval);
	filePutString (buffer, elcount(buffer), hFile);
	intval = getSignal(CHASSIS::ParkSensObj_Stat2_FR2::ParkSensObj_Radius32);
	snprintf(buffer, elcount(buffer), "   0.000000 F1 PARK::ParkSensObj_Stat2_FR2::ParkSensObj_Radius32 = %d\n", intval);
	filePutString (buffer, elcount(buffer), hFile);
	intval = getSignal(CHASSIS::ParkSensObj_Stat2_FR2::ParkSensObj_Radius3);
	snprintf(buffer, elcount(buffer), "   0.000000 F1 PARK::ParkSensObj_Stat2_FR2::ParkSensObj_Radius3 = %d\n", intval);
	filePutString (buffer, elcount(buffer), hFile);
	intval = getSignal(CHASSIS::ParkSensObj_Stat2_FR2::ParkSensObj_Radius3_ConfdcLvl);
	snprintf(buffer, elcount(buffer), "   0.000000 F1 PARK::ParkSensObj_Stat2_FR2::ParkSensObj_Radius3_ConfdcLvl = %d\n", intval);
	filePutString (buffer, elcount(buffer), hFile);
	intval = getSignal(CHASSIS::ParkSensObj_Stat2_FR2::ParkSensObj_Radius34_ConfdcLvl);
	snprintf(buffer, elcount(buffer), "   0.000000 F1 PARK::ParkSensObj_Stat2_FR2::ParkSensObj_Radius34_ConfdcLvl = %d\n", intval);
	filePutString (buffer, elcount(buffer), hFile);
	intval = getSignal(CHASSIS::ParkSensObj_Stat2_FR2::ParkSensObj_Radius34);
	snprintf(buffer, elcount(buffer), "   0.000000 F1 PARK::ParkSensObj_Stat2_FR2::ParkSensObj_Radius34 = %d\n", intval);
	filePutString (buffer, elcount(buffer), hFile);
	intval = getSignal(CHASSIS::ParkSensObj_Stat2_FR2::ParkSensObj_Radius43);
	snprintf(buffer, elcount(buffer), "   0.000000 F1 PARK::ParkSensObj_Stat2_FR2::ParkSensObj_Radius43 = %d\n", intval);
	filePutString (buffer, elcount(buffer), hFile);
	intval = getSignal(CHASSIS::ParkSensObj_Stat2_FR2::ParkSensObj_Radius43_ConfdcLvl);
	snprintf(buffer, elcount(buffer), "   0.000000 F1 PARK::ParkSensObj_Stat2_FR2::ParkSensObj_Radius43_ConfdcLvl = %d\n", intval);
	filePutString (buffer, elcount(buffer), hFile);
	intval = getSignal(CHASSIS::ParkSensObj_Stat2_FR2::ParkSensObj_Radius4_ConfdcLvl);
	snprintf(buffer, elcount(buffer), "   0.000000 F1 PARK::ParkSensObj_Stat2_FR2::ParkSensObj_Radius4_ConfdcLvl = %d\n", intval);
	filePutString (buffer, elcount(buffer), hFile);
	intval = getSignal(CHASSIS::ParkSensObj_Stat2_FR2::ParkSensObj_Radius4);
	snprintf(buffer, elcount(buffer), "   0.000000 F1 PARK::ParkSensObj_Stat2_FR2::ParkSensObj_Radius4 = %d\n", intval);
	filePutString (buffer, elcount(buffer), hFile);
	intval = getSignal(CHASSIS::ParkSensObj_Stat2_FR2::ParkSensObj_Radius45);
	snprintf(buffer, elcount(buffer), "   0.000000 F1 PARK::ParkSensObj_Stat2_FR2::ParkSensObj_Radius45 = %d\n", intval);
	filePutString (buffer, elcount(buffer), hFile);
	intval = getSignal(CHASSIS::ParkSensObj_Stat2_FR2::ParkSensObj_Radius45_ConfdcLvl);
	snprintf(buffer, elcount(buffer), "   0.000000 F1 PARK::ParkSensObj_Stat2_FR2::ParkSensObj_Radius45_ConfdcLvl = %d\n", intval);
	filePutString (buffer, elcount(buffer), hFile);
	intval = getSignal(CHASSIS::ParkSensObj_Stat2_FR2::ParkSensObj_Radius54_ConfdcLvl);
	snprintf(buffer, elcount(buffer), "   0.000000 F1 PARK::ParkSensObj_Stat2_FR2::ParkSensObj_Radius54_ConfdcLvl = %d\n", intval);
	filePutString (buffer, elcount(buffer), hFile);
	intval = getSignal(CHASSIS::ParkSensObj_Stat2_FR2::ParkSensObj_Radius54);
	snprintf(buffer, elcount(buffer), "   0.000000 F1 PARK::ParkSensObj_Stat2_FR2::ParkSensObj_Radius54 = %d\n", intval);
	filePutString (buffer, elcount(buffer), hFile);
	intval = getSignal(CHASSIS::ParkSensObj_Stat2_FR2::ParkSensObj_Radius5);
	snprintf(buffer, elcount(buffer), "   0.000000 F1 PARK::ParkSensObj_Stat2_FR2::ParkSensObj_Radius5 = %d\n", intval);
	filePutString (buffer, elcount(buffer), hFile);
	intval = getSignal(CHASSIS::ParkSensObj_Stat2_FR2::ParkSensObj_Radius5_ConfdcLvl);
	snprintf(buffer, elcount(buffer), "   0.000000 F1 PARK::ParkSensObj_Stat2_FR2::ParkSensObj_Radius5_ConfdcLvl = %d\n", intval);
	filePutString (buffer, elcount(buffer), hFile);
	intval = getSignal(CHASSIS::ParkSensObj_Stat2_FR2::Rsrv1_ParkSensObj_Stat2_Pr2);
	snprintf(buffer, elcount(buffer), "   0.000000 F1 PARK::ParkSensObj_Stat2_FR2::Rsrv1_ParkSensObj_Stat2_Pr2 = %d\n", intval);
	filePutString (buffer, elcount(buffer), hFile);
	intval = getSignal(CHASSIS::ParkSensObj_Stat2_FR2::Rsrv2_ParkSensObj_Stat2_Pr2);
	snprintf(buffer, elcount(buffer), "   0.000000 F1 PARK::ParkSensObj_Stat2_FR2::Rsrv2_ParkSensObj_Stat2_Pr2 = %d\n", intval);
	filePutString (buffer, elcount(buffer), hFile);
	intval = getSignal(CHASSIS::ParkSpaceMeas_Stat_AR::ParkSpaceMeas_F_Actv);
	snprintf(buffer, elcount(buffer), "   0.000000 F1 PARK::ParkSpaceMeas_Stat_AR::ParkSpaceMeas_F_Actv = %d\n", intval);
	filePutString (buffer, elcount(buffer), hFile);
	intval = getSignal(CHASSIS::ParkSpaceMeas_Stat_AR::ParkSpaceMeas_R_Actv);
	snprintf(buffer, elcount(buffer), "   0.000000 F1 PARK::ParkSpaceMeas_Stat_AR::ParkSpaceMeas_R_Actv = %d\n", intval);
	filePutString (buffer, elcount(buffer), hFile);
	intval = getSignal(CHASSIS::ParkSpaceMeas_Stat_AR::ParkSys_Flt);
	snprintf(buffer, elcount(buffer), "   0.000000 F1 PARK::ParkSpaceMeas_Stat_AR::ParkSys_Flt = %d\n", intval);
	filePutString (buffer, elcount(buffer), hFile);
	intval = getSignal(CHASSIS::ParkSpaceMeas_Stat_AR::ParkSeg_F_OuterLt_ObstclDist);
	snprintf(buffer, elcount(buffer), "   0.000000 F1 PARK::ParkSpaceMeas_Stat_AR::ParkSeg_F_OuterLt_ObstclDist = %d\n", intval);
	filePutString (buffer, elcount(buffer), hFile);
	intval = getSignal(CHASSIS::ParkSpaceMeas_Stat_AR::ParkSeg_F_InnerLt_ObstclDist);
	snprintf(buffer, elcount(buffer), "   0.000000 F1 PARK::ParkSpaceMeas_Stat_AR::ParkSeg_F_InnerLt_ObstclDist = %d\n", intval);
	filePutString (buffer, elcount(buffer), hFile);
	intval = getSignal(CHASSIS::ParkSpaceMeas_Stat_AR::ParkSeg_F_InnerRt_ObstclDist);
	snprintf(buffer, elcount(buffer), "   0.000000 F1 PARK::ParkSpaceMeas_Stat_AR::ParkSeg_F_InnerRt_ObstclDist = %d\n", intval);
	filePutString (buffer, elcount(buffer), hFile);
	intval = getSignal(CHASSIS::ParkSpaceMeas_Stat_AR::ParkSeg_F_OuterRt_ObstclDist);
	snprintf(buffer, elcount(buffer), "   0.000000 F1 PARK::ParkSpaceMeas_Stat_AR::ParkSeg_F_OuterRt_ObstclDist = %d\n", intval);
	filePutString (buffer, elcount(buffer), hFile);
	intval = getSignal(CHASSIS::ParkSpaceMeas_Stat_AR::ParkSpace_FL_ObstclDist);
	snprintf(buffer, elcount(buffer), "   0.000000 F1 PARK::ParkSpaceMeas_Stat_AR::ParkSpace_FL_ObstclDist = %d\n", intval);
	filePutString (buffer, elcount(buffer), hFile);
	intval = getSignal(CHASSIS::ParkSpaceMeas_Stat_AR::ParkSpace_FR_ObstclDist);
	snprintf(buffer, elcount(buffer), "   0.000000 F1 PARK::ParkSpaceMeas_Stat_AR::ParkSpace_FR_ObstclDist = %d\n", intval);
	filePutString (buffer, elcount(buffer), hFile);
	intval = getSignal(CHASSIS::ParkSpaceMeas_Stat_AR::ParkSpace_RL_ObstclDist);
	snprintf(buffer, elcount(buffer), "   0.000000 F1 PARK::ParkSpaceMeas_Stat_AR::ParkSpace_RL_ObstclDist = %d\n", intval);
	filePutString (buffer, elcount(buffer), hFile);
	intval = getSignal(CHASSIS::ParkSpaceMeas_Stat_AR::ParkSpace_RR_ObstclDist);
	snprintf(buffer, elcount(buffer), "   0.000000 F1 PARK::ParkSpaceMeas_Stat_AR::ParkSpace_RR_ObstclDist = %d\n", intval);
	filePutString (buffer, elcount(buffer), hFile);
	intval = getSignal(CHASSIS::ParkSpaceMeas_Stat_AR::ParkSeg_R_OuterLt_ObstclDist);
	snprintf(buffer, elcount(buffer), "   0.000000 F1 PARK::ParkSpaceMeas_Stat_AR::ParkSeg_R_OuterLt_ObstclDist = %d\n", intval);
	filePutString (buffer, elcount(buffer), hFile);
	intval = getSignal(CHASSIS::ParkSpaceMeas_Stat_AR::ParkSeg_R_InnerLt_ObstclDist);
	snprintf(buffer, elcount(buffer), "   0.000000 F1 PARK::ParkSpaceMeas_Stat_AR::ParkSeg_R_InnerLt_ObstclDist = %d\n", intval);
	filePutString (buffer, elcount(buffer), hFile);
	intval = getSignal(CHASSIS::ParkSpaceMeas_Stat_AR::ParkSeg_R_InnerRt_ObstclDist);
	snprintf(buffer, elcount(buffer), "   0.000000 F1 PARK::ParkSpaceMeas_Stat_AR::ParkSeg_R_InnerRt_ObstclDist = %d\n", intval);
	filePutString (buffer, elcount(buffer), hFile);
}
/*@@end*/

/*@@caplFunc:saveVars_91(dword):*/
void saveVars_91(dword hFile)
{
	intval = getSignal(CHASSIS::ParkSpaceMeas_Stat_AR::ParkSeg_R_OuterRt_ObstclDist);
	snprintf(buffer, elcount(buffer), "   0.000000 F1 PARK::ParkSpaceMeas_Stat_AR::ParkSeg_R_OuterRt_ObstclDist = %d\n", intval);
	filePutString (buffer, elcount(buffer), hFile);
	intval = getSignal(CHASSIS::ParkWarn_AR2::ParkWarnElem_FL_Stat);
	snprintf(buffer, elcount(buffer), "   0.000000 F1 PARK::ParkWarn_AR2::ParkWarnElem_FL_Stat = %d\n", intval);
	filePutString (buffer, elcount(buffer), hFile);
	intval = getSignal(CHASSIS::ParkWarn_AR2::ParkWarnElem_FR_Stat);
	snprintf(buffer, elcount(buffer), "   0.000000 F1 PARK::ParkWarn_AR2::ParkWarnElem_FR_Stat = %d\n", intval);
	filePutString (buffer, elcount(buffer), hFile);
	intval = getSignal(CHASSIS::ParkWarn_AR2::ParkWarnSnd_FL);
	snprintf(buffer, elcount(buffer), "   0.000000 F1 PARK::ParkWarn_AR2::ParkWarnSnd_FL = %d\n", intval);
	filePutString (buffer, elcount(buffer), hFile);
	intval = getSignal(CHASSIS::ParkWarn_AR2::ParkWarnSnd_FR);
	snprintf(buffer, elcount(buffer), "   0.000000 F1 PARK::ParkWarn_AR2::ParkWarnSnd_FR = %d\n", intval);
	filePutString (buffer, elcount(buffer), hFile);
	intval = getSignal(CHASSIS::ParkWarn_AR2::ParkWarnVol_Ft);
	snprintf(buffer, elcount(buffer), "   0.000000 F1 PARK::ParkWarn_AR2::ParkWarnVol_Ft = %d\n", intval);
	filePutString (buffer, elcount(buffer), hFile);
	intval = getSignal(CHASSIS::ParkWarn_AR2::ParkSideProt_Lt_Warn_Rq);
	snprintf(buffer, elcount(buffer), "   0.000000 F1 PARK::ParkWarn_AR2::ParkSideProt_Lt_Warn_Rq = %d\n", intval);
	filePutString (buffer, elcount(buffer), hFile);
	intval = getSignal(CHASSIS::ParkWarn_AR2::ParkWarnFreq_Ft);
	snprintf(buffer, elcount(buffer), "   0.000000 F1 PARK::ParkWarn_AR2::ParkWarnFreq_Ft = %d\n", intval);
	filePutString (buffer, elcount(buffer), hFile);
	intval = getSignal(CHASSIS::ParkWarn_AR2::ParkWarnElem_RL_Stat);
	snprintf(buffer, elcount(buffer), "   0.000000 F1 PARK::ParkWarn_AR2::ParkWarnElem_RL_Stat = %d\n", intval);
	filePutString (buffer, elcount(buffer), hFile);
	intval = getSignal(CHASSIS::ParkWarn_AR2::ParkWarnElem_RR_Stat);
	snprintf(buffer, elcount(buffer), "   0.000000 F1 PARK::ParkWarn_AR2::ParkWarnElem_RR_Stat = %d\n", intval);
	filePutString (buffer, elcount(buffer), hFile);
	intval = getSignal(CHASSIS::ParkWarn_AR2::ParkWarnSnd_RL);
	snprintf(buffer, elcount(buffer), "   0.000000 F1 PARK::ParkWarn_AR2::ParkWarnSnd_RL = %d\n", intval);
	filePutString (buffer, elcount(buffer), hFile);
	intval = getSignal(CHASSIS::ParkWarn_AR2::ParkWarnSnd_RR);
	snprintf(buffer, elcount(buffer), "   0.000000 F1 PARK::ParkWarn_AR2::ParkWarnSnd_RR = %d\n", intval);
	filePutString (buffer, elcount(buffer), hFile);
	intval = getSignal(CHASSIS::ParkWarn_AR2::ParkWarnVol_R);
	snprintf(buffer, elcount(buffer), "   0.000000 F1 PARK::ParkWarn_AR2::ParkWarnVol_R = %d\n", intval);
	filePutString (buffer, elcount(buffer), hFile);
	intval = getSignal(CHASSIS::ParkWarn_AR2::ParkSideProt_Rt_Warn_Rq);
	snprintf(buffer, elcount(buffer), "   0.000000 F1 PARK::ParkWarn_AR2::ParkSideProt_Rt_Warn_Rq = %d\n", intval);
	filePutString (buffer, elcount(buffer), hFile);
	intval = getSignal(CHASSIS::ParkWarn_AR2::ParkWarnFreq_R);
	snprintf(buffer, elcount(buffer), "   0.000000 F1 PARK::ParkWarn_AR2::ParkWarnFreq_R = %d\n", intval);
	filePutString (buffer, elcount(buffer), hFile);
	intval = getSignal(CHASSIS::ParkWarn_AR2::ParkSwLED_Rq);
	snprintf(buffer, elcount(buffer), "   0.000000 F1 PARK::ParkWarn_AR2::ParkSwLED_Rq = %d\n", intval);
	filePutString (buffer, elcount(buffer), hFile);
	intval = getSignal(CHASSIS::ParkWarn_AR2::ParkWarnSnd_Ft_Rq);
	snprintf(buffer, elcount(buffer), "   0.000000 F1 PARK::ParkWarn_AR2::ParkWarnSnd_Ft_Rq = %d\n", intval);
	filePutString (buffer, elcount(buffer), hFile);
	intval = getSignal(CHASSIS::ParkWarn_AR2::ParkWarnSnd_R_Rq);
	snprintf(buffer, elcount(buffer), "   0.000000 F1 PARK::ParkWarn_AR2::ParkWarnSnd_R_Rq = %d\n", intval);
	filePutString (buffer, elcount(buffer), hFile);
	intval = getSignal(CHASSIS::ParkWarn_AR2::AcustWarn_Actv_PARK);
	snprintf(buffer, elcount(buffer), "   0.000000 F1 PARK::ParkWarn_AR2::AcustWarn_Actv_PARK = %d\n", intval);
	filePutString (buffer, elcount(buffer), hFile);
	intval = getSignal(CHASSIS::ParkWarn_AR2::PARK_TP_Flt);
	snprintf(buffer, elcount(buffer), "   0.000000 F1 PARK::ParkWarn_AR2::PARK_TP_Flt = %d\n", intval);
	filePutString (buffer, elcount(buffer), hFile);
	intval = getSignal(CHASSIS::ParkWarn_AR2::Park_Off);
	snprintf(buffer, elcount(buffer), "   0.000000 F1 PARK::ParkWarn_AR2::Park_Off = %d\n", intval);
	filePutString (buffer, elcount(buffer), hFile);
	intval = @sysvar::CH_Nodes::CH_PARKCRC_RemPark_Rq_Pr2Re_AUTO;
	snprintf(buffer, elcount(buffer), "   0.000000    SV: 2 0 0 ::CH_Nodes::CH_PARKCRC_RemPark_Rq_Pr2Re_AUTO = %d\n", intval);
	filePutString (buffer, elcount(buffer), hFile);
	intval = getSignal(CHASSIS::RemPark_Rq_AR2::CRC_RemPark_Rq_Pr2);
	snprintf(buffer, elcount(buffer), "   0.000000 F1 PARK::RemPark_Rq_AR2::CRC_RemPark_Rq_Pr2 = %d\n", intval);
	filePutString (buffer, elcount(buffer), hFile);
	intval = @sysvar::CH_Nodes::CH_PARKSQC_RemPark_Rq_Pr2Re_AUTO;
	snprintf(buffer, elcount(buffer), "   0.000000    SV: 2 0 0 ::CH_Nodes::CH_PARKSQC_RemPark_Rq_Pr2Re_AUTO = %d\n", intval);
	filePutString (buffer, elcount(buffer), hFile);
	intval = getSignal(CHASSIS::RemPark_Rq_AR2::SQC_RemPark_Rq_Pr2);
	snprintf(buffer, elcount(buffer), "   0.000000 F1 PARK::RemPark_Rq_AR2::SQC_RemPark_Rq_Pr2 = %d\n", intval);
	filePutString (buffer, elcount(buffer), hFile);
	intval = getSignal(CHASSIS::RemPark_Rq_AR2::KG_RemPark_Rq);
	snprintf(buffer, elcount(buffer), "   0.000000 F1 PARK::RemPark_Rq_AR2::KG_RemPark_Rq = %d\n", intval);
	filePutString (buffer, elcount(buffer), hFile);
	intval = getSignal(CHASSIS::RemPark_Rq_AR2::RemPark_Actv);
	snprintf(buffer, elcount(buffer), "   0.000000 F1 PARK::RemPark_Rq_AR2::RemPark_Actv = %d\n", intval);
	filePutString (buffer, elcount(buffer), hFile);
	intval = getSignal(CHASSIS::RemPark_Rq_AR2::RemPark_VehLk_Rq);
	snprintf(buffer, elcount(buffer), "   0.000000 F1 PARK::RemPark_Rq_AR2::RemPark_VehLk_Rq = %d\n", intval);
	filePutString (buffer, elcount(buffer), hFile);
	intval = getSignal(CHASSIS::RemPark_Rq_AR2::TurnInd_Rq_RemPark);
	snprintf(buffer, elcount(buffer), "   0.000000 F1 PARK::RemPark_Rq_AR2::TurnInd_Rq_RemPark = %d\n", intval);
	filePutString (buffer, elcount(buffer), hFile);
	intval = getSignal(CHASSIS::RemPark_Rq_AR2::EIS_RemPark_Rq);
	snprintf(buffer, elcount(buffer), "   0.000000 F1 PARK::RemPark_Rq_AR2::EIS_RemPark_Rq = %d\n", intval);
	filePutString (buffer, elcount(buffer), hFile);
	intval = getSignal(CHASSIS::RemPark_Rq_AR2::RemPark_Auth_Rq);
	snprintf(buffer, elcount(buffer), "   0.000000 F1 PARK::RemPark_Rq_AR2::RemPark_Auth_Rq = %d\n", intval);
	filePutString (buffer, elcount(buffer), hFile);
	intval = getSignal(CHASSIS::RemPark_Rq_AR2::Rsrv3_RemPark_Rq_Pr2);
	snprintf(buffer, elcount(buffer), "   0.000000 F1 PARK::RemPark_Rq_AR2::Rsrv3_RemPark_Rq_Pr2 = %d\n", intval);
	filePutString (buffer, elcount(buffer), hFile);
	intval = getSignal(CHASSIS::RemPark_Rq_AR2::MirrFld_Rq_RemPark);
	snprintf(buffer, elcount(buffer), "   0.000000 F1 PARK::RemPark_Rq_AR2::MirrFld_Rq_RemPark = %d\n", intval);
	filePutString (buffer, elcount(buffer), hFile);
	intval = getSignal(CHASSIS::ROE_PARK::ROE_Header_PARK);
	snprintf(buffer, elcount(buffer), "   0.000000 F1 PARK::ROE_PARK::ROE_Header_PARK = %d\n", intval);
	filePutString (buffer, elcount(buffer), hFile);
	intval = getSignal(CHASSIS::ROE_PARK::ROE_DTC_PARK);
	snprintf(buffer, elcount(buffer), "   0.000000 F1 PARK::ROE_PARK::ROE_DTC_PARK = %d\n", intval);
	filePutString (buffer, elcount(buffer), hFile);
	intval = getSignal(CHASSIS::ROE_PARK::ROE_DTC_Stat_PARK);
	snprintf(buffer, elcount(buffer), "   0.000000 F1 PARK::ROE_PARK::ROE_DTC_Stat_PARK = %d\n", intval);
	filePutString (buffer, elcount(buffer), hFile);
	intval = getSignal(CHASSIS::RVC_SVS_Park_Stat_AR2::PARK_StartList_Rq);
	snprintf(buffer, elcount(buffer), "   0.000000 F1 PARK::RVC_SVS_Park_Stat_AR2::PARK_StartList_Rq = %d\n", intval);
	filePutString (buffer, elcount(buffer), hFile);
	intval = getSignal(CHASSIS::RVC_SVS_Park_Stat_AR2::DRVM_Warn_Rq);
	snprintf(buffer, elcount(buffer), "   0.000000 F1 PARK::RVC_SVS_Park_Stat_AR2::DRVM_Warn_Rq = %d\n", intval);
	filePutString (buffer, elcount(buffer), hFile);
	intval = getSignal(CHASSIS::RVC_SVS_Park_Stat_AR2::RVC_CPF_R_Rq);
	snprintf(buffer, elcount(buffer), "   0.000000 F1 PARK::RVC_SVS_Park_Stat_AR2::RVC_CPF_R_Rq = %d\n", intval);
	filePutString (buffer, elcount(buffer), hFile);
	intval = getSignal(CHASSIS::RVC_SVS_Park_Stat_AR2::DRVM_SysMd_Stat_V2);
	snprintf(buffer, elcount(buffer), "   0.000000 F1 PARK::RVC_SVS_Park_Stat_AR2::DRVM_SysMd_Stat_V2 = %d\n", intval);
	filePutString (buffer, elcount(buffer), hFile);
	intval = getSignal(CHASSIS::RVC_SVS_Park_Stat_AR2::DRVM_PkMd_Stat_V3);
	snprintf(buffer, elcount(buffer), "   0.000000 F1 PARK::RVC_SVS_Park_Stat_AR2::DRVM_PkMd_Stat_V3 = %d\n", intval);
	filePutString (buffer, elcount(buffer), hFile);
	intval = getSignal(CHASSIS::RVC_SVS_Park_Stat_AR2::PARK_SelMenu_Rq);
	snprintf(buffer, elcount(buffer), "   0.000000 F1 PARK::RVC_SVS_Park_Stat_AR2::PARK_SelMenu_Rq = %d\n", intval);
	filePutString (buffer, elcount(buffer), hFile);
	intval = getSignal(CHASSIS::RVC_SVS_Park_Stat_AR2::PARK_SysMd_Rq_Cam);
	snprintf(buffer, elcount(buffer), "   0.000000 F1 PARK::RVC_SVS_Park_Stat_AR2::PARK_SysMd_Rq_Cam = %d\n", intval);
	filePutString (buffer, elcount(buffer), hFile);
	intval = getSignal(CHASSIS::RVC_SVS_Park_Stat_AR2::SVS_CPF_R_Rq);
	snprintf(buffer, elcount(buffer), "   0.000000 F1 PARK::RVC_SVS_Park_Stat_AR2::SVS_CPF_R_Rq = %d\n", intval);
	filePutString (buffer, elcount(buffer), hFile);
	intval = getSignal(CHASSIS::RVC_SVS_Park_Stat_AR2::SVS_CPF_Ft_Rq);
	snprintf(buffer, elcount(buffer), "   0.000000 F1 PARK::RVC_SVS_Park_Stat_AR2::SVS_CPF_Ft_Rq = %d\n", intval);
	filePutString (buffer, elcount(buffer), hFile);
	intval = getSignal(CHASSIS::RVC_SVS_Park_Stat_AR2::SVS_ExtLmp_Rq);
	snprintf(buffer, elcount(buffer), "   0.000000 F1 PARK::RVC_SVS_Park_Stat_AR2::SVS_ExtLmp_Rq = %d\n", intval);
	filePutString (buffer, elcount(buffer), hFile);
	intval = getSignal(CHASSIS::RVC_SVS_Park_Stat_AR2::Park_Row1_MsgDisp_Rq);
	snprintf(buffer, elcount(buffer), "   0.000000 F1 PARK::RVC_SVS_Park_Stat_AR2::Park_Row1_MsgDisp_Rq = %d\n", intval);
	filePutString (buffer, elcount(buffer), hFile);
	intval = getSignal(CHASSIS::RVC_SVS_Park_Stat_AR2::PARK_SlotStartPosn_Rq);
	snprintf(buffer, elcount(buffer), "   0.000000 F1 PARK::RVC_SVS_Park_Stat_AR2::PARK_SlotStartPosn_Rq = %d\n", intval);
	filePutString (buffer, elcount(buffer), hFile);
	intval = getSignal(CHASSIS::RVC_SVS_Park_Stat_AR2::PARK_Detents_Rq);
	snprintf(buffer, elcount(buffer), "   0.000000 F1 PARK::RVC_SVS_Park_Stat_AR2::PARK_Detents_Rq = %d\n", intval);
	filePutString (buffer, elcount(buffer), hFile);
	intval = getSignal(CHASSIS::RVC_SVS_Park_Stat_AR2::Park_Row2_MsgDisp_Rq);
	snprintf(buffer, elcount(buffer), "   0.000000 F1 PARK::RVC_SVS_Park_Stat_AR2::Park_Row2_MsgDisp_Rq = %d\n", intval);
	filePutString (buffer, elcount(buffer), hFile);
	intval = getSignal(CHASSIS::RVC_SVS_Park_Stat_AR2::Park_ExplorMd_Avl);
	snprintf(buffer, elcount(buffer), "   0.000000 F1 PARK::RVC_SVS_Park_Stat_AR2::Park_ExplorMd_Avl = %d\n", intval);
	filePutString (buffer, elcount(buffer), hFile);
	intval = getSignal(CHASSIS::RVC_SVS_Park_Stat_AR2::PARK_Detents2_Rq);
	snprintf(buffer, elcount(buffer), "   0.000000 F1 PARK::RVC_SVS_Park_Stat_AR2::PARK_Detents2_Rq = %d\n", intval);
	filePutString (buffer, elcount(buffer), hFile);
	intval = getSignal(CHASSIS::RVC_SVS_Park_Stat_AR2::PARK_Detents3_Rq);
	snprintf(buffer, elcount(buffer), "   0.000000 F1 PARK::RVC_SVS_Park_Stat_AR2::PARK_Detents3_Rq = %d\n", intval);
	filePutString (buffer, elcount(buffer), hFile);
}
/*@@end*/

/*@@caplFunc:saveVars_92(dword):*/
void saveVars_92(dword hFile)
{
	intval = getSignal(CHASSIS::RVC_SVS_Park_Stat_AR2::PARK_SlotStartPosn2_Rq);
	snprintf(buffer, elcount(buffer), "   0.000000 F1 PARK::RVC_SVS_Park_Stat_AR2::PARK_SlotStartPosn2_Rq = %d\n", intval);
	filePutString (buffer, elcount(buffer), hFile);
	intval = getSignal(CHASSIS::RVC_SVS_Park_Stat_AR2::PARK_SlotStartPosn3_Rq);
	snprintf(buffer, elcount(buffer), "   0.000000 F1 PARK::RVC_SVS_Park_Stat_AR2::PARK_SlotStartPosn3_Rq = %d\n", intval);
	filePutString (buffer, elcount(buffer), hFile);
	intval = @sysvar::CH_Nodes::CH_PARKCRC_SADR_Trgr_PARK_P_AUTO;
	snprintf(buffer, elcount(buffer), "   0.000000    SV: 2 0 0 ::CH_Nodes::CH_PARKCRC_SADR_Trgr_PARK_P_AUTO = %d\n", intval);
	filePutString (buffer, elcount(buffer), hFile);
	intval = getSignal(CHASSIS::SADR_Trgr_PARK_AR2::CRC_SADR_Trgr_PARK_Pr2);
	snprintf(buffer, elcount(buffer), "   0.000000 F1 PARK::SADR_Trgr_PARK_AR2::CRC_SADR_Trgr_PARK_Pr2 = %d\n", intval);
	filePutString (buffer, elcount(buffer), hFile);
	intval = @sysvar::CH_Nodes::CH_PARKSQC_SADR_Trgr_PARK_P_AUTO;
	snprintf(buffer, elcount(buffer), "   0.000000    SV: 2 0 0 ::CH_Nodes::CH_PARKSQC_SADR_Trgr_PARK_P_AUTO = %d\n", intval);
	filePutString (buffer, elcount(buffer), hFile);
	intval = getSignal(CHASSIS::SADR_Trgr_PARK_AR2::SQC_SADR_Trgr_PARK_Pr2);
	snprintf(buffer, elcount(buffer), "   0.000000 F1 PARK::SADR_Trgr_PARK_AR2::SQC_SADR_Trgr_PARK_Pr2 = %d\n", intval);
	filePutString (buffer, elcount(buffer), hFile);
	intval = getSignal(CHASSIS::SADR_Trgr_PARK_AR2::SADR_TrgrPrio_PARK);
	snprintf(buffer, elcount(buffer), "   0.000000 F1 PARK::SADR_Trgr_PARK_AR2::SADR_TrgrPrio_PARK = %d\n", intval);
	filePutString (buffer, elcount(buffer), hFile);
	intval = getSignal(CHASSIS::SADR_Trgr_PARK_AR2::Rsrv2_SADR_Trgr_PARK_Pr2);
	snprintf(buffer, elcount(buffer), "   0.000000 F1 PARK::SADR_Trgr_PARK_AR2::Rsrv2_SADR_Trgr_PARK_Pr2 = %d\n", intval);
	filePutString (buffer, elcount(buffer), hFile);
	intval = getSignal(CHASSIS::SADR_Trgr_PARK_AR2::SADR_TrgrTm_PARK);
	snprintf(buffer, elcount(buffer), "   0.000000 F1 PARK::SADR_Trgr_PARK_AR2::SADR_TrgrTm_PARK = %d\n", intval);
	filePutString (buffer, elcount(buffer), hFile);
	intval = getSignal(CHASSIS::SADR_Trgr_PARK_AR2::Rsrv1_SADR_Trgr_PARK_Pr2);
	snprintf(buffer, elcount(buffer), "   0.000000 F1 PARK::SADR_Trgr_PARK_AR2::Rsrv1_SADR_Trgr_PARK_Pr2 = %d\n", intval);
	filePutString (buffer, elcount(buffer), hFile);
	intval = @sysvar::CH_Nodes::CH_PARKCRC_St_Rq_PARK_Pr2St_AUTO;
	snprintf(buffer, elcount(buffer), "   0.000000    SV: 2 0 0 ::CH_Nodes::CH_PARKCRC_St_Rq_PARK_Pr2St_AUTO = %d\n", intval);
	filePutString (buffer, elcount(buffer), hFile);
	intval = getSignal(CHASSIS::St_Rq_PARK_AR2::CRC_St_Rq_PARK_Pr2);
	snprintf(buffer, elcount(buffer), "   0.000000 F1 PARK::St_Rq_PARK_AR2::CRC_St_Rq_PARK_Pr2 = %d\n", intval);
	filePutString (buffer, elcount(buffer), hFile);
	intval = @sysvar::CH_Nodes::CH_PARKSQC_St_Rq_PARK_Pr2St_AUTO;
	snprintf(buffer, elcount(buffer), "   0.000000    SV: 2 0 0 ::CH_Nodes::CH_PARKSQC_St_Rq_PARK_Pr2St_AUTO = %d\n", intval);
	filePutString (buffer, elcount(buffer), hFile);
	intval = getSignal(CHASSIS::St_Rq_PARK_AR2::SQC_St_Rq_PARK_Pr2);
	snprintf(buffer, elcount(buffer), "   0.000000 F1 PARK::St_Rq_PARK_AR2::SQC_St_Rq_PARK_Pr2 = %d\n", intval);
	filePutString (buffer, elcount(buffer), hFile);
	intval = getSignal(CHASSIS::St_Rq_PARK_AR2::PARK_Stat_PARK);
	snprintf(buffer, elcount(buffer), "   0.000000 F1 PARK::St_Rq_PARK_AR2::PARK_Stat_PARK = %d\n", intval);
	filePutString (buffer, elcount(buffer), hFile);
	intval = getSignal(CHASSIS::St_Rq_PARK_AR2::PPS_AddRf_Rq);
	snprintf(buffer, elcount(buffer), "   0.000000 F1 PARK::St_Rq_PARK_AR2::PPS_AddRf_Rq = %d\n", intval);
	filePutString (buffer, elcount(buffer), hFile);
	intval = getSignal(CHASSIS::St_Rq_PARK_AR2::PPS_Stat_PARK);
	snprintf(buffer, elcount(buffer), "   0.000000 F1 PARK::St_Rq_PARK_AR2::PPS_Stat_PARK = %d\n", intval);
	filePutString (buffer, elcount(buffer), hFile);
	floatval = getSignal(CHASSIS::St_Rq_PARK_AR2::FtWhlAngl_Rq_PARK);
	snprintf(buffer, elcount(buffer), "   0.000000 F1 PARK::St_Rq_PARK_AR2::FtWhlAngl_Rq_PARK = %f\n", floatval);
	filePutString (buffer, elcount(buffer), hFile);
	intval = getSignal(CHASSIS::St_Rq_PARK_AR2::PARK_Sp_Stat);
	snprintf(buffer, elcount(buffer), "   0.000000 F1 PARK::St_Rq_PARK_AR2::PARK_Sp_Stat = %d\n", intval);
	filePutString (buffer, elcount(buffer), hFile);
	intval = getSignal(CHASSIS::St_Rq_PARK_AR2::Rsrv2_St_Rq_PARK_Pr2);
	snprintf(buffer, elcount(buffer), "   0.000000 F1 PARK::St_Rq_PARK_AR2::Rsrv2_St_Rq_PARK_Pr2 = %d\n", intval);
	filePutString (buffer, elcount(buffer), hFile);
	snprintf(buffer, elcount(buffer), "   0.000000    SV: 2 0 0 ::CH_Nodes::CH__NMActive_RDU = %X\n", @sysvar::CH_Nodes::CH__NMActive_RDU);
	filePutString (buffer, elcount(buffer), hFile);
	snprintf(buffer, elcount(buffer), "   0.000000    SV: 2 0 0 ::CH_Nodes::CH__NMAwake_RDU = %X\n", @sysvar::CH_Nodes::CH__NMAwake_RDU);
	filePutString (buffer, elcount(buffer), hFile);
	intval = @sysvar::CH_Nodes::CH_RDUCRC_Brk_Rq_YMAS_Pr2Br_AUTO;
	snprintf(buffer, elcount(buffer), "   0.000000    SV: 2 0 0 ::CH_Nodes::CH_RDUCRC_Brk_Rq_YMAS_Pr2Br_AUTO = %d\n", intval);
	filePutString (buffer, elcount(buffer), hFile);
	intval = getSignal(CHASSIS::BrkSys_Rq_YMAS_AR2::CRC_Brk_Rq_YMAS_Pr2);
	snprintf(buffer, elcount(buffer), "   0.000000 F1 RDU::BrkSys_Rq_YMAS_AR2::CRC_Brk_Rq_YMAS_Pr2 = %d\n", intval);
	filePutString (buffer, elcount(buffer), hFile);
	intval = @sysvar::CH_Nodes::CH_RDUSQC_Brk_Rq_YMAS_Pr2Br_AUTO;
	snprintf(buffer, elcount(buffer), "   0.000000    SV: 2 0 0 ::CH_Nodes::CH_RDUSQC_Brk_Rq_YMAS_Pr2Br_AUTO = %d\n", intval);
	filePutString (buffer, elcount(buffer), hFile);
	intval = getSignal(CHASSIS::BrkSys_Rq_YMAS_AR2::SQC_Brk_Rq_YMAS_Pr2);
	snprintf(buffer, elcount(buffer), "   0.000000 F1 RDU::BrkSys_Rq_YMAS_AR2::SQC_Brk_Rq_YMAS_Pr2 = %d\n", intval);
	filePutString (buffer, elcount(buffer), hFile);
	intval = getSignal(CHASSIS::BrkSys_Rq_YMAS_AR2::YMAS_BrkSrc);
	snprintf(buffer, elcount(buffer), "   0.000000 F1 RDU::BrkSys_Rq_YMAS_AR2::YMAS_BrkSrc = %d\n", intval);
	filePutString (buffer, elcount(buffer), hFile);
	floatval = getSignal(CHASSIS::BrkSys_Rq_YMAS_AR2::VehYawRate_Rq_YMAS);
	snprintf(buffer, elcount(buffer), "   0.000000 F1 RDU::BrkSys_Rq_YMAS_AR2::VehYawRate_Rq_YMAS = %f\n", floatval);
	filePutString (buffer, elcount(buffer), hFile);
	intval = getSignal(CHASSIS::BrkSys_Rq_YMAS_AR2::VehYawMoment_Ft_Rq);
	snprintf(buffer, elcount(buffer), "   0.000000 F1 RDU::BrkSys_Rq_YMAS_AR2::VehYawMoment_Ft_Rq = %d\n", intval);
	filePutString (buffer, elcount(buffer), hFile);
	intval = getSignal(CHASSIS::BrkSys_Rq_YMAS_AR2::Rsrv1_Brk_Rq_YMAS_Pr2);
	snprintf(buffer, elcount(buffer), "   0.000000 F1 RDU::BrkSys_Rq_YMAS_AR2::Rsrv1_Brk_Rq_YMAS_Pr2 = %d\n", intval);
	filePutString (buffer, elcount(buffer), hFile);
	intval = getSignal(CHASSIS::BrkSys_Rq_YMAS_AR2::VehYawMoment_R_Rq);
	snprintf(buffer, elcount(buffer), "   0.000000 F1 RDU::BrkSys_Rq_YMAS_AR2::VehYawMoment_R_Rq = %d\n", intval);
	filePutString (buffer, elcount(buffer), hFile);
	intval = getSignal(CHASSIS::BrkSys_Rq_YMAS_AR2::Rsrv2_Brk_Rq_YMAS_Pr2);
	snprintf(buffer, elcount(buffer), "   0.000000 F1 RDU::BrkSys_Rq_YMAS_AR2::Rsrv2_Brk_Rq_YMAS_Pr2 = %d\n", intval);
	filePutString (buffer, elcount(buffer), hFile);
	intval = getSignal(CHASSIS::BrkSys_Rq_YMAS_AR2::YMAS_Ok);
	snprintf(buffer, elcount(buffer), "   0.000000 F1 RDU::BrkSys_Rq_YMAS_AR2::YMAS_Ok = %d\n", intval);
	filePutString (buffer, elcount(buffer), hFile);
	floatval = getSignal(CHASSIS::BSM_Disp_Warn_Rq_Gw_AR2::BSM_ObjCls_Lt_Dist_Y);
	snprintf(buffer, elcount(buffer), "   0.000000 F1 RDU::BSM_Disp_Warn_Rq_Gw_AR2::BSM_ObjCls_Lt_Dist_Y = %f\n", floatval);
	filePutString (buffer, elcount(buffer), hFile);
	floatval = getSignal(CHASSIS::BSM_Disp_Warn_Rq_Gw_AR2::BSM_ObjCls_Rt_Dist_Y);
	snprintf(buffer, elcount(buffer), "   0.000000 F1 RDU::BSM_Disp_Warn_Rq_Gw_AR2::BSM_ObjCls_Rt_Dist_Y = %f\n", floatval);
	filePutString (buffer, elcount(buffer), hFile);
	intval = getSignal(CHASSIS::BSM_Disp_Warn_Rq_Gw_AR2::BSM_ObjCls_Lt_Type);
	snprintf(buffer, elcount(buffer), "   0.000000 F1 RDU::BSM_Disp_Warn_Rq_Gw_AR2::BSM_ObjCls_Lt_Type = %d\n", intval);
	filePutString (buffer, elcount(buffer), hFile);
	intval = getSignal(CHASSIS::BSM_Disp_Warn_Rq_Gw_AR2::BSM_ObjCls_Rt_Type);
	snprintf(buffer, elcount(buffer), "   0.000000 F1 RDU::BSM_Disp_Warn_Rq_Gw_AR2::BSM_ObjCls_Rt_Type = %d\n", intval);
	filePutString (buffer, elcount(buffer), hFile);
	intval = getSignal(CHASSIS::BSM_Disp_Warn_Rq_Gw_AR2::BSM_Md_Stat);
	snprintf(buffer, elcount(buffer), "   0.000000 F1 RDU::BSM_Disp_Warn_Rq_Gw_AR2::BSM_Md_Stat = %d\n", intval);
	filePutString (buffer, elcount(buffer), hFile);
	intval = getSignal(CHASSIS::BSM_Disp_Warn_Rq_Gw_AR2::CTA_Brk_Rq);
	snprintf(buffer, elcount(buffer), "   0.000000 F1 RDU::BSM_Disp_Warn_Rq_Gw_AR2::CTA_Brk_Rq = %d\n", intval);
	filePutString (buffer, elcount(buffer), hFile);
	intval = getSignal(CHASSIS::BSM_Disp_Warn_Rq_Gw_AR2::CTA_Stat);
	snprintf(buffer, elcount(buffer), "   0.000000 F1 RDU::BSM_Disp_Warn_Rq_Gw_AR2::CTA_Stat = %d\n", intval);
	filePutString (buffer, elcount(buffer), hFile);
	intval = getSignal(CHASSIS::BSM_Disp_Warn_Rq_Gw_AR2::CTA_Warn_Lt_Rq);
	snprintf(buffer, elcount(buffer), "   0.000000 F1 RDU::BSM_Disp_Warn_Rq_Gw_AR2::CTA_Warn_Lt_Rq = %d\n", intval);
	filePutString (buffer, elcount(buffer), hFile);
	intval = getSignal(CHASSIS::BSM_Disp_Warn_Rq_Gw_AR2::CTA_Warn_Rt_Rq);
	snprintf(buffer, elcount(buffer), "   0.000000 F1 RDU::BSM_Disp_Warn_Rq_Gw_AR2::CTA_Warn_Rt_Rq = %d\n", intval);
	filePutString (buffer, elcount(buffer), hFile);
	intval = getSignal(CHASSIS::BSM_Disp_Warn_Rq_Gw_AR2::BSM_MsgDisp_Rq);
	snprintf(buffer, elcount(buffer), "   0.000000 F1 RDU::BSM_Disp_Warn_Rq_Gw_AR2::BSM_MsgDisp_Rq = %d\n", intval);
	filePutString (buffer, elcount(buffer), hFile);
	intval = getSignal(CHASSIS::BSM_Disp_Warn_Rq_Gw_AR2::BSM_AcustWarn_Rt_Rq);
	snprintf(buffer, elcount(buffer), "   0.000000 F1 RDU::BSM_Disp_Warn_Rq_Gw_AR2::BSM_AcustWarn_Rt_Rq = %d\n", intval);
	filePutString (buffer, elcount(buffer), hFile);
	intval = getSignal(CHASSIS::BSM_Disp_Warn_Rq_Gw_AR2::BSM_Stat);
	snprintf(buffer, elcount(buffer), "   0.000000 F1 RDU::BSM_Disp_Warn_Rq_Gw_AR2::BSM_Stat = %d\n", intval);
	filePutString (buffer, elcount(buffer), hFile);
	intval = getSignal(CHASSIS::BSM_Disp_Warn_Rq_Gw_AR2::BSM_AcustWarn_Rq);
	snprintf(buffer, elcount(buffer), "   0.000000 F1 RDU::BSM_Disp_Warn_Rq_Gw_AR2::BSM_AcustWarn_Rq = %d\n", intval);
	filePutString (buffer, elcount(buffer), hFile);
	intval = getSignal(CHASSIS::BSM_Disp_Warn_Rq_Gw_AR2::BSM_AcustWarn_Lt_Rq);
	snprintf(buffer, elcount(buffer), "   0.000000 F1 RDU::BSM_Disp_Warn_Rq_Gw_AR2::BSM_AcustWarn_Lt_Rq = %d\n", intval);
	filePutString (buffer, elcount(buffer), hFile);
	intval = getSignal(CHASSIS::BSM_Disp_Warn_Rq_Gw_AR2::LCMS_BrkMsgDisp_Rq);
	snprintf(buffer, elcount(buffer), "   0.000000 F1 RDU::BSM_Disp_Warn_Rq_Gw_AR2::LCMS_BrkMsgDisp_Rq = %d\n", intval);
	filePutString (buffer, elcount(buffer), hFile);
	intval = getSignal(CHASSIS::BSM_Disp_Warn_Rq_Gw_AR2::LCMS_MsgDisp_Rq);
	snprintf(buffer, elcount(buffer), "   0.000000 F1 RDU::BSM_Disp_Warn_Rq_Gw_AR2::LCMS_MsgDisp_Rq = %d\n", intval);
	filePutString (buffer, elcount(buffer), hFile);
	intval = getSignal(CHASSIS::BSM_Disp_Warn_Rq_Gw_AR2::LCMS_Beep_Rq);
	snprintf(buffer, elcount(buffer), "   0.000000 F1 RDU::BSM_Disp_Warn_Rq_Gw_AR2::LCMS_Beep_Rq = %d\n", intval);
	filePutString (buffer, elcount(buffer), hFile);
	intval = getSignal(CHASSIS::BSM_Disp_Warn_Rq_Gw_AR2::BSM_Warn_Lt_Rq);
	snprintf(buffer, elcount(buffer), "   0.000000 F1 RDU::BSM_Disp_Warn_Rq_Gw_AR2::BSM_Warn_Lt_Rq = %d\n", intval);
	filePutString (buffer, elcount(buffer), hFile);
	intval = getSignal(CHASSIS::BSM_Disp_Warn_Rq_Gw_AR2::BSM_Warn_Rt_Rq);
	snprintf(buffer, elcount(buffer), "   0.000000 F1 RDU::BSM_Disp_Warn_Rq_Gw_AR2::BSM_Warn_Rt_Rq = %d\n", intval);
	filePutString (buffer, elcount(buffer), hFile);
	intval = @sysvar::CH_Nodes::CH_RDUCRC_CMS_PI_Sd_Lt_Stat_AUTO;
	snprintf(buffer, elcount(buffer), "   0.000000    SV: 2 0 0 ::CH_Nodes::CH_RDUCRC_CMS_PI_Sd_Lt_Stat_AUTO = %d\n", intval);
	filePutString (buffer, elcount(buffer), hFile);
	intval = getSignal(CHASSIS::CMS_PI_Sd_Stat_MMR_F1_AR2::CRC_CMS_PI_Sd_Lt_Stat_Pr2);
	snprintf(buffer, elcount(buffer), "   0.000000 F1 RDU::CMS_PI_Sd_Stat_MMR_F1_AR2::CRC_CMS_PI_Sd_Lt_Stat_Pr2 = %d\n", intval);
	filePutString (buffer, elcount(buffer), hFile);
	intval = @sysvar::CH_Nodes::CH_RDUSQC_CMS_PI_Sd_Lt_Stat_AUTO;
	snprintf(buffer, elcount(buffer), "   0.000000    SV: 2 0 0 ::CH_Nodes::CH_RDUSQC_CMS_PI_Sd_Lt_Stat_AUTO = %d\n", intval);
	filePutString (buffer, elcount(buffer), hFile);
	intval = getSignal(CHASSIS::CMS_PI_Sd_Stat_MMR_F1_AR2::SQC_CMS_PI_Sd_Lt_Stat_Pr2);
	snprintf(buffer, elcount(buffer), "   0.000000 F1 RDU::CMS_PI_Sd_Stat_MMR_F1_AR2::SQC_CMS_PI_Sd_Lt_Stat_Pr2 = %d\n", intval);
	filePutString (buffer, elcount(buffer), hFile);
	intval = getSignal(CHASSIS::CMS_PI_Sd_Stat_MMR_F1_AR2::PI_Sd_Lt_Enbl);
	snprintf(buffer, elcount(buffer), "   0.000000 F1 RDU::CMS_PI_Sd_Stat_MMR_F1_AR2::PI_Sd_Lt_Enbl = %d\n", intval);
	filePutString (buffer, elcount(buffer), hFile);
	intval = getSignal(CHASSIS::CMS_PI_Sd_Stat_MMR_F1_AR2::PI_Sd_RelsRcmmnd_Pyro_Lt);
	snprintf(buffer, elcount(buffer), "   0.000000 F1 RDU::CMS_PI_Sd_Stat_MMR_F1_AR2::PI_Sd_RelsRcmmnd_Pyro_Lt = %d\n", intval);
	filePutString (buffer, elcount(buffer), hFile);
	intval = getSignal(CHASSIS::CMS_PI_Sd_Stat_MMR_F1_AR2::PI_Sd_RelsRcmmnd_Rev_Lt);
	snprintf(buffer, elcount(buffer), "   0.000000 F1 RDU::CMS_PI_Sd_Stat_MMR_F1_AR2::PI_Sd_RelsRcmmnd_Rev_Lt = %d\n", intval);
	filePutString (buffer, elcount(buffer), hFile);
}
/*@@end*/

/*@@caplFunc:saveVars_93(dword):*/
void saveVars_93(dword hFile)
{
	intval = getSignal(CHASSIS::CMS_PI_Sd_Stat_MMR_F1_AR2::Rsrv1_CMS_PI_Sd_Lt_Stat_Pr2);
	snprintf(buffer, elcount(buffer), "   0.000000 F1 RDU::CMS_PI_Sd_Stat_MMR_F1_AR2::Rsrv1_CMS_PI_Sd_Lt_Stat_Pr2 = %d\n", intval);
	filePutString (buffer, elcount(buffer), hFile);
	floatval = getSignal(CHASSIS::CMS_PI_Sd_Stat_MMR_F1_AR2::PI_Sd_Obj_Lt_RelSpd);
	snprintf(buffer, elcount(buffer), "   0.000000 F1 RDU::CMS_PI_Sd_Stat_MMR_F1_AR2::PI_Sd_Obj_Lt_RelSpd = %f\n", floatval);
	filePutString (buffer, elcount(buffer), hFile);
	intval = getSignal(CHASSIS::CMS_PI_Sd_Stat_MMR_F1_AR2::PI_Sd_TTI_Lt);
	snprintf(buffer, elcount(buffer), "   0.000000 F1 RDU::CMS_PI_Sd_Stat_MMR_F1_AR2::PI_Sd_TTI_Lt = %d\n", intval);
	filePutString (buffer, elcount(buffer), hFile);
	intval = @sysvar::CH_Nodes::CH_RDUCRC_CMS_PI_Sd_Rt_Stat_AUTO;
	snprintf(buffer, elcount(buffer), "   0.000000    SV: 2 0 0 ::CH_Nodes::CH_RDUCRC_CMS_PI_Sd_Rt_Stat_AUTO = %d\n", intval);
	filePutString (buffer, elcount(buffer), hFile);
	intval = getSignal(CHASSIS::CMS_PI_Sd_Stat_MMR_F4_AR2::CRC_CMS_PI_Sd_Rt_Stat_Pr2);
	snprintf(buffer, elcount(buffer), "   0.000000 F1 RDU::CMS_PI_Sd_Stat_MMR_F4_AR2::CRC_CMS_PI_Sd_Rt_Stat_Pr2 = %d\n", intval);
	filePutString (buffer, elcount(buffer), hFile);
	intval = @sysvar::CH_Nodes::CH_RDUSQC_CMS_PI_Sd_Rt_Stat_AUTO;
	snprintf(buffer, elcount(buffer), "   0.000000    SV: 2 0 0 ::CH_Nodes::CH_RDUSQC_CMS_PI_Sd_Rt_Stat_AUTO = %d\n", intval);
	filePutString (buffer, elcount(buffer), hFile);
	intval = getSignal(CHASSIS::CMS_PI_Sd_Stat_MMR_F4_AR2::SQC_CMS_PI_Sd_Rt_Stat_Pr2);
	snprintf(buffer, elcount(buffer), "   0.000000 F1 RDU::CMS_PI_Sd_Stat_MMR_F4_AR2::SQC_CMS_PI_Sd_Rt_Stat_Pr2 = %d\n", intval);
	filePutString (buffer, elcount(buffer), hFile);
	intval = getSignal(CHASSIS::CMS_PI_Sd_Stat_MMR_F4_AR2::PI_Sd_Rt_Enbl);
	snprintf(buffer, elcount(buffer), "   0.000000 F1 RDU::CMS_PI_Sd_Stat_MMR_F4_AR2::PI_Sd_Rt_Enbl = %d\n", intval);
	filePutString (buffer, elcount(buffer), hFile);
	intval = getSignal(CHASSIS::CMS_PI_Sd_Stat_MMR_F4_AR2::PI_Sd_RelsRcmmnd_Pyro_Rt);
	snprintf(buffer, elcount(buffer), "   0.000000 F1 RDU::CMS_PI_Sd_Stat_MMR_F4_AR2::PI_Sd_RelsRcmmnd_Pyro_Rt = %d\n", intval);
	filePutString (buffer, elcount(buffer), hFile);
	intval = getSignal(CHASSIS::CMS_PI_Sd_Stat_MMR_F4_AR2::PI_Sd_RelsRcmmnd_Rev_Rt);
	snprintf(buffer, elcount(buffer), "   0.000000 F1 RDU::CMS_PI_Sd_Stat_MMR_F4_AR2::PI_Sd_RelsRcmmnd_Rev_Rt = %d\n", intval);
	filePutString (buffer, elcount(buffer), hFile);
	intval = getSignal(CHASSIS::CMS_PI_Sd_Stat_MMR_F4_AR2::Rsrv1_CMS_PI_Sd_Rt_Stat_Pr2);
	snprintf(buffer, elcount(buffer), "   0.000000 F1 RDU::CMS_PI_Sd_Stat_MMR_F4_AR2::Rsrv1_CMS_PI_Sd_Rt_Stat_Pr2 = %d\n", intval);
	filePutString (buffer, elcount(buffer), hFile);
	floatval = getSignal(CHASSIS::CMS_PI_Sd_Stat_MMR_F4_AR2::PI_Sd_Obj_Rt_RelSpd);
	snprintf(buffer, elcount(buffer), "   0.000000 F1 RDU::CMS_PI_Sd_Stat_MMR_F4_AR2::PI_Sd_Obj_Rt_RelSpd = %f\n", floatval);
	filePutString (buffer, elcount(buffer), hFile);
	intval = getSignal(CHASSIS::CMS_PI_Sd_Stat_MMR_F4_AR2::PI_Sd_TTI_Rt);
	snprintf(buffer, elcount(buffer), "   0.000000 F1 RDU::CMS_PI_Sd_Stat_MMR_F4_AR2::PI_Sd_TTI_Rt = %d\n", intval);
	filePutString (buffer, elcount(buffer), hFile);
	intval = @sysvar::CH_Nodes::CH_RDUCRC_CMS_PI_Stat_Pr2CM_AUTO;
	snprintf(buffer, elcount(buffer), "   0.000000    SV: 2 0 0 ::CH_Nodes::CH_RDUCRC_CMS_PI_Stat_Pr2CM_AUTO = %d\n", intval);
	filePutString (buffer, elcount(buffer), hFile);
	intval = getSignal(CHASSIS::CMS_PI_State_AR2::CRC_CMS_PI_Stat_Pr2);
	snprintf(buffer, elcount(buffer), "   0.000000 F1 RDU::CMS_PI_State_AR2::CRC_CMS_PI_Stat_Pr2 = %d\n", intval);
	filePutString (buffer, elcount(buffer), hFile);
	intval = @sysvar::CH_Nodes::CH_RDUSQC_CMS_PI_Stat_Pr2CM_AUTO;
	snprintf(buffer, elcount(buffer), "   0.000000    SV: 2 0 0 ::CH_Nodes::CH_RDUSQC_CMS_PI_Stat_Pr2CM_AUTO = %d\n", intval);
	filePutString (buffer, elcount(buffer), hFile);
	intval = getSignal(CHASSIS::CMS_PI_State_AR2::SQC_CMS_PI_Stat_Pr2);
	snprintf(buffer, elcount(buffer), "   0.000000 F1 RDU::CMS_PI_State_AR2::SQC_CMS_PI_Stat_Pr2 = %d\n", intval);
	filePutString (buffer, elcount(buffer), hFile);
	intval = getSignal(CHASSIS::CMS_PI_State_AR2::PI_Enbl);
	snprintf(buffer, elcount(buffer), "   0.000000 F1 RDU::CMS_PI_State_AR2::PI_Enbl = %d\n", intval);
	filePutString (buffer, elcount(buffer), hFile);
	intval = getSignal(CHASSIS::CMS_PI_State_AR2::CMS_Brk_Rq_V2);
	snprintf(buffer, elcount(buffer), "   0.000000 F1 RDU::CMS_PI_State_AR2::CMS_Brk_Rq_V2 = %d\n", intval);
	filePutString (buffer, elcount(buffer), hFile);
	floatval = getSignal(CHASSIS::CMS_PI_State_AR2::CMS_VehDecel_Rq);
	snprintf(buffer, elcount(buffer), "   0.000000 F1 RDU::CMS_PI_State_AR2::CMS_VehDecel_Rq = %f\n", floatval);
	filePutString (buffer, elcount(buffer), hFile);
	floatval = getSignal(CHASSIS::CMS_PI_State_AR2::PI_Obj_R_RelSpd);
	snprintf(buffer, elcount(buffer), "   0.000000 F1 RDU::CMS_PI_State_AR2::PI_Obj_R_RelSpd = %f\n", floatval);
	filePutString (buffer, elcount(buffer), hFile);
	intval = getSignal(CHASSIS::CMS_PI_State_AR2::PI_TTI_R);
	snprintf(buffer, elcount(buffer), "   0.000000 F1 RDU::CMS_PI_State_AR2::PI_TTI_R = %d\n", intval);
	filePutString (buffer, elcount(buffer), hFile);
	intval = getSignal(CHASSIS::CMS_PI_State_AR2::CMS_R_Warn_Rq);
	snprintf(buffer, elcount(buffer), "   0.000000 F1 RDU::CMS_PI_State_AR2::CMS_R_Warn_Rq = %d\n", intval);
	filePutString (buffer, elcount(buffer), hFile);
	intval = getSignal(CHASSIS::CMS_PI_State_AR2::Rsrv1_CMS_PI_Stat_Pr2);
	snprintf(buffer, elcount(buffer), "   0.000000 F1 RDU::CMS_PI_State_AR2::Rsrv1_CMS_PI_Stat_Pr2 = %d\n", intval);
	filePutString (buffer, elcount(buffer), hFile);
	intval = getSignal(CHASSIS::CMS_PI_State_AR2::PI_RelsRcmmnd_R);
	snprintf(buffer, elcount(buffer), "   0.000000 F1 RDU::CMS_PI_State_AR2::PI_RelsRcmmnd_R = %d\n", intval);
	filePutString (buffer, elcount(buffer), hFile);
	intval = getSignal(CHASSIS::CMS_PI_State_AR2::PI_R_Enbl);
	snprintf(buffer, elcount(buffer), "   0.000000 F1 RDU::CMS_PI_State_AR2::PI_R_Enbl = %d\n", intval);
	filePutString (buffer, elcount(buffer), hFile);
	intval = getSignal(CHASSIS::CMS_PI_State_AR2::PI_RelsRcmmnd_Ft);
	snprintf(buffer, elcount(buffer), "   0.000000 F1 RDU::CMS_PI_State_AR2::PI_RelsRcmmnd_Ft = %d\n", intval);
	filePutString (buffer, elcount(buffer), hFile);
	intval = getSignal(CHASSIS::CMS_PI_State_AR2::PI_TTI_Ft);
	snprintf(buffer, elcount(buffer), "   0.000000 F1 RDU::CMS_PI_State_AR2::PI_TTI_Ft = %d\n", intval);
	filePutString (buffer, elcount(buffer), hFile);
	floatval = getSignal(CHASSIS::CMS_PI_State_AR2::PI_ObjAhdRelSpd);
	snprintf(buffer, elcount(buffer), "   0.000000 F1 RDU::CMS_PI_State_AR2::PI_ObjAhdRelSpd = %f\n", floatval);
	filePutString (buffer, elcount(buffer), hFile);
	intval = getSignal(CHASSIS::DTQ_Disp_Warn_Rq_AR2::DTQ_Ctrl_Stat);
	snprintf(buffer, elcount(buffer), "   0.000000 F1 RDU::DTQ_Disp_Warn_Rq_AR2::DTQ_Ctrl_Stat = %d\n", intval);
	filePutString (buffer, elcount(buffer), hFile);
	intval = getSignal(CHASSIS::DTQ_Disp_Warn_Rq_AR2::DTQ_SwEnbl_Rq);
	snprintf(buffer, elcount(buffer), "   0.000000 F1 RDU::DTQ_Disp_Warn_Rq_AR2::DTQ_SwEnbl_Rq = %d\n", intval);
	filePutString (buffer, elcount(buffer), hFile);
	floatval = getSignal(CHASSIS::DTQ_Disp_Warn_Rq_AR2::DTQ_WarnDelay_Rt_Rq);
	snprintf(buffer, elcount(buffer), "   0.000000 F1 RDU::DTQ_Disp_Warn_Rq_AR2::DTQ_WarnDelay_Rt_Rq = %f\n", floatval);
	filePutString (buffer, elcount(buffer), hFile);
	intval = getSignal(CHASSIS::DTQ_Disp_Warn_Rq_AR2::DTQ_SwLED_On_Rq);
	snprintf(buffer, elcount(buffer), "   0.000000 F1 RDU::DTQ_Disp_Warn_Rq_AR2::DTQ_SwLED_On_Rq = %d\n", intval);
	filePutString (buffer, elcount(buffer), hFile);
	intval = getSignal(CHASSIS::DTQ_Disp_Warn_Rq_AR2::DTQ_WarnSupp_Stat);
	snprintf(buffer, elcount(buffer), "   0.000000 F1 RDU::DTQ_Disp_Warn_Rq_AR2::DTQ_WarnSupp_Stat = %d\n", intval);
	filePutString (buffer, elcount(buffer), hFile);
	floatval = getSignal(CHASSIS::DTQ_Disp_Warn_Rq_AR2::DTQ_WarnDelay_Lt_Rq);
	snprintf(buffer, elcount(buffer), "   0.000000 F1 RDU::DTQ_Disp_Warn_Rq_AR2::DTQ_WarnDelay_Lt_Rq = %f\n", floatval);
	filePutString (buffer, elcount(buffer), hFile);
	intval = getSignal(CHASSIS::DTQ_Disp_Warn_Rq_AR2::DTQ_Md_Stat);
	snprintf(buffer, elcount(buffer), "   0.000000 F1 RDU::DTQ_Disp_Warn_Rq_AR2::DTQ_Md_Stat = %d\n", intval);
	filePutString (buffer, elcount(buffer), hFile);
	intval = getSignal(CHASSIS::DTQ_Disp_Warn_Rq_AR2::DTQ_MsgDisp_Rq_V2);
	snprintf(buffer, elcount(buffer), "   0.000000 F1 RDU::DTQ_Disp_Warn_Rq_AR2::DTQ_MsgDisp_Rq_V2 = %d\n", intval);
	filePutString (buffer, elcount(buffer), hFile);
	intval = getSignal(CHASSIS::DTQ_Disp_Warn_Rq_AR2::DTQ_FltMsgDisp_Rq);
	snprintf(buffer, elcount(buffer), "   0.000000 F1 RDU::DTQ_Disp_Warn_Rq_AR2::DTQ_FltMsgDisp_Rq = %d\n", intval);
	filePutString (buffer, elcount(buffer), hFile);
	intval = getSignal(CHASSIS::DTQ_Disp_Warn_Rq_AR2::DTQ_Stat_Disp_Rq);
	snprintf(buffer, elcount(buffer), "   0.000000 F1 RDU::DTQ_Disp_Warn_Rq_AR2::DTQ_Stat_Disp_Rq = %d\n", intval);
	filePutString (buffer, elcount(buffer), hFile);
	intval = @sysvar::CH_Nodes::CH_RDUCRC_DTQ_Rq1_Pr2DTQ_Rq_AUTO;
	snprintf(buffer, elcount(buffer), "   0.000000    SV: 2 0 0 ::CH_Nodes::CH_RDUCRC_DTQ_Rq1_Pr2DTQ_Rq_AUTO = %d\n", intval);
	filePutString (buffer, elcount(buffer), hFile);
	intval = getSignal(CHASSIS::DTQ_Rq1_AR2::CRC_DTQ_Rq1_Pr2);
	snprintf(buffer, elcount(buffer), "   0.000000 F1 RDU::DTQ_Rq1_AR2::CRC_DTQ_Rq1_Pr2 = %d\n", intval);
	filePutString (buffer, elcount(buffer), hFile);
	intval = @sysvar::CH_Nodes::CH_RDUSQC_DTQ_Rq1_Pr2DTQ_Rq_AUTO;
	snprintf(buffer, elcount(buffer), "   0.000000    SV: 2 0 0 ::CH_Nodes::CH_RDUSQC_DTQ_Rq1_Pr2DTQ_Rq_AUTO = %d\n", intval);
	filePutString (buffer, elcount(buffer), hFile);
	intval = getSignal(CHASSIS::DTQ_Rq1_AR2::SQC_DTQ_Rq1_Pr2);
	snprintf(buffer, elcount(buffer), "   0.000000 F1 RDU::DTQ_Rq1_AR2::SQC_DTQ_Rq1_Pr2 = %d\n", intval);
	filePutString (buffer, elcount(buffer), hFile);
	intval = getSignal(CHASSIS::DTQ_Rq1_AR2::DTQ_Stat_RDU);
	snprintf(buffer, elcount(buffer), "   0.000000 F1 RDU::DTQ_Rq1_AR2::DTQ_Stat_RDU = %d\n", intval);
	filePutString (buffer, elcount(buffer), hFile);
	floatval = getSignal(CHASSIS::DTQ_Rq1_AR2::DTQ_FtWhlAngl_Rq);
	snprintf(buffer, elcount(buffer), "   0.000000 F1 RDU::DTQ_Rq1_AR2::DTQ_FtWhlAngl_Rq = %f\n", floatval);
	filePutString (buffer, elcount(buffer), hFile);
	intval = getSignal(CHASSIS::DTQ_Rq1_AR2::DTQ_AddRf_Rq_V2);
	snprintf(buffer, elcount(buffer), "   0.000000 F1 RDU::DTQ_Rq1_AR2::DTQ_AddRf_Rq_V2 = %d\n", intval);
	filePutString (buffer, elcount(buffer), hFile);
	intval = getSignal(CHASSIS::DTQ_Rq1_AR2::Rsrv2_DTQ_Rq1_Pr2);
	snprintf(buffer, elcount(buffer), "   0.000000 F1 RDU::DTQ_Rq1_AR2::Rsrv2_DTQ_Rq1_Pr2 = %d\n", intval);
	filePutString (buffer, elcount(buffer), hFile);
	intval = getSignal(CHASSIS::DTQ_Rq1_AR2::Rsrv1_DTQ_Rq1_Pr2);
	snprintf(buffer, elcount(buffer), "   0.000000 F1 RDU::DTQ_Rq1_AR2::Rsrv1_DTQ_Rq1_Pr2 = %d\n", intval);
	filePutString (buffer, elcount(buffer), hFile);
	intval = getSignal(CHASSIS::DTQ_Rq1_AR2::DTQ_AnglIfc_Rq);
	snprintf(buffer, elcount(buffer), "   0.000000 F1 RDU::DTQ_Rq1_AR2::DTQ_AnglIfc_Rq = %d\n", intval);
	filePutString (buffer, elcount(buffer), hFile);
	intval = getSignal(CHASSIS::DTQ_Rq1_AR2::DTQ_RfIfc_Rq);
	snprintf(buffer, elcount(buffer), "   0.000000 F1 RDU::DTQ_Rq1_AR2::DTQ_RfIfc_Rq = %d\n", intval);
	filePutString (buffer, elcount(buffer), hFile);
	floatval = getSignal(CHASSIS::DTQ_Rq1_AR2::DTQ_FtWhlAnglCtrl_Weight);
	snprintf(buffer, elcount(buffer), "   0.000000 F1 RDU::DTQ_Rq1_AR2::DTQ_FtWhlAnglCtrl_Weight = %f\n", floatval);
	filePutString (buffer, elcount(buffer), hFile);
	intval = @sysvar::CH_Nodes::CH_RDUCRC_DTQ_Rq2_Pr2DTQ_Rq_AUTO;
	snprintf(buffer, elcount(buffer), "   0.000000    SV: 2 0 0 ::CH_Nodes::CH_RDUCRC_DTQ_Rq2_Pr2DTQ_Rq_AUTO = %d\n", intval);
	filePutString (buffer, elcount(buffer), hFile);
	intval = getSignal(CHASSIS::DTQ_Rq2_AR2::CRC_DTQ_Rq2_Pr2);
	snprintf(buffer, elcount(buffer), "   0.000000 F1 RDU::DTQ_Rq2_AR2::CRC_DTQ_Rq2_Pr2 = %d\n", intval);
	filePutString (buffer, elcount(buffer), hFile);
	intval = @sysvar::CH_Nodes::CH_RDUSQC_DTQ_Rq2_Pr2DTQ_Rq_AUTO;
	snprintf(buffer, elcount(buffer), "   0.000000    SV: 2 0 0 ::CH_Nodes::CH_RDUSQC_DTQ_Rq2_Pr2DTQ_Rq_AUTO = %d\n", intval);
	filePutString (buffer, elcount(buffer), hFile);
	intval = getSignal(CHASSIS::DTQ_Rq2_AR2::SQC_DTQ_Rq2_Pr2);
	snprintf(buffer, elcount(buffer), "   0.000000 F1 RDU::DTQ_Rq2_AR2::SQC_DTQ_Rq2_Pr2 = %d\n", intval);
	filePutString (buffer, elcount(buffer), hFile);
	intval = getSignal(CHASSIS::DTQ_Rq2_AR2::Rsrv1_DTQ_Rq2_Pr2);
	snprintf(buffer, elcount(buffer), "   0.000000 F1 RDU::DTQ_Rq2_AR2::Rsrv1_DTQ_Rq2_Pr2 = %d\n", intval);
	filePutString (buffer, elcount(buffer), hFile);
	intval = getSignal(CHASSIS::DTQ_Rq2_AR2::DTQ_FtWhlAnglCtrl_MinRf_V2);
	snprintf(buffer, elcount(buffer), "   0.000000 F1 RDU::DTQ_Rq2_AR2::DTQ_FtWhlAnglCtrl_MinRf_V2 = %d\n", intval);
	filePutString (buffer, elcount(buffer), hFile);
	intval = getSignal(CHASSIS::DTQ_Rq2_AR2::DTQ_Fctr_ActvReturn);
	snprintf(buffer, elcount(buffer), "   0.000000 F1 RDU::DTQ_Rq2_AR2::DTQ_Fctr_ActvReturn = %d\n", intval);
	filePutString (buffer, elcount(buffer), hFile);
	intval = getSignal(CHASSIS::DTQ_Rq2_AR2::DTQ_FtWhlAnglCtrl_MaxRf_V2);
	snprintf(buffer, elcount(buffer), "   0.000000 F1 RDU::DTQ_Rq2_AR2::DTQ_FtWhlAnglCtrl_MaxRf_V2 = %d\n", intval);
	filePutString (buffer, elcount(buffer), hFile);
}
/*@@end*/

/*@@caplFunc:saveVars_94(dword):*/
void saveVars_94(dword hFile)
{
	intval = getSignal(CHASSIS::DTQ_Rq2_AR2::DTQ_Fctr_ActvDamp);
	snprintf(buffer, elcount(buffer), "   0.000000 F1 RDU::DTQ_Rq2_AR2::DTQ_Fctr_ActvDamp = %d\n", intval);
	filePutString (buffer, elcount(buffer), hFile);
	floatval = getSignal(CHASSIS::DTQ_Rq2_AR2::DTQ_FtWhlAnglCtrl_Dyn);
	snprintf(buffer, elcount(buffer), "   0.000000 F1 RDU::DTQ_Rq2_AR2::DTQ_FtWhlAnglCtrl_Dyn = %f\n", floatval);
	filePutString (buffer, elcount(buffer), hFile);
	intval = getSignal(CHASSIS::DTQ_Rq2_AR2::DTQ_Fctr_StSup);
	snprintf(buffer, elcount(buffer), "   0.000000 F1 RDU::DTQ_Rq2_AR2::DTQ_Fctr_StSup = %d\n", intval);
	filePutString (buffer, elcount(buffer), hFile);
	intval = getSignal(CHASSIS::LDC_Disp_Rq_RDU_AR2::LDC_DTR_MsgDisp_Rq_RDU);
	snprintf(buffer, elcount(buffer), "   0.000000 F1 RDU::LDC_Disp_Rq_RDU_AR2::LDC_DTR_MsgDisp_Rq_RDU = %d\n", intval);
	filePutString (buffer, elcount(buffer), hFile);
	intval = getSignal(CHASSIS::LDC_Disp_Rq_RDU_AR2::LDC_CMS_MsgDisp_Rq_RDU);
	snprintf(buffer, elcount(buffer), "   0.000000 F1 RDU::LDC_Disp_Rq_RDU_AR2::LDC_CMS_MsgDisp_Rq_RDU = %d\n", intval);
	filePutString (buffer, elcount(buffer), hFile);
	intval = getSignal(CHASSIS::LDC_Disp_Rq_RDU_AR2::LDC_CMS_Stat_RDU);
	snprintf(buffer, elcount(buffer), "   0.000000 F1 RDU::LDC_Disp_Rq_RDU_AR2::LDC_CMS_Stat_RDU = %d\n", intval);
	filePutString (buffer, elcount(buffer), hFile);
	intval = getSignal(CHASSIS::LDC_Disp_Rq_RDU_AR2::LDC_DTR_Stat_RDU_V2);
	snprintf(buffer, elcount(buffer), "   0.000000 F1 RDU::LDC_Disp_Rq_RDU_AR2::LDC_DTR_Stat_RDU_V2 = %d\n", intval);
	filePutString (buffer, elcount(buffer), hFile);
	intval = getSignal(CHASSIS::LDC_Disp_Rq_RDU_AR2::TSA_Warn_Supp_Rq_RDU);
	snprintf(buffer, elcount(buffer), "   0.000000 F1 RDU::LDC_Disp_Rq_RDU_AR2::TSA_Warn_Supp_Rq_RDU = %d\n", intval);
	filePutString (buffer, elcount(buffer), hFile);
	intval = getSignal(CHASSIS::LDC_Disp_Rq_RDU_AR2::LDC_SpdUnit_Rs_RDU);
	snprintf(buffer, elcount(buffer), "   0.000000 F1 RDU::LDC_Disp_Rq_RDU_AR2::LDC_SpdUnit_Rs_RDU = %d\n", intval);
	filePutString (buffer, elcount(buffer), hFile);
	intval = getSignal(CHASSIS::LDC_Disp_Rq_RDU_AR2::LDC_MsgDisp_Rq_RDU);
	snprintf(buffer, elcount(buffer), "   0.000000 F1 RDU::LDC_Disp_Rq_RDU_AR2::LDC_MsgDisp_Rq_RDU = %d\n", intval);
	filePutString (buffer, elcount(buffer), hFile);
	intval = getSignal(CHASSIS::LDC_Disp_Rq_RDU_AR2::LDC_MsgDisp_TrgrRq_RDU);
	snprintf(buffer, elcount(buffer), "   0.000000 F1 RDU::LDC_Disp_Rq_RDU_AR2::LDC_MsgDisp_TrgrRq_RDU = %d\n", intval);
	filePutString (buffer, elcount(buffer), hFile);
	intval = getSignal(CHASSIS::LDC_Disp_Rq_RDU_AR2::LDC_DTR_IndLmp_On_Rq_RDU);
	snprintf(buffer, elcount(buffer), "   0.000000 F1 RDU::LDC_Disp_Rq_RDU_AR2::LDC_DTR_IndLmp_On_Rq_RDU = %d\n", intval);
	filePutString (buffer, elcount(buffer), hFile);
	intval = getSignal(CHASSIS::LDC_Disp_Rq_RDU_AR2::LDC_AcustWarn_Rq_RDU);
	snprintf(buffer, elcount(buffer), "   0.000000 F1 RDU::LDC_Disp_Rq_RDU_AR2::LDC_AcustWarn_Rq_RDU = %d\n", intval);
	filePutString (buffer, elcount(buffer), hFile);
	intval = getSignal(CHASSIS::LDC_Disp_Rq_RDU_AR2::LDC_RadarSensSoil_Disp_Rq_RDU);
	snprintf(buffer, elcount(buffer), "   0.000000 F1 RDU::LDC_Disp_Rq_RDU_AR2::LDC_RadarSensSoil_Disp_Rq_RDU = %d\n", intval);
	filePutString (buffer, elcount(buffer), hFile);
	intval = getSignal(CHASSIS::LDC_Disp_Rq_RDU_AR2::LDC_SPEEDO_SegRing_Disp_Rq_RDU);
	snprintf(buffer, elcount(buffer), "   0.000000 F1 RDU::LDC_Disp_Rq_RDU_AR2::LDC_SPEEDO_SegRing_Disp_Rq_RDU = %d\n", intval);
	filePutString (buffer, elcount(buffer), hFile);
	intval = getSignal(CHASSIS::LDC_Disp_Rq_RDU_AR2::LDC_IconDisp_Rq_RDU);
	snprintf(buffer, elcount(buffer), "   0.000000 F1 RDU::LDC_Disp_Rq_RDU_AR2::LDC_IconDisp_Rq_RDU = %d\n", intval);
	filePutString (buffer, elcount(buffer), hFile);
	intval = getSignal(CHASSIS::LDC_Disp_Rq_RDU_AR2::LDC_Spd_Dsr_RDU);
	snprintf(buffer, elcount(buffer), "   0.000000 F1 RDU::LDC_Disp_Rq_RDU_AR2::LDC_Spd_Dsr_RDU = %d\n", intval);
	filePutString (buffer, elcount(buffer), hFile);
	intval = getSignal(CHASSIS::LDC_Disp_Rq_RDU_AR2::LDC_Spd_Add_RDU);
	snprintf(buffer, elcount(buffer), "   0.000000 F1 RDU::LDC_Disp_Rq_RDU_AR2::LDC_Spd_Add_RDU = %d\n", intval);
	filePutString (buffer, elcount(buffer), hFile);
	intval = getSignal(CHASSIS::LDC_Disp_Rq_RDU_AR2::LDC_Dist_RDU);
	snprintf(buffer, elcount(buffer), "   0.000000 F1 RDU::LDC_Disp_Rq_RDU_AR2::LDC_Dist_RDU = %d\n", intval);
	filePutString (buffer, elcount(buffer), hFile);
	intval = getSignal(CHASSIS::LDC_Disp_Rq_RDU_AR2::LDC_Dist_Dsr_RDU);
	snprintf(buffer, elcount(buffer), "   0.000000 F1 RDU::LDC_Disp_Rq_RDU_AR2::LDC_Dist_Dsr_RDU = %d\n", intval);
	filePutString (buffer, elcount(buffer), hFile);
	intval = getSignal(CHASSIS::LDP_Warn_Rq_AR2::LDP_MsgDisp_Rq_V2);
	snprintf(buffer, elcount(buffer), "   0.000000 F1 RDU::LDP_Warn_Rq_AR2::LDP_MsgDisp_Rq_V2 = %d\n", intval);
	filePutString (buffer, elcount(buffer), hFile);
	intval = getSignal(CHASSIS::LDP_Warn_Rq_AR2::LDP_IndLmp_On_Rq_V2);
	snprintf(buffer, elcount(buffer), "   0.000000 F1 RDU::LDP_Warn_Rq_AR2::LDP_IndLmp_On_Rq_V2 = %d\n", intval);
	filePutString (buffer, elcount(buffer), hFile);
	intval = getSignal(CHASSIS::LDP_Warn_Rq_AR2::LDP_BrkMsgDisp_Rq);
	snprintf(buffer, elcount(buffer), "   0.000000 F1 RDU::LDP_Warn_Rq_AR2::LDP_BrkMsgDisp_Rq = %d\n", intval);
	filePutString (buffer, elcount(buffer), hFile);
	intval = getSignal(CHASSIS::LDP_Warn_Rq_AR2::LDP_Md_Stat);
	snprintf(buffer, elcount(buffer), "   0.000000 F1 RDU::LDP_Warn_Rq_AR2::LDP_Md_Stat = %d\n", intval);
	filePutString (buffer, elcount(buffer), hFile);
	intval = @sysvar::CH_Nodes::CH_RDUCRC_PT_ObjIntrst_Pr2P_AUTO;
	snprintf(buffer, elcount(buffer), "   0.000000    SV: 2 0 0 ::CH_Nodes::CH_RDUCRC_PT_ObjIntrst_Pr2P_AUTO = %d\n", intval);
	filePutString (buffer, elcount(buffer), hFile);
	intval = getSignal(CHASSIS::PT_ObjIntrst_AR2::CRC_PT_ObjIntrst_Pr2);
	snprintf(buffer, elcount(buffer), "   0.000000 F1 RDU::PT_ObjIntrst_AR2::CRC_PT_ObjIntrst_Pr2 = %d\n", intval);
	filePutString (buffer, elcount(buffer), hFile);
	intval = @sysvar::CH_Nodes::CH_RDUSQC_PT_ObjIntrst_Pr2P_AUTO;
	snprintf(buffer, elcount(buffer), "   0.000000    SV: 2 0 0 ::CH_Nodes::CH_RDUSQC_PT_ObjIntrst_Pr2P_AUTO = %d\n", intval);
	filePutString (buffer, elcount(buffer), hFile);
	intval = getSignal(CHASSIS::PT_ObjIntrst_AR2::SQC_PT_ObjIntrst_Pr2);
	snprintf(buffer, elcount(buffer), "   0.000000 F1 RDU::PT_ObjIntrst_AR2::SQC_PT_ObjIntrst_Pr2 = %d\n", intval);
	filePutString (buffer, elcount(buffer), hFile);
	intval = getSignal(CHASSIS::PT_ObjIntrst_AR2::PT_ObjIntrstType);
	snprintf(buffer, elcount(buffer), "   0.000000 F1 RDU::PT_ObjIntrst_AR2::PT_ObjIntrstType = %d\n", intval);
	filePutString (buffer, elcount(buffer), hFile);
	intval = getSignal(CHASSIS::PT_ObjIntrst_AR2::PT_ObjIntrstNew);
	snprintf(buffer, elcount(buffer), "   0.000000 F1 RDU::PT_ObjIntrst_AR2::PT_ObjIntrstNew = %d\n", intval);
	filePutString (buffer, elcount(buffer), hFile);
	floatval = getSignal(CHASSIS::PT_ObjIntrst_AR2::PT_ObjIntrstDist);
	snprintf(buffer, elcount(buffer), "   0.000000 F1 RDU::PT_ObjIntrst_AR2::PT_ObjIntrstDist = %f\n", floatval);
	filePutString (buffer, elcount(buffer), hFile);
	floatval = getSignal(CHASSIS::PT_ObjIntrst_AR2::PT_ObjIntrstRelSpd);
	snprintf(buffer, elcount(buffer), "   0.000000 F1 RDU::PT_ObjIntrst_AR2::PT_ObjIntrstRelSpd = %f\n", floatval);
	filePutString (buffer, elcount(buffer), hFile);
	intval = getSignal(CHASSIS::PT_ObjIntrst_AR2::PT_ObjIntrst_Flt);
	snprintf(buffer, elcount(buffer), "   0.000000 F1 RDU::PT_ObjIntrst_AR2::PT_ObjIntrst_Flt = %d\n", intval);
	filePutString (buffer, elcount(buffer), hFile);
	intval = getSignal(CHASSIS::PT_ObjIntrst_AR2::Rsrv1_PT_ObjIntrst_Pr2);
	snprintf(buffer, elcount(buffer), "   0.000000 F1 RDU::PT_ObjIntrst_AR2::Rsrv1_PT_ObjIntrst_Pr2 = %d\n", intval);
	filePutString (buffer, elcount(buffer), hFile);
	intval = getSignal(CHASSIS::RDU_Disp_Rq_AR::PN14_ElecPwr_Rq_AS);
	snprintf(buffer, elcount(buffer), "   0.000000 F1 RDU::RDU_Disp_Rq_AR::PN14_ElecPwr_Rq_AS = %d\n", intval);
	filePutString (buffer, elcount(buffer), hFile);
	intval = getSignal(CHASSIS::RDU_Disp_Rq_AR::LDC_Dist_Dsr_MsgDisp_Rq_RDU);
	snprintf(buffer, elcount(buffer), "   0.000000 F1 RDU::RDU_Disp_Rq_AR::LDC_Dist_Dsr_MsgDisp_Rq_RDU = %d\n", intval);
	filePutString (buffer, elcount(buffer), hFile);
	intval = getSignal(CHASSIS::RDU_Disp_Rq_AR::LDC_SLA_SpdLmtTkOvr_Stat);
	snprintf(buffer, elcount(buffer), "   0.000000 F1 RDU::RDU_Disp_Rq_AR::LDC_SLA_SpdLmtTkOvr_Stat = %d\n", intval);
	filePutString (buffer, elcount(buffer), hFile);
	intval = getSignal(CHASSIS::RDU_Disp_Rq_AR::LDC_SLA_SpdLmtTkOvr_Avl_Stat);
	snprintf(buffer, elcount(buffer), "   0.000000 F1 RDU::RDU_Disp_Rq_AR::LDC_SLA_SpdLmtTkOvr_Avl_Stat = %d\n", intval);
	filePutString (buffer, elcount(buffer), hFile);
	intval = getSignal(CHASSIS::RDU_Disp_Rq_AR::LDC_CMS_Md_Stat);
	snprintf(buffer, elcount(buffer), "   0.000000 F1 RDU::RDU_Disp_Rq_AR::LDC_CMS_Md_Stat = %d\n", intval);
	filePutString (buffer, elcount(buffer), hFile);
	intval = @sysvar::CH_Nodes::CH_RDUCRC_RDU_GlobalAttr_Pr_AUTO;
	snprintf(buffer, elcount(buffer), "   0.000000    SV: 2 0 0 ::CH_Nodes::CH_RDUCRC_RDU_GlobalAttr_Pr_AUTO = %d\n", intval);
	filePutString (buffer, elcount(buffer), hFile);
	intval = getSignal(CHASSIS::RDU_GlobalAttr_AR2::CRC_RDU_GlobalAttr_Pr2);
	snprintf(buffer, elcount(buffer), "   0.000000 F1 RDU::RDU_GlobalAttr_AR2::CRC_RDU_GlobalAttr_Pr2 = %d\n", intval);
	filePutString (buffer, elcount(buffer), hFile);
	intval = @sysvar::CH_Nodes::CH_RDUSQC_RDU_GlobalAttr_Pr_AUTO;
	snprintf(buffer, elcount(buffer), "   0.000000    SV: 2 0 0 ::CH_Nodes::CH_RDUSQC_RDU_GlobalAttr_Pr_AUTO = %d\n", intval);
	filePutString (buffer, elcount(buffer), hFile);
	intval = getSignal(CHASSIS::RDU_GlobalAttr_AR2::SQC_RDU_GlobalAttr_Pr2);
	snprintf(buffer, elcount(buffer), "   0.000000 F1 RDU::RDU_GlobalAttr_AR2::SQC_RDU_GlobalAttr_Pr2 = %d\n", intval);
	filePutString (buffer, elcount(buffer), hFile);
	intval = getSignal(CHASSIS::RDU_GlobalAttr_AR2::Rsrv1_RDU_GlobalAttr_Pr2);
	snprintf(buffer, elcount(buffer), "   0.000000 F1 RDU::RDU_GlobalAttr_AR2::Rsrv1_RDU_GlobalAttr_Pr2 = %d\n", intval);
	filePutString (buffer, elcount(buffer), hFile);
	intval = getSignal(CHASSIS::RDU_GlobalAttr_AR2::DTR_SensOrient_V2);
	snprintf(buffer, elcount(buffer), "   0.000000 F1 RDU::RDU_GlobalAttr_AR2::DTR_SensOrient_V2 = %d\n", intval);
	filePutString (buffer, elcount(buffer), hFile);
	floatval = getSignal(CHASSIS::RDU_GlobalAttr_AR2::DTR_SensHght);
	snprintf(buffer, elcount(buffer), "   0.000000 F1 RDU::RDU_GlobalAttr_AR2::DTR_SensHght = %f\n", floatval);
	filePutString (buffer, elcount(buffer), hFile);
	floatval = getSignal(CHASSIS::RDU_GlobalAttr_AR2::DTR_WhlLoadDepend_F);
	snprintf(buffer, elcount(buffer), "   0.000000 F1 RDU::RDU_GlobalAttr_AR2::DTR_WhlLoadDepend_F = %f\n", floatval);
	filePutString (buffer, elcount(buffer), hFile);
	floatval = getSignal(CHASSIS::RDU_GlobalAttr_AR2::DTR_WhlLoadDepend_R);
	snprintf(buffer, elcount(buffer), "   0.000000 F1 RDU::RDU_GlobalAttr_AR2::DTR_WhlLoadDepend_R = %f\n", floatval);
	filePutString (buffer, elcount(buffer), hFile);
	floatval = getSignal(CHASSIS::RDU_GlobalAttr_AR2::DTR_SensOffset_X);
	snprintf(buffer, elcount(buffer), "   0.000000 F1 RDU::RDU_GlobalAttr_AR2::DTR_SensOffset_X = %f\n", floatval);
	filePutString (buffer, elcount(buffer), hFile);
	floatval = getSignal(CHASSIS::RDU_GlobalAttr_AR2::DTR_SensOffset_Y);
	snprintf(buffer, elcount(buffer), "   0.000000 F1 RDU::RDU_GlobalAttr_AR2::DTR_SensOffset_Y = %f\n", floatval);
	filePutString (buffer, elcount(buffer), hFile);
	floatval = getSignal(CHASSIS::RDU_GlobalAttr_AR2::DTR_SensOffset_X_Bmpr_Ft);
	snprintf(buffer, elcount(buffer), "   0.000000 F1 RDU::RDU_GlobalAttr_AR2::DTR_SensOffset_X_Bmpr_Ft = %f\n", floatval);
	filePutString (buffer, elcount(buffer), hFile);
	intval = getSignal(CHASSIS::RDU_GlobalAttr_AR2::Rsrv3_RDU_GlobalAttr_Pr2);
	snprintf(buffer, elcount(buffer), "   0.000000 F1 RDU::RDU_GlobalAttr_AR2::Rsrv3_RDU_GlobalAttr_Pr2 = %d\n", intval);
	filePutString (buffer, elcount(buffer), hFile);
	intval = getSignal(CHASSIS::RDU_Stat1_AR::DPC_Md_AS_Rs);
	snprintf(buffer, elcount(buffer), "   0.000000 F1 RDU::RDU_Stat1_AR::DPC_Md_AS_Rs = %d\n", intval);
	filePutString (buffer, elcount(buffer), hFile);
	intval = getSignal(CHASSIS::ROE_MMR_F1::ROE_Header_MMR_F1);
	snprintf(buffer, elcount(buffer), "   0.000000 F1 RDU::ROE_MMR_F1::ROE_Header_MMR_F1 = %d\n", intval);
	filePutString (buffer, elcount(buffer), hFile);
	intval = getSignal(CHASSIS::ROE_MMR_F1::ROE_DTC_MMR_F1);
	snprintf(buffer, elcount(buffer), "   0.000000 F1 RDU::ROE_MMR_F1::ROE_DTC_MMR_F1 = %d\n", intval);
	filePutString (buffer, elcount(buffer), hFile);
}
/*@@end*/

/*@@caplFunc:saveVars_95(dword):*/
void saveVars_95(dword hFile)
{
	intval = getSignal(CHASSIS::ROE_MMR_F1::ROE_DTC_Stat_MMR_F1);
	snprintf(buffer, elcount(buffer), "   0.000000 F1 RDU::ROE_MMR_F1::ROE_DTC_Stat_MMR_F1 = %d\n", intval);
	filePutString (buffer, elcount(buffer), hFile);
	intval = getSignal(CHASSIS::ROE_MMR_F4::ROE_Header_MMR_F4);
	snprintf(buffer, elcount(buffer), "   0.000000 F1 RDU::ROE_MMR_F4::ROE_Header_MMR_F4 = %d\n", intval);
	filePutString (buffer, elcount(buffer), hFile);
	intval = getSignal(CHASSIS::ROE_MMR_F4::ROE_DTC_MMR_F4);
	snprintf(buffer, elcount(buffer), "   0.000000 F1 RDU::ROE_MMR_F4::ROE_DTC_MMR_F4 = %d\n", intval);
	filePutString (buffer, elcount(buffer), hFile);
	intval = getSignal(CHASSIS::ROE_MMR_F4::ROE_DTC_Stat_MMR_F4);
	snprintf(buffer, elcount(buffer), "   0.000000 F1 RDU::ROE_MMR_F4::ROE_DTC_Stat_MMR_F4 = %d\n", intval);
	filePutString (buffer, elcount(buffer), hFile);
	intval = getSignal(CHASSIS::ROE_MMR_RM::ROE_Header_MMR_RM);
	snprintf(buffer, elcount(buffer), "   0.000000 F1 RDU::ROE_MMR_RM::ROE_Header_MMR_RM = %d\n", intval);
	filePutString (buffer, elcount(buffer), hFile);
	intval = getSignal(CHASSIS::ROE_MMR_RM::ROE_DTC_MMR_RM);
	snprintf(buffer, elcount(buffer), "   0.000000 F1 RDU::ROE_MMR_RM::ROE_DTC_MMR_RM = %d\n", intval);
	filePutString (buffer, elcount(buffer), hFile);
	intval = getSignal(CHASSIS::ROE_MMR_RM::ROE_DTC_Stat_MMR_RM);
	snprintf(buffer, elcount(buffer), "   0.000000 F1 RDU::ROE_MMR_RM::ROE_DTC_Stat_MMR_RM = %d\n", intval);
	filePutString (buffer, elcount(buffer), hFile);
	intval = getSignal(CHASSIS::ROE_MMR_RS::ROE_Header_MMR_RS);
	snprintf(buffer, elcount(buffer), "   0.000000 F1 RDU::ROE_MMR_RS::ROE_Header_MMR_RS = %d\n", intval);
	filePutString (buffer, elcount(buffer), hFile);
	intval = getSignal(CHASSIS::ROE_MMR_RS::ROE_DTC_MMR_RS);
	snprintf(buffer, elcount(buffer), "   0.000000 F1 RDU::ROE_MMR_RS::ROE_DTC_MMR_RS = %d\n", intval);
	filePutString (buffer, elcount(buffer), hFile);
	intval = getSignal(CHASSIS::ROE_MMR_RS::ROE_DTC_Stat_MMR_RS);
	snprintf(buffer, elcount(buffer), "   0.000000 F1 RDU::ROE_MMR_RS::ROE_DTC_Stat_MMR_RS = %d\n", intval);
	filePutString (buffer, elcount(buffer), hFile);
	intval = getSignal(CHASSIS::ROE_RDU::ROE_Header_RDU);
	snprintf(buffer, elcount(buffer), "   0.000000 F1 RDU::ROE_RDU::ROE_Header_RDU = %d\n", intval);
	filePutString (buffer, elcount(buffer), hFile);
	intval = getSignal(CHASSIS::ROE_RDU::ROE_DTC_RDU);
	snprintf(buffer, elcount(buffer), "   0.000000 F1 RDU::ROE_RDU::ROE_DTC_RDU = %d\n", intval);
	filePutString (buffer, elcount(buffer), hFile);
	intval = getSignal(CHASSIS::ROE_RDU::ROE_DTC_Stat_RDU);
	snprintf(buffer, elcount(buffer), "   0.000000 F1 RDU::ROE_RDU::ROE_DTC_Stat_RDU = %d\n", intval);
	filePutString (buffer, elcount(buffer), hFile);
	intval = @sysvar::CH_Nodes::CH_RDUCRC_SADR_Trgr_RDU_Pr2_AUTO;
	snprintf(buffer, elcount(buffer), "   0.000000    SV: 2 0 0 ::CH_Nodes::CH_RDUCRC_SADR_Trgr_RDU_Pr2_AUTO = %d\n", intval);
	filePutString (buffer, elcount(buffer), hFile);
	intval = getSignal(CHASSIS::SADR_Trgr_RDU_AR2::CRC_SADR_Trgr_RDU_Pr2);
	snprintf(buffer, elcount(buffer), "   0.000000 F1 RDU::SADR_Trgr_RDU_AR2::CRC_SADR_Trgr_RDU_Pr2 = %d\n", intval);
	filePutString (buffer, elcount(buffer), hFile);
	intval = @sysvar::CH_Nodes::CH_RDUSQC_SADR_Trgr_RDU_Pr2_AUTO;
	snprintf(buffer, elcount(buffer), "   0.000000    SV: 2 0 0 ::CH_Nodes::CH_RDUSQC_SADR_Trgr_RDU_Pr2_AUTO = %d\n", intval);
	filePutString (buffer, elcount(buffer), hFile);
	intval = getSignal(CHASSIS::SADR_Trgr_RDU_AR2::SQC_SADR_Trgr_RDU_Pr2);
	snprintf(buffer, elcount(buffer), "   0.000000 F1 RDU::SADR_Trgr_RDU_AR2::SQC_SADR_Trgr_RDU_Pr2 = %d\n", intval);
	filePutString (buffer, elcount(buffer), hFile);
	intval = getSignal(CHASSIS::SADR_Trgr_RDU_AR2::SADR_TrgrPrio_RDU);
	snprintf(buffer, elcount(buffer), "   0.000000 F1 RDU::SADR_Trgr_RDU_AR2::SADR_TrgrPrio_RDU = %d\n", intval);
	filePutString (buffer, elcount(buffer), hFile);
	intval = getSignal(CHASSIS::SADR_Trgr_RDU_AR2::Rsrv2_SADR_Trgr_RDU_Pr2);
	snprintf(buffer, elcount(buffer), "   0.000000 F1 RDU::SADR_Trgr_RDU_AR2::Rsrv2_SADR_Trgr_RDU_Pr2 = %d\n", intval);
	filePutString (buffer, elcount(buffer), hFile);
	intval = getSignal(CHASSIS::SADR_Trgr_RDU_AR2::SADR_TrgrTm_RDU);
	snprintf(buffer, elcount(buffer), "   0.000000 F1 RDU::SADR_Trgr_RDU_AR2::SADR_TrgrTm_RDU = %d\n", intval);
	filePutString (buffer, elcount(buffer), hFile);
	intval = getSignal(CHASSIS::SADR_Trgr_RDU_AR2::Rsrv1_SADR_Trgr_RDU_Pr2);
	snprintf(buffer, elcount(buffer), "   0.000000 F1 RDU::SADR_Trgr_RDU_AR2::Rsrv1_SADR_Trgr_RDU_Pr2 = %d\n", intval);
	filePutString (buffer, elcount(buffer), hFile);
	intval = @sysvar::CH_Nodes::CH_RDUCRC_SCS_Stat1_RDU_Pr2_AUTO;
	snprintf(buffer, elcount(buffer), "   0.000000    SV: 2 0 0 ::CH_Nodes::CH_RDUCRC_SCS_Stat1_RDU_Pr2_AUTO = %d\n", intval);
	filePutString (buffer, elcount(buffer), hFile);
	intval = getSignal(CHASSIS::SCS_Stat1_RDU_AR2::CRC_SCS_Stat1_RDU_Pr2);
	snprintf(buffer, elcount(buffer), "   0.000000 F1 RDU::SCS_Stat1_RDU_AR2::CRC_SCS_Stat1_RDU_Pr2 = %d\n", intval);
	filePutString (buffer, elcount(buffer), hFile);
	intval = @sysvar::CH_Nodes::CH_RDUSQC_SCS_Stat1_RDU_Pr2_AUTO;
	snprintf(buffer, elcount(buffer), "   0.000000    SV: 2 0 0 ::CH_Nodes::CH_RDUSQC_SCS_Stat1_RDU_Pr2_AUTO = %d\n", intval);
	filePutString (buffer, elcount(buffer), hFile);
	intval = getSignal(CHASSIS::SCS_Stat1_RDU_AR2::SQC_SCS_Stat1_RDU_Pr2);
	snprintf(buffer, elcount(buffer), "   0.000000 F1 RDU::SCS_Stat1_RDU_AR2::SQC_SCS_Stat1_RDU_Pr2 = %d\n", intval);
	filePutString (buffer, elcount(buffer), hFile);
	intval = getSignal(CHASSIS::SCS_Stat1_RDU_AR2::Rsrv4_SCS_Stat1_RDU_Pr2);
	snprintf(buffer, elcount(buffer), "   0.000000 F1 RDU::SCS_Stat1_RDU_AR2::Rsrv4_SCS_Stat1_RDU_Pr2 = %d\n", intval);
	filePutString (buffer, elcount(buffer), hFile);
	intval = getSignal(CHASSIS::SCS_Stat1_RDU_AR2::TrckOffSpd);
	snprintf(buffer, elcount(buffer), "   0.000000 F1 RDU::SCS_Stat1_RDU_AR2::TrckOffSpd = %d\n", intval);
	filePutString (buffer, elcount(buffer), hFile);
	intval = getSignal(CHASSIS::SCS_Stat1_RDU_AR2::VehDirRev);
	snprintf(buffer, elcount(buffer), "   0.000000 F1 RDU::SCS_Stat1_RDU_AR2::VehDirRev = %d\n", intval);
	filePutString (buffer, elcount(buffer), hFile);
	intval = getSignal(CHASSIS::SCS_Stat1_RDU_AR2::Rsrv1_SCS_Stat1_RDU_Pr2);
	snprintf(buffer, elcount(buffer), "   0.000000 F1 RDU::SCS_Stat1_RDU_AR2::Rsrv1_SCS_Stat1_RDU_Pr2 = %d\n", intval);
	filePutString (buffer, elcount(buffer), hFile);
	floatval = getSignal(CHASSIS::SCS_Stat1_RDU_AR2::SCS_VehSpd_X);
	snprintf(buffer, elcount(buffer), "   0.000000 F1 RDU::SCS_Stat1_RDU_AR2::SCS_VehSpd_X = %f\n", floatval);
	filePutString (buffer, elcount(buffer), hFile);
	intval = getSignal(CHASSIS::SCS_Stat1_RDU_AR2::SCS_ActvCnt);
	snprintf(buffer, elcount(buffer), "   0.000000 F1 RDU::SCS_Stat1_RDU_AR2::SCS_ActvCnt = %d\n", intval);
	filePutString (buffer, elcount(buffer), hFile);
	intval = getSignal(CHASSIS::SCS_Stat1_RDU_AR2::SCS_ErrMon_Actv);
	snprintf(buffer, elcount(buffer), "   0.000000 F1 RDU::SCS_Stat1_RDU_AR2::SCS_ErrMon_Actv = %d\n", intval);
	filePutString (buffer, elcount(buffer), hFile);
	intval = getSignal(CHASSIS::SCS_Stat1_RDU_AR2::SCS_Off);
	snprintf(buffer, elcount(buffer), "   0.000000 F1 RDU::SCS_Stat1_RDU_AR2::SCS_Off = %d\n", intval);
	filePutString (buffer, elcount(buffer), hFile);
	floatval = getSignal(CHASSIS::SCS_Stat1_RDU_AR2::SCS_VehAccel_X);
	snprintf(buffer, elcount(buffer), "   0.000000 F1 RDU::SCS_Stat1_RDU_AR2::SCS_VehAccel_X = %f\n", floatval);
	filePutString (buffer, elcount(buffer), hFile);
	intval = getSignal(CHASSIS::SCS_Stat1_RDU_AR2::Rsrv5_SCS_Stat1_RDU_Pr2);
	snprintf(buffer, elcount(buffer), "   0.000000 F1 RDU::SCS_Stat1_RDU_AR2::Rsrv5_SCS_Stat1_RDU_Pr2 = %d\n", intval);
	filePutString (buffer, elcount(buffer), hFile);
	intval = getSignal(CHASSIS::SCS_Stat1_RDU_AR2::Rsrv2_SCS_Stat1_RDU_Pr2);
	snprintf(buffer, elcount(buffer), "   0.000000 F1 RDU::SCS_Stat1_RDU_AR2::Rsrv2_SCS_Stat1_RDU_Pr2 = %d\n", intval);
	filePutString (buffer, elcount(buffer), hFile);
	intval = getSignal(CHASSIS::SCS_Stat1_RDU_AR2::Rsrv3_SCS_Stat1_RDU_Pr2);
	snprintf(buffer, elcount(buffer), "   0.000000 F1 RDU::SCS_Stat1_RDU_AR2::Rsrv3_SCS_Stat1_RDU_Pr2 = %d\n", intval);
	filePutString (buffer, elcount(buffer), hFile);
	intval = @sysvar::CH_Nodes::CH_RDUCRC_SCS_Stat2_RDU_Pr2_AUTO;
	snprintf(buffer, elcount(buffer), "   0.000000    SV: 2 0 0 ::CH_Nodes::CH_RDUCRC_SCS_Stat2_RDU_Pr2_AUTO = %d\n", intval);
	filePutString (buffer, elcount(buffer), hFile);
	intval = getSignal(CHASSIS::SCS_Stat2_RDU_AR2::CRC_SCS_Stat2_RDU_Pr2);
	snprintf(buffer, elcount(buffer), "   0.000000 F1 RDU::SCS_Stat2_RDU_AR2::CRC_SCS_Stat2_RDU_Pr2 = %d\n", intval);
	filePutString (buffer, elcount(buffer), hFile);
	intval = @sysvar::CH_Nodes::CH_RDUSQC_SCS_Stat2_RDU_Pr2_AUTO;
	snprintf(buffer, elcount(buffer), "   0.000000    SV: 2 0 0 ::CH_Nodes::CH_RDUSQC_SCS_Stat2_RDU_Pr2_AUTO = %d\n", intval);
	filePutString (buffer, elcount(buffer), hFile);
	intval = getSignal(CHASSIS::SCS_Stat2_RDU_AR2::SQC_SCS_Stat2_RDU_Pr2);
	snprintf(buffer, elcount(buffer), "   0.000000 F1 RDU::SCS_Stat2_RDU_AR2::SQC_SCS_Stat2_RDU_Pr2 = %d\n", intval);
	filePutString (buffer, elcount(buffer), hFile);
	intval = getSignal(CHASSIS::SCS_Stat2_RDU_AR2::Rsrv4_SCS_Stat2_RDU_Pr2);
	snprintf(buffer, elcount(buffer), "   0.000000 F1 RDU::SCS_Stat2_RDU_AR2::Rsrv4_SCS_Stat2_RDU_Pr2 = %d\n", intval);
	filePutString (buffer, elcount(buffer), hFile);
	intval = getSignal(CHASSIS::SCS_Stat2_RDU_AR2::SRD_SysDamp);
	snprintf(buffer, elcount(buffer), "   0.000000 F1 RDU::SCS_Stat2_RDU_AR2::SRD_SysDamp = %d\n", intval);
	filePutString (buffer, elcount(buffer), hFile);
	intval = getSignal(CHASSIS::SCS_Stat2_RDU_AR2::Rsrv1_SCS_Stat2_RDU_Pr2);
	snprintf(buffer, elcount(buffer), "   0.000000 F1 RDU::SCS_Stat2_RDU_AR2::Rsrv1_SCS_Stat2_RDU_Pr2 = %d\n", intval);
	filePutString (buffer, elcount(buffer), hFile);
	intval = getSignal(CHASSIS::SCS_Stat2_RDU_AR2::Rsrv2_SCS_Stat2_RDU_Pr2);
	snprintf(buffer, elcount(buffer), "   0.000000 F1 RDU::SCS_Stat2_RDU_AR2::Rsrv2_SCS_Stat2_RDU_Pr2 = %d\n", intval);
	filePutString (buffer, elcount(buffer), hFile);
	intval = getSignal(CHASSIS::SCS_Stat2_RDU_AR2::RDU_GlobalTmStmp_V2);
	snprintf(buffer, elcount(buffer), "   0.000000 F1 RDU::SCS_Stat2_RDU_AR2::RDU_GlobalTmStmp_V2 = %d\n", intval);
	filePutString (buffer, elcount(buffer), hFile);
	intval = @sysvar::CH_Nodes::CH_RDUCRC_Veh_Stat_RDU_Pr2V_AUTO;
	snprintf(buffer, elcount(buffer), "   0.000000    SV: 2 0 0 ::CH_Nodes::CH_RDUCRC_Veh_Stat_RDU_Pr2V_AUTO = %d\n", intval);
	filePutString (buffer, elcount(buffer), hFile);
	intval = getSignal(CHASSIS::Veh_Stat_RDU_FR2::CRC_Veh_Stat_RDU_Pr2);
	snprintf(buffer, elcount(buffer), "   0.000000 F1 RDU::Veh_Stat_RDU_FR2::CRC_Veh_Stat_RDU_Pr2 = %d\n", intval);
	filePutString (buffer, elcount(buffer), hFile);
	intval = @sysvar::CH_Nodes::CH_RDUSQC_Veh_Stat_RDU_Pr2V_AUTO;
	snprintf(buffer, elcount(buffer), "   0.000000    SV: 2 0 0 ::CH_Nodes::CH_RDUSQC_Veh_Stat_RDU_Pr2V_AUTO = %d\n", intval);
	filePutString (buffer, elcount(buffer), hFile);
	intval = getSignal(CHASSIS::Veh_Stat_RDU_FR2::SQC_Veh_Stat_RDU_Pr2);
	snprintf(buffer, elcount(buffer), "   0.000000 F1 RDU::Veh_Stat_RDU_FR2::SQC_Veh_Stat_RDU_Pr2 = %d\n", intval);
	filePutString (buffer, elcount(buffer), hFile);
	intval = getSignal(CHASSIS::Veh_Stat_RDU_FR2::Rsrv1_Veh_Stat_RDU_Pr2);
	snprintf(buffer, elcount(buffer), "   0.000000 F1 RDU::Veh_Stat_RDU_FR2::Rsrv1_Veh_Stat_RDU_Pr2 = %d\n", intval);
	filePutString (buffer, elcount(buffer), hFile);
	floatval = getSignal(CHASSIS::Veh_Stat_RDU_FR2::AxleLoad_R);
	snprintf(buffer, elcount(buffer), "   0.000000 F1 RDU::Veh_Stat_RDU_FR2::AxleLoad_R = %f\n", floatval);
	filePutString (buffer, elcount(buffer), hFile);
	floatval = getSignal(CHASSIS::Veh_Stat_RDU_FR2::VehCenGravAlt);
	snprintf(buffer, elcount(buffer), "   0.000000 F1 RDU::Veh_Stat_RDU_FR2::VehCenGravAlt = %f\n", floatval);
	filePutString (buffer, elcount(buffer), hFile);
	floatval = getSignal(CHASSIS::Veh_Stat_RDU_FR2::StRatio);
	snprintf(buffer, elcount(buffer), "   0.000000 F1 RDU::Veh_Stat_RDU_FR2::StRatio = %f\n", floatval);
	filePutString (buffer, elcount(buffer), hFile);
	floatval = getSignal(CHASSIS::Veh_Stat_RDU_FR2::VehWidth);
	snprintf(buffer, elcount(buffer), "   0.000000 F1 RDU::Veh_Stat_RDU_FR2::VehWidth = %f\n", floatval);
	filePutString (buffer, elcount(buffer), hFile);
	floatval = getSignal(CHASSIS::Veh_Stat_RDU_FR2::SelfStGrdnt);
	snprintf(buffer, elcount(buffer), "   0.000000 F1 RDU::Veh_Stat_RDU_FR2::SelfStGrdnt = %f\n", floatval);
	filePutString (buffer, elcount(buffer), hFile);
	floatval = getSignal(CHASSIS::Veh_Stat_RDU_FR2::TrckWidth_Ft);
	snprintf(buffer, elcount(buffer), "   0.000000 F1 RDU::Veh_Stat_RDU_FR2::TrckWidth_Ft = %f\n", floatval);
	filePutString (buffer, elcount(buffer), hFile);
	floatval = getSignal(CHASSIS::Veh_Stat_RDU_FR2::TrckWidth_R);
	snprintf(buffer, elcount(buffer), "   0.000000 F1 RDU::Veh_Stat_RDU_FR2::TrckWidth_R = %f\n", floatval);
	filePutString (buffer, elcount(buffer), hFile);
	intval = getSignal(CHASSIS::Veh_Stat_RDU_FR2::VehWeight);
	snprintf(buffer, elcount(buffer), "   0.000000 F1 RDU::Veh_Stat_RDU_FR2::VehWeight = %d\n", intval);
	filePutString (buffer, elcount(buffer), hFile);
}
/*@@end*/

/*@@caplFunc:saveVars_96(dword):*/
void saveVars_96(dword hFile)
{
	floatval = getSignal(CHASSIS::Veh_Stat_RDU_FR2::WhlBase);
	snprintf(buffer, elcount(buffer), "   0.000000 F1 RDU::Veh_Stat_RDU_FR2::WhlBase = %f\n", floatval);
	filePutString (buffer, elcount(buffer), hFile);
	floatval = getSignal(CHASSIS::Veh_Stat_RDU_FR2::WhlCircumDyn);
	snprintf(buffer, elcount(buffer), "   0.000000 F1 RDU::Veh_Stat_RDU_FR2::WhlCircumDyn = %f\n", floatval);
	filePutString (buffer, elcount(buffer), hFile);
	intval = @sysvar::CH_Nodes::CH_RDUCRC_VehAccel_X_Rq_Pr2_AUTO;
	snprintf(buffer, elcount(buffer), "   0.000000    SV: 2 0 0 ::CH_Nodes::CH_RDUCRC_VehAccel_X_Rq_Pr2_AUTO = %d\n", intval);
	filePutString (buffer, elcount(buffer), hFile);
	intval = getSignal(CHASSIS::VehAccel_X_Rq_AR2::CRC_VehAccel_X_Rq_Pr2);
	snprintf(buffer, elcount(buffer), "   0.000000 F1 RDU::VehAccel_X_Rq_AR2::CRC_VehAccel_X_Rq_Pr2 = %d\n", intval);
	filePutString (buffer, elcount(buffer), hFile);
	intval = @sysvar::CH_Nodes::CH_RDUSQC_VehAccel_X_Rq_Pr2_AUTO;
	snprintf(buffer, elcount(buffer), "   0.000000    SV: 2 0 0 ::CH_Nodes::CH_RDUSQC_VehAccel_X_Rq_Pr2_AUTO = %d\n", intval);
	filePutString (buffer, elcount(buffer), hFile);
	intval = getSignal(CHASSIS::VehAccel_X_Rq_AR2::SQC_VehAccel_X_Rq_Pr2);
	snprintf(buffer, elcount(buffer), "   0.000000 F1 RDU::VehAccel_X_Rq_AR2::SQC_VehAccel_X_Rq_Pr2 = %d\n", intval);
	filePutString (buffer, elcount(buffer), hFile);
	intval = getSignal(CHASSIS::VehAccel_X_Rq_AR2::VehAccel_X_Md_Rq);
	snprintf(buffer, elcount(buffer), "   0.000000 F1 RDU::VehAccel_X_Rq_AR2::VehAccel_X_Md_Rq = %d\n", intval);
	filePutString (buffer, elcount(buffer), hFile);
	intval = getSignal(CHASSIS::VehAccel_X_Rq_AR2::Rsrv2_VehAccel_X_Rq_Pr2);
	snprintf(buffer, elcount(buffer), "   0.000000 F1 RDU::VehAccel_X_Rq_AR2::Rsrv2_VehAccel_X_Rq_Pr2 = %d\n", intval);
	filePutString (buffer, elcount(buffer), hFile);
	floatval = getSignal(CHASSIS::VehAccel_X_Rq_AR2::VehAccel_X_Rq);
	snprintf(buffer, elcount(buffer), "   0.000000 F1 RDU::VehAccel_X_Rq_AR2::VehAccel_X_Rq = %f\n", floatval);
	filePutString (buffer, elcount(buffer), hFile);
	intval = getSignal(CHASSIS::VehAccel_X_Rq_AR2::ECU_Flt_Stat);
	snprintf(buffer, elcount(buffer), "   0.000000 F1 RDU::VehAccel_X_Rq_AR2::ECU_Flt_Stat = %d\n", intval);
	filePutString (buffer, elcount(buffer), hFile);
	floatval = getSignal(CHASSIS::VehAccel_X_Rq_AR2::VehAccel_X_Rq_Raw);
	snprintf(buffer, elcount(buffer), "   0.000000 F1 RDU::VehAccel_X_Rq_AR2::VehAccel_X_Rq_Raw = %f\n", floatval);
	filePutString (buffer, elcount(buffer), hFile);
	intval = getSignal(CHASSIS::VehAccel_X_Rq_AR2::AS_Actv_Ctrl_Stat);
	snprintf(buffer, elcount(buffer), "   0.000000 F1 RDU::VehAccel_X_Rq_AR2::AS_Actv_Ctrl_Stat = %d\n", intval);
	filePutString (buffer, elcount(buffer), hFile);
	intval = getSignal(CHASSIS::VehAccel_X_Rq_AR2::PwrFreeD_Supp_Rq_RDU);
	snprintf(buffer, elcount(buffer), "   0.000000 F1 RDU::VehAccel_X_Rq_AR2::PwrFreeD_Supp_Rq_RDU = %d\n", intval);
	filePutString (buffer, elcount(buffer), hFile);
	intval = getSignal(CHASSIS::VehAccel_X_Rq_AR2::BrkPrefill_Rq_RDU);
	snprintf(buffer, elcount(buffer), "   0.000000 F1 RDU::VehAccel_X_Rq_AR2::BrkPrefill_Rq_RDU = %d\n", intval);
	filePutString (buffer, elcount(buffer), hFile);
	intval = getSignal(CHASSIS::VehAccel_X_Rq_AR2::VehAccel_X_Rq_AS_Actv);
	snprintf(buffer, elcount(buffer), "   0.000000 F1 RDU::VehAccel_X_Rq_AR2::VehAccel_X_Rq_AS_Actv = %d\n", intval);
	filePutString (buffer, elcount(buffer), hFile);
	intval = getSignal(CHASSIS::VehAccel_X_Rq_AR2::AS_DrvAway_Rq);
	snprintf(buffer, elcount(buffer), "   0.000000 F1 RDU::VehAccel_X_Rq_AR2::AS_DrvAway_Rq = %d\n", intval);
	filePutString (buffer, elcount(buffer), hFile);
	intval = getSignal(CHASSIS::VehAccel_X_Rq_AR2::AS_VehSp_Rq);
	snprintf(buffer, elcount(buffer), "   0.000000 F1 RDU::VehAccel_X_Rq_AR2::AS_VehSp_Rq = %d\n", intval);
	filePutString (buffer, elcount(buffer), hFile);
	intval = getSignal(CHASSIS::VehAccel_X_Rq_AR2::SPCR_ErrEntry_Rq);
	snprintf(buffer, elcount(buffer), "   0.000000 F1 RDU::VehAccel_X_Rq_AR2::SPCR_ErrEntry_Rq = %d\n", intval);
	filePutString (buffer, elcount(buffer), hFile);
	intval = getSignal(CHASSIS::VehAccel_X_Rq_AR2::AS_SpdCtrl_Actv);
	snprintf(buffer, elcount(buffer), "   0.000000 F1 RDU::VehAccel_X_Rq_AR2::AS_SpdCtrl_Actv = %d\n", intval);
	filePutString (buffer, elcount(buffer), hFile);
	intval = getSignal(CHASSIS::VehAccel_X_Rq_AR2::AS_DistCtrl_Actv);
	snprintf(buffer, elcount(buffer), "   0.000000 F1 RDU::VehAccel_X_Rq_AR2::AS_DistCtrl_Actv = %d\n", intval);
	filePutString (buffer, elcount(buffer), hFile);
	intval = getSignal(CHASSIS::VehAccel_X_Rq_AR2::SSA_Enbl_Rq_RDU);
	snprintf(buffer, elcount(buffer), "   0.000000 F1 RDU::VehAccel_X_Rq_AR2::SSA_Enbl_Rq_RDU = %d\n", intval);
	filePutString (buffer, elcount(buffer), hFile);
	intval = getSignal(CHASSIS::VehAccel_X_Rq_AR2::AS_EV_Md_Rq);
	snprintf(buffer, elcount(buffer), "   0.000000 F1 RDU::VehAccel_X_Rq_AR2::AS_EV_Md_Rq = %d\n", intval);
	filePutString (buffer, elcount(buffer), hFile);
	intval = getSignal(CHASSIS::VehAccel_X_Rq_AR2::AS_DnShift_Dsabl_Rq);
	snprintf(buffer, elcount(buffer), "   0.000000 F1 RDU::VehAccel_X_Rq_AR2::AS_DnShift_Dsabl_Rq = %d\n", intval);
	filePutString (buffer, elcount(buffer), hFile);
	intval = getSignal(CHASSIS::VehAccel_X_Rq_AR2::AS_UpShift_Dsabl_Rq);
	snprintf(buffer, elcount(buffer), "   0.000000 F1 RDU::VehAccel_X_Rq_AR2::AS_UpShift_Dsabl_Rq = %d\n", intval);
	filePutString (buffer, elcount(buffer), hFile);
	intval = getSignal(CHASSIS::VehAccel_X_Rq_AR2::Rsrv1_VehAccel_X_Rq_Pr2);
	snprintf(buffer, elcount(buffer), "   0.000000 F1 RDU::VehAccel_X_Rq_AR2::Rsrv1_VehAccel_X_Rq_Pr2 = %d\n", intval);
	filePutString (buffer, elcount(buffer), hFile);
	snprintf(buffer, elcount(buffer), "   0.000000    SV: 2 0 0 ::CH_Nodes::CH__NMActive_SCCM = %X\n", @sysvar::CH_Nodes::CH__NMActive_SCCM);
	filePutString (buffer, elcount(buffer), hFile);
	snprintf(buffer, elcount(buffer), "   0.000000    SV: 2 0 0 ::CH_Nodes::CH__NMAwake_SCCM = %X\n", @sysvar::CH_Nodes::CH__NMAwake_SCCM);
	filePutString (buffer, elcount(buffer), hFile);
	intval = @sysvar::CH_Nodes::CH_SCCMCRC_LDC_Rq_StWhl_Pr2_AUTO;
	snprintf(buffer, elcount(buffer), "   0.000000    SV: 2 0 0 ::CH_Nodes::CH_SCCMCRC_LDC_Rq_StWhl_Pr2_AUTO = %d\n", intval);
	filePutString (buffer, elcount(buffer), hFile);
	intval = getSignal(CHASSIS::LDC_Rq_StWhl_AR2::CRC_LDC_Rq_StWhl_Pr2);
	snprintf(buffer, elcount(buffer), "   0.000000 F1 SCCM::LDC_Rq_StWhl_AR2::CRC_LDC_Rq_StWhl_Pr2 = %d\n", intval);
	filePutString (buffer, elcount(buffer), hFile);
	intval = @sysvar::CH_Nodes::CH_SCCMSQC_LDC_Rq_StWhl_Pr2_AUTO;
	snprintf(buffer, elcount(buffer), "   0.000000    SV: 2 0 0 ::CH_Nodes::CH_SCCMSQC_LDC_Rq_StWhl_Pr2_AUTO = %d\n", intval);
	filePutString (buffer, elcount(buffer), hFile);
	intval = getSignal(CHASSIS::LDC_Rq_StWhl_AR2::SQC_LDC_Rq_StWhl_Pr2);
	snprintf(buffer, elcount(buffer), "   0.000000 F1 SCCM::LDC_Rq_StWhl_AR2::SQC_LDC_Rq_StWhl_Pr2 = %d\n", intval);
	filePutString (buffer, elcount(buffer), hFile);
	intval = getSignal(CHASSIS::LDC_Rq_StWhl_AR2::LDC_Sw_CC_Chs_Psd);
	snprintf(buffer, elcount(buffer), "   0.000000 F1 SCCM::LDC_Rq_StWhl_AR2::LDC_Sw_CC_Chs_Psd = %d\n", intval);
	filePutString (buffer, elcount(buffer), hFile);
	intval = getSignal(CHASSIS::LDC_Rq_StWhl_AR2::LDC_Sw_CC_Off_Psd);
	snprintf(buffer, elcount(buffer), "   0.000000 F1 SCCM::LDC_Rq_StWhl_AR2::LDC_Sw_CC_Off_Psd = %d\n", intval);
	filePutString (buffer, elcount(buffer), hFile);
	intval = getSignal(CHASSIS::LDC_Rq_StWhl_AR2::LDC_Sw_Cancel_Psd);
	snprintf(buffer, elcount(buffer), "   0.000000 F1 SCCM::LDC_Rq_StWhl_AR2::LDC_Sw_Cancel_Psd = %d\n", intval);
	filePutString (buffer, elcount(buffer), hFile);
	intval = getSignal(CHASSIS::LDC_Rq_StWhl_AR2::LDC_Sw_DTR_Dist_Tgl_Psd);
	snprintf(buffer, elcount(buffer), "   0.000000 F1 SCCM::LDC_Rq_StWhl_AR2::LDC_Sw_DTR_Dist_Tgl_Psd = %d\n", intval);
	filePutString (buffer, elcount(buffer), hFile);
	intval = getSignal(CHASSIS::LDC_Rq_StWhl_AR2::LDC_Sw_Resume_Psd);
	snprintf(buffer, elcount(buffer), "   0.000000 F1 SCCM::LDC_Rq_StWhl_AR2::LDC_Sw_Resume_Psd = %d\n", intval);
	filePutString (buffer, elcount(buffer), hFile);
	intval = getSignal(CHASSIS::LDC_Rq_StWhl_AR2::LDC_Sw_Mode_Psd);
	snprintf(buffer, elcount(buffer), "   0.000000 F1 SCCM::LDC_Rq_StWhl_AR2::LDC_Sw_Mode_Psd = %d\n", intval);
	filePutString (buffer, elcount(buffer), hFile);
	intval = getSignal(CHASSIS::LDC_Rq_StWhl_AR2::LDC_Sw_Up10_Set_Psd);
	snprintf(buffer, elcount(buffer), "   0.000000 F1 SCCM::LDC_Rq_StWhl_AR2::LDC_Sw_Up10_Set_Psd = %d\n", intval);
	filePutString (buffer, elcount(buffer), hFile);
	intval = getSignal(CHASSIS::LDC_Rq_StWhl_AR2::LDC_Sw_Up1_Set_Psd);
	snprintf(buffer, elcount(buffer), "   0.000000 F1 SCCM::LDC_Rq_StWhl_AR2::LDC_Sw_Up1_Set_Psd = %d\n", intval);
	filePutString (buffer, elcount(buffer), hFile);
	intval = getSignal(CHASSIS::LDC_Rq_StWhl_AR2::LDC_Sw_Dn1_Set_Psd);
	snprintf(buffer, elcount(buffer), "   0.000000 F1 SCCM::LDC_Rq_StWhl_AR2::LDC_Sw_Dn1_Set_Psd = %d\n", intval);
	filePutString (buffer, elcount(buffer), hFile);
	intval = getSignal(CHASSIS::LDC_Rq_StWhl_AR2::LDC_Sw_Dn10_Set_Psd);
	snprintf(buffer, elcount(buffer), "   0.000000 F1 SCCM::LDC_Rq_StWhl_AR2::LDC_Sw_Dn10_Set_Psd = %d\n", intval);
	filePutString (buffer, elcount(buffer), hFile);
	intval = getSignal(CHASSIS::LDC_Rq_StWhl_AR2::LDC_Sw_VSL_Chs_Psd);
	snprintf(buffer, elcount(buffer), "   0.000000 F1 SCCM::LDC_Rq_StWhl_AR2::LDC_Sw_VSL_Chs_Psd = %d\n", intval);
	filePutString (buffer, elcount(buffer), hFile);
	intval = getSignal(CHASSIS::LDC_Rq_StWhl_AR2::LDC_Sw_VSL_Off_Psd);
	snprintf(buffer, elcount(buffer), "   0.000000 F1 SCCM::LDC_Rq_StWhl_AR2::LDC_Sw_VSL_Off_Psd = %d\n", intval);
	filePutString (buffer, elcount(buffer), hFile);
	intval = getSignal(CHASSIS::LDC_Rq_StWhl_AR2::LDC_Sw_DTR_Dist_Plus_Psd);
	snprintf(buffer, elcount(buffer), "   0.000000 F1 SCCM::LDC_Rq_StWhl_AR2::LDC_Sw_DTR_Dist_Plus_Psd = %d\n", intval);
	filePutString (buffer, elcount(buffer), hFile);
	intval = getSignal(CHASSIS::LDC_Rq_StWhl_AR2::LDC_Sw_DTR_Dist_Minus_Psd);
	snprintf(buffer, elcount(buffer), "   0.000000 F1 SCCM::LDC_Rq_StWhl_AR2::LDC_Sw_DTR_Dist_Minus_Psd = %d\n", intval);
	filePutString (buffer, elcount(buffer), hFile);
	intval = @sysvar::CH_Nodes::CH_SCCMCRC_LDC_Rq_SCCM_Pr2L_AUTO;
	snprintf(buffer, elcount(buffer), "   0.000000    SV: 2 0 0 ::CH_Nodes::CH_SCCMCRC_LDC_Rq_SCCM_Pr2L_AUTO = %d\n", intval);
	filePutString (buffer, elcount(buffer), hFile);
	intval = getSignal(CHASSIS::LDC_SBW_Rq_SCCM_AR2::CRC_LDC_Rq_SCCM_Pr2);
	snprintf(buffer, elcount(buffer), "   0.000000 F1 SCCM::LDC_SBW_Rq_SCCM_AR2::CRC_LDC_Rq_SCCM_Pr2 = %d\n", intval);
	filePutString (buffer, elcount(buffer), hFile);
	intval = @sysvar::CH_Nodes::CH_SCCMSQC_LDC_Rq_SCCM_Pr2L_AUTO;
	snprintf(buffer, elcount(buffer), "   0.000000    SV: 2 0 0 ::CH_Nodes::CH_SCCMSQC_LDC_Rq_SCCM_Pr2L_AUTO = %d\n", intval);
	filePutString (buffer, elcount(buffer), hFile);
	intval = getSignal(CHASSIS::LDC_SBW_Rq_SCCM_AR2::SQC_LDC_Rq_SCCM_Pr2);
	snprintf(buffer, elcount(buffer), "   0.000000 F1 SCCM::LDC_SBW_Rq_SCCM_AR2::SQC_LDC_Rq_SCCM_Pr2 = %d\n", intval);
	filePutString (buffer, elcount(buffer), hFile);
	intval = getSignal(CHASSIS::LDC_SBW_Rq_SCCM_AR2::Rsrv1_LDC_Rq_SCCM_Pr2);
	snprintf(buffer, elcount(buffer), "   0.000000 F1 SCCM::LDC_SBW_Rq_SCCM_AR2::Rsrv1_LDC_Rq_SCCM_Pr2 = %d\n", intval);
	filePutString (buffer, elcount(buffer), hFile);
	intval = getSignal(CHASSIS::LDC_SBW_Rq_SCCM_AR2::SpdCtrlLvr_Stat_V3);
	snprintf(buffer, elcount(buffer), "   0.000000 F1 SCCM::LDC_SBW_Rq_SCCM_AR2::SpdCtrlLvr_Stat_V3 = %d\n", intval);
	filePutString (buffer, elcount(buffer), hFile);
	intval = getSignal(CHASSIS::LDC_SBW_Rq_SCCM_AR2::Rsrv2_LDC_Rq_SCCM_Pr2);
	snprintf(buffer, elcount(buffer), "   0.000000 F1 SCCM::LDC_SBW_Rq_SCCM_AR2::Rsrv2_LDC_Rq_SCCM_Pr2 = %d\n", intval);
	filePutString (buffer, elcount(buffer), hFile);
	intval = getSignal(CHASSIS::LDC_SBW_Rq_SCCM_AR2::VSL_Enbl_Rq);
	snprintf(buffer, elcount(buffer), "   0.000000 F1 SCCM::LDC_SBW_Rq_SCCM_AR2::VSL_Enbl_Rq = %d\n", intval);
	filePutString (buffer, elcount(buffer), hFile);
	intval = getSignal(CHASSIS::LDC_SBW_Rq_SCCM_AR2::DTR_Dist_Rq);
	snprintf(buffer, elcount(buffer), "   0.000000 F1 SCCM::LDC_SBW_Rq_SCCM_AR2::DTR_Dist_Rq = %d\n", intval);
	filePutString (buffer, elcount(buffer), hFile);
	intval = @sysvar::CH_Nodes::CH_SCCMCRC_SBW_Rq_SCCM_Pr2L_AUTO;
	snprintf(buffer, elcount(buffer), "   0.000000    SV: 2 0 0 ::CH_Nodes::CH_SCCMCRC_SBW_Rq_SCCM_Pr2L_AUTO = %d\n", intval);
	filePutString (buffer, elcount(buffer), hFile);
	intval = getSignal(CHASSIS::LDC_SBW_Rq_SCCM_AR2::CRC_SBW_Rq_SCCM_Pr2);
	snprintf(buffer, elcount(buffer), "   0.000000 F1 SCCM::LDC_SBW_Rq_SCCM_AR2::CRC_SBW_Rq_SCCM_Pr2 = %d\n", intval);
	filePutString (buffer, elcount(buffer), hFile);
	intval = @sysvar::CH_Nodes::CH_SCCMSQC_SBW_Rq_SCCM_Pr2L_AUTO;
	snprintf(buffer, elcount(buffer), "   0.000000    SV: 2 0 0 ::CH_Nodes::CH_SCCMSQC_SBW_Rq_SCCM_Pr2L_AUTO = %d\n", intval);
	filePutString (buffer, elcount(buffer), hFile);
	intval = getSignal(CHASSIS::LDC_SBW_Rq_SCCM_AR2::SQC_SBW_Rq_SCCM_Pr2);
	snprintf(buffer, elcount(buffer), "   0.000000 F1 SCCM::LDC_SBW_Rq_SCCM_AR2::SQC_SBW_Rq_SCCM_Pr2 = %d\n", intval);
	filePutString (buffer, elcount(buffer), hFile);
	intval = getSignal(CHASSIS::LDC_SBW_Rq_SCCM_AR2::TSL_RND_Posn_StW);
	snprintf(buffer, elcount(buffer), "   0.000000 F1 SCCM::LDC_SBW_Rq_SCCM_AR2::TSL_RND_Posn_StW = %d\n", intval);
	filePutString (buffer, elcount(buffer), hFile);
}
/*@@end*/

/*@@caplFunc:saveVars_97(dword):*/
void saveVars_97(dword hFile)
{
	intval = getSignal(CHASSIS::LDC_SBW_Rq_SCCM_AR2::TSL_P_Psd_StW);
	snprintf(buffer, elcount(buffer), "   0.000000 F1 SCCM::LDC_SBW_Rq_SCCM_AR2::TSL_P_Psd_StW = %d\n", intval);
	filePutString (buffer, elcount(buffer), hFile);
	intval = getSignal(CHASSIS::LDC_SBW_Rq_SCCM_AR2::TxmtId_SBW_Rq_SCCM);
	snprintf(buffer, elcount(buffer), "   0.000000 F1 SCCM::LDC_SBW_Rq_SCCM_AR2::TxmtId_SBW_Rq_SCCM = %d\n", intval);
	filePutString (buffer, elcount(buffer), hFile);
	intval = getSignal(CHASSIS::LDC_SBW_Rq_SCCM_AR2::StWhl_Sw_Stat3);
	snprintf(buffer, elcount(buffer), "   0.000000 F1 SCCM::LDC_SBW_Rq_SCCM_AR2::StWhl_Sw_Stat3 = %d\n", intval);
	filePutString (buffer, elcount(buffer), hFile);
	intval = getSignal(CHASSIS::LDC_SBW_Rq_SCCM_AR2::Rsrv1_SBW_Rq_SCCM_Pr2);
	snprintf(buffer, elcount(buffer), "   0.000000 F1 SCCM::LDC_SBW_Rq_SCCM_AR2::Rsrv1_SBW_Rq_SCCM_Pr2 = %d\n", intval);
	filePutString (buffer, elcount(buffer), hFile);
	intval = getSignal(CHASSIS::LDC_SBW_Rq_SCCM_AR2::Rsrv2_SBW_Rq_SCCM_Pr2);
	snprintf(buffer, elcount(buffer), "   0.000000 F1 SCCM::LDC_SBW_Rq_SCCM_AR2::Rsrv2_SBW_Rq_SCCM_Pr2 = %d\n", intval);
	filePutString (buffer, elcount(buffer), hFile);
	intval = getSignal(CHASSIS::ROE_SCCM::ROE_Header_SCCM);
	snprintf(buffer, elcount(buffer), "   0.000000 F1 SCCM::ROE_SCCM::ROE_Header_SCCM = %d\n", intval);
	filePutString (buffer, elcount(buffer), hFile);
	intval = getSignal(CHASSIS::ROE_SCCM::ROE_DTC_SCCM);
	snprintf(buffer, elcount(buffer), "   0.000000 F1 SCCM::ROE_SCCM::ROE_DTC_SCCM = %d\n", intval);
	filePutString (buffer, elcount(buffer), hFile);
	intval = getSignal(CHASSIS::ROE_SCCM::ROE_DTC_Stat_SCCM);
	snprintf(buffer, elcount(buffer), "   0.000000 F1 SCCM::ROE_SCCM::ROE_DTC_Stat_SCCM = %d\n", intval);
	filePutString (buffer, elcount(buffer), hFile);
	intval = getSignal(CHASSIS::ROE_SWSP::ROE_Header_SWSP);
	snprintf(buffer, elcount(buffer), "   0.000000 F1 SCCM::ROE_SWSP::ROE_Header_SWSP = %d\n", intval);
	filePutString (buffer, elcount(buffer), hFile);
	intval = getSignal(CHASSIS::ROE_SWSP::ROE_DTC_SWSP);
	snprintf(buffer, elcount(buffer), "   0.000000 F1 SCCM::ROE_SWSP::ROE_DTC_SWSP = %d\n", intval);
	filePutString (buffer, elcount(buffer), hFile);
	intval = getSignal(CHASSIS::ROE_SWSP::ROE_DTC_Stat_SWSP);
	snprintf(buffer, elcount(buffer), "   0.000000 F1 SCCM::ROE_SWSP::ROE_DTC_Stat_SWSP = %d\n", intval);
	filePutString (buffer, elcount(buffer), hFile);
	intval = @sysvar::CH_Nodes::CH_SCCMCRC_SCCM_Lvr_Stat_Pr_AUTO;
	snprintf(buffer, elcount(buffer), "   0.000000    SV: 2 0 0 ::CH_Nodes::CH_SCCMCRC_SCCM_Lvr_Stat_Pr_AUTO = %d\n", intval);
	filePutString (buffer, elcount(buffer), hFile);
	intval = getSignal(CHASSIS::SCCM_Sw_Stat_AR2::CRC_SCCM_Lvr_Stat_Pr2);
	snprintf(buffer, elcount(buffer), "   0.000000 F1 SCCM::SCCM_Sw_Stat_AR2::CRC_SCCM_Lvr_Stat_Pr2 = %d\n", intval);
	filePutString (buffer, elcount(buffer), hFile);
	intval = @sysvar::CH_Nodes::CH_SCCMSQC_SCCM_Lvr_Stat_Pr_AUTO;
	snprintf(buffer, elcount(buffer), "   0.000000    SV: 2 0 0 ::CH_Nodes::CH_SCCMSQC_SCCM_Lvr_Stat_Pr_AUTO = %d\n", intval);
	filePutString (buffer, elcount(buffer), hFile);
	intval = getSignal(CHASSIS::SCCM_Sw_Stat_AR2::SQC_SCCM_Lvr_Stat_Pr2);
	snprintf(buffer, elcount(buffer), "   0.000000 F1 SCCM::SCCM_Sw_Stat_AR2::SQC_SCCM_Lvr_Stat_Pr2 = %d\n", intval);
	filePutString (buffer, elcount(buffer), hFile);
	intval = getSignal(CHASSIS::SCCM_Sw_Stat_AR2::TurnIndLvr_Stat);
	snprintf(buffer, elcount(buffer), "   0.000000 F1 SCCM::SCCM_Sw_Stat_AR2::TurnIndLvr_Stat = %d\n", intval);
	filePutString (buffer, elcount(buffer), hFile);
	intval = getSignal(CHASSIS::SCCM_Sw_Stat_AR2::HiBmLvr_Stat);
	snprintf(buffer, elcount(buffer), "   0.000000 F1 SCCM::SCCM_Sw_Stat_AR2::HiBmLvr_Stat = %d\n", intval);
	filePutString (buffer, elcount(buffer), hFile);
	intval = getSignal(CHASSIS::SCCM_Sw_Stat_AR2::Rsrv1_SCCM_Lvr_Stat_Pr2);
	snprintf(buffer, elcount(buffer), "   0.000000 F1 SCCM::SCCM_Sw_Stat_AR2::Rsrv1_SCCM_Lvr_Stat_Pr2 = %d\n", intval);
	filePutString (buffer, elcount(buffer), hFile);
	intval = @sysvar::CH_Nodes::CH_SCCMCRC_WprWashSw_Stat_P_AUTO;
	snprintf(buffer, elcount(buffer), "   0.000000    SV: 2 0 0 ::CH_Nodes::CH_SCCMCRC_WprWashSw_Stat_P_AUTO = %d\n", intval);
	filePutString (buffer, elcount(buffer), hFile);
	intval = getSignal(CHASSIS::SCCM_Sw_Stat_AR2::CRC_WprWashSw_Stat_Pr2);
	snprintf(buffer, elcount(buffer), "   0.000000 F1 SCCM::SCCM_Sw_Stat_AR2::CRC_WprWashSw_Stat_Pr2 = %d\n", intval);
	filePutString (buffer, elcount(buffer), hFile);
	intval = @sysvar::CH_Nodes::CH_SCCMSQC_WprWashSw_Stat_P_AUTO;
	snprintf(buffer, elcount(buffer), "   0.000000    SV: 2 0 0 ::CH_Nodes::CH_SCCMSQC_WprWashSw_Stat_P_AUTO = %d\n", intval);
	filePutString (buffer, elcount(buffer), hFile);
	intval = getSignal(CHASSIS::SCCM_Sw_Stat_AR2::SQC_WprWashSw_Stat_Pr2);
	snprintf(buffer, elcount(buffer), "   0.000000 F1 SCCM::SCCM_Sw_Stat_AR2::SQC_WprWashSw_Stat_Pr2 = %d\n", intval);
	filePutString (buffer, elcount(buffer), hFile);
	intval = getSignal(CHASSIS::SCCM_Sw_Stat_AR2::WprWashSw_Psd);
	snprintf(buffer, elcount(buffer), "   0.000000 F1 SCCM::SCCM_Sw_Stat_AR2::WprWashSw_Psd = %d\n", intval);
	filePutString (buffer, elcount(buffer), hFile);
	intval = getSignal(CHASSIS::SCCM_Sw_Stat_AR2::WprWash_R_Sw_Posn_V2);
	snprintf(buffer, elcount(buffer), "   0.000000 F1 SCCM::SCCM_Sw_Stat_AR2::WprWash_R_Sw_Posn_V2 = %d\n", intval);
	filePutString (buffer, elcount(buffer), hFile);
	intval = getSignal(CHASSIS::SCCM_Sw_Stat_AR2::WprSw6Posn);
	snprintf(buffer, elcount(buffer), "   0.000000 F1 SCCM::SCCM_Sw_Stat_AR2::WprSw6Posn = %d\n", intval);
	filePutString (buffer, elcount(buffer), hFile);
	intval = getSignal(CHASSIS::SCCM_Sw_Stat_AR2::Rsrv1_WprWashSw_Stat_Pr2);
	snprintf(buffer, elcount(buffer), "   0.000000 F1 SCCM::SCCM_Sw_Stat_AR2::Rsrv1_WprWashSw_Stat_Pr2 = %d\n", intval);
	filePutString (buffer, elcount(buffer), hFile);
	intval = getSignal(CHASSIS::SCCM_Sw_Stat_AR2::StW_Lvr_Stat);
	snprintf(buffer, elcount(buffer), "   0.000000 F1 SCCM::SCCM_Sw_Stat_AR2::StW_Lvr_Stat = %d\n", intval);
	filePutString (buffer, elcount(buffer), hFile);
	intval = getSignal(CHASSIS::SCCM_Sw_Stat_AR2::StW_Cond_Psd);
	snprintf(buffer, elcount(buffer), "   0.000000 F1 SCCM::SCCM_Sw_Stat_AR2::StW_Cond_Psd = %d\n", intval);
	filePutString (buffer, elcount(buffer), hFile);
	intval = getSignal(CHASSIS::SCCM_Sw_Stat_AR2::StWhl_Cond_Disp_Rq);
	snprintf(buffer, elcount(buffer), "   0.000000 F1 SCCM::SCCM_Sw_Stat_AR2::StWhl_Cond_Disp_Rq = %d\n", intval);
	filePutString (buffer, elcount(buffer), hFile);
	intval = @sysvar::CH_Nodes::CH_SCCMStWhl_Cond_Disp_R_UB_AUTO;
	snprintf(buffer, elcount(buffer), "   0.000000    SV: 2 0 0 ::CH_Nodes::CH_SCCMStWhl_Cond_Disp_R_UB_AUTO = %d\n", intval);
	filePutString (buffer, elcount(buffer), hFile);
	intval = @sysvar::CH_Nodes::CH_SCCMStWhl_Cond_Disp_RqSCC_UB_;
	snprintf(buffer, elcount(buffer), "   0.000000    SV: 2 0 0 ::CH_Nodes::CH_SCCMStWhl_Cond_Disp_RqSCC_UB_ = %d\n", intval);
	filePutString (buffer, elcount(buffer), hFile);
	intval = getSignal(CHASSIS::SCCM_Sw_Stat_AR2::HMSW_Act_Stat);
	snprintf(buffer, elcount(buffer), "   0.000000 F1 SCCM::SCCM_Sw_Stat_AR2::HMSW_Act_Stat = %d\n", intval);
	filePutString (buffer, elcount(buffer), hFile);
	intval = @sysvar::CH_Nodes::CH_SCCMHMSW_Act_StatSCCM_UB_AUTO;
	snprintf(buffer, elcount(buffer), "   0.000000    SV: 2 0 0 ::CH_Nodes::CH_SCCMHMSW_Act_StatSCCM_UB_AUTO = %d\n", intval);
	filePutString (buffer, elcount(buffer), hFile);
	intval = @sysvar::CH_Nodes::CH_SCCMHMSW_Act_StatSCCM_Sw__UB_;
	snprintf(buffer, elcount(buffer), "   0.000000    SV: 2 0 0 ::CH_Nodes::CH_SCCMHMSW_Act_StatSCCM_Sw__UB_ = %d\n", intval);
	filePutString (buffer, elcount(buffer), hFile);
	intval = @sysvar::CH_Nodes::CH_SCCMCRC_StWhl_Angl_Stat__AUTO;
	snprintf(buffer, elcount(buffer), "   0.000000    SV: 2 0 0 ::CH_Nodes::CH_SCCMCRC_StWhl_Angl_Stat__AUTO = %d\n", intval);
	filePutString (buffer, elcount(buffer), hFile);
	intval = getSignal(CHASSIS::StWhl_Angl_Stat_AR2::CRC_StWhl_Angl_Stat_Pr2);
	snprintf(buffer, elcount(buffer), "   0.000000 F1 SCCM::StWhl_Angl_Stat_AR2::CRC_StWhl_Angl_Stat_Pr2 = %d\n", intval);
	filePutString (buffer, elcount(buffer), hFile);
	intval = @sysvar::CH_Nodes::CH_SCCMSQC_StWhl_Angl_Stat__AUTO;
	snprintf(buffer, elcount(buffer), "   0.000000    SV: 2 0 0 ::CH_Nodes::CH_SCCMSQC_StWhl_Angl_Stat__AUTO = %d\n", intval);
	filePutString (buffer, elcount(buffer), hFile);
	intval = getSignal(CHASSIS::StWhl_Angl_Stat_AR2::SQC_StWhl_Angl_Stat_Pr2);
	snprintf(buffer, elcount(buffer), "   0.000000 F1 SCCM::StWhl_Angl_Stat_AR2::SQC_StWhl_Angl_Stat_Pr2 = %d\n", intval);
	filePutString (buffer, elcount(buffer), hFile);
	intval = getSignal(CHASSIS::StWhl_Angl_Stat_AR2::StWhl_AnglSens_Id);
	snprintf(buffer, elcount(buffer), "   0.000000 F1 SCCM::StWhl_Angl_Stat_AR2::StWhl_AnglSens_Id = %d\n", intval);
	filePutString (buffer, elcount(buffer), hFile);
	intval = getSignal(CHASSIS::StWhl_Angl_Stat_AR2::StWhl_AnglSens_Stat);
	snprintf(buffer, elcount(buffer), "   0.000000 F1 SCCM::StWhl_Angl_Stat_AR2::StWhl_AnglSens_Stat = %d\n", intval);
	filePutString (buffer, elcount(buffer), hFile);
	floatval = getSignal(CHASSIS::StWhl_Angl_Stat_AR2::StWhl_Angl);
	snprintf(buffer, elcount(buffer), "   0.000000 F1 SCCM::StWhl_Angl_Stat_AR2::StWhl_Angl = %f\n", floatval);
	filePutString (buffer, elcount(buffer), hFile);
	intval = getSignal(CHASSIS::StWhl_Angl_Stat_AR2::StWhl_AnglSensVld_Stat);
	snprintf(buffer, elcount(buffer), "   0.000000 F1 SCCM::StWhl_Angl_Stat_AR2::StWhl_AnglSensVld_Stat = %d\n", intval);
	filePutString (buffer, elcount(buffer), hFile);
	floatval = getSignal(CHASSIS::StWhl_Angl_Stat_AR2::StWhl_AnglSpd);
	snprintf(buffer, elcount(buffer), "   0.000000 F1 SCCM::StWhl_Angl_Stat_AR2::StWhl_AnglSpd = %f\n", floatval);
	filePutString (buffer, elcount(buffer), hFile);
	intval = getSignal(CHASSIS::StWhl_Angl_Stat_AR2::Rsrv2_StWhl_Angl_Stat_Pr2);
	snprintf(buffer, elcount(buffer), "   0.000000 F1 SCCM::StWhl_Angl_Stat_AR2::Rsrv2_StWhl_Angl_Stat_Pr2 = %d\n", intval);
	filePutString (buffer, elcount(buffer), hFile);
	intval = getSignal(CHASSIS::StWhl_Angl_Stat_AR2::Rsrv3_StWhl_Angl_Stat_Pr2);
	snprintf(buffer, elcount(buffer), "   0.000000 F1 SCCM::StWhl_Angl_Stat_AR2::Rsrv3_StWhl_Angl_Stat_Pr2 = %d\n", intval);
	filePutString (buffer, elcount(buffer), hFile);
	intval = getSignal(CHASSIS::StWhl_OFN_Stat_AR2::StWhl_OFN1_Mtn_X_Comp);
	snprintf(buffer, elcount(buffer), "   0.000000 F1 SCCM::StWhl_OFN_Stat_AR2::StWhl_OFN1_Mtn_X_Comp = %d\n", intval);
	filePutString (buffer, elcount(buffer), hFile);
	intval = getSignal(CHASSIS::StWhl_OFN_Stat_AR2::StWhl_OFN1_Mtn_Y_Comp);
	snprintf(buffer, elcount(buffer), "   0.000000 F1 SCCM::StWhl_OFN_Stat_AR2::StWhl_OFN1_Mtn_Y_Comp = %d\n", intval);
	filePutString (buffer, elcount(buffer), hFile);
	intval = getSignal(CHASSIS::StWhl_OFN_Stat_AR2::StWhl_OFN1_Stat);
	snprintf(buffer, elcount(buffer), "   0.000000 F1 SCCM::StWhl_OFN_Stat_AR2::StWhl_OFN1_Stat = %d\n", intval);
	filePutString (buffer, elcount(buffer), hFile);
	intval = getSignal(CHASSIS::StWhl_OFN_Stat_AR2::StWhl_OFN1_TmStmp);
	snprintf(buffer, elcount(buffer), "   0.000000 F1 SCCM::StWhl_OFN_Stat_AR2::StWhl_OFN1_TmStmp = %d\n", intval);
	filePutString (buffer, elcount(buffer), hFile);
	intval = getSignal(CHASSIS::StWhl_OFN_Stat_AR2::StWhl_OFN2_Mtn_X_Comp);
	snprintf(buffer, elcount(buffer), "   0.000000 F1 SCCM::StWhl_OFN_Stat_AR2::StWhl_OFN2_Mtn_X_Comp = %d\n", intval);
	filePutString (buffer, elcount(buffer), hFile);
	intval = getSignal(CHASSIS::StWhl_OFN_Stat_AR2::StWhl_OFN2_Mtn_Y_Comp);
	snprintf(buffer, elcount(buffer), "   0.000000 F1 SCCM::StWhl_OFN_Stat_AR2::StWhl_OFN2_Mtn_Y_Comp = %d\n", intval);
	filePutString (buffer, elcount(buffer), hFile);
	intval = getSignal(CHASSIS::StWhl_OFN_Stat_AR2::StWhl_OFN2_Stat);
	snprintf(buffer, elcount(buffer), "   0.000000 F1 SCCM::StWhl_OFN_Stat_AR2::StWhl_OFN2_Stat = %d\n", intval);
	filePutString (buffer, elcount(buffer), hFile);
	intval = getSignal(CHASSIS::StWhl_OFN_Stat_AR2::StWhl_OFN2_TmStmp);
	snprintf(buffer, elcount(buffer), "   0.000000 F1 SCCM::StWhl_OFN_Stat_AR2::StWhl_OFN2_TmStmp = %d\n", intval);
	filePutString (buffer, elcount(buffer), hFile);
	intval = getSignal(CHASSIS::StWhl_OFN_Stat_AR2::StWhl_OFN_SnstyMd_Stat);
	snprintf(buffer, elcount(buffer), "   0.000000 F1 SCCM::StWhl_OFN_Stat_AR2::StWhl_OFN_SnstyMd_Stat = %d\n", intval);
	filePutString (buffer, elcount(buffer), hFile);
	intval = getSignal(CHASSIS::StWhl_Sw_Stat_AR2::ALDW_VibMot_Stat);
	snprintf(buffer, elcount(buffer), "   0.000000 F1 SCCM::StWhl_Sw_Stat_AR2::ALDW_VibMot_Stat = %d\n", intval);
	filePutString (buffer, elcount(buffer), hFile);
	intval = @sysvar::CH_Nodes::CH_SCCMALDW_VibMot_StatS_UB_AUTO;
	snprintf(buffer, elcount(buffer), "   0.000000    SV: 2 0 0 ::CH_Nodes::CH_SCCMALDW_VibMot_StatS_UB_AUTO = %d\n", intval);
	filePutString (buffer, elcount(buffer), hFile);
	intval = @sysvar::CH_Nodes::CH_SCCMALDW_VibMot_StatStWhl_UB_;
	snprintf(buffer, elcount(buffer), "   0.000000    SV: 2 0 0 ::CH_Nodes::CH_SCCMALDW_VibMot_StatStWhl_UB_ = %d\n", intval);
	filePutString (buffer, elcount(buffer), hFile);
	intval = getSignal(CHASSIS::StWhl_Sw_Stat_AR2::ALDW_VibMot_Avl);
	snprintf(buffer, elcount(buffer), "   0.000000 F1 SCCM::StWhl_Sw_Stat_AR2::ALDW_VibMot_Avl = %d\n", intval);
	filePutString (buffer, elcount(buffer), hFile);
	intval = @sysvar::CH_Nodes::CH_SCCMALDW_VibMot_AvlSt_UB_AUTO;
	snprintf(buffer, elcount(buffer), "   0.000000    SV: 2 0 0 ::CH_Nodes::CH_SCCMALDW_VibMot_AvlSt_UB_AUTO = %d\n", intval);
	filePutString (buffer, elcount(buffer), hFile);
	intval = @sysvar::CH_Nodes::CH_SCCMALDW_VibMot_AvlStWhl__UB_;
	snprintf(buffer, elcount(buffer), "   0.000000    SV: 2 0 0 ::CH_Nodes::CH_SCCMALDW_VibMot_AvlStWhl__UB_ = %d\n", intval);
	filePutString (buffer, elcount(buffer), hFile);
	intval = getSignal(CHASSIS::StWhl_Sw_Stat_AR2::StWhl_Cond_ALDW_Sup);
	snprintf(buffer, elcount(buffer), "   0.000000 F1 SCCM::StWhl_Sw_Stat_AR2::StWhl_Cond_ALDW_Sup = %d\n", intval);
	filePutString (buffer, elcount(buffer), hFile);
}
/*@@end*/

/*@@caplFunc:saveVars_98(dword):*/
void saveVars_98(dword hFile)
{
	intval = @sysvar::CH_Nodes::CH_SCCMCRC_StWhl_Sw_Ok1_Ok2_AUTO;
	snprintf(buffer, elcount(buffer), "   0.000000    SV: 2 0 0 ::CH_Nodes::CH_SCCMCRC_StWhl_Sw_Ok1_Ok2_AUTO = %d\n", intval);
	filePutString (buffer, elcount(buffer), hFile);
	intval = getSignal(CHASSIS::StWhl_Sw_Stat_AR2::CRC_StWhl_Sw_Ok1_Ok2_Psd_Pr2);
	snprintf(buffer, elcount(buffer), "   0.000000 F1 SCCM::StWhl_Sw_Stat_AR2::CRC_StWhl_Sw_Ok1_Ok2_Psd_Pr2 = %d\n", intval);
	filePutString (buffer, elcount(buffer), hFile);
	intval = @sysvar::CH_Nodes::CH_SCCMSQC_StWhl_Sw_Ok1_Ok2_AUTO;
	snprintf(buffer, elcount(buffer), "   0.000000    SV: 2 0 0 ::CH_Nodes::CH_SCCMSQC_StWhl_Sw_Ok1_Ok2_AUTO = %d\n", intval);
	filePutString (buffer, elcount(buffer), hFile);
	intval = getSignal(CHASSIS::StWhl_Sw_Stat_AR2::SQC_StWhl_Sw_Ok1_Ok2_Psd_Pr2);
	snprintf(buffer, elcount(buffer), "   0.000000 F1 SCCM::StWhl_Sw_Stat_AR2::SQC_StWhl_Sw_Ok1_Ok2_Psd_Pr2 = %d\n", intval);
	filePutString (buffer, elcount(buffer), hFile);
	intval = getSignal(CHASSIS::StWhl_Sw_Stat_AR2::StWhl_Sw_Ok2_Psd);
	snprintf(buffer, elcount(buffer), "   0.000000 F1 SCCM::StWhl_Sw_Stat_AR2::StWhl_Sw_Ok2_Psd = %d\n", intval);
	filePutString (buffer, elcount(buffer), hFile);
	intval = getSignal(CHASSIS::StWhl_Sw_Stat_AR2::StWhl_Sw_Ok1_Psd);
	snprintf(buffer, elcount(buffer), "   0.000000 F1 SCCM::StWhl_Sw_Stat_AR2::StWhl_Sw_Ok1_Psd = %d\n", intval);
	filePutString (buffer, elcount(buffer), hFile);
	intval = getSignal(CHASSIS::StWhl_Sw_Stat_AR2::StWhl_Sw_Back1_Psd);
	snprintf(buffer, elcount(buffer), "   0.000000 F1 SCCM::StWhl_Sw_Stat_AR2::StWhl_Sw_Back1_Psd = %d\n", intval);
	filePutString (buffer, elcount(buffer), hFile);
	intval = getSignal(CHASSIS::StWhl_Sw_Stat_AR2::StWhl_Sw_Mute_Psd);
	snprintf(buffer, elcount(buffer), "   0.000000 F1 SCCM::StWhl_Sw_Stat_AR2::StWhl_Sw_Mute_Psd = %d\n", intval);
	filePutString (buffer, elcount(buffer), hFile);
	intval = getSignal(CHASSIS::StWhl_Sw_Stat_AR2::StWhl_Sw_Minus_Psd);
	snprintf(buffer, elcount(buffer), "   0.000000 F1 SCCM::StWhl_Sw_Stat_AR2::StWhl_Sw_Minus_Psd = %d\n", intval);
	filePutString (buffer, elcount(buffer), hFile);
	intval = getSignal(CHASSIS::StWhl_Sw_Stat_AR2::StWhl_Sw_Plus_Psd);
	snprintf(buffer, elcount(buffer), "   0.000000 F1 SCCM::StWhl_Sw_Stat_AR2::StWhl_Sw_Plus_Psd = %d\n", intval);
	filePutString (buffer, elcount(buffer), hFile);
	intval = getSignal(CHASSIS::StWhl_Sw_Stat_AR2::StWhl_Sw_Back2_Psd);
	snprintf(buffer, elcount(buffer), "   0.000000 F1 SCCM::StWhl_Sw_Stat_AR2::StWhl_Sw_Back2_Psd = %d\n", intval);
	filePutString (buffer, elcount(buffer), hFile);
	intval = getSignal(CHASSIS::StWhl_Sw_Stat_AR2::StWhl_Sw_PTT_Psd);
	snprintf(buffer, elcount(buffer), "   0.000000 F1 SCCM::StWhl_Sw_Stat_AR2::StWhl_Sw_PTT_Psd = %d\n", intval);
	filePutString (buffer, elcount(buffer), hFile);
	intval = getSignal(CHASSIS::StWhl_Sw_Stat_AR2::StWhl_Sw_TelSend_Psd);
	snprintf(buffer, elcount(buffer), "   0.000000 F1 SCCM::StWhl_Sw_Stat_AR2::StWhl_Sw_TelSend_Psd = %d\n", intval);
	filePutString (buffer, elcount(buffer), hFile);
	intval = getSignal(CHASSIS::StWhl_Sw_Stat_AR2::StWhl_Sw_TelEnd_Psd);
	snprintf(buffer, elcount(buffer), "   0.000000 F1 SCCM::StWhl_Sw_Stat_AR2::StWhl_Sw_TelEnd_Psd = %d\n", intval);
	filePutString (buffer, elcount(buffer), hFile);
	intval = getSignal(CHASSIS::StWhl_Sw_Stat_AR2::HrnSw_Psd_V2);
	snprintf(buffer, elcount(buffer), "   0.000000 F1 SCCM::StWhl_Sw_Stat_AR2::HrnSw_Psd_V2 = %d\n", intval);
	filePutString (buffer, elcount(buffer), hFile);
	intval = getSignal(CHASSIS::StWhl_Sw_Stat_AR2::Vol_Rq_SWSP);
	snprintf(buffer, elcount(buffer), "   0.000000 F1 SCCM::StWhl_Sw_Stat_AR2::Vol_Rq_SWSP = %d\n", intval);
	filePutString (buffer, elcount(buffer), hFile);
	intval = getSignal(CHASSIS::WUDOP_SCCM_FR::WUDOP_1_1);
	snprintf(buffer, elcount(buffer), "   0.000000 F1 SCCM::WUDOP_SCCM_FR::WUDOP_1_1 = %d\n", intval);
	filePutString (buffer, elcount(buffer), hFile);
	intval = getSignal(CHASSIS::WUDOP_SCCM_FR::WUDOP_1_2);
	snprintf(buffer, elcount(buffer), "   0.000000 F1 SCCM::WUDOP_SCCM_FR::WUDOP_1_2 = %d\n", intval);
	filePutString (buffer, elcount(buffer), hFile);
	intval = getSignal(CHASSIS::WUDOP_SCCM_FR::WUDOP_1_3);
	snprintf(buffer, elcount(buffer), "   0.000000 F1 SCCM::WUDOP_SCCM_FR::WUDOP_1_3 = %d\n", intval);
	filePutString (buffer, elcount(buffer), hFile);
	intval = getSignal(CHASSIS::WUDOP_SCCM_FR::WUDOP_1_4);
	snprintf(buffer, elcount(buffer), "   0.000000 F1 SCCM::WUDOP_SCCM_FR::WUDOP_1_4 = %d\n", intval);
	filePutString (buffer, elcount(buffer), hFile);
	intval = getSignal(CHASSIS::WUDOP_SCCM_FR::WUDOP_1_5);
	snprintf(buffer, elcount(buffer), "   0.000000 F1 SCCM::WUDOP_SCCM_FR::WUDOP_1_5 = %d\n", intval);
	filePutString (buffer, elcount(buffer), hFile);
	intval = getSignal(CHASSIS::WUDOP_SCCM_FR::WUDOP_2_1);
	snprintf(buffer, elcount(buffer), "   0.000000 F1 SCCM::WUDOP_SCCM_FR::WUDOP_2_1 = %d\n", intval);
	filePutString (buffer, elcount(buffer), hFile);
	intval = getSignal(CHASSIS::WUDOP_SCCM_FR::WUDOP_2_2);
	snprintf(buffer, elcount(buffer), "   0.000000 F1 SCCM::WUDOP_SCCM_FR::WUDOP_2_2 = %d\n", intval);
	filePutString (buffer, elcount(buffer), hFile);
	intval = getSignal(CHASSIS::WUDOP_SCCM_FR::WUDOP_2_3);
	snprintf(buffer, elcount(buffer), "   0.000000 F1 SCCM::WUDOP_SCCM_FR::WUDOP_2_3 = %d\n", intval);
	filePutString (buffer, elcount(buffer), hFile);
	intval = getSignal(CHASSIS::WUDOP_SCCM_FR::WUDOP_2_4);
	snprintf(buffer, elcount(buffer), "   0.000000 F1 SCCM::WUDOP_SCCM_FR::WUDOP_2_4 = %d\n", intval);
	filePutString (buffer, elcount(buffer), hFile);
	intval = getSignal(CHASSIS::WUDOP_SCCM_FR::WUDOP_2_5);
	snprintf(buffer, elcount(buffer), "   0.000000 F1 SCCM::WUDOP_SCCM_FR::WUDOP_2_5 = %d\n", intval);
	filePutString (buffer, elcount(buffer), hFile);
	intval = getSignal(CHASSIS::WUDOP_SCCM_FR::WUDOP_3_1);
	snprintf(buffer, elcount(buffer), "   0.000000 F1 SCCM::WUDOP_SCCM_FR::WUDOP_3_1 = %d\n", intval);
	filePutString (buffer, elcount(buffer), hFile);
	intval = getSignal(CHASSIS::WUDOP_SCCM_FR::WUDOP_3_2);
	snprintf(buffer, elcount(buffer), "   0.000000 F1 SCCM::WUDOP_SCCM_FR::WUDOP_3_2 = %d\n", intval);
	filePutString (buffer, elcount(buffer), hFile);
	intval = getSignal(CHASSIS::WUDOP_SCCM_FR::WUDOP_3_3);
	snprintf(buffer, elcount(buffer), "   0.000000 F1 SCCM::WUDOP_SCCM_FR::WUDOP_3_3 = %d\n", intval);
	filePutString (buffer, elcount(buffer), hFile);
	intval = getSignal(CHASSIS::WUDOP_SCCM_FR::WUDOP_3_4);
	snprintf(buffer, elcount(buffer), "   0.000000 F1 SCCM::WUDOP_SCCM_FR::WUDOP_3_4 = %d\n", intval);
	filePutString (buffer, elcount(buffer), hFile);
	intval = getSignal(CHASSIS::WUDOP_SCCM_FR::WUDOP_3_5);
	snprintf(buffer, elcount(buffer), "   0.000000 F1 SCCM::WUDOP_SCCM_FR::WUDOP_3_5 = %d\n", intval);
	filePutString (buffer, elcount(buffer), hFile);
	intval = getSignal(CHASSIS::WUDOP_SCCM_FR::WUDOP_4_1);
	snprintf(buffer, elcount(buffer), "   0.000000 F1 SCCM::WUDOP_SCCM_FR::WUDOP_4_1 = %d\n", intval);
	filePutString (buffer, elcount(buffer), hFile);
	intval = getSignal(CHASSIS::WUDOP_SCCM_FR::WUDOP_4_2);
	snprintf(buffer, elcount(buffer), "   0.000000 F1 SCCM::WUDOP_SCCM_FR::WUDOP_4_2 = %d\n", intval);
	filePutString (buffer, elcount(buffer), hFile);
	intval = getSignal(CHASSIS::WUDOP_SCCM_FR::WUDOP_4_3);
	snprintf(buffer, elcount(buffer), "   0.000000 F1 SCCM::WUDOP_SCCM_FR::WUDOP_4_3 = %d\n", intval);
	filePutString (buffer, elcount(buffer), hFile);
	intval = getSignal(CHASSIS::WUDOP_SCCM_FR::WUDOP_4_4);
	snprintf(buffer, elcount(buffer), "   0.000000 F1 SCCM::WUDOP_SCCM_FR::WUDOP_4_4 = %d\n", intval);
	filePutString (buffer, elcount(buffer), hFile);
	intval = getSignal(CHASSIS::WUDOP_SCCM_FR::WUDOP_4_5);
	snprintf(buffer, elcount(buffer), "   0.000000 F1 SCCM::WUDOP_SCCM_FR::WUDOP_4_5 = %d\n", intval);
	filePutString (buffer, elcount(buffer), hFile);
	intval = getSignal(CHASSIS::WUDOP_SCCM_FR::WUDOP_4_6);
	snprintf(buffer, elcount(buffer), "   0.000000 F1 SCCM::WUDOP_SCCM_FR::WUDOP_4_6 = %d\n", intval);
	filePutString (buffer, elcount(buffer), hFile);
	snprintf(buffer, elcount(buffer), "   0.000000    SV: 2 0 0 ::CH_Nodes::CH__NMActive_SDTR = %X\n", @sysvar::CH_Nodes::CH__NMActive_SDTR);
	filePutString (buffer, elcount(buffer), hFile);
	snprintf(buffer, elcount(buffer), "   0.000000    SV: 2 0 0 ::CH_Nodes::CH__NMAwake_SDTR = %X\n", @sysvar::CH_Nodes::CH__NMAwake_SDTR);
	filePutString (buffer, elcount(buffer), hFile);
	intval = @sysvar::CH_Nodes::CH_SDTRCRC_CMS_PI_Stat_Pr2C_AUTO;
	snprintf(buffer, elcount(buffer), "   0.000000    SV: 2 0 0 ::CH_Nodes::CH_SDTRCRC_CMS_PI_Stat_Pr2C_AUTO = %d\n", intval);
	filePutString (buffer, elcount(buffer), hFile);
	intval = getSignal(CHASSIS::CMS_PI_State_AR2::CRC_CMS_PI_Stat_Pr2);
	snprintf(buffer, elcount(buffer), "   0.000000 F1 SDTR::CMS_PI_State_AR2::CRC_CMS_PI_Stat_Pr2 = %d\n", intval);
	filePutString (buffer, elcount(buffer), hFile);
	intval = @sysvar::CH_Nodes::CH_SDTRSQC_CMS_PI_Stat_Pr2C_AUTO;
	snprintf(buffer, elcount(buffer), "   0.000000    SV: 2 0 0 ::CH_Nodes::CH_SDTRSQC_CMS_PI_Stat_Pr2C_AUTO = %d\n", intval);
	filePutString (buffer, elcount(buffer), hFile);
	intval = getSignal(CHASSIS::CMS_PI_State_AR2::SQC_CMS_PI_Stat_Pr2);
	snprintf(buffer, elcount(buffer), "   0.000000 F1 SDTR::CMS_PI_State_AR2::SQC_CMS_PI_Stat_Pr2 = %d\n", intval);
	filePutString (buffer, elcount(buffer), hFile);
	intval = getSignal(CHASSIS::CMS_PI_State_AR2::PI_Enbl);
	snprintf(buffer, elcount(buffer), "   0.000000 F1 SDTR::CMS_PI_State_AR2::PI_Enbl = %d\n", intval);
	filePutString (buffer, elcount(buffer), hFile);
	intval = getSignal(CHASSIS::CMS_PI_State_AR2::CMS_Brk_Rq_V2);
	snprintf(buffer, elcount(buffer), "   0.000000 F1 SDTR::CMS_PI_State_AR2::CMS_Brk_Rq_V2 = %d\n", intval);
	filePutString (buffer, elcount(buffer), hFile);
	floatval = getSignal(CHASSIS::CMS_PI_State_AR2::CMS_VehDecel_Rq);
	snprintf(buffer, elcount(buffer), "   0.000000 F1 SDTR::CMS_PI_State_AR2::CMS_VehDecel_Rq = %f\n", floatval);
	filePutString (buffer, elcount(buffer), hFile);
	floatval = getSignal(CHASSIS::CMS_PI_State_AR2::PI_Obj_R_RelSpd);
	snprintf(buffer, elcount(buffer), "   0.000000 F1 SDTR::CMS_PI_State_AR2::PI_Obj_R_RelSpd = %f\n", floatval);
	filePutString (buffer, elcount(buffer), hFile);
	intval = getSignal(CHASSIS::CMS_PI_State_AR2::PI_TTI_R);
	snprintf(buffer, elcount(buffer), "   0.000000 F1 SDTR::CMS_PI_State_AR2::PI_TTI_R = %d\n", intval);
	filePutString (buffer, elcount(buffer), hFile);
	intval = getSignal(CHASSIS::CMS_PI_State_AR2::CMS_R_Warn_Rq);
	snprintf(buffer, elcount(buffer), "   0.000000 F1 SDTR::CMS_PI_State_AR2::CMS_R_Warn_Rq = %d\n", intval);
	filePutString (buffer, elcount(buffer), hFile);
	intval = getSignal(CHASSIS::CMS_PI_State_AR2::Rsrv1_CMS_PI_Stat_Pr2);
	snprintf(buffer, elcount(buffer), "   0.000000 F1 SDTR::CMS_PI_State_AR2::Rsrv1_CMS_PI_Stat_Pr2 = %d\n", intval);
	filePutString (buffer, elcount(buffer), hFile);
	intval = getSignal(CHASSIS::CMS_PI_State_AR2::PI_RelsRcmmnd_R);
	snprintf(buffer, elcount(buffer), "   0.000000 F1 SDTR::CMS_PI_State_AR2::PI_RelsRcmmnd_R = %d\n", intval);
	filePutString (buffer, elcount(buffer), hFile);
	intval = getSignal(CHASSIS::CMS_PI_State_AR2::PI_R_Enbl);
	snprintf(buffer, elcount(buffer), "   0.000000 F1 SDTR::CMS_PI_State_AR2::PI_R_Enbl = %d\n", intval);
	filePutString (buffer, elcount(buffer), hFile);
	intval = getSignal(CHASSIS::CMS_PI_State_AR2::PI_RelsRcmmnd_Ft);
	snprintf(buffer, elcount(buffer), "   0.000000 F1 SDTR::CMS_PI_State_AR2::PI_RelsRcmmnd_Ft = %d\n", intval);
	filePutString (buffer, elcount(buffer), hFile);
	intval = getSignal(CHASSIS::CMS_PI_State_AR2::PI_TTI_Ft);
	snprintf(buffer, elcount(buffer), "   0.000000 F1 SDTR::CMS_PI_State_AR2::PI_TTI_Ft = %d\n", intval);
	filePutString (buffer, elcount(buffer), hFile);
	floatval = getSignal(CHASSIS::CMS_PI_State_AR2::PI_ObjAhdRelSpd);
	snprintf(buffer, elcount(buffer), "   0.000000 F1 SDTR::CMS_PI_State_AR2::PI_ObjAhdRelSpd = %f\n", floatval);
	filePutString (buffer, elcount(buffer), hFile);
}
/*@@end*/

/*@@caplFunc:saveVars_99(dword):*/
void saveVars_99(dword hFile)
{
	intval = getSignal(CHASSIS::LDC_Disp_Rq_RDU_AR2::LDC_DTR_MsgDisp_Rq_RDU);
	snprintf(buffer, elcount(buffer), "   0.000000 F1 SDTR::LDC_Disp_Rq_RDU_AR2::LDC_DTR_MsgDisp_Rq_RDU = %d\n", intval);
	filePutString (buffer, elcount(buffer), hFile);
	intval = getSignal(CHASSIS::LDC_Disp_Rq_RDU_AR2::LDC_CMS_MsgDisp_Rq_RDU);
	snprintf(buffer, elcount(buffer), "   0.000000 F1 SDTR::LDC_Disp_Rq_RDU_AR2::LDC_CMS_MsgDisp_Rq_RDU = %d\n", intval);
	filePutString (buffer, elcount(buffer), hFile);
	intval = getSignal(CHASSIS::LDC_Disp_Rq_RDU_AR2::LDC_CMS_Stat_RDU);
	snprintf(buffer, elcount(buffer), "   0.000000 F1 SDTR::LDC_Disp_Rq_RDU_AR2::LDC_CMS_Stat_RDU = %d\n", intval);
	filePutString (buffer, elcount(buffer), hFile);
	intval = getSignal(CHASSIS::LDC_Disp_Rq_RDU_AR2::LDC_DTR_Stat_RDU_V2);
	snprintf(buffer, elcount(buffer), "   0.000000 F1 SDTR::LDC_Disp_Rq_RDU_AR2::LDC_DTR_Stat_RDU_V2 = %d\n", intval);
	filePutString (buffer, elcount(buffer), hFile);
	intval = getSignal(CHASSIS::LDC_Disp_Rq_RDU_AR2::TSA_Warn_Supp_Rq_RDU);
	snprintf(buffer, elcount(buffer), "   0.000000 F1 SDTR::LDC_Disp_Rq_RDU_AR2::TSA_Warn_Supp_Rq_RDU = %d\n", intval);
	filePutString (buffer, elcount(buffer), hFile);
	intval = getSignal(CHASSIS::LDC_Disp_Rq_RDU_AR2::LDC_SpdUnit_Rs_RDU);
	snprintf(buffer, elcount(buffer), "   0.000000 F1 SDTR::LDC_Disp_Rq_RDU_AR2::LDC_SpdUnit_Rs_RDU = %d\n", intval);
	filePutString (buffer, elcount(buffer), hFile);
	intval = getSignal(CHASSIS::LDC_Disp_Rq_RDU_AR2::LDC_MsgDisp_Rq_RDU);
	snprintf(buffer, elcount(buffer), "   0.000000 F1 SDTR::LDC_Disp_Rq_RDU_AR2::LDC_MsgDisp_Rq_RDU = %d\n", intval);
	filePutString (buffer, elcount(buffer), hFile);
	intval = getSignal(CHASSIS::LDC_Disp_Rq_RDU_AR2::LDC_MsgDisp_TrgrRq_RDU);
	snprintf(buffer, elcount(buffer), "   0.000000 F1 SDTR::LDC_Disp_Rq_RDU_AR2::LDC_MsgDisp_TrgrRq_RDU = %d\n", intval);
	filePutString (buffer, elcount(buffer), hFile);
	intval = getSignal(CHASSIS::LDC_Disp_Rq_RDU_AR2::LDC_DTR_IndLmp_On_Rq_RDU);
	snprintf(buffer, elcount(buffer), "   0.000000 F1 SDTR::LDC_Disp_Rq_RDU_AR2::LDC_DTR_IndLmp_On_Rq_RDU = %d\n", intval);
	filePutString (buffer, elcount(buffer), hFile);
	intval = getSignal(CHASSIS::LDC_Disp_Rq_RDU_AR2::LDC_AcustWarn_Rq_RDU);
	snprintf(buffer, elcount(buffer), "   0.000000 F1 SDTR::LDC_Disp_Rq_RDU_AR2::LDC_AcustWarn_Rq_RDU = %d\n", intval);
	filePutString (buffer, elcount(buffer), hFile);
	intval = getSignal(CHASSIS::LDC_Disp_Rq_RDU_AR2::LDC_RadarSensSoil_Disp_Rq_RDU);
	snprintf(buffer, elcount(buffer), "   0.000000 F1 SDTR::LDC_Disp_Rq_RDU_AR2::LDC_RadarSensSoil_Disp_Rq_RDU = %d\n", intval);
	filePutString (buffer, elcount(buffer), hFile);
	intval = getSignal(CHASSIS::LDC_Disp_Rq_RDU_AR2::LDC_SPEEDO_SegRing_Disp_Rq_RDU);
	snprintf(buffer, elcount(buffer), "   0.000000 F1 SDTR::LDC_Disp_Rq_RDU_AR2::LDC_SPEEDO_SegRing_Disp_Rq_RDU = %d\n", intval);
	filePutString (buffer, elcount(buffer), hFile);
	intval = getSignal(CHASSIS::LDC_Disp_Rq_RDU_AR2::LDC_IconDisp_Rq_RDU);
	snprintf(buffer, elcount(buffer), "   0.000000 F1 SDTR::LDC_Disp_Rq_RDU_AR2::LDC_IconDisp_Rq_RDU = %d\n", intval);
	filePutString (buffer, elcount(buffer), hFile);
	intval = getSignal(CHASSIS::LDC_Disp_Rq_RDU_AR2::LDC_Spd_Dsr_RDU);
	snprintf(buffer, elcount(buffer), "   0.000000 F1 SDTR::LDC_Disp_Rq_RDU_AR2::LDC_Spd_Dsr_RDU = %d\n", intval);
	filePutString (buffer, elcount(buffer), hFile);
	intval = getSignal(CHASSIS::LDC_Disp_Rq_RDU_AR2::LDC_Spd_Add_RDU);
	snprintf(buffer, elcount(buffer), "   0.000000 F1 SDTR::LDC_Disp_Rq_RDU_AR2::LDC_Spd_Add_RDU = %d\n", intval);
	filePutString (buffer, elcount(buffer), hFile);
	intval = getSignal(CHASSIS::LDC_Disp_Rq_RDU_AR2::LDC_Dist_RDU);
	snprintf(buffer, elcount(buffer), "   0.000000 F1 SDTR::LDC_Disp_Rq_RDU_AR2::LDC_Dist_RDU = %d\n", intval);
	filePutString (buffer, elcount(buffer), hFile);
	intval = getSignal(CHASSIS::LDC_Disp_Rq_RDU_AR2::LDC_Dist_Dsr_RDU);
	snprintf(buffer, elcount(buffer), "   0.000000 F1 SDTR::LDC_Disp_Rq_RDU_AR2::LDC_Dist_Dsr_RDU = %d\n", intval);
	filePutString (buffer, elcount(buffer), hFile);
	intval = @sysvar::CH_Nodes::CH_SDTRCRC_PT_ObjIntrst_Pr2_AUTO;
	snprintf(buffer, elcount(buffer), "   0.000000    SV: 2 0 0 ::CH_Nodes::CH_SDTRCRC_PT_ObjIntrst_Pr2_AUTO = %d\n", intval);
	filePutString (buffer, elcount(buffer), hFile);
	intval = getSignal(CHASSIS::PT_ObjIntrst_AR2::CRC_PT_ObjIntrst_Pr2);
	snprintf(buffer, elcount(buffer), "   0.000000 F1 SDTR::PT_ObjIntrst_AR2::CRC_PT_ObjIntrst_Pr2 = %d\n", intval);
	filePutString (buffer, elcount(buffer), hFile);
	intval = @sysvar::CH_Nodes::CH_SDTRSQC_PT_ObjIntrst_Pr2_AUTO;
	snprintf(buffer, elcount(buffer), "   0.000000    SV: 2 0 0 ::CH_Nodes::CH_SDTRSQC_PT_ObjIntrst_Pr2_AUTO = %d\n", intval);
	filePutString (buffer, elcount(buffer), hFile);
	intval = getSignal(CHASSIS::PT_ObjIntrst_AR2::SQC_PT_ObjIntrst_Pr2);
	snprintf(buffer, elcount(buffer), "   0.000000 F1 SDTR::PT_ObjIntrst_AR2::SQC_PT_ObjIntrst_Pr2 = %d\n", intval);
	filePutString (buffer, elcount(buffer), hFile);
	intval = getSignal(CHASSIS::PT_ObjIntrst_AR2::PT_ObjIntrstType);
	snprintf(buffer, elcount(buffer), "   0.000000 F1 SDTR::PT_ObjIntrst_AR2::PT_ObjIntrstType = %d\n", intval);
	filePutString (buffer, elcount(buffer), hFile);
	intval = getSignal(CHASSIS::PT_ObjIntrst_AR2::PT_ObjIntrstNew);
	snprintf(buffer, elcount(buffer), "   0.000000 F1 SDTR::PT_ObjIntrst_AR2::PT_ObjIntrstNew = %d\n", intval);
	filePutString (buffer, elcount(buffer), hFile);
	floatval = getSignal(CHASSIS::PT_ObjIntrst_AR2::PT_ObjIntrstDist);
	snprintf(buffer, elcount(buffer), "   0.000000 F1 SDTR::PT_ObjIntrst_AR2::PT_ObjIntrstDist = %f\n", floatval);
	filePutString (buffer, elcount(buffer), hFile);
	floatval = getSignal(CHASSIS::PT_ObjIntrst_AR2::PT_ObjIntrstRelSpd);
	snprintf(buffer, elcount(buffer), "   0.000000 F1 SDTR::PT_ObjIntrst_AR2::PT_ObjIntrstRelSpd = %f\n", floatval);
	filePutString (buffer, elcount(buffer), hFile);
	intval = getSignal(CHASSIS::PT_ObjIntrst_AR2::PT_ObjIntrst_Flt);
	snprintf(buffer, elcount(buffer), "   0.000000 F1 SDTR::PT_ObjIntrst_AR2::PT_ObjIntrst_Flt = %d\n", intval);
	filePutString (buffer, elcount(buffer), hFile);
	intval = getSignal(CHASSIS::PT_ObjIntrst_AR2::Rsrv1_PT_ObjIntrst_Pr2);
	snprintf(buffer, elcount(buffer), "   0.000000 F1 SDTR::PT_ObjIntrst_AR2::Rsrv1_PT_ObjIntrst_Pr2 = %d\n", intval);
	filePutString (buffer, elcount(buffer), hFile);
	intval = getSignal(CHASSIS::RDU_Disp_Rq_AR::PN14_ElecPwr_Rq_AS);
	snprintf(buffer, elcount(buffer), "   0.000000 F1 SDTR::RDU_Disp_Rq_AR::PN14_ElecPwr_Rq_AS = %d\n", intval);
	filePutString (buffer, elcount(buffer), hFile);
	intval = getSignal(CHASSIS::RDU_Disp_Rq_AR::LDC_Dist_Dsr_MsgDisp_Rq_RDU);
	snprintf(buffer, elcount(buffer), "   0.000000 F1 SDTR::RDU_Disp_Rq_AR::LDC_Dist_Dsr_MsgDisp_Rq_RDU = %d\n", intval);
	filePutString (buffer, elcount(buffer), hFile);
	intval = getSignal(CHASSIS::RDU_Disp_Rq_AR::LDC_SLA_SpdLmtTkOvr_Stat);
	snprintf(buffer, elcount(buffer), "   0.000000 F1 SDTR::RDU_Disp_Rq_AR::LDC_SLA_SpdLmtTkOvr_Stat = %d\n", intval);
	filePutString (buffer, elcount(buffer), hFile);
	intval = getSignal(CHASSIS::RDU_Disp_Rq_AR::LDC_SLA_SpdLmtTkOvr_Avl_Stat);
	snprintf(buffer, elcount(buffer), "   0.000000 F1 SDTR::RDU_Disp_Rq_AR::LDC_SLA_SpdLmtTkOvr_Avl_Stat = %d\n", intval);
	filePutString (buffer, elcount(buffer), hFile);
	intval = getSignal(CHASSIS::RDU_Disp_Rq_AR::LDC_CMS_Md_Stat);
	snprintf(buffer, elcount(buffer), "   0.000000 F1 SDTR::RDU_Disp_Rq_AR::LDC_CMS_Md_Stat = %d\n", intval);
	filePutString (buffer, elcount(buffer), hFile);
	intval = getSignal(CHASSIS::RDU_Stat1_AR::DPC_Md_AS_Rs);
	snprintf(buffer, elcount(buffer), "   0.000000 F1 SDTR::RDU_Stat1_AR::DPC_Md_AS_Rs = %d\n", intval);
	filePutString (buffer, elcount(buffer), hFile);
	intval = getSignal(CHASSIS::ROE_RDU::ROE_Header_RDU);
	snprintf(buffer, elcount(buffer), "   0.000000 F1 SDTR::ROE_RDU::ROE_Header_RDU = %d\n", intval);
	filePutString (buffer, elcount(buffer), hFile);
	intval = getSignal(CHASSIS::ROE_RDU::ROE_DTC_RDU);
	snprintf(buffer, elcount(buffer), "   0.000000 F1 SDTR::ROE_RDU::ROE_DTC_RDU = %d\n", intval);
	filePutString (buffer, elcount(buffer), hFile);
	intval = getSignal(CHASSIS::ROE_RDU::ROE_DTC_Stat_RDU);
	snprintf(buffer, elcount(buffer), "   0.000000 F1 SDTR::ROE_RDU::ROE_DTC_Stat_RDU = %d\n", intval);
	filePutString (buffer, elcount(buffer), hFile);
	intval = @sysvar::CH_Nodes::CH_SDTRCRC_SADR_Trgr_RDU_Pr_AUTO;
	snprintf(buffer, elcount(buffer), "   0.000000    SV: 2 0 0 ::CH_Nodes::CH_SDTRCRC_SADR_Trgr_RDU_Pr_AUTO = %d\n", intval);
	filePutString (buffer, elcount(buffer), hFile);
	intval = getSignal(CHASSIS::SADR_Trgr_RDU_AR2::CRC_SADR_Trgr_RDU_Pr2);
	snprintf(buffer, elcount(buffer), "   0.000000 F1 SDTR::SADR_Trgr_RDU_AR2::CRC_SADR_Trgr_RDU_Pr2 = %d\n", intval);
	filePutString (buffer, elcount(buffer), hFile);
	intval = @sysvar::CH_Nodes::CH_SDTRSQC_SADR_Trgr_RDU_Pr_AUTO;
	snprintf(buffer, elcount(buffer), "   0.000000    SV: 2 0 0 ::CH_Nodes::CH_SDTRSQC_SADR_Trgr_RDU_Pr_AUTO = %d\n", intval);
	filePutString (buffer, elcount(buffer), hFile);
	intval = getSignal(CHASSIS::SADR_Trgr_RDU_AR2::SQC_SADR_Trgr_RDU_Pr2);
	snprintf(buffer, elcount(buffer), "   0.000000 F1 SDTR::SADR_Trgr_RDU_AR2::SQC_SADR_Trgr_RDU_Pr2 = %d\n", intval);
	filePutString (buffer, elcount(buffer), hFile);
	intval = getSignal(CHASSIS::SADR_Trgr_RDU_AR2::SADR_TrgrPrio_RDU);
	snprintf(buffer, elcount(buffer), "   0.000000 F1 SDTR::SADR_Trgr_RDU_AR2::SADR_TrgrPrio_RDU = %d\n", intval);
	filePutString (buffer, elcount(buffer), hFile);
	intval = getSignal(CHASSIS::SADR_Trgr_RDU_AR2::Rsrv2_SADR_Trgr_RDU_Pr2);
	snprintf(buffer, elcount(buffer), "   0.000000 F1 SDTR::SADR_Trgr_RDU_AR2::Rsrv2_SADR_Trgr_RDU_Pr2 = %d\n", intval);
	filePutString (buffer, elcount(buffer), hFile);
	intval = getSignal(CHASSIS::SADR_Trgr_RDU_AR2::SADR_TrgrTm_RDU);
	snprintf(buffer, elcount(buffer), "   0.000000 F1 SDTR::SADR_Trgr_RDU_AR2::SADR_TrgrTm_RDU = %d\n", intval);
	filePutString (buffer, elcount(buffer), hFile);
	intval = getSignal(CHASSIS::SADR_Trgr_RDU_AR2::Rsrv1_SADR_Trgr_RDU_Pr2);
	snprintf(buffer, elcount(buffer), "   0.000000 F1 SDTR::SADR_Trgr_RDU_AR2::Rsrv1_SADR_Trgr_RDU_Pr2 = %d\n", intval);
	filePutString (buffer, elcount(buffer), hFile);
	intval = @sysvar::CH_Nodes::CH_SDTRCRC_VehAccel_X_Rq_Pr_AUTO;
	snprintf(buffer, elcount(buffer), "   0.000000    SV: 2 0 0 ::CH_Nodes::CH_SDTRCRC_VehAccel_X_Rq_Pr_AUTO = %d\n", intval);
	filePutString (buffer, elcount(buffer), hFile);
	intval = getSignal(CHASSIS::VehAccel_X_Rq_AR2::CRC_VehAccel_X_Rq_Pr2);
	snprintf(buffer, elcount(buffer), "   0.000000 F1 SDTR::VehAccel_X_Rq_AR2::CRC_VehAccel_X_Rq_Pr2 = %d\n", intval);
	filePutString (buffer, elcount(buffer), hFile);
	intval = @sysvar::CH_Nodes::CH_SDTRSQC_VehAccel_X_Rq_Pr_AUTO;
	snprintf(buffer, elcount(buffer), "   0.000000    SV: 2 0 0 ::CH_Nodes::CH_SDTRSQC_VehAccel_X_Rq_Pr_AUTO = %d\n", intval);
	filePutString (buffer, elcount(buffer), hFile);
	intval = getSignal(CHASSIS::VehAccel_X_Rq_AR2::SQC_VehAccel_X_Rq_Pr2);
	snprintf(buffer, elcount(buffer), "   0.000000 F1 SDTR::VehAccel_X_Rq_AR2::SQC_VehAccel_X_Rq_Pr2 = %d\n", intval);
	filePutString (buffer, elcount(buffer), hFile);
	intval = getSignal(CHASSIS::VehAccel_X_Rq_AR2::VehAccel_X_Md_Rq);
	snprintf(buffer, elcount(buffer), "   0.000000 F1 SDTR::VehAccel_X_Rq_AR2::VehAccel_X_Md_Rq = %d\n", intval);
	filePutString (buffer, elcount(buffer), hFile);
	intval = getSignal(CHASSIS::VehAccel_X_Rq_AR2::Rsrv2_VehAccel_X_Rq_Pr2);
	snprintf(buffer, elcount(buffer), "   0.000000 F1 SDTR::VehAccel_X_Rq_AR2::Rsrv2_VehAccel_X_Rq_Pr2 = %d\n", intval);
	filePutString (buffer, elcount(buffer), hFile);
	floatval = getSignal(CHASSIS::VehAccel_X_Rq_AR2::VehAccel_X_Rq);
	snprintf(buffer, elcount(buffer), "   0.000000 F1 SDTR::VehAccel_X_Rq_AR2::VehAccel_X_Rq = %f\n", floatval);
	filePutString (buffer, elcount(buffer), hFile);
	intval = getSignal(CHASSIS::VehAccel_X_Rq_AR2::ECU_Flt_Stat);
	snprintf(buffer, elcount(buffer), "   0.000000 F1 SDTR::VehAccel_X_Rq_AR2::ECU_Flt_Stat = %d\n", intval);
	filePutString (buffer, elcount(buffer), hFile);
	floatval = getSignal(CHASSIS::VehAccel_X_Rq_AR2::VehAccel_X_Rq_Raw);
	snprintf(buffer, elcount(buffer), "   0.000000 F1 SDTR::VehAccel_X_Rq_AR2::VehAccel_X_Rq_Raw = %f\n", floatval);
	filePutString (buffer, elcount(buffer), hFile);
	intval = getSignal(CHASSIS::VehAccel_X_Rq_AR2::AS_Actv_Ctrl_Stat);
	snprintf(buffer, elcount(buffer), "   0.000000 F1 SDTR::VehAccel_X_Rq_AR2::AS_Actv_Ctrl_Stat = %d\n", intval);
	filePutString (buffer, elcount(buffer), hFile);
	intval = getSignal(CHASSIS::VehAccel_X_Rq_AR2::PwrFreeD_Supp_Rq_RDU);
	snprintf(buffer, elcount(buffer), "   0.000000 F1 SDTR::VehAccel_X_Rq_AR2::PwrFreeD_Supp_Rq_RDU = %d\n", intval);
	filePutString (buffer, elcount(buffer), hFile);
	intval = getSignal(CHASSIS::VehAccel_X_Rq_AR2::BrkPrefill_Rq_RDU);
	snprintf(buffer, elcount(buffer), "   0.000000 F1 SDTR::VehAccel_X_Rq_AR2::BrkPrefill_Rq_RDU = %d\n", intval);
	filePutString (buffer, elcount(buffer), hFile);
	intval = getSignal(CHASSIS::VehAccel_X_Rq_AR2::VehAccel_X_Rq_AS_Actv);
	snprintf(buffer, elcount(buffer), "   0.000000 F1 SDTR::VehAccel_X_Rq_AR2::VehAccel_X_Rq_AS_Actv = %d\n", intval);
	filePutString (buffer, elcount(buffer), hFile);
}
/*@@end*/

/*@@caplFunc:saveVars_100(dword):*/
void saveVars_100(dword hFile)
{
	intval = getSignal(CHASSIS::VehAccel_X_Rq_AR2::AS_DrvAway_Rq);
	snprintf(buffer, elcount(buffer), "   0.000000 F1 SDTR::VehAccel_X_Rq_AR2::AS_DrvAway_Rq = %d\n", intval);
	filePutString (buffer, elcount(buffer), hFile);
	intval = getSignal(CHASSIS::VehAccel_X_Rq_AR2::AS_VehSp_Rq);
	snprintf(buffer, elcount(buffer), "   0.000000 F1 SDTR::VehAccel_X_Rq_AR2::AS_VehSp_Rq = %d\n", intval);
	filePutString (buffer, elcount(buffer), hFile);
	intval = getSignal(CHASSIS::VehAccel_X_Rq_AR2::SPCR_ErrEntry_Rq);
	snprintf(buffer, elcount(buffer), "   0.000000 F1 SDTR::VehAccel_X_Rq_AR2::SPCR_ErrEntry_Rq = %d\n", intval);
	filePutString (buffer, elcount(buffer), hFile);
	intval = getSignal(CHASSIS::VehAccel_X_Rq_AR2::AS_SpdCtrl_Actv);
	snprintf(buffer, elcount(buffer), "   0.000000 F1 SDTR::VehAccel_X_Rq_AR2::AS_SpdCtrl_Actv = %d\n", intval);
	filePutString (buffer, elcount(buffer), hFile);
	intval = getSignal(CHASSIS::VehAccel_X_Rq_AR2::AS_DistCtrl_Actv);
	snprintf(buffer, elcount(buffer), "   0.000000 F1 SDTR::VehAccel_X_Rq_AR2::AS_DistCtrl_Actv = %d\n", intval);
	filePutString (buffer, elcount(buffer), hFile);
	intval = getSignal(CHASSIS::VehAccel_X_Rq_AR2::SSA_Enbl_Rq_RDU);
	snprintf(buffer, elcount(buffer), "   0.000000 F1 SDTR::VehAccel_X_Rq_AR2::SSA_Enbl_Rq_RDU = %d\n", intval);
	filePutString (buffer, elcount(buffer), hFile);
	intval = getSignal(CHASSIS::VehAccel_X_Rq_AR2::AS_EV_Md_Rq);
	snprintf(buffer, elcount(buffer), "   0.000000 F1 SDTR::VehAccel_X_Rq_AR2::AS_EV_Md_Rq = %d\n", intval);
	filePutString (buffer, elcount(buffer), hFile);
	intval = getSignal(CHASSIS::VehAccel_X_Rq_AR2::AS_DnShift_Dsabl_Rq);
	snprintf(buffer, elcount(buffer), "   0.000000 F1 SDTR::VehAccel_X_Rq_AR2::AS_DnShift_Dsabl_Rq = %d\n", intval);
	filePutString (buffer, elcount(buffer), hFile);
	intval = getSignal(CHASSIS::VehAccel_X_Rq_AR2::AS_UpShift_Dsabl_Rq);
	snprintf(buffer, elcount(buffer), "   0.000000 F1 SDTR::VehAccel_X_Rq_AR2::AS_UpShift_Dsabl_Rq = %d\n", intval);
	filePutString (buffer, elcount(buffer), hFile);
	intval = getSignal(CHASSIS::VehAccel_X_Rq_AR2::Rsrv1_VehAccel_X_Rq_Pr2);
	snprintf(buffer, elcount(buffer), "   0.000000 F1 SDTR::VehAccel_X_Rq_AR2::Rsrv1_VehAccel_X_Rq_Pr2 = %d\n", intval);
	filePutString (buffer, elcount(buffer), hFile);
	snprintf(buffer, elcount(buffer), "   0.000000    SV: 2 0 0 ::CH_Nodes::CH__NMActive_SPC = %X\n", @sysvar::CH_Nodes::CH__NMActive_SPC);
	filePutString (buffer, elcount(buffer), hFile);
	snprintf(buffer, elcount(buffer), "   0.000000    SV: 2 0 0 ::CH_Nodes::CH__NMAwake_SPC = %X\n", @sysvar::CH_Nodes::CH__NMAwake_SPC);
	filePutString (buffer, elcount(buffer), hFile);
	intval = @sysvar::CH_Nodes::CH_SPCCRC_Eng_Rq_ABC_Pr2Eng_AUTO;
	snprintf(buffer, elcount(buffer), "   0.000000    SV: 2 0 0 ::CH_Nodes::CH_SPCCRC_Eng_Rq_ABC_Pr2Eng_AUTO = %d\n", intval);
	filePutString (buffer, elcount(buffer), hFile);
	intval = getSignal(CHASSIS::Eng_Rq_ABC_AR2::CRC_Eng_Rq_ABC_Pr2);
	snprintf(buffer, elcount(buffer), "   0.000000 F1 SPC::Eng_Rq_ABC_AR2::CRC_Eng_Rq_ABC_Pr2 = %d\n", intval);
	filePutString (buffer, elcount(buffer), hFile);
	intval = @sysvar::CH_Nodes::CH_SPCSQC_Eng_Rq_ABC_Pr2Eng_AUTO;
	snprintf(buffer, elcount(buffer), "   0.000000    SV: 2 0 0 ::CH_Nodes::CH_SPCSQC_Eng_Rq_ABC_Pr2Eng_AUTO = %d\n", intval);
	filePutString (buffer, elcount(buffer), hFile);
	intval = getSignal(CHASSIS::Eng_Rq_ABC_AR2::SQC_Eng_Rq_ABC_Pr2);
	snprintf(buffer, elcount(buffer), "   0.000000 F1 SPC::Eng_Rq_ABC_AR2::SQC_Eng_Rq_ABC_Pr2 = %d\n", intval);
	filePutString (buffer, elcount(buffer), hFile);
	intval = getSignal(CHASSIS::Eng_Rq_ABC_AR2::Rsrv1_Eng_Rq_ABC_Pr2);
	snprintf(buffer, elcount(buffer), "   0.000000 F1 SPC::Eng_Rq_ABC_AR2::Rsrv1_Eng_Rq_ABC_Pr2 = %d\n", intval);
	filePutString (buffer, elcount(buffer), hFile);
	floatval = getSignal(CHASSIS::Eng_Rq_ABC_AR2::ABC_PmpTrq);
	snprintf(buffer, elcount(buffer), "   0.000000 F1 SPC::Eng_Rq_ABC_AR2::ABC_PmpTrq = %f\n", floatval);
	filePutString (buffer, elcount(buffer), hFile);
	intval = getSignal(CHASSIS::Eng_Rq_ABC_AR2::EngRPM_Rq_ABC);
	snprintf(buffer, elcount(buffer), "   0.000000 F1 SPC::Eng_Rq_ABC_AR2::EngRPM_Rq_ABC = %d\n", intval);
	filePutString (buffer, elcount(buffer), hFile);
	intval = getSignal(CHASSIS::Eng_Rq_ABC_AR2::Rsrv2_Eng_Rq_ABC_Pr2);
	snprintf(buffer, elcount(buffer), "   0.000000 F1 SPC::Eng_Rq_ABC_AR2::Rsrv2_Eng_Rq_ABC_Pr2 = %d\n", intval);
	filePutString (buffer, elcount(buffer), hFile);
	intval = getSignal(CHASSIS::Eng_Rq_ABC_AR2::ABC_AxleRollMomentIfc_Stat);
	snprintf(buffer, elcount(buffer), "   0.000000 F1 SPC::Eng_Rq_ABC_AR2::ABC_AxleRollMomentIfc_Stat = %d\n", intval);
	filePutString (buffer, elcount(buffer), hFile);
	intval = getSignal(CHASSIS::Eng_Rq_ABC_AR2::SSA_Enbl_Rq_SPC);
	snprintf(buffer, elcount(buffer), "   0.000000 F1 SPC::Eng_Rq_ABC_AR2::SSA_Enbl_Rq_SPC = %d\n", intval);
	filePutString (buffer, elcount(buffer), hFile);
	intval = getSignal(CHASSIS::Eng_Rq_ABC_AR2::VehDstrtn);
	snprintf(buffer, elcount(buffer), "   0.000000 F1 SPC::Eng_Rq_ABC_AR2::VehDstrtn = %d\n", intval);
	filePutString (buffer, elcount(buffer), hFile);
	intval = getSignal(CHASSIS::Eng_Rq_ABC_AR2::VehDstrtn_Rq);
	snprintf(buffer, elcount(buffer), "   0.000000 F1 SPC::Eng_Rq_ABC_AR2::VehDstrtn_Rq = %d\n", intval);
	filePutString (buffer, elcount(buffer), hFile);
	intval = getSignal(CHASSIS::OffRoad_Disp_Rq_AR::VehLvl_FL_Disp_Rq);
	snprintf(buffer, elcount(buffer), "   0.000000 F1 SPC::OffRoad_Disp_Rq_AR::VehLvl_FL_Disp_Rq = %d\n", intval);
	filePutString (buffer, elcount(buffer), hFile);
	intval = getSignal(CHASSIS::OffRoad_Disp_Rq_AR::VehLvl_FR_Disp_Rq);
	snprintf(buffer, elcount(buffer), "   0.000000 F1 SPC::OffRoad_Disp_Rq_AR::VehLvl_FR_Disp_Rq = %d\n", intval);
	filePutString (buffer, elcount(buffer), hFile);
	intval = getSignal(CHASSIS::OffRoad_Disp_Rq_AR::VehLvl_RL_Disp_Rq);
	snprintf(buffer, elcount(buffer), "   0.000000 F1 SPC::OffRoad_Disp_Rq_AR::VehLvl_RL_Disp_Rq = %d\n", intval);
	filePutString (buffer, elcount(buffer), hFile);
	intval = getSignal(CHASSIS::OffRoad_Disp_Rq_AR::VehLvl_RR_Disp_Rq);
	snprintf(buffer, elcount(buffer), "   0.000000 F1 SPC::OffRoad_Disp_Rq_AR::VehLvl_RR_Disp_Rq = %d\n", intval);
	filePutString (buffer, elcount(buffer), hFile);
	intval = getSignal(CHASSIS::OffRoad_Disp_Rq_AR::VehLvl_Bmpr_Disp_Rq);
	snprintf(buffer, elcount(buffer), "   0.000000 F1 SPC::OffRoad_Disp_Rq_AR::VehLvl_Bmpr_Disp_Rq = %d\n", intval);
	filePutString (buffer, elcount(buffer), hFile);
	intval = getSignal(CHASSIS::OffRoad_Disp_Rq_AR::OffRoadDisp_RedNum);
	snprintf(buffer, elcount(buffer), "   0.000000 F1 SPC::OffRoad_Disp_Rq_AR::OffRoadDisp_RedNum = %d\n", intval);
	filePutString (buffer, elcount(buffer), hFile);
	intval = getSignal(CHASSIS::OffRoad_Disp_Rq_AR::OffRoadDisp_Bar0_Actv);
	snprintf(buffer, elcount(buffer), "   0.000000 F1 SPC::OffRoad_Disp_Rq_AR::OffRoadDisp_Bar0_Actv = %d\n", intval);
	filePutString (buffer, elcount(buffer), hFile);
	intval = getSignal(CHASSIS::OffRoad_Disp_Rq_AR::OffRoadDisp_Bar1_Actv);
	snprintf(buffer, elcount(buffer), "   0.000000 F1 SPC::OffRoad_Disp_Rq_AR::OffRoadDisp_Bar1_Actv = %d\n", intval);
	filePutString (buffer, elcount(buffer), hFile);
	intval = getSignal(CHASSIS::OffRoad_Disp_Rq_AR::OffRoadDisp_Bar2_Actv);
	snprintf(buffer, elcount(buffer), "   0.000000 F1 SPC::OffRoad_Disp_Rq_AR::OffRoadDisp_Bar2_Actv = %d\n", intval);
	filePutString (buffer, elcount(buffer), hFile);
	intval = getSignal(CHASSIS::OffRoad_Disp_Rq_AR::OffRoadDisp_Bar3_Actv);
	snprintf(buffer, elcount(buffer), "   0.000000 F1 SPC::OffRoad_Disp_Rq_AR::OffRoadDisp_Bar3_Actv = %d\n", intval);
	filePutString (buffer, elcount(buffer), hFile);
	intval = getSignal(CHASSIS::OffRoad_Disp_Rq_AR::OffRoadDisp_SportBar_Actv);
	snprintf(buffer, elcount(buffer), "   0.000000 F1 SPC::OffRoad_Disp_Rq_AR::OffRoadDisp_SportBar_Actv = %d\n", intval);
	filePutString (buffer, elcount(buffer), hFile);
	intval = getSignal(CHASSIS::OffRoad_Disp_Rq_AR::SPC_VehLvl_Actv);
	snprintf(buffer, elcount(buffer), "   0.000000 F1 SPC::OffRoad_Disp_Rq_AR::SPC_VehLvl_Actv = %d\n", intval);
	filePutString (buffer, elcount(buffer), hFile);
	floatval = getSignal(CHASSIS::Preview_Data_SPC_AR::VehAccel_Vert);
	snprintf(buffer, elcount(buffer), "   0.000000 F1 SPC::Preview_Data_SPC_AR::VehAccel_Vert = %f\n", floatval);
	filePutString (buffer, elcount(buffer), hFile);
	floatval = getSignal(CHASSIS::Preview_Data_SPC_AR::VehAccel_Pitch);
	snprintf(buffer, elcount(buffer), "   0.000000 F1 SPC::Preview_Data_SPC_AR::VehAccel_Pitch = %f\n", floatval);
	filePutString (buffer, elcount(buffer), hFile);
	floatval = getSignal(CHASSIS::Preview_Data_SPC_AR::VehAccel_Roll);
	snprintf(buffer, elcount(buffer), "   0.000000 F1 SPC::Preview_Data_SPC_AR::VehAccel_Roll = %f\n", floatval);
	filePutString (buffer, elcount(buffer), hFile);
	floatval = getSignal(CHASSIS::Preview_Data_SPC_AR::SideSlpAnglGrdnt);
	snprintf(buffer, elcount(buffer), "   0.000000 F1 SPC::Preview_Data_SPC_AR::SideSlpAnglGrdnt = %f\n", floatval);
	filePutString (buffer, elcount(buffer), hFile);
	intval = getSignal(CHASSIS::Preview_Data_SPC_AR::DPC_Md_ABC_Preview_Rs);
	snprintf(buffer, elcount(buffer), "   0.000000 F1 SPC::Preview_Data_SPC_AR::DPC_Md_ABC_Preview_Rs = %d\n", intval);
	filePutString (buffer, elcount(buffer), hFile);
	floatval = getSignal(CHASSIS::Preview_Data_SPC_AR::WhlCircumDyn_F_SPC);
	snprintf(buffer, elcount(buffer), "   0.000000 F1 SPC::Preview_Data_SPC_AR::WhlCircumDyn_F_SPC = %f\n", floatval);
	filePutString (buffer, elcount(buffer), hFile);
	floatval = getSignal(CHASSIS::Preview_Data_SPC_AR::WhlCircumDyn_R_SPC);
	snprintf(buffer, elcount(buffer), "   0.000000 F1 SPC::Preview_Data_SPC_AR::WhlCircumDyn_R_SPC = %f\n", floatval);
	filePutString (buffer, elcount(buffer), hFile);
	intval = getSignal(CHASSIS::ROE_MPU_FL::ROE_Header_MPU_FL);
	snprintf(buffer, elcount(buffer), "   0.000000 F1 SPC::ROE_MPU_FL::ROE_Header_MPU_FL = %d\n", intval);
	filePutString (buffer, elcount(buffer), hFile);
	intval = getSignal(CHASSIS::ROE_MPU_FL::ROE_DTC_MPU_FL);
	snprintf(buffer, elcount(buffer), "   0.000000 F1 SPC::ROE_MPU_FL::ROE_DTC_MPU_FL = %d\n", intval);
	filePutString (buffer, elcount(buffer), hFile);
	intval = getSignal(CHASSIS::ROE_MPU_FL::ROE_DTC_Stat_MPU_FL);
	snprintf(buffer, elcount(buffer), "   0.000000 F1 SPC::ROE_MPU_FL::ROE_DTC_Stat_MPU_FL = %d\n", intval);
	filePutString (buffer, elcount(buffer), hFile);
	intval = getSignal(CHASSIS::ROE_MPU_FR::ROE_Header_MPU_FR);
	snprintf(buffer, elcount(buffer), "   0.000000 F1 SPC::ROE_MPU_FR::ROE_Header_MPU_FR = %d\n", intval);
	filePutString (buffer, elcount(buffer), hFile);
	intval = getSignal(CHASSIS::ROE_MPU_FR::ROE_DTC_MPU_FR);
	snprintf(buffer, elcount(buffer), "   0.000000 F1 SPC::ROE_MPU_FR::ROE_DTC_MPU_FR = %d\n", intval);
	filePutString (buffer, elcount(buffer), hFile);
	intval = getSignal(CHASSIS::ROE_MPU_FR::ROE_DTC_Stat_MPU_FR);
	snprintf(buffer, elcount(buffer), "   0.000000 F1 SPC::ROE_MPU_FR::ROE_DTC_Stat_MPU_FR = %d\n", intval);
	filePutString (buffer, elcount(buffer), hFile);
	intval = getSignal(CHASSIS::ROE_MPU_RL::ROE_Header_MPU_RL);
	snprintf(buffer, elcount(buffer), "   0.000000 F1 SPC::ROE_MPU_RL::ROE_Header_MPU_RL = %d\n", intval);
	filePutString (buffer, elcount(buffer), hFile);
	intval = getSignal(CHASSIS::ROE_MPU_RL::ROE_DTC_MPU_RL);
	snprintf(buffer, elcount(buffer), "   0.000000 F1 SPC::ROE_MPU_RL::ROE_DTC_MPU_RL = %d\n", intval);
	filePutString (buffer, elcount(buffer), hFile);
	intval = getSignal(CHASSIS::ROE_MPU_RL::ROE_DTC_Stat_MPU_RL);
	snprintf(buffer, elcount(buffer), "   0.000000 F1 SPC::ROE_MPU_RL::ROE_DTC_Stat_MPU_RL = %d\n", intval);
	filePutString (buffer, elcount(buffer), hFile);
	intval = getSignal(CHASSIS::ROE_MPU_RR::ROE_Header_MPU_RR);
	snprintf(buffer, elcount(buffer), "   0.000000 F1 SPC::ROE_MPU_RR::ROE_Header_MPU_RR = %d\n", intval);
	filePutString (buffer, elcount(buffer), hFile);
}
/*@@end*/

/*@@caplFunc:saveVars_101(dword):*/
void saveVars_101(dword hFile)
{
	intval = getSignal(CHASSIS::ROE_MPU_RR::ROE_DTC_MPU_RR);
	snprintf(buffer, elcount(buffer), "   0.000000 F1 SPC::ROE_MPU_RR::ROE_DTC_MPU_RR = %d\n", intval);
	filePutString (buffer, elcount(buffer), hFile);
	intval = getSignal(CHASSIS::ROE_MPU_RR::ROE_DTC_Stat_MPU_RR);
	snprintf(buffer, elcount(buffer), "   0.000000 F1 SPC::ROE_MPU_RR::ROE_DTC_Stat_MPU_RR = %d\n", intval);
	filePutString (buffer, elcount(buffer), hFile);
	intval = getSignal(CHASSIS::ROE_SPC::ROE_Header_SPC);
	snprintf(buffer, elcount(buffer), "   0.000000 F1 SPC::ROE_SPC::ROE_Header_SPC = %d\n", intval);
	filePutString (buffer, elcount(buffer), hFile);
	intval = getSignal(CHASSIS::ROE_SPC::ROE_DTC_SPC);
	snprintf(buffer, elcount(buffer), "   0.000000 F1 SPC::ROE_SPC::ROE_DTC_SPC = %d\n", intval);
	filePutString (buffer, elcount(buffer), hFile);
	intval = getSignal(CHASSIS::ROE_SPC::ROE_DTC_Stat_SPC);
	snprintf(buffer, elcount(buffer), "   0.000000 F1 SPC::ROE_SPC::ROE_DTC_Stat_SPC = %d\n", intval);
	filePutString (buffer, elcount(buffer), hFile);
	floatval = getSignal(CHASSIS::SPC_Disp_Rq_AR::DampRatio_FL_Disp_Rq);
	snprintf(buffer, elcount(buffer), "   0.000000 F1 SPC::SPC_Disp_Rq_AR::DampRatio_FL_Disp_Rq = %f\n", floatval);
	filePutString (buffer, elcount(buffer), hFile);
	floatval = getSignal(CHASSIS::SPC_Disp_Rq_AR::DampRatio_FR_Disp_Rq);
	snprintf(buffer, elcount(buffer), "   0.000000 F1 SPC::SPC_Disp_Rq_AR::DampRatio_FR_Disp_Rq = %f\n", floatval);
	filePutString (buffer, elcount(buffer), hFile);
	floatval = getSignal(CHASSIS::SPC_Disp_Rq_AR::DampRatio_RL_Disp_Rq);
	snprintf(buffer, elcount(buffer), "   0.000000 F1 SPC::SPC_Disp_Rq_AR::DampRatio_RL_Disp_Rq = %f\n", floatval);
	filePutString (buffer, elcount(buffer), hFile);
	floatval = getSignal(CHASSIS::SPC_Disp_Rq_AR::DampRatio_RR_Disp_Rq);
	snprintf(buffer, elcount(buffer), "   0.000000 F1 SPC::SPC_Disp_Rq_AR::DampRatio_RR_Disp_Rq = %f\n", floatval);
	filePutString (buffer, elcount(buffer), hFile);
	intval = @sysvar::CH_Nodes::CH_SPCCRC_SPC_Msg_Rq_Pr2SPC_AUTO;
	snprintf(buffer, elcount(buffer), "   0.000000    SV: 2 0 0 ::CH_Nodes::CH_SPCCRC_SPC_Msg_Rq_Pr2SPC_AUTO = %d\n", intval);
	filePutString (buffer, elcount(buffer), hFile);
	intval = getSignal(CHASSIS::SPC_SwLED_Msg_Rq_AR2::CRC_SPC_Msg_Rq_Pr2);
	snprintf(buffer, elcount(buffer), "   0.000000 F1 SPC::SPC_SwLED_Msg_Rq_AR2::CRC_SPC_Msg_Rq_Pr2 = %d\n", intval);
	filePutString (buffer, elcount(buffer), hFile);
	intval = @sysvar::CH_Nodes::CH_SPCSQC_SPC_Msg_Rq_Pr2SPC_AUTO;
	snprintf(buffer, elcount(buffer), "   0.000000    SV: 2 0 0 ::CH_Nodes::CH_SPCSQC_SPC_Msg_Rq_Pr2SPC_AUTO = %d\n", intval);
	filePutString (buffer, elcount(buffer), hFile);
	intval = getSignal(CHASSIS::SPC_SwLED_Msg_Rq_AR2::SQC_SPC_Msg_Rq_Pr2);
	snprintf(buffer, elcount(buffer), "   0.000000 F1 SPC::SPC_SwLED_Msg_Rq_AR2::SQC_SPC_Msg_Rq_Pr2 = %d\n", intval);
	filePutString (buffer, elcount(buffer), hFile);
	intval = getSignal(CHASSIS::SPC_SwLED_Msg_Rq_AR2::Rsrv1_SPC_Msg_Rq_Pr2);
	snprintf(buffer, elcount(buffer), "   0.000000 F1 SPC::SPC_SwLED_Msg_Rq_AR2::Rsrv1_SPC_Msg_Rq_Pr2 = %d\n", intval);
	filePutString (buffer, elcount(buffer), hFile);
	intval = getSignal(CHASSIS::SPC_SwLED_Msg_Rq_AR2::SPC_ErrMsg1_Disp_Rq_V2);
	snprintf(buffer, elcount(buffer), "   0.000000 F1 SPC::SPC_SwLED_Msg_Rq_AR2::SPC_ErrMsg1_Disp_Rq_V2 = %d\n", intval);
	filePutString (buffer, elcount(buffer), hFile);
	intval = getSignal(CHASSIS::SPC_SwLED_Msg_Rq_AR2::SPC_ErrMsg2_Disp_Rq_V2);
	snprintf(buffer, elcount(buffer), "   0.000000 F1 SPC::SPC_SwLED_Msg_Rq_AR2::SPC_ErrMsg2_Disp_Rq_V2 = %d\n", intval);
	filePutString (buffer, elcount(buffer), hFile);
	intval = getSignal(CHASSIS::SPC_SwLED_Msg_Rq_AR2::SPC_ErrMsg3_Disp_Rq_V2);
	snprintf(buffer, elcount(buffer), "   0.000000 F1 SPC::SPC_SwLED_Msg_Rq_AR2::SPC_ErrMsg3_Disp_Rq_V2 = %d\n", intval);
	filePutString (buffer, elcount(buffer), hFile);
	intval = getSignal(CHASSIS::SPC_SwLED_Msg_Rq_AR2::SPC_ErrMsg4_Disp_Rq_V2);
	snprintf(buffer, elcount(buffer), "   0.000000 F1 SPC::SPC_SwLED_Msg_Rq_AR2::SPC_ErrMsg4_Disp_Rq_V2 = %d\n", intval);
	filePutString (buffer, elcount(buffer), hFile);
	intval = getSignal(CHASSIS::SPC_SwLED_Msg_Rq_AR2::SPC_Msg1_Disp_Rq);
	snprintf(buffer, elcount(buffer), "   0.000000 F1 SPC::SPC_SwLED_Msg_Rq_AR2::SPC_Msg1_Disp_Rq = %d\n", intval);
	filePutString (buffer, elcount(buffer), hFile);
	intval = getSignal(CHASSIS::SPC_SwLED_Msg_Rq_AR2::SPC_Msg2_Disp_Rq);
	snprintf(buffer, elcount(buffer), "   0.000000 F1 SPC::SPC_SwLED_Msg_Rq_AR2::SPC_Msg2_Disp_Rq = %d\n", intval);
	filePutString (buffer, elcount(buffer), hFile);
	intval = getSignal(CHASSIS::SPC_SwLED_Msg_Rq_AR2::SPC_Msg3_Disp_Rq);
	snprintf(buffer, elcount(buffer), "   0.000000 F1 SPC::SPC_SwLED_Msg_Rq_AR2::SPC_Msg3_Disp_Rq = %d\n", intval);
	filePutString (buffer, elcount(buffer), hFile);
	intval = getSignal(CHASSIS::SPC_SwLED_Msg_Rq_AR2::SPC_Msg4_Disp_Rq);
	snprintf(buffer, elcount(buffer), "   0.000000 F1 SPC::SPC_SwLED_Msg_Rq_AR2::SPC_Msg4_Disp_Rq = %d\n", intval);
	filePutString (buffer, elcount(buffer), hFile);
	intval = getSignal(CHASSIS::SPC_SwLED_Msg_Rq_AR2::SPC_Msg5_Disp_Rq);
	snprintf(buffer, elcount(buffer), "   0.000000 F1 SPC::SPC_SwLED_Msg_Rq_AR2::SPC_Msg5_Disp_Rq = %d\n", intval);
	filePutString (buffer, elcount(buffer), hFile);
	intval = getSignal(CHASSIS::SPC_SwLED_Msg_Rq_AR2::SPC_Msg6_Disp_Rq);
	snprintf(buffer, elcount(buffer), "   0.000000 F1 SPC::SPC_SwLED_Msg_Rq_AR2::SPC_Msg6_Disp_Rq = %d\n", intval);
	filePutString (buffer, elcount(buffer), hFile);
	intval = getSignal(CHASSIS::SPC_SwLED_Msg_Rq_AR2::SPC_Msg7_Disp_Rq);
	snprintf(buffer, elcount(buffer), "   0.000000 F1 SPC::SPC_SwLED_Msg_Rq_AR2::SPC_Msg7_Disp_Rq = %d\n", intval);
	filePutString (buffer, elcount(buffer), hFile);
	intval = getSignal(CHASSIS::SPC_SwLED_Msg_Rq_AR2::SPC_Msg13_Disp_Rq);
	snprintf(buffer, elcount(buffer), "   0.000000 F1 SPC::SPC_SwLED_Msg_Rq_AR2::SPC_Msg13_Disp_Rq = %d\n", intval);
	filePutString (buffer, elcount(buffer), hFile);
	intval = getSignal(CHASSIS::SPC_SwLED_Msg_Rq_AR2::SuspLvlAdjSwLED_Rq);
	snprintf(buffer, elcount(buffer), "   0.000000 F1 SPC::SPC_SwLED_Msg_Rq_AR2::SuspLvlAdjSwLED_Rq = %d\n", intval);
	filePutString (buffer, elcount(buffer), hFile);
	intval = getSignal(CHASSIS::SPC_SwLED_Msg_Rq_AR2::ADC_SwLED_Rq_V2);
	snprintf(buffer, elcount(buffer), "   0.000000 F1 SPC::SPC_SwLED_Msg_Rq_AR2::ADC_SwLED_Rq_V2 = %d\n", intval);
	filePutString (buffer, elcount(buffer), hFile);
	intval = getSignal(CHASSIS::SPC_SwLED_Msg_Rq_AR2::SPC_Flt_Stat);
	snprintf(buffer, elcount(buffer), "   0.000000 F1 SPC::SPC_SwLED_Msg_Rq_AR2::SPC_Flt_Stat = %d\n", intval);
	filePutString (buffer, elcount(buffer), hFile);
	intval = getSignal(CHASSIS::SPC_SwLED_Msg_Rq_AR2::SPC_ECU_Stat);
	snprintf(buffer, elcount(buffer), "   0.000000 F1 SPC::SPC_SwLED_Msg_Rq_AR2::SPC_ECU_Stat = %d\n", intval);
	filePutString (buffer, elcount(buffer), hFile);
	intval = getSignal(CHASSIS::SPC_SwLED_Msg_Rq_AR2::DPC_Md_Susp_Rs_V2);
	snprintf(buffer, elcount(buffer), "   0.000000 F1 SPC::SPC_SwLED_Msg_Rq_AR2::DPC_Md_Susp_Rs_V2 = %d\n", intval);
	filePutString (buffer, elcount(buffer), hFile);
	intval = getSignal(CHASSIS::SPC_SwLED_Msg_Rq_AR2::SPC_Id);
	snprintf(buffer, elcount(buffer), "   0.000000 F1 SPC::SPC_SwLED_Msg_Rq_AR2::SPC_Id = %d\n", intval);
	filePutString (buffer, elcount(buffer), hFile);
	intval = getSignal(CHASSIS::SPC_SwLED_Msg_Rq_AR2::Preview_Stat_Disp_Rq);
	snprintf(buffer, elcount(buffer), "   0.000000 F1 SPC::SPC_SwLED_Msg_Rq_AR2::Preview_Stat_Disp_Rq = %d\n", intval);
	filePutString (buffer, elcount(buffer), hFile);
	intval = getSignal(CHASSIS::SPC_SwLED_Msg_Rq_AR2::SPC_WarnMsg_Disp_Rq);
	snprintf(buffer, elcount(buffer), "   0.000000 F1 SPC::SPC_SwLED_Msg_Rq_AR2::SPC_WarnMsg_Disp_Rq = %d\n", intval);
	filePutString (buffer, elcount(buffer), hFile);
	intval = getSignal(CHASSIS::SPC_SwLED_Msg_Rq_AR2::SPC_ErrMsg5_Disp_Rq_V2);
	snprintf(buffer, elcount(buffer), "   0.000000 F1 SPC::SPC_SwLED_Msg_Rq_AR2::SPC_ErrMsg5_Disp_Rq_V2 = %d\n", intval);
	filePutString (buffer, elcount(buffer), hFile);
	intval = getSignal(CHASSIS::SPC_SwLED_Msg_Rq_AR2::SPC_LvlMsg_Disp_Rq);
	snprintf(buffer, elcount(buffer), "   0.000000 F1 SPC::SPC_SwLED_Msg_Rq_AR2::SPC_LvlMsg_Disp_Rq = %d\n", intval);
	filePutString (buffer, elcount(buffer), hFile);
	intval = getSignal(CHASSIS::SPC_SwLED_Msg_Rq_AR2::SPC_LvlMsg_Disp_Rq_TrgRq);
	snprintf(buffer, elcount(buffer), "   0.000000 F1 SPC::SPC_SwLED_Msg_Rq_AR2::SPC_LvlMsg_Disp_Rq_TrgRq = %d\n", intval);
	filePutString (buffer, elcount(buffer), hFile);
	intval = getSignal(CHASSIS::SPC_SwLED_Msg_Rq_AR2::SPC_LvlMsg_NoCnfrm);
	snprintf(buffer, elcount(buffer), "   0.000000 F1 SPC::SPC_SwLED_Msg_Rq_AR2::SPC_LvlMsg_NoCnfrm = %d\n", intval);
	filePutString (buffer, elcount(buffer), hFile);
	intval = getSignal(CHASSIS::SpringVlv_Rq_AR::SpringVlv1_FL_Rq);
	snprintf(buffer, elcount(buffer), "   0.000000 F1 SPC::SpringVlv_Rq_AR::SpringVlv1_FL_Rq = %d\n", intval);
	filePutString (buffer, elcount(buffer), hFile);
	intval = getSignal(CHASSIS::SpringVlv_Rq_AR::SpringVlv2_FL_Rq);
	snprintf(buffer, elcount(buffer), "   0.000000 F1 SPC::SpringVlv_Rq_AR::SpringVlv2_FL_Rq = %d\n", intval);
	filePutString (buffer, elcount(buffer), hFile);
	intval = getSignal(CHASSIS::SpringVlv_Rq_AR::SpringVlv1_FR_Rq);
	snprintf(buffer, elcount(buffer), "   0.000000 F1 SPC::SpringVlv_Rq_AR::SpringVlv1_FR_Rq = %d\n", intval);
	filePutString (buffer, elcount(buffer), hFile);
	intval = getSignal(CHASSIS::SpringVlv_Rq_AR::SpringVlv2_FR_Rq);
	snprintf(buffer, elcount(buffer), "   0.000000 F1 SPC::SpringVlv_Rq_AR::SpringVlv2_FR_Rq = %d\n", intval);
	filePutString (buffer, elcount(buffer), hFile);
	intval = getSignal(CHASSIS::SpringVlv_Rq_AR::SpringVlv1_RL_Rq);
	snprintf(buffer, elcount(buffer), "   0.000000 F1 SPC::SpringVlv_Rq_AR::SpringVlv1_RL_Rq = %d\n", intval);
	filePutString (buffer, elcount(buffer), hFile);
	intval = getSignal(CHASSIS::SpringVlv_Rq_AR::SpringVlv2_RL_Rq);
	snprintf(buffer, elcount(buffer), "   0.000000 F1 SPC::SpringVlv_Rq_AR::SpringVlv2_RL_Rq = %d\n", intval);
	filePutString (buffer, elcount(buffer), hFile);
	intval = getSignal(CHASSIS::SpringVlv_Rq_AR::SpringVlv1_RR_Rq);
	snprintf(buffer, elcount(buffer), "   0.000000 F1 SPC::SpringVlv_Rq_AR::SpringVlv1_RR_Rq = %d\n", intval);
	filePutString (buffer, elcount(buffer), hFile);
	intval = getSignal(CHASSIS::SpringVlv_Rq_AR::SpringVlv2_RR_Rq);
	snprintf(buffer, elcount(buffer), "   0.000000 F1 SPC::SpringVlv_Rq_AR::SpringVlv2_RR_Rq = %d\n", intval);
	filePutString (buffer, elcount(buffer), hFile);
	floatval = getSignal(CHASSIS::VehCarv_Stat_AR::VehRollAngl);
	snprintf(buffer, elcount(buffer), "   0.000000 F1 SPC::VehCarv_Stat_AR::VehRollAngl = %f\n", floatval);
	filePutString (buffer, elcount(buffer), hFile);
	intval = getSignal(CHASSIS::VehCarv_Stat_AR::VehCarv_Stat);
	snprintf(buffer, elcount(buffer), "   0.000000 F1 SPC::VehCarv_Stat_AR::VehCarv_Stat = %d\n", intval);
	filePutString (buffer, elcount(buffer), hFile);
	intval = getSignal(CHASSIS::VehCarv_Stat_AR::DPC_Md_ABC_Carv_Rs);
	snprintf(buffer, elcount(buffer), "   0.000000 F1 SPC::VehCarv_Stat_AR::DPC_Md_ABC_Carv_Rs = %d\n", intval);
	filePutString (buffer, elcount(buffer), hFile);
	intval = @sysvar::CH_Nodes::CH_SPCCRC_VehLvl_Stat_Pr2Ve_AUTO;
	snprintf(buffer, elcount(buffer), "   0.000000    SV: 2 0 0 ::CH_Nodes::CH_SPCCRC_VehLvl_Stat_Pr2Ve_AUTO = %d\n", intval);
	filePutString (buffer, elcount(buffer), hFile);
	intval = getSignal(CHASSIS::VehLvl_Stat_AR2::CRC_VehLvl_Stat_Pr2);
	snprintf(buffer, elcount(buffer), "   0.000000 F1 SPC::VehLvl_Stat_AR2::CRC_VehLvl_Stat_Pr2 = %d\n", intval);
	filePutString (buffer, elcount(buffer), hFile);
	intval = @sysvar::CH_Nodes::CH_SPCSQC_VehLvl_Stat_Pr2Ve_AUTO;
	snprintf(buffer, elcount(buffer), "   0.000000    SV: 2 0 0 ::CH_Nodes::CH_SPCSQC_VehLvl_Stat_Pr2Ve_AUTO = %d\n", intval);
	filePutString (buffer, elcount(buffer), hFile);
	intval = getSignal(CHASSIS::VehLvl_Stat_AR2::SQC_VehLvl_Stat_Pr2);
	snprintf(buffer, elcount(buffer), "   0.000000 F1 SPC::VehLvl_Stat_AR2::SQC_VehLvl_Stat_Pr2 = %d\n", intval);
	filePutString (buffer, elcount(buffer), hFile);
	intval = getSignal(CHASSIS::VehLvl_Stat_AR2::VehLoad_Stat);
	snprintf(buffer, elcount(buffer), "   0.000000 F1 SPC::VehLvl_Stat_AR2::VehLoad_Stat = %d\n", intval);
	filePutString (buffer, elcount(buffer), hFile);
	intval = getSignal(CHASSIS::VehLvl_Stat_AR2::VehLoad_Stat_Vld);
	snprintf(buffer, elcount(buffer), "   0.000000 F1 SPC::VehLvl_Stat_AR2::VehLoad_Stat_Vld = %d\n", intval);
	filePutString (buffer, elcount(buffer), hFile);
}
/*@@end*/

/*@@caplFunc:saveVars_102(dword):*/
void saveVars_102(dword hFile)
{
	intval = getSignal(CHASSIS::VehLvl_Stat_AR2::LvlCal_Exec);
	snprintf(buffer, elcount(buffer), "   0.000000 F1 SPC::VehLvl_Stat_AR2::LvlCal_Exec = %d\n", intval);
	filePutString (buffer, elcount(buffer), hFile);
	intval = getSignal(CHASSIS::VehLvl_Stat_AR2::VehLvl_FL);
	snprintf(buffer, elcount(buffer), "   0.000000 F1 SPC::VehLvl_Stat_AR2::VehLvl_FL = %d\n", intval);
	filePutString (buffer, elcount(buffer), hFile);
	intval = getSignal(CHASSIS::VehLvl_Stat_AR2::VehLvl_FR);
	snprintf(buffer, elcount(buffer), "   0.000000 F1 SPC::VehLvl_Stat_AR2::VehLvl_FR = %d\n", intval);
	filePutString (buffer, elcount(buffer), hFile);
	intval = getSignal(CHASSIS::VehLvl_Stat_AR2::VehLvl_RL);
	snprintf(buffer, elcount(buffer), "   0.000000 F1 SPC::VehLvl_Stat_AR2::VehLvl_RL = %d\n", intval);
	filePutString (buffer, elcount(buffer), hFile);
	intval = getSignal(CHASSIS::VehLvl_Stat_AR2::VehLvl_RR);
	snprintf(buffer, elcount(buffer), "   0.000000 F1 SPC::VehLvl_Stat_AR2::VehLvl_RR = %d\n", intval);
	filePutString (buffer, elcount(buffer), hFile);
	intval = getSignal(CHASSIS::VehLvl_Stat_AR2::VehLvl_Rel);
	snprintf(buffer, elcount(buffer), "   0.000000 F1 SPC::VehLvl_Stat_AR2::VehLvl_Rel = %d\n", intval);
	filePutString (buffer, elcount(buffer), hFile);
	intval = getSignal(CHASSIS::VehLvl_Stat_AR2::Rsrv1_VehLvl_Stat_Pr2);
	snprintf(buffer, elcount(buffer), "   0.000000 F1 SPC::VehLvl_Stat_AR2::Rsrv1_VehLvl_Stat_Pr2 = %d\n", intval);
	filePutString (buffer, elcount(buffer), hFile);
	snprintf(buffer, elcount(buffer), "   0.000000    SV: 2 0 0 ::CH_Nodes::CH__NMActive_SPC_VX = %X\n", @sysvar::CH_Nodes::CH__NMActive_SPC_VX);
	filePutString (buffer, elcount(buffer), hFile);
	snprintf(buffer, elcount(buffer), "   0.000000    SV: 2 0 0 ::CH_Nodes::CH__NMAwake_SPC_VX = %X\n", @sysvar::CH_Nodes::CH__NMAwake_SPC_VX);
	filePutString (buffer, elcount(buffer), hFile);
	intval = getSignal(CHASSIS::ROE_SPC_VX::ROE_Header_SPC_VX);
	snprintf(buffer, elcount(buffer), "   0.000000 F1 SPC_VX::ROE_SPC_VX::ROE_Header_SPC_VX = %d\n", intval);
	filePutString (buffer, elcount(buffer), hFile);
	intval = getSignal(CHASSIS::ROE_SPC_VX::ROE_DTC_SPC_VX);
	snprintf(buffer, elcount(buffer), "   0.000000 F1 SPC_VX::ROE_SPC_VX::ROE_DTC_SPC_VX = %d\n", intval);
	filePutString (buffer, elcount(buffer), hFile);
	intval = getSignal(CHASSIS::ROE_SPC_VX::ROE_DTC_Stat_SPC_VX);
	snprintf(buffer, elcount(buffer), "   0.000000 F1 SPC_VX::ROE_SPC_VX::ROE_DTC_Stat_SPC_VX = %d\n", intval);
	filePutString (buffer, elcount(buffer), hFile);
	intval = getSignal(CHASSIS::SPC_VX_Stat1_AR::SPC_VX_ECU_Stat);
	snprintf(buffer, elcount(buffer), "   0.000000 F1 SPC_VX::SPC_VX_Stat1_AR::SPC_VX_ECU_Stat = %d\n", intval);
	filePutString (buffer, elcount(buffer), hFile);
	intval = getSignal(CHASSIS::SpringVlv_Stat_AR::SpringVlv1_FL_Stat);
	snprintf(buffer, elcount(buffer), "   0.000000 F1 SPC_VX::SpringVlv_Stat_AR::SpringVlv1_FL_Stat = %d\n", intval);
	filePutString (buffer, elcount(buffer), hFile);
	intval = getSignal(CHASSIS::SpringVlv_Stat_AR::SpringVlv2_FL_Stat);
	snprintf(buffer, elcount(buffer), "   0.000000 F1 SPC_VX::SpringVlv_Stat_AR::SpringVlv2_FL_Stat = %d\n", intval);
	filePutString (buffer, elcount(buffer), hFile);
	intval = getSignal(CHASSIS::SpringVlv_Stat_AR::SpringVlv1_FR_Stat);
	snprintf(buffer, elcount(buffer), "   0.000000 F1 SPC_VX::SpringVlv_Stat_AR::SpringVlv1_FR_Stat = %d\n", intval);
	filePutString (buffer, elcount(buffer), hFile);
	intval = getSignal(CHASSIS::SpringVlv_Stat_AR::SpringVlv2_FR_Stat);
	snprintf(buffer, elcount(buffer), "   0.000000 F1 SPC_VX::SpringVlv_Stat_AR::SpringVlv2_FR_Stat = %d\n", intval);
	filePutString (buffer, elcount(buffer), hFile);
	intval = getSignal(CHASSIS::SpringVlv_Stat_AR::SpringVlv1_RL_Stat);
	snprintf(buffer, elcount(buffer), "   0.000000 F1 SPC_VX::SpringVlv_Stat_AR::SpringVlv1_RL_Stat = %d\n", intval);
	filePutString (buffer, elcount(buffer), hFile);
	intval = getSignal(CHASSIS::SpringVlv_Stat_AR::SpringVlv2_RL_Stat);
	snprintf(buffer, elcount(buffer), "   0.000000 F1 SPC_VX::SpringVlv_Stat_AR::SpringVlv2_RL_Stat = %d\n", intval);
	filePutString (buffer, elcount(buffer), hFile);
	intval = getSignal(CHASSIS::SpringVlv_Stat_AR::SpringVlv1_RR_Stat);
	snprintf(buffer, elcount(buffer), "   0.000000 F1 SPC_VX::SpringVlv_Stat_AR::SpringVlv1_RR_Stat = %d\n", intval);
	filePutString (buffer, elcount(buffer), hFile);
	intval = getSignal(CHASSIS::SpringVlv_Stat_AR::SpringVlv2_RR_Stat);
	snprintf(buffer, elcount(buffer), "   0.000000 F1 SPC_VX::SpringVlv_Stat_AR::SpringVlv2_RR_Stat = %d\n", intval);
	filePutString (buffer, elcount(buffer), hFile);
	intval = getSignal(CHASSIS::SpringVlv_Stat_AR::SpringVlv1_FL_Flt_Stat);
	snprintf(buffer, elcount(buffer), "   0.000000 F1 SPC_VX::SpringVlv_Stat_AR::SpringVlv1_FL_Flt_Stat = %d\n", intval);
	filePutString (buffer, elcount(buffer), hFile);
	intval = getSignal(CHASSIS::SpringVlv_Stat_AR::SpringVlv2_FL_Flt_Stat);
	snprintf(buffer, elcount(buffer), "   0.000000 F1 SPC_VX::SpringVlv_Stat_AR::SpringVlv2_FL_Flt_Stat = %d\n", intval);
	filePutString (buffer, elcount(buffer), hFile);
	intval = getSignal(CHASSIS::SpringVlv_Stat_AR::SpringVlv1_FR_Flt_Stat);
	snprintf(buffer, elcount(buffer), "   0.000000 F1 SPC_VX::SpringVlv_Stat_AR::SpringVlv1_FR_Flt_Stat = %d\n", intval);
	filePutString (buffer, elcount(buffer), hFile);
	intval = getSignal(CHASSIS::SpringVlv_Stat_AR::SpringVlv2_FR_Flt_Stat);
	snprintf(buffer, elcount(buffer), "   0.000000 F1 SPC_VX::SpringVlv_Stat_AR::SpringVlv2_FR_Flt_Stat = %d\n", intval);
	filePutString (buffer, elcount(buffer), hFile);
	intval = getSignal(CHASSIS::SpringVlv_Stat_AR::SpringVlv1_RL_Flt_Stat);
	snprintf(buffer, elcount(buffer), "   0.000000 F1 SPC_VX::SpringVlv_Stat_AR::SpringVlv1_RL_Flt_Stat = %d\n", intval);
	filePutString (buffer, elcount(buffer), hFile);
	intval = getSignal(CHASSIS::SpringVlv_Stat_AR::SpringVlv2_RL_Flt_Stat);
	snprintf(buffer, elcount(buffer), "   0.000000 F1 SPC_VX::SpringVlv_Stat_AR::SpringVlv2_RL_Flt_Stat = %d\n", intval);
	filePutString (buffer, elcount(buffer), hFile);
	intval = getSignal(CHASSIS::SpringVlv_Stat_AR::SpringVlv1_RR_Flt_Stat);
	snprintf(buffer, elcount(buffer), "   0.000000 F1 SPC_VX::SpringVlv_Stat_AR::SpringVlv1_RR_Flt_Stat = %d\n", intval);
	filePutString (buffer, elcount(buffer), hFile);
	intval = getSignal(CHASSIS::SpringVlv_Stat_AR::SpringVlv2_RR_Flt_Stat);
	snprintf(buffer, elcount(buffer), "   0.000000 F1 SPC_VX::SpringVlv_Stat_AR::SpringVlv2_RR_Flt_Stat = %d\n", intval);
	filePutString (buffer, elcount(buffer), hFile);
	floatval = getSignal(CHASSIS::SpringVlv_Stat_AR::SpringVlv1_FL_Curr);
	snprintf(buffer, elcount(buffer), "   0.000000 F1 SPC_VX::SpringVlv_Stat_AR::SpringVlv1_FL_Curr = %f\n", floatval);
	filePutString (buffer, elcount(buffer), hFile);
	floatval = getSignal(CHASSIS::SpringVlv_Stat_AR::SpringVlv2_FL_Curr);
	snprintf(buffer, elcount(buffer), "   0.000000 F1 SPC_VX::SpringVlv_Stat_AR::SpringVlv2_FL_Curr = %f\n", floatval);
	filePutString (buffer, elcount(buffer), hFile);
	floatval = getSignal(CHASSIS::SpringVlv_Stat_AR::SpringVlv1_FR_Curr);
	snprintf(buffer, elcount(buffer), "   0.000000 F1 SPC_VX::SpringVlv_Stat_AR::SpringVlv1_FR_Curr = %f\n", floatval);
	filePutString (buffer, elcount(buffer), hFile);
	floatval = getSignal(CHASSIS::SpringVlv_Stat_AR::SpringVlv2_FR_Curr);
	snprintf(buffer, elcount(buffer), "   0.000000 F1 SPC_VX::SpringVlv_Stat_AR::SpringVlv2_FR_Curr = %f\n", floatval);
	filePutString (buffer, elcount(buffer), hFile);
	floatval = getSignal(CHASSIS::SpringVlv_Stat_AR::SpringVlv1_RL_Curr);
	snprintf(buffer, elcount(buffer), "   0.000000 F1 SPC_VX::SpringVlv_Stat_AR::SpringVlv1_RL_Curr = %f\n", floatval);
	filePutString (buffer, elcount(buffer), hFile);
	floatval = getSignal(CHASSIS::SpringVlv_Stat_AR::SpringVlv2_RL_Curr);
	snprintf(buffer, elcount(buffer), "   0.000000 F1 SPC_VX::SpringVlv_Stat_AR::SpringVlv2_RL_Curr = %f\n", floatval);
	filePutString (buffer, elcount(buffer), hFile);
	floatval = getSignal(CHASSIS::SpringVlv_Stat_AR::SpringVlv1_RR_Curr);
	snprintf(buffer, elcount(buffer), "   0.000000 F1 SPC_VX::SpringVlv_Stat_AR::SpringVlv1_RR_Curr = %f\n", floatval);
	filePutString (buffer, elcount(buffer), hFile);
	floatval = getSignal(CHASSIS::SpringVlv_Stat_AR::SpringVlv2_RR_Curr);
	snprintf(buffer, elcount(buffer), "   0.000000 F1 SPC_VX::SpringVlv_Stat_AR::SpringVlv2_RR_Curr = %f\n", floatval);
	filePutString (buffer, elcount(buffer), hFile);
	snprintf(buffer, elcount(buffer), "   0.000000    SV: 2 0 0 ::CH_Nodes::CH__NMActive_XCP_MASTER = %X\n", @sysvar::CH_Nodes::CH__NMActive_XCP_MASTER);
	filePutString (buffer, elcount(buffer), hFile);
	snprintf(buffer, elcount(buffer), "   0.000000    SV: 2 0 0 ::CH_Nodes::CH__NMAwake_XCP_MASTER = %X\n", @sysvar::CH_Nodes::CH__NMAwake_XCP_MASTER);
	filePutString (buffer, elcount(buffer), hFile);
}
/*@@end*/

/*@@sysvarChange:CH_Nodes::CH_SAVE_PANEL_CONFIG:*/
on sysvar sysvar::CH_Nodes::CH_SAVE_PANEL_CONFIG
{
	dword hFile;

	if (@this)
	{
		write("Saving CHASSIS_FR Panel Variables ...");

		hFile = openFileWrite("CONFIG\\CHASSIS_FR_PRESETS.ASC", 0);
		filePutString("base hex  timestamps absolute\n", 31, hFile);

		saveVars_1(hFile);
		saveVars_2(hFile);
		saveVars_3(hFile);
		saveVars_4(hFile);
		saveVars_5(hFile);
		saveVars_6(hFile);
		saveVars_7(hFile);
		saveVars_8(hFile);
		saveVars_9(hFile);
		saveVars_10(hFile);
		saveVars_11(hFile);
		saveVars_12(hFile);
		saveVars_13(hFile);
		saveVars_14(hFile);
		saveVars_15(hFile);
		saveVars_16(hFile);
		saveVars_17(hFile);
		saveVars_18(hFile);
		saveVars_19(hFile);
		saveVars_20(hFile);
		saveVars_21(hFile);
		saveVars_22(hFile);
		saveVars_23(hFile);
		saveVars_24(hFile);
		saveVars_25(hFile);
		saveVars_26(hFile);
		saveVars_27(hFile);
		saveVars_28(hFile);
		saveVars_29(hFile);
		saveVars_30(hFile);
		saveVars_31(hFile);
		saveVars_32(hFile);
		saveVars_33(hFile);
		saveVars_34(hFile);
		saveVars_35(hFile);
		saveVars_36(hFile);
		saveVars_37(hFile);
		saveVars_38(hFile);
		saveVars_39(hFile);
		saveVars_40(hFile);
		saveVars_41(hFile);
		saveVars_42(hFile);
		saveVars_43(hFile);
		saveVars_44(hFile);
		saveVars_45(hFile);
		saveVars_46(hFile);
		saveVars_47(hFile);
		saveVars_48(hFile);
		saveVars_49(hFile);
		saveVars_50(hFile);
		saveVars_51(hFile);
		saveVars_52(hFile);
		saveVars_53(hFile);
		saveVars_54(hFile);
		saveVars_55(hFile);
		saveVars_56(hFile);
		saveVars_57(hFile);
		saveVars_58(hFile);
		saveVars_59(hFile);
		saveVars_60(hFile);
		saveVars_61(hFile);
		saveVars_62(hFile);
		saveVars_63(hFile);
		saveVars_64(hFile);
		saveVars_65(hFile);
		saveVars_66(hFile);
		saveVars_67(hFile);
		saveVars_68(hFile);
		saveVars_69(hFile);
		saveVars_70(hFile);
		saveVars_71(hFile);
		saveVars_72(hFile);
		saveVars_73(hFile);
		saveVars_74(hFile);
		saveVars_75(hFile);
		saveVars_76(hFile);
		saveVars_77(hFile);
		saveVars_78(hFile);
		saveVars_79(hFile);
		saveVars_80(hFile);
		saveVars_81(hFile);
		saveVars_82(hFile);
		saveVars_83(hFile);
		saveVars_84(hFile);
		saveVars_85(hFile);
		saveVars_86(hFile);
		saveVars_87(hFile);
		saveVars_88(hFile);
		saveVars_89(hFile);
		saveVars_90(hFile);
		saveVars_91(hFile);
		saveVars_92(hFile);
		saveVars_93(hFile);
		saveVars_94(hFile);
		saveVars_95(hFile);
		saveVars_96(hFile);
		saveVars_97(hFile);
		saveVars_98(hFile);
		saveVars_99(hFile);
		saveVars_100(hFile);
		saveVars_101(hFile);
		saveVars_102(hFile);

		fileClose(hFile);
	}
}
/*@@end*/

