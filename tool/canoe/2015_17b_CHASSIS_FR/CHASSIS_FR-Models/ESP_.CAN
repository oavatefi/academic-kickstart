includes
{
	#include "ASR_FR_NM_IL.CIN"
}

/*
|==========================================================================================|
|                                                                                          |
|                                                                                          |
|                                         COPYRIGHT                                        |
|                                                                                          |
|                   Copyright (c) by Daimler AG Abt. RD/EEV 2015                           |
|                                                                                          |
|                                                                                          |
|==========================================================================================|
|                                                                                          |
|                                   CAPL AUTHOR IDENTITY                                   |
|                                   --------------------                                   |
|                                                                                          |
| Initials   | Name                 | Company                                              |
| -----------+----------------------+----------------------------------------------------- |
| BH         | Björn Haßelkus       | Firma TZM (EXTERN im Auftrag der Daimler AG)         |
| RS         | Rainer Schulte       | Firma TZM (EXTERN im Auftrag der Daimler AG)         |
|            |                      |                                                      |
|                                                                                          |
|==========================================================================================|
|                                                                                          |
|                                     REVISION HISTORY                                     |
|                                     ----------------                                     |
|                                                                                          |
| Date       | Ver   | Author       | Description                                          |
| -----------+-------+--------------+----------------------------------------------------- |
| 27.04.15   | 1.0   | RS           | creation                                             |
|            |       |              |                                                      |
|                                                                                          |
|------------------------------------------------------------------------------------------|
*/

variables
{
	long ret_Register;
	// global variable for getting (showing) results auf dll-Functions
	long result;

	int CRC_AWD_TCASE_Rq_ESP_Pr2;
	dword CounterValForCRC_AWD_TCASE_Rq_ESP_Pr2;
	int SQC_VAL_AWD_TCASE_Rq_ESP_Pr2;
	int SQC_AWD_TCASE_Rq_ESP_Pr2;
	int CRC_BrkSys_Stat_Pr2;
	dword CounterValForCRC_BrkSys_Stat_Pr2;
	int SQC_VAL_BrkSys_Stat_Pr2;
	int SQC_BrkSys_Stat_Pr2;
	int CRC_DPC_Disp_Rq_Pr2;
	dword CounterValForCRC_DPC_Disp_Rq_Pr2;
	int SQC_VAL_DPC_Disp_Rq_Pr2;
	int SQC_DPC_Disp_Rq_Pr2;
	int CRC_DPC_IndMd_Stat_Pr2;
	dword CounterValForCRC_DPC_IndMd_Stat_Pr2;
	int SQC_VAL_DPC_IndMd_Stat_Pr2;
	int SQC_DPC_IndMd_Stat_Pr2;
	int CRC_DPC_IndMd_Style2_Pr2;
	dword CounterValForCRC_DPC_IndMd_Style2_Pr2;
	int SQC_VAL_DPC_IndMd_Style2_Pr2;
	int SQC_DPC_IndMd_Style2_Pr2;
	int CRC_DPC_IndMd_Style_Pr2;
	dword CounterValForCRC_DPC_IndMd_Style_Pr2;
	int SQC_VAL_DPC_IndMd_Style_Pr2;
	int SQC_DPC_IndMd_Style_Pr2;
	int CRC_DPC_Master_Rq_Pr2;
	dword CounterValForCRC_DPC_Master_Rq_Pr2;
	int SQC_VAL_DPC_Master_Rq_Pr2;
	int SQC_DPC_Master_Rq_Pr2;
	int CRC_Eng_Susp_Rq_AS_Pr2;
	dword CounterValForCRC_Eng_Susp_Rq_AS_Pr2;
	int SQC_VAL_Eng_Susp_Rq_AS_Pr2;
	int SQC_Eng_Susp_Rq_AS_Pr2;
	int CRC_EPKB_Disp_IndLmp_Rq_Pr2;
	dword CounterValForCRC_EPKB_Disp_IndLmp_Rq_Pr2;
	int SQC_VAL_EPKB_Disp_IndLmp_Rq_Pr2;
	int SQC_EPKB_Disp_IndLmp_Rq_Pr2;
	int CRC_EPKB_Stat_Pr2;
	dword CounterValForCRC_EPKB_Stat_Pr2;
	int SQC_VAL_EPKB_Stat_Pr2;
	int SQC_EPKB_Stat_Pr2;
	int CRC_DSR_Disp_Rq_Pr2;
	dword CounterValForCRC_DSR_Disp_Rq_Pr2;
	int SQC_VAL_DSR_Disp_Rq_Pr2;
	int SQC_DSR_Disp_Rq_Pr2;
	int CRC_ESP_Disp_Rq_Pr2;
	dword CounterValForCRC_ESP_Disp_Rq_Pr2;
	int SQC_VAL_ESP_Disp_Rq_Pr2;
	int SQC_ESP_Disp_Rq_Pr2;
	int CRC_PARK_Brk_Rs_Pr2;
	dword CounterValForCRC_PARK_Brk_Rs_Pr2;
	int SQC_VAL_PARK_Brk_Rs_Pr2;
	int SQC_PARK_Brk_Rs_Pr2;
	int CRC_PARK_Drv_Rq_ESP_Pr2;
	dword CounterValForCRC_PARK_Drv_Rq_ESP_Pr2;
	int SQC_VAL_PARK_Drv_Rq_ESP_Pr2;
	int SQC_PARK_Drv_Rq_ESP_Pr2;
	int CRC_PresfCtrl_Rq_ESP_Pr2;
	dword CounterValForCRC_PresfCtrl_Rq_ESP_Pr2;
	int SQC_VAL_PresfCtrl_Rq_ESP_Pr2;
	int SQC_PresfCtrl_Rq_ESP_Pr2;
	int TGL_VAL_resfAct_Adj_;	
	int TGL_resfAct_Adj_;	
	int CRC_PT_Rq_ESP_Pr2;
	dword CounterValForCRC_PT_Rq_ESP_Pr2;
	int SQC_VAL_PT_Rq_ESP_Pr2;
	int SQC_PT_Rq_ESP_Pr2;
	int CRC_SADR_Trgr_ESP_Pr2;
	dword CounterValForCRC_SADR_Trgr_ESP_Pr2;
	int SQC_VAL_SADR_Trgr_ESP_Pr2;
	int SQC_SADR_Trgr_ESP_Pr2;
	int CRC_St_Rq_STA_Pr2;
	dword CounterValForCRC_St_Rq_STA_Pr2;
	int SQC_VAL_St_Rq_STA_Pr2;
	int SQC_St_Rq_STA_Pr2;
	int CRC_TBCSC_Rs1_ESP_Pr2;
	dword CounterValForCRC_TBCSC_Rs1_ESP_Pr2;
	int SQC_VAL_TBCSC_Rs1_ESP_Pr2;
	int SQC_TBCSC_Rs1_ESP_Pr2;
	int CRC_TBCSC_Rs2_ESP_Pr2;
	dword CounterValForCRC_TBCSC_Rs2_ESP_Pr2;
	int SQC_VAL_TBCSC_Rs2_ESP_Pr2;
	int SQC_TBCSC_Rs2_ESP_Pr2;
	int CRC_VehAccel_X_Rs1_Pr2;
	dword CounterValForCRC_VehAccel_X_Rs1_Pr2;
	int SQC_VAL_VehAccel_X_Rs1_Pr2;
	int SQC_VehAccel_X_Rs1_Pr2;
	int CRC_VehAccel_X_Rs2_Pr2;
	dword CounterValForCRC_VehAccel_X_Rs2_Pr2;
	int SQC_VAL_VehAccel_X_Rs2_Pr2;
	int SQC_VehAccel_X_Rs2_Pr2;
	int CRC_VehDyn_Stat1_Pr2;
	dword CounterValForCRC_VehDyn_Stat1_Pr2;
	int SQC_VAL_VehDyn_Stat1_Pr2;
	int SQC_VehDyn_Stat1_Pr2;
	int CRC_VehDyn_Stat2_Pr2;
	dword CounterValForCRC_VehDyn_Stat2_Pr2;
	int SQC_VAL_VehDyn_Stat2_Pr2;
	int SQC_VehDyn_Stat2_Pr2;
	int CRC_VehSpd_X_Pr2;
	dword CounterValForCRC_VehSpd_X_Pr2;
	int SQC_VAL_VehSpd_X_Pr2;
	int SQC_VehSpd_X_Pr2;
	int CRC_Whl_Lt_Stat_Pr2;
	dword CounterValForCRC_Whl_Lt_Stat_Pr2;
	int SQC_VAL_Whl_Lt_Stat_Pr2;
	int SQC_Whl_Lt_Stat_Pr2;

	// Simulation der WhlPls-Signale (FL, FR, RL, RR, wenn vorhanden)
	int Whl_Lt_Stat_AR2_WhlPlsCnt_FL_Count = 0;


	// Simulation der WhlPls-Signale (FL, FR, RL, RR, wenn vorhanden)
	int Whl_Lt_Stat_AR2_WhlPlsCnt_RL_Count = 0;

	int CRC_Whl_Rt_Stat_Pr2;
	dword CounterValForCRC_Whl_Rt_Stat_Pr2;
	int SQC_VAL_Whl_Rt_Stat_Pr2;
	int SQC_Whl_Rt_Stat_Pr2;

	// Simulation der WhlPls-Signale (FL, FR, RL, RR, wenn vorhanden)
	int Whl_Rt_Stat_AR2_WhlPlsCnt_FR_Count = 0;


	// Simulation der WhlPls-Signale (FL, FR, RL, RR, wenn vorhanden)
	int Whl_Rt_Stat_AR2_WhlPlsCnt_RR_Count = 0;

	int CRC_WhlPlsCnt_TPM_Pr2;
	dword CounterValForCRC_WhlPlsCnt_TPM_Pr2;
	int SQC_VAL_WhlPlsCnt_TPM_Pr2;
	int SQC_WhlPlsCnt_TPM_Pr2;
	int CRC_YMAS_Rs_Pr2;
	dword CounterValForCRC_YMAS_Rs_Pr2;
	int SQC_VAL_YMAS_Rs_Pr2;
	int SQC_YMAS_Rs_Pr2;

	msTimer Timer_ESP_AWD_TCASE_Rq_ESP_AR2;
	msTimer Timer_ESP_BrkSys_Stat_AR2;
	msTimer Timer_ESP_DPC_Disp_Rq_AR2;
	msTimer Timer_ESP_DPC_IndMd_Stat_AR2;
	msTimer Timer_ESP_DPC_IndMd_Style2_AR2;
	msTimer Timer_ESP_DPC_IndMd_Style_AR2;
	msTimer Timer_ESP_DPC_Master_Rq_AR2;
	msTimer Timer_ESP_Eng_Susp_Rq_AS_AR2;
	msTimer Timer_ESP_EPKB_Disp_IndLmp_Rq_2_AR2;
	msTimer Timer_ESP_EPKB_Stat_Gw_AR2;
	msTimer Timer_ESP_ESP_Disp_Rq2_AR2;
	msTimer Timer_ESP_ESP_Disp_Rq3_AR;
	msTimer Timer_ESP_ESP_Disp_Rq_AMG_AR2;
	msTimer Timer_ESP_ESP_Disp_Rq_AR2;
	msTimer Timer_ESP_ESP_OBD_Stat_AR;
	msTimer Timer_ESP_ESP_Stat1_AR2;
	msTimer Timer_ESP_LDC_Disp_Rq_ESP_AR;
	msTimer Timer_ESP_PARK_Brk_Rs_AR2;
	msTimer Timer_ESP_PARK_Drv_Rq_ESP_AR2;
	msTimer Timer_ESP_PresfCtrl_Rq_ESP_AR2;
	msTimer Timer_ESP_PT_Rq_ESP_AR2;
	msTimer Timer_ESP_ROE_ESP;
	msTimer Timer_ESP_SADR_Trgr_ESP_AR2;
	msTimer Timer_ESP_St_Rq_STA_AR2;
	msTimer Timer_ESP_TBCSC_ESP_DAC_AR2;
	msTimer Timer_ESP_TBCSC_Rs1_ESP_AR2;
	msTimer Timer_ESP_TBCSC_Rs2_ESP_AR2;
	msTimer Timer_ESP_VehAccel_X_Rs1_AR2;
	msTimer Timer_ESP_VehAccel_X_Rs2_AR2;
	msTimer Timer_ESP_VehDyn_Stat1_AR2;
	msTimer Timer_ESP_VehDyn_Stat2_AR2;
	msTimer Timer_ESP_VehSpd_X_AR2;
	msTimer Timer_ESP_Whl_Lt_Stat_AR2;
	msTimer Timer_ESP_Whl_Rt_Stat_AR2;
	msTimer Timer_ESP_WhlPlsCnt_TPM_AR2;
	msTimer Timer_ESP_WUDOP_ESP_FR;
	msTimer Timer_ESP_YMAS_Rs_AR2;

   byte  crctable[256] = {
      0x00, 0x1D, 0x3A, 0x27, 0x74, 0x69, 0x4E, 0x53,
      0xE8, 0xF5, 0xD2, 0xCF, 0x9C, 0x81, 0xA6, 0xBB,
      0xCD, 0xD0, 0xF7, 0xEA, 0xB9, 0xA4, 0x83, 0x9E,
      0x25, 0x38, 0x1F, 0x02, 0x51, 0x4C, 0x6B, 0x76,
      0x87, 0x9A, 0xBD, 0xA0, 0xF3, 0xEE, 0xC9, 0xD4,
      0x6F, 0x72, 0x55, 0x48, 0x1B, 0x06, 0x21, 0x3C,
      0x4A, 0x57, 0x70, 0x6D, 0x3E, 0x23, 0x04, 0x19,
      0xA2, 0xBF, 0x98, 0x85, 0xD6, 0xCB, 0xEC, 0xF1,
      0x13, 0x0E, 0x29, 0x34, 0x67, 0x7A, 0x5D, 0x40,
      0xFB, 0xE6, 0xC1, 0xDC, 0x8F, 0x92, 0xB5, 0xA8,
      0xDE, 0xC3, 0xE4, 0xF9, 0xAA, 0xB7, 0x90, 0x8D,
      0x36, 0x2B, 0x0C, 0x11, 0x42, 0x5F, 0x78, 0x65,
      0x94, 0x89, 0xAE, 0xB3, 0xE0, 0xFD, 0xDA, 0xC7,
      0x7C, 0x61, 0x46, 0x5B, 0x08, 0x15, 0x32, 0x2F,
      0x59, 0x44, 0x63, 0x7E, 0x2D, 0x30, 0x17, 0x0A,
      0xB1, 0xAC, 0x8B, 0x96, 0xC5, 0xD8, 0xFF, 0xE2,
      0x26, 0x3B, 0x1C, 0x01, 0x52, 0x4F, 0x68, 0x75,
      0xCE, 0xD3, 0xF4, 0xE9, 0xBA, 0xA7, 0x80, 0x9D,
      0xEB, 0xF6, 0xD1, 0xCC, 0x9F, 0x82, 0xA5, 0xB8,
      0x03, 0x1E, 0x39, 0x24, 0x77, 0x6A, 0x4D, 0x50,
      0xA1, 0xBC, 0x9B, 0x86, 0xD5, 0xC8, 0xEF, 0xF2,
      0x49, 0x54, 0x73, 0x6E, 0x3D, 0x20, 0x07, 0x1A,
      0x6C, 0x71, 0x56, 0x4B, 0x18, 0x05, 0x22, 0x3F,
      0x84, 0x99, 0xBE, 0xA3, 0xF0, 0xED, 0xCA, 0xD7,
      0x35, 0x28, 0x0F, 0x12, 0x41, 0x5C, 0x7B, 0x66,
      0xDD, 0xC0, 0xE7, 0xFA, 0xA9, 0xB4, 0x93, 0x8E,
      0xF8, 0xE5, 0xC2, 0xDF, 0x8C, 0x91, 0xB6, 0xAB,
      0x10, 0x0D, 0x2A, 0x37, 0x64, 0x79, 0x5E, 0x43,
      0xB2, 0xAF, 0x88, 0x95, 0xC6, 0xDB, 0xFC, 0xE1,
      0x5A, 0x47, 0x60, 0x7D, 0x2E, 0x33, 0x14, 0x09,
      0x7F, 0x62, 0x45, 0x58, 0x0B, 0x16, 0x31, 0x2C,
      0x97, 0x8A, 0xAD, 0xB0, 0xE3, 0xFE, 0xD9, 0xC4
   };

   byte  crctableProfTwo[256] = {
			0x00, 0x2F, 0x5E, 0x71, 0xBC, 0x93, 0xE2, 0xCD,
			0x57, 0x78, 0x09, 0x26, 0xEB, 0xC4, 0xB5, 0x9A,
			0xAE, 0x81, 0xF0, 0xDF, 0x12, 0x3D, 0x4C, 0x63,
			0xF9, 0xD6, 0xA7, 0x88, 0x45, 0x6A, 0x1B, 0x34,
			0x73, 0x5C, 0x2D, 0x02, 0xCF, 0xE0, 0x91, 0xBE,
			0x24, 0x0B, 0x7A, 0x55, 0x98, 0xB7, 0xC6, 0xE9,
			0xDD, 0xF2, 0x83, 0xAC, 0x61, 0x4E, 0x3F, 0x10,
			0x8A, 0xA5, 0xD4, 0xFB, 0x36, 0x19, 0x68, 0x47,
			0xE6, 0xC9, 0xB8, 0x97, 0x5A, 0x75, 0x04, 0x2B,
			0xB1, 0x9E, 0xEF, 0xC0, 0x0D, 0x22, 0x53, 0x7C,
			0x48, 0x67, 0x16, 0x39, 0xF4, 0xDB, 0xAA, 0x85,
			0x1F, 0x30, 0x41, 0x6E, 0xA3, 0x8C, 0xFD, 0xD2,
			0x95, 0xBA, 0xCB, 0xE4, 0x29, 0x06, 0x77, 0x58,
			0xC2, 0xED, 0x9C, 0xB3, 0x7E, 0x51, 0x20, 0x0F,
			0x3B, 0x14, 0x65, 0x4A, 0x87, 0xA8, 0xD9, 0xF6,
			0x6C, 0x43, 0x32, 0x1D, 0xD0, 0xFF, 0x8E, 0xA1,
			0xE3, 0xCC, 0xBD, 0x92, 0x5F, 0x70, 0x01, 0x2E,
			0xB4, 0x9B, 0xEA, 0xC5, 0x08, 0x27, 0x56, 0x79,
			0x4D, 0x62, 0x13, 0x3C, 0xF1, 0xDE, 0xAF, 0x80,
			0x1A, 0x35, 0x44, 0x6B, 0xA6, 0x89, 0xF8, 0xD7,
			0x90, 0xBF, 0xCE, 0xE1, 0x2C, 0x03, 0x72, 0x5D,
			0xC7, 0xE8, 0x99, 0xB6, 0x7B, 0x54, 0x25, 0x0A,
			0x3E, 0x11, 0x60, 0x4F, 0x82, 0xAD, 0xDC, 0xF3,
			0x69, 0x46, 0x37, 0x18, 0xD5, 0xFA, 0x8B, 0xA4,
			0x05, 0x2A, 0x5B, 0x74, 0xB9, 0x96, 0xE7, 0xC8,
			0x52, 0x7D, 0x0C, 0x23, 0xEE, 0xC1, 0xB0, 0x9F,
			0xAB, 0x84, 0xF5, 0xDA, 0x17, 0x38, 0x49, 0x66,
			0xFC, 0xD3, 0xA2, 0x8D, 0x40, 0x6F, 0x1E, 0x31,
			0x76, 0x59, 0x28, 0x07, 0xCA, 0xE5, 0x94, 0xBB,
			0x21, 0x0E, 0x7F, 0x50, 0x9D, 0xB2, 0xC3, 0xEC,
			0xD8, 0xF7, 0x86, 0xA9, 0x64, 0x4B, 0x3A, 0x15,
			0x8F, 0xA0, 0xD1, 0xFE, 0x33, 0x1C, 0x6D, 0x42
   };
}

on start
{
	result = EnableCRC("", 0); // 1 = on, 0 = off
	result = EnableTGL("", 0); // 1 = on, 0 = off 
	result = EnableSQC("", 0); // 1 = on, 0 = off 
	result = EnableMC("", 0); // 1 = on, 0 = off 

	if (@sysvar::CH_Nodes::CH_ESPCRC_AWD_TCASE_Rq_ESP__AUTO == 0)
	{
		//Automatisch
		enableControl("AWD_TCASE_Rq_ESP_AR2", "CH_ESPCRC_AWD_TCASE_Rq_ESP_Pr2A_", 0); //1: enable; 0: disable
	}
	else
	{
		//Manuel
		enableControl("AWD_TCASE_Rq_ESP_AR2", "CH_ESPCRC_AWD_TCASE_Rq_ESP_Pr2A_", 1); //1: enable; 0: disable
	}
	if (@sysvar::CH_Nodes::CH_ESPSQC_AWD_TCASE_Rq_ESP__AUTO == 0)
	{
		//Automatisch
		enableControl("AWD_TCASE_Rq_ESP_AR2", "CH_ESPSQC_AWD_TCASE_Rq_ESP_Pr2A_", 0); //1: enable; 0: disable
	}
	else
	{
		//Manuel
		enableControl("AWD_TCASE_Rq_ESP_AR2", "CH_ESPSQC_AWD_TCASE_Rq_ESP_Pr2A_", 1); //1: enable; 0: disable
	}
	@sysvar::CH_Nodes::CH__PDURECEIPT_SIM_ESP_AWD_TCASE_Rq_ESP_AR2 = 1;
	if (@sysvar::CH_Nodes::CH_ESPCRC_BrkSys_Stat_Pr2Br_AUTO == 0)
	{
		//Automatisch
		enableControl("BrkSys_Stat_AR2", "CH_ESPCRC_BrkSys_Stat_Pr2BrkSys_", 0); //1: enable; 0: disable
	}
	else
	{
		//Manuel
		enableControl("BrkSys_Stat_AR2", "CH_ESPCRC_BrkSys_Stat_Pr2BrkSys_", 1); //1: enable; 0: disable
	}
	if (@sysvar::CH_Nodes::CH_ESPSQC_BrkSys_Stat_Pr2Br_AUTO == 0)
	{
		//Automatisch
		enableControl("BrkSys_Stat_AR2", "CH_ESPSQC_BrkSys_Stat_Pr2BrkSys_", 0); //1: enable; 0: disable
	}
	else
	{
		//Manuel
		enableControl("BrkSys_Stat_AR2", "CH_ESPSQC_BrkSys_Stat_Pr2BrkSys_", 1); //1: enable; 0: disable
	}
	@sysvar::CH_Nodes::CH__PDURECEIPT_SIM_ESP_BrkSys_Stat_AR2 = 1;
	if (@sysvar::CH_Nodes::CH_ESPCRC_DPC_Disp_Rq_Pr2DP_AUTO == 0)
	{
		//Automatisch
		enableControl("DPC_Disp_Rq_AR2", "CH_ESPCRC_DPC_Disp_Rq_Pr2DPC_Di_", 0); //1: enable; 0: disable
	}
	else
	{
		//Manuel
		enableControl("DPC_Disp_Rq_AR2", "CH_ESPCRC_DPC_Disp_Rq_Pr2DPC_Di_", 1); //1: enable; 0: disable
	}
	if (@sysvar::CH_Nodes::CH_ESPSQC_DPC_Disp_Rq_Pr2DP_AUTO == 0)
	{
		//Automatisch
		enableControl("DPC_Disp_Rq_AR2", "CH_ESPSQC_DPC_Disp_Rq_Pr2DPC_Di_", 0); //1: enable; 0: disable
	}
	else
	{
		//Manuel
		enableControl("DPC_Disp_Rq_AR2", "CH_ESPSQC_DPC_Disp_Rq_Pr2DPC_Di_", 1); //1: enable; 0: disable
	}
	@sysvar::CH_Nodes::CH__PDURECEIPT_SIM_ESP_DPC_Disp_Rq_AR2 = 1;
	if (@sysvar::CH_Nodes::CH_ESPCRC_DPC_IndMd_Stat_Pr_AUTO == 0)
	{
		//Automatisch
		enableControl("DPC_IndMd_Stat_AR2", "CH_ESPCRC_DPC_IndMd_Stat_Pr2DPC_", 0); //1: enable; 0: disable
	}
	else
	{
		//Manuel
		enableControl("DPC_IndMd_Stat_AR2", "CH_ESPCRC_DPC_IndMd_Stat_Pr2DPC_", 1); //1: enable; 0: disable
	}
	if (@sysvar::CH_Nodes::CH_ESPSQC_DPC_IndMd_Stat_Pr_AUTO == 0)
	{
		//Automatisch
		enableControl("DPC_IndMd_Stat_AR2", "CH_ESPSQC_DPC_IndMd_Stat_Pr2DPC_", 0); //1: enable; 0: disable
	}
	else
	{
		//Manuel
		enableControl("DPC_IndMd_Stat_AR2", "CH_ESPSQC_DPC_IndMd_Stat_Pr2DPC_", 1); //1: enable; 0: disable
	}
	@sysvar::CH_Nodes::CH__PDURECEIPT_SIM_ESP_DPC_IndMd_Stat_AR2 = 1;
	if (@sysvar::CH_Nodes::CH_ESPCRC_DPC_IndMd_Style2__AUTO == 0)
	{
		//Automatisch
		enableControl("DPC_IndMd_Style2_AR2", "CH_ESPCRC_DPC_IndMd_Style2_Pr2D_", 0); //1: enable; 0: disable
	}
	else
	{
		//Manuel
		enableControl("DPC_IndMd_Style2_AR2", "CH_ESPCRC_DPC_IndMd_Style2_Pr2D_", 1); //1: enable; 0: disable
	}
	if (@sysvar::CH_Nodes::CH_ESPSQC_DPC_IndMd_Style2__AUTO == 0)
	{
		//Automatisch
		enableControl("DPC_IndMd_Style2_AR2", "CH_ESPSQC_DPC_IndMd_Style2_Pr2D_", 0); //1: enable; 0: disable
	}
	else
	{
		//Manuel
		enableControl("DPC_IndMd_Style2_AR2", "CH_ESPSQC_DPC_IndMd_Style2_Pr2D_", 1); //1: enable; 0: disable
	}
	@sysvar::CH_Nodes::CH__PDURECEIPT_SIM_ESP_DPC_IndMd_Style2_AR2 = 1;
	if (@sysvar::CH_Nodes::CH_ESPCRC_DPC_IndMd_Style_P_AUTO == 0)
	{
		//Automatisch
		enableControl("DPC_IndMd_Style_AR2", "CH_ESPCRC_DPC_IndMd_Style_Pr2DP_", 0); //1: enable; 0: disable
	}
	else
	{
		//Manuel
		enableControl("DPC_IndMd_Style_AR2", "CH_ESPCRC_DPC_IndMd_Style_Pr2DP_", 1); //1: enable; 0: disable
	}
	if (@sysvar::CH_Nodes::CH_ESPSQC_DPC_IndMd_Style_P_AUTO == 0)
	{
		//Automatisch
		enableControl("DPC_IndMd_Style_AR2", "CH_ESPSQC_DPC_IndMd_Style_Pr2DP_", 0); //1: enable; 0: disable
	}
	else
	{
		//Manuel
		enableControl("DPC_IndMd_Style_AR2", "CH_ESPSQC_DPC_IndMd_Style_Pr2DP_", 1); //1: enable; 0: disable
	}
	@sysvar::CH_Nodes::CH__PDURECEIPT_SIM_ESP_DPC_IndMd_Style_AR2 = 1;
	if (@sysvar::CH_Nodes::CH_ESPCRC_DPC_Master_Rq_Pr2_AUTO == 0)
	{
		//Automatisch
		enableControl("DPC_Master_Rq_AR2", "CH_ESPCRC_DPC_Master_Rq_Pr2DPC__", 0); //1: enable; 0: disable
	}
	else
	{
		//Manuel
		enableControl("DPC_Master_Rq_AR2", "CH_ESPCRC_DPC_Master_Rq_Pr2DPC__", 1); //1: enable; 0: disable
	}
	if (@sysvar::CH_Nodes::CH_ESPSQC_DPC_Master_Rq_Pr2_AUTO == 0)
	{
		//Automatisch
		enableControl("DPC_Master_Rq_AR2", "CH_ESPSQC_DPC_Master_Rq_Pr2DPC__", 0); //1: enable; 0: disable
	}
	else
	{
		//Manuel
		enableControl("DPC_Master_Rq_AR2", "CH_ESPSQC_DPC_Master_Rq_Pr2DPC__", 1); //1: enable; 0: disable
	}
	@sysvar::CH_Nodes::CH__PDURECEIPT_SIM_ESP_DPC_Master_Rq_AR2 = 1;
	if (@sysvar::CH_Nodes::CH_ESPCRC_Eng_Susp_Rq_AS_Pr_AUTO == 0)
	{
		//Automatisch
		enableControl("Eng_Susp_Rq_AS_AR2", "CH_ESPCRC_Eng_Susp_Rq_AS_Pr2Eng_", 0); //1: enable; 0: disable
	}
	else
	{
		//Manuel
		enableControl("Eng_Susp_Rq_AS_AR2", "CH_ESPCRC_Eng_Susp_Rq_AS_Pr2Eng_", 1); //1: enable; 0: disable
	}
	if (@sysvar::CH_Nodes::CH_ESPSQC_Eng_Susp_Rq_AS_Pr_AUTO == 0)
	{
		//Automatisch
		enableControl("Eng_Susp_Rq_AS_AR2", "CH_ESPSQC_Eng_Susp_Rq_AS_Pr2Eng_", 0); //1: enable; 0: disable
	}
	else
	{
		//Manuel
		enableControl("Eng_Susp_Rq_AS_AR2", "CH_ESPSQC_Eng_Susp_Rq_AS_Pr2Eng_", 1); //1: enable; 0: disable
	}
	@sysvar::CH_Nodes::CH__PDURECEIPT_SIM_ESP_Eng_Susp_Rq_AS_AR2 = 1;
	if (@sysvar::CH_Nodes::CH_ESPCRC_EPKB_Disp_IndLmp__AUTO == 0)
	{
		//Automatisch
		enableControl("EPKB_Disp_IndLmp_Rq_2_AR2", "CH_ESPCRC_EPKB_Disp_IndLmp_Rq_P_", 0); //1: enable; 0: disable
	}
	else
	{
		//Manuel
		enableControl("EPKB_Disp_IndLmp_Rq_2_AR2", "CH_ESPCRC_EPKB_Disp_IndLmp_Rq_P_", 1); //1: enable; 0: disable
	}
	if (@sysvar::CH_Nodes::CH_ESPSQC_EPKB_Disp_IndLmp__AUTO == 0)
	{
		//Automatisch
		enableControl("EPKB_Disp_IndLmp_Rq_2_AR2", "CH_ESPSQC_EPKB_Disp_IndLmp_Rq_P_", 0); //1: enable; 0: disable
	}
	else
	{
		//Manuel
		enableControl("EPKB_Disp_IndLmp_Rq_2_AR2", "CH_ESPSQC_EPKB_Disp_IndLmp_Rq_P_", 1); //1: enable; 0: disable
	}
	@sysvar::CH_Nodes::CH__PDURECEIPT_SIM_ESP_EPKB_Disp_IndLmp_Rq_2_AR2 = 1;
	if (@sysvar::CH_Nodes::CH_ESPCRC_EPKB_Stat_Pr2EPKB_AUTO == 0)
	{
		//Automatisch
		enableControl("EPKB_Stat_Gw_AR2", "CH_ESPCRC_EPKB_Stat_Pr2EPKB_Sta_", 0); //1: enable; 0: disable
	}
	else
	{
		//Manuel
		enableControl("EPKB_Stat_Gw_AR2", "CH_ESPCRC_EPKB_Stat_Pr2EPKB_Sta_", 1); //1: enable; 0: disable
	}
	if (@sysvar::CH_Nodes::CH_ESPSQC_EPKB_Stat_Pr2EPKB_AUTO == 0)
	{
		//Automatisch
		enableControl("EPKB_Stat_Gw_AR2", "CH_ESPSQC_EPKB_Stat_Pr2EPKB_Sta_", 0); //1: enable; 0: disable
	}
	else
	{
		//Manuel
		enableControl("EPKB_Stat_Gw_AR2", "CH_ESPSQC_EPKB_Stat_Pr2EPKB_Sta_", 1); //1: enable; 0: disable
	}
	@sysvar::CH_Nodes::CH__PDURECEIPT_SIM_ESP_EPKB_Stat_Gw_AR2 = 1;
	if (@sysvar::CH_Nodes::CH_ESPCRC_DSR_Disp_Rq_Pr2ES_AUTO == 0)
	{
		//Automatisch
		enableControl("ESP_Disp_Rq2_AR2", "CH_ESPCRC_DSR_Disp_Rq_Pr2ESP_Di_", 0); //1: enable; 0: disable
	}
	else
	{
		//Manuel
		enableControl("ESP_Disp_Rq2_AR2", "CH_ESPCRC_DSR_Disp_Rq_Pr2ESP_Di_", 1); //1: enable; 0: disable
	}
	if (@sysvar::CH_Nodes::CH_ESPSQC_DSR_Disp_Rq_Pr2ES_AUTO == 0)
	{
		//Automatisch
		enableControl("ESP_Disp_Rq2_AR2", "CH_ESPSQC_DSR_Disp_Rq_Pr2ESP_Di_", 0); //1: enable; 0: disable
	}
	else
	{
		//Manuel
		enableControl("ESP_Disp_Rq2_AR2", "CH_ESPSQC_DSR_Disp_Rq_Pr2ESP_Di_", 1); //1: enable; 0: disable
	}
	@sysvar::CH_Nodes::CH__PDURECEIPT_SIM_ESP_ESP_Disp_Rq2_AR2 = 1;
	@sysvar::CH_Nodes::CH__PDURECEIPT_SIM_ESP_ESP_Disp_Rq3_AR = 1;
	@sysvar::CH_Nodes::CH__PDURECEIPT_SIM_ESP_ESP_Disp_Rq_AMG_AR2 = 1;
	if (@sysvar::CH_Nodes::CH_ESPCRC_ESP_Disp_Rq_Pr2ES_AUTO == 0)
	{
		//Automatisch
		enableControl("ESP_Disp_Rq_AR2", "CH_ESPCRC_ESP_Disp_Rq_Pr2ESP_Di_", 0); //1: enable; 0: disable
	}
	else
	{
		//Manuel
		enableControl("ESP_Disp_Rq_AR2", "CH_ESPCRC_ESP_Disp_Rq_Pr2ESP_Di_", 1); //1: enable; 0: disable
	}
	if (@sysvar::CH_Nodes::CH_ESPSQC_ESP_Disp_Rq_Pr2ES_AUTO == 0)
	{
		//Automatisch
		enableControl("ESP_Disp_Rq_AR2", "CH_ESPSQC_ESP_Disp_Rq_Pr2ESP_Di_", 0); //1: enable; 0: disable
	}
	else
	{
		//Manuel
		enableControl("ESP_Disp_Rq_AR2", "CH_ESPSQC_ESP_Disp_Rq_Pr2ESP_Di_", 1); //1: enable; 0: disable
	}
	@sysvar::CH_Nodes::CH__PDURECEIPT_SIM_ESP_ESP_Disp_Rq_AR2 = 1;
	@sysvar::CH_Nodes::CH__PDURECEIPT_SIM_ESP_ESP_OBD_Stat_AR = 1;
	@sysvar::CH_Nodes::CH__PDURECEIPT_SIM_ESP_ESP_Stat1_AR2 = 1;
	@sysvar::CH_Nodes::CH__PDURECEIPT_SIM_ESP_LDC_Disp_Rq_ESP_AR = 1;
	if (@sysvar::CH_Nodes::CH_ESPCRC_PARK_Brk_Rs_Pr2PA_AUTO == 0)
	{
		//Automatisch
		enableControl("PARK_Brk_Rs_AR2", "CH_ESPCRC_PARK_Brk_Rs_Pr2PARK_B_", 0); //1: enable; 0: disable
	}
	else
	{
		//Manuel
		enableControl("PARK_Brk_Rs_AR2", "CH_ESPCRC_PARK_Brk_Rs_Pr2PARK_B_", 1); //1: enable; 0: disable
	}
	if (@sysvar::CH_Nodes::CH_ESPSQC_PARK_Brk_Rs_Pr2PA_AUTO == 0)
	{
		//Automatisch
		enableControl("PARK_Brk_Rs_AR2", "CH_ESPSQC_PARK_Brk_Rs_Pr2PARK_B_", 0); //1: enable; 0: disable
	}
	else
	{
		//Manuel
		enableControl("PARK_Brk_Rs_AR2", "CH_ESPSQC_PARK_Brk_Rs_Pr2PARK_B_", 1); //1: enable; 0: disable
	}
	@sysvar::CH_Nodes::CH__PDURECEIPT_SIM_ESP_PARK_Brk_Rs_AR2 = 1;
	if (@sysvar::CH_Nodes::CH_ESPCRC_PARK_Drv_Rq_ESP_P_AUTO == 0)
	{
		//Automatisch
		enableControl("PARK_Drv_Rq_ESP_AR2", "CH_ESPCRC_PARK_Drv_Rq_ESP_Pr2PA_", 0); //1: enable; 0: disable
	}
	else
	{
		//Manuel
		enableControl("PARK_Drv_Rq_ESP_AR2", "CH_ESPCRC_PARK_Drv_Rq_ESP_Pr2PA_", 1); //1: enable; 0: disable
	}
	if (@sysvar::CH_Nodes::CH_ESPSQC_PARK_Drv_Rq_ESP_P_AUTO == 0)
	{
		//Automatisch
		enableControl("PARK_Drv_Rq_ESP_AR2", "CH_ESPSQC_PARK_Drv_Rq_ESP_Pr2PA_", 0); //1: enable; 0: disable
	}
	else
	{
		//Manuel
		enableControl("PARK_Drv_Rq_ESP_AR2", "CH_ESPSQC_PARK_Drv_Rq_ESP_Pr2PA_", 1); //1: enable; 0: disable
	}
	@sysvar::CH_Nodes::CH__PDURECEIPT_SIM_ESP_PARK_Drv_Rq_ESP_AR2 = 1;
	if (@sysvar::CH_Nodes::CH_ESPCRC_PresfCtrl_Rq_ESP__AUTO == 0)
	{
		//Automatisch
		enableControl("PresfCtrl_Rq_ESP_AR2", "CH_ESPCRC_PresfCtrl_Rq_ESP_Pr2P_", 0); //1: enable; 0: disable
	}
	else
	{
		//Manuel
		enableControl("PresfCtrl_Rq_ESP_AR2", "CH_ESPCRC_PresfCtrl_Rq_ESP_Pr2P_", 1); //1: enable; 0: disable
	}
	if (@sysvar::CH_Nodes::CH_ESPSQC_PresfCtrl_Rq_ESP__AUTO == 0)
	{
		//Automatisch
		enableControl("PresfCtrl_Rq_ESP_AR2", "CH_ESPSQC_PresfCtrl_Rq_ESP_Pr2P_", 0); //1: enable; 0: disable
	}
	else
	{
		//Manuel
		enableControl("PresfCtrl_Rq_ESP_AR2", "CH_ESPSQC_PresfCtrl_Rq_ESP_Pr2P_", 1); //1: enable; 0: disable
	}
	if (@sysvar::CH_Nodes::CH_ESPPresfAct_Adj_TglPresf_AUTO == 0)
	{
		//Automatisch
		enableControl("PresfCtrl_Rq_ESP_AR2", "CH_ESPPresfAct_Adj_TglPresfCtrl_", 0); //1: enable; 0: disable
	}
	else
	{
		//Manuel
		enableControl("PresfCtrl_Rq_ESP_AR2", "CH_ESPPresfAct_Adj_TglPresfCtrl_", 1); //1: enable; 0: disable
	}
	@sysvar::CH_Nodes::CH__PDURECEIPT_SIM_ESP_PresfCtrl_Rq_ESP_AR2 = 1;
	if (@sysvar::CH_Nodes::CH_ESPCRC_PT_Rq_ESP_Pr2PT_R_AUTO == 0)
	{
		//Automatisch
		enableControl("PT_Rq_ESP_AR2", "CH_ESPCRC_PT_Rq_ESP_Pr2PT_Rq_ES_", 0); //1: enable; 0: disable
	}
	else
	{
		//Manuel
		enableControl("PT_Rq_ESP_AR2", "CH_ESPCRC_PT_Rq_ESP_Pr2PT_Rq_ES_", 1); //1: enable; 0: disable
	}
	if (@sysvar::CH_Nodes::CH_ESPSQC_PT_Rq_ESP_Pr2PT_R_AUTO == 0)
	{
		//Automatisch
		enableControl("PT_Rq_ESP_AR2", "CH_ESPSQC_PT_Rq_ESP_Pr2PT_Rq_ES_", 0); //1: enable; 0: disable
	}
	else
	{
		//Manuel
		enableControl("PT_Rq_ESP_AR2", "CH_ESPSQC_PT_Rq_ESP_Pr2PT_Rq_ES_", 1); //1: enable; 0: disable
	}
	@sysvar::CH_Nodes::CH__PDURECEIPT_SIM_ESP_PT_Rq_ESP_AR2 = 1;
	@sysvar::CH_Nodes::CH__PDURECEIPT_SIM_ESP_ROE_ESP = 1;
	if (@sysvar::CH_Nodes::CH_ESPCRC_SADR_Trgr_ESP_Pr2_AUTO == 0)
	{
		//Automatisch
		enableControl("SADR_Trgr_ESP_AR2", "CH_ESPCRC_SADR_Trgr_ESP_Pr2SADR_", 0); //1: enable; 0: disable
	}
	else
	{
		//Manuel
		enableControl("SADR_Trgr_ESP_AR2", "CH_ESPCRC_SADR_Trgr_ESP_Pr2SADR_", 1); //1: enable; 0: disable
	}
	if (@sysvar::CH_Nodes::CH_ESPSQC_SADR_Trgr_ESP_Pr2_AUTO == 0)
	{
		//Automatisch
		enableControl("SADR_Trgr_ESP_AR2", "CH_ESPSQC_SADR_Trgr_ESP_Pr2SADR_", 0); //1: enable; 0: disable
	}
	else
	{
		//Manuel
		enableControl("SADR_Trgr_ESP_AR2", "CH_ESPSQC_SADR_Trgr_ESP_Pr2SADR_", 1); //1: enable; 0: disable
	}
	@sysvar::CH_Nodes::CH__PDURECEIPT_SIM_ESP_SADR_Trgr_ESP_AR2 = 1;
	if (@sysvar::CH_Nodes::CH_ESPCRC_St_Rq_STA_Pr2St_R_AUTO == 0)
	{
		//Automatisch
		enableControl("St_Rq_STA_AR2", "CH_ESPCRC_St_Rq_STA_Pr2St_Rq_ST_", 0); //1: enable; 0: disable
	}
	else
	{
		//Manuel
		enableControl("St_Rq_STA_AR2", "CH_ESPCRC_St_Rq_STA_Pr2St_Rq_ST_", 1); //1: enable; 0: disable
	}
	if (@sysvar::CH_Nodes::CH_ESPSQC_St_Rq_STA_Pr2St_R_AUTO == 0)
	{
		//Automatisch
		enableControl("St_Rq_STA_AR2", "CH_ESPSQC_St_Rq_STA_Pr2St_Rq_ST_", 0); //1: enable; 0: disable
	}
	else
	{
		//Manuel
		enableControl("St_Rq_STA_AR2", "CH_ESPSQC_St_Rq_STA_Pr2St_Rq_ST_", 1); //1: enable; 0: disable
	}
	@sysvar::CH_Nodes::CH__PDURECEIPT_SIM_ESP_St_Rq_STA_AR2 = 1;
	@sysvar::CH_Nodes::CH__PDURECEIPT_SIM_ESP_TBCSC_ESP_DAC_AR2 = 1;
	if (@sysvar::CH_Nodes::CH_ESPCRC_TBCSC_Rs1_ESP_Pr2_AUTO == 0)
	{
		//Automatisch
		enableControl("TBCSC_Rs1_ESP_AR2", "CH_ESPCRC_TBCSC_Rs1_ESP_Pr2TBCS_", 0); //1: enable; 0: disable
	}
	else
	{
		//Manuel
		enableControl("TBCSC_Rs1_ESP_AR2", "CH_ESPCRC_TBCSC_Rs1_ESP_Pr2TBCS_", 1); //1: enable; 0: disable
	}
	if (@sysvar::CH_Nodes::CH_ESPSQC_TBCSC_Rs1_ESP_Pr2_AUTO == 0)
	{
		//Automatisch
		enableControl("TBCSC_Rs1_ESP_AR2", "CH_ESPSQC_TBCSC_Rs1_ESP_Pr2TBCS_", 0); //1: enable; 0: disable
	}
	else
	{
		//Manuel
		enableControl("TBCSC_Rs1_ESP_AR2", "CH_ESPSQC_TBCSC_Rs1_ESP_Pr2TBCS_", 1); //1: enable; 0: disable
	}
	@sysvar::CH_Nodes::CH__PDURECEIPT_SIM_ESP_TBCSC_Rs1_ESP_AR2 = 1;
	if (@sysvar::CH_Nodes::CH_ESPCRC_TBCSC_Rs2_ESP_Pr2_AUTO == 0)
	{
		//Automatisch
		enableControl("TBCSC_Rs2_ESP_AR2", "CH_ESPCRC_TBCSC_Rs2_ESP_Pr2TBCS_", 0); //1: enable; 0: disable
	}
	else
	{
		//Manuel
		enableControl("TBCSC_Rs2_ESP_AR2", "CH_ESPCRC_TBCSC_Rs2_ESP_Pr2TBCS_", 1); //1: enable; 0: disable
	}
	if (@sysvar::CH_Nodes::CH_ESPSQC_TBCSC_Rs2_ESP_Pr2_AUTO == 0)
	{
		//Automatisch
		enableControl("TBCSC_Rs2_ESP_AR2", "CH_ESPSQC_TBCSC_Rs2_ESP_Pr2TBCS_", 0); //1: enable; 0: disable
	}
	else
	{
		//Manuel
		enableControl("TBCSC_Rs2_ESP_AR2", "CH_ESPSQC_TBCSC_Rs2_ESP_Pr2TBCS_", 1); //1: enable; 0: disable
	}
	@sysvar::CH_Nodes::CH__PDURECEIPT_SIM_ESP_TBCSC_Rs2_ESP_AR2 = 1;
	if (@sysvar::CH_Nodes::CH_ESPCRC_VehAccel_X_Rs1_Pr_AUTO == 0)
	{
		//Automatisch
		enableControl("VehAccel_X_Rs1_AR2", "CH_ESPCRC_VehAccel_X_Rs1_Pr2Veh_", 0); //1: enable; 0: disable
	}
	else
	{
		//Manuel
		enableControl("VehAccel_X_Rs1_AR2", "CH_ESPCRC_VehAccel_X_Rs1_Pr2Veh_", 1); //1: enable; 0: disable
	}
	if (@sysvar::CH_Nodes::CH_ESPSQC_VehAccel_X_Rs1_Pr_AUTO == 0)
	{
		//Automatisch
		enableControl("VehAccel_X_Rs1_AR2", "CH_ESPSQC_VehAccel_X_Rs1_Pr2Veh_", 0); //1: enable; 0: disable
	}
	else
	{
		//Manuel
		enableControl("VehAccel_X_Rs1_AR2", "CH_ESPSQC_VehAccel_X_Rs1_Pr2Veh_", 1); //1: enable; 0: disable
	}
	@sysvar::CH_Nodes::CH__PDURECEIPT_SIM_ESP_VehAccel_X_Rs1_AR2 = 1;
	if (@sysvar::CH_Nodes::CH_ESPCRC_VehAccel_X_Rs2_Pr_AUTO == 0)
	{
		//Automatisch
		enableControl("VehAccel_X_Rs2_AR2", "CH_ESPCRC_VehAccel_X_Rs2_Pr2Veh_", 0); //1: enable; 0: disable
	}
	else
	{
		//Manuel
		enableControl("VehAccel_X_Rs2_AR2", "CH_ESPCRC_VehAccel_X_Rs2_Pr2Veh_", 1); //1: enable; 0: disable
	}
	if (@sysvar::CH_Nodes::CH_ESPSQC_VehAccel_X_Rs2_Pr_AUTO == 0)
	{
		//Automatisch
		enableControl("VehAccel_X_Rs2_AR2", "CH_ESPSQC_VehAccel_X_Rs2_Pr2Veh_", 0); //1: enable; 0: disable
	}
	else
	{
		//Manuel
		enableControl("VehAccel_X_Rs2_AR2", "CH_ESPSQC_VehAccel_X_Rs2_Pr2Veh_", 1); //1: enable; 0: disable
	}
	@sysvar::CH_Nodes::CH__PDURECEIPT_SIM_ESP_VehAccel_X_Rs2_AR2 = 1;
	if (@sysvar::CH_Nodes::CH_ESPCRC_VehDyn_Stat1_Pr2V_AUTO == 0)
	{
		//Automatisch
		enableControl("VehDyn_Stat1_AR2", "CH_ESPCRC_VehDyn_Stat1_Pr2VehDy_", 0); //1: enable; 0: disable
	}
	else
	{
		//Manuel
		enableControl("VehDyn_Stat1_AR2", "CH_ESPCRC_VehDyn_Stat1_Pr2VehDy_", 1); //1: enable; 0: disable
	}
	if (@sysvar::CH_Nodes::CH_ESPSQC_VehDyn_Stat1_Pr2V_AUTO == 0)
	{
		//Automatisch
		enableControl("VehDyn_Stat1_AR2", "CH_ESPSQC_VehDyn_Stat1_Pr2VehDy_", 0); //1: enable; 0: disable
	}
	else
	{
		//Manuel
		enableControl("VehDyn_Stat1_AR2", "CH_ESPSQC_VehDyn_Stat1_Pr2VehDy_", 1); //1: enable; 0: disable
	}
	@sysvar::CH_Nodes::CH__PDURECEIPT_SIM_ESP_VehDyn_Stat1_AR2 = 1;
	if (@sysvar::CH_Nodes::CH_ESPCRC_VehDyn_Stat2_Pr2V_AUTO == 0)
	{
		//Automatisch
		enableControl("VehDyn_Stat2_AR2", "CH_ESPCRC_VehDyn_Stat2_Pr2VehDy_", 0); //1: enable; 0: disable
	}
	else
	{
		//Manuel
		enableControl("VehDyn_Stat2_AR2", "CH_ESPCRC_VehDyn_Stat2_Pr2VehDy_", 1); //1: enable; 0: disable
	}
	if (@sysvar::CH_Nodes::CH_ESPSQC_VehDyn_Stat2_Pr2V_AUTO == 0)
	{
		//Automatisch
		enableControl("VehDyn_Stat2_AR2", "CH_ESPSQC_VehDyn_Stat2_Pr2VehDy_", 0); //1: enable; 0: disable
	}
	else
	{
		//Manuel
		enableControl("VehDyn_Stat2_AR2", "CH_ESPSQC_VehDyn_Stat2_Pr2VehDy_", 1); //1: enable; 0: disable
	}
	@sysvar::CH_Nodes::CH__PDURECEIPT_SIM_ESP_VehDyn_Stat2_AR2 = 1;
	if (@sysvar::CH_Nodes::CH_ESPCRC_VehSpd_X_Pr2VehSp_AUTO == 0)
	{
		//Automatisch
		enableControl("VehSpd_X_AR2", "CH_ESPCRC_VehSpd_X_Pr2VehSpd_X__", 0); //1: enable; 0: disable
	}
	else
	{
		//Manuel
		enableControl("VehSpd_X_AR2", "CH_ESPCRC_VehSpd_X_Pr2VehSpd_X__", 1); //1: enable; 0: disable
	}
	if (@sysvar::CH_Nodes::CH_ESPSQC_VehSpd_X_Pr2VehSp_AUTO == 0)
	{
		//Automatisch
		enableControl("VehSpd_X_AR2", "CH_ESPSQC_VehSpd_X_Pr2VehSpd_X__", 0); //1: enable; 0: disable
	}
	else
	{
		//Manuel
		enableControl("VehSpd_X_AR2", "CH_ESPSQC_VehSpd_X_Pr2VehSpd_X__", 1); //1: enable; 0: disable
	}
	@sysvar::CH_Nodes::CH__PDURECEIPT_SIM_ESP_VehSpd_X_AR2 = 1;
	if (@sysvar::CH_Nodes::CH_ESPCRC_Whl_Lt_Stat_Pr2Wh_AUTO == 0)
	{
		//Automatisch
		enableControl("Whl_Lt_Stat_AR2", "CH_ESPCRC_Whl_Lt_Stat_Pr2Whl_Lt_", 0); //1: enable; 0: disable
	}
	else
	{
		//Manuel
		enableControl("Whl_Lt_Stat_AR2", "CH_ESPCRC_Whl_Lt_Stat_Pr2Whl_Lt_", 1); //1: enable; 0: disable
	}
	if (@sysvar::CH_Nodes::CH_ESPSQC_Whl_Lt_Stat_Pr2Wh_AUTO == 0)
	{
		//Automatisch
		enableControl("Whl_Lt_Stat_AR2", "CH_ESPSQC_Whl_Lt_Stat_Pr2Whl_Lt_", 0); //1: enable; 0: disable
	}
	else
	{
		//Manuel
		enableControl("Whl_Lt_Stat_AR2", "CH_ESPSQC_Whl_Lt_Stat_Pr2Whl_Lt_", 1); //1: enable; 0: disable
	}
	@sysvar::CH_Nodes::CH__PDURECEIPT_SIM_ESP_Whl_Lt_Stat_AR2 = 1;
	if (@sysvar::CH_Nodes::CH_ESPCRC_Whl_Rt_Stat_Pr2Wh_AUTO == 0)
	{
		//Automatisch
		enableControl("Whl_Rt_Stat_AR2", "CH_ESPCRC_Whl_Rt_Stat_Pr2Whl_Rt_", 0); //1: enable; 0: disable
	}
	else
	{
		//Manuel
		enableControl("Whl_Rt_Stat_AR2", "CH_ESPCRC_Whl_Rt_Stat_Pr2Whl_Rt_", 1); //1: enable; 0: disable
	}
	if (@sysvar::CH_Nodes::CH_ESPSQC_Whl_Rt_Stat_Pr2Wh_AUTO == 0)
	{
		//Automatisch
		enableControl("Whl_Rt_Stat_AR2", "CH_ESPSQC_Whl_Rt_Stat_Pr2Whl_Rt_", 0); //1: enable; 0: disable
	}
	else
	{
		//Manuel
		enableControl("Whl_Rt_Stat_AR2", "CH_ESPSQC_Whl_Rt_Stat_Pr2Whl_Rt_", 1); //1: enable; 0: disable
	}
	@sysvar::CH_Nodes::CH__PDURECEIPT_SIM_ESP_Whl_Rt_Stat_AR2 = 1;
	if (@sysvar::CH_Nodes::CH_ESPCRC_WhlPlsCnt_TPM_Pr2_AUTO == 0)
	{
		//Automatisch
		enableControl("WhlPlsCnt_TPM_AR2", "CH_ESPCRC_WhlPlsCnt_TPM_Pr2WhlP_", 0); //1: enable; 0: disable
	}
	else
	{
		//Manuel
		enableControl("WhlPlsCnt_TPM_AR2", "CH_ESPCRC_WhlPlsCnt_TPM_Pr2WhlP_", 1); //1: enable; 0: disable
	}
	if (@sysvar::CH_Nodes::CH_ESPSQC_WhlPlsCnt_TPM_Pr2_AUTO == 0)
	{
		//Automatisch
		enableControl("WhlPlsCnt_TPM_AR2", "CH_ESPSQC_WhlPlsCnt_TPM_Pr2WhlP_", 0); //1: enable; 0: disable
	}
	else
	{
		//Manuel
		enableControl("WhlPlsCnt_TPM_AR2", "CH_ESPSQC_WhlPlsCnt_TPM_Pr2WhlP_", 1); //1: enable; 0: disable
	}
	@sysvar::CH_Nodes::CH__PDURECEIPT_SIM_ESP_WhlPlsCnt_TPM_AR2 = 1;
	@sysvar::CH_Nodes::CH__PDURECEIPT_SIM_ESP_WUDOP_ESP_FR = 1;
	if (@sysvar::CH_Nodes::CH_ESPCRC_YMAS_Rs_Pr2YMAS_R_AUTO == 0)
	{
		//Automatisch
		enableControl("YMAS_Rs_AR2", "CH_ESPCRC_YMAS_Rs_Pr2YMAS_Rs_AR_", 0); //1: enable; 0: disable
	}
	else
	{
		//Manuel
		enableControl("YMAS_Rs_AR2", "CH_ESPCRC_YMAS_Rs_Pr2YMAS_Rs_AR_", 1); //1: enable; 0: disable
	}
	if (@sysvar::CH_Nodes::CH_ESPSQC_YMAS_Rs_Pr2YMAS_R_AUTO == 0)
	{
		//Automatisch
		enableControl("YMAS_Rs_AR2", "CH_ESPSQC_YMAS_Rs_Pr2YMAS_Rs_AR_", 0); //1: enable; 0: disable
	}
	else
	{
		//Manuel
		enableControl("YMAS_Rs_AR2", "CH_ESPSQC_YMAS_Rs_Pr2YMAS_Rs_AR_", 1); //1: enable; 0: disable
	}
	@sysvar::CH_Nodes::CH__PDURECEIPT_SIM_ESP_YMAS_Rs_AR2 = 1;
	// netzwerk management

	enableControl("CHASSIS_FR Netzmanagement", "CH__NMActive_ESP", 1);
}

on preStart
{


}

on timer Timer_ESP_AWD_TCASE_Rq_ESP_AR2
{
	@sysvar::CH_Nodes::CH__STPDU_ESP_AWD_TCASE_Rq_ESP_AR2 = 0;
}

on timer Timer_ESP_BrkSys_Stat_AR2
{
	@sysvar::CH_Nodes::CH__STPDU_ESP_BrkSys_Stat_AR2 = 0;
}

on timer Timer_ESP_DPC_Disp_Rq_AR2
{
	@sysvar::CH_Nodes::CH__STPDU_ESP_DPC_Disp_Rq_AR2 = 0;
}

on timer Timer_ESP_DPC_IndMd_Stat_AR2
{
	@sysvar::CH_Nodes::CH__STPDU_ESP_DPC_IndMd_Stat_AR2 = 0;
}

on timer Timer_ESP_DPC_IndMd_Style2_AR2
{
	@sysvar::CH_Nodes::CH__STPDU_ESP_DPC_IndMd_Style2_AR2 = 0;
}

on timer Timer_ESP_DPC_IndMd_Style_AR2
{
	@sysvar::CH_Nodes::CH__STPDU_ESP_DPC_IndMd_Style_AR2 = 0;
}

on timer Timer_ESP_DPC_Master_Rq_AR2
{
	@sysvar::CH_Nodes::CH__STPDU_ESP_DPC_Master_Rq_AR2 = 0;
}

on timer Timer_ESP_Eng_Susp_Rq_AS_AR2
{
	@sysvar::CH_Nodes::CH__STPDU_ESP_Eng_Susp_Rq_AS_AR2 = 0;
}

on timer Timer_ESP_EPKB_Disp_IndLmp_Rq_2_AR2
{
	@sysvar::CH_Nodes::CH__STPDU_ESP_EPKB_Disp_IndLmp_Rq_2_AR2 = 0;
}

on timer Timer_ESP_EPKB_Stat_Gw_AR2
{
	@sysvar::CH_Nodes::CH__STPDU_ESP_EPKB_Stat_Gw_AR2 = 0;
}

on timer Timer_ESP_ESP_Disp_Rq2_AR2
{
	@sysvar::CH_Nodes::CH__STPDU_ESP_ESP_Disp_Rq2_AR2 = 0;
}

on timer Timer_ESP_ESP_Disp_Rq3_AR
{
	@sysvar::CH_Nodes::CH__STPDU_ESP_ESP_Disp_Rq3_AR = 0;
}

on timer Timer_ESP_ESP_Disp_Rq_AMG_AR2
{
	@sysvar::CH_Nodes::CH__STPDU_ESP_ESP_Disp_Rq_AMG_AR2 = 0;
}

on timer Timer_ESP_ESP_Disp_Rq_AR2
{
	@sysvar::CH_Nodes::CH__STPDU_ESP_ESP_Disp_Rq_AR2 = 0;
}

on timer Timer_ESP_ESP_OBD_Stat_AR
{
	@sysvar::CH_Nodes::CH__STPDU_ESP_ESP_OBD_Stat_AR = 0;
}

on timer Timer_ESP_ESP_Stat1_AR2
{
	@sysvar::CH_Nodes::CH__STPDU_ESP_ESP_Stat1_AR2 = 0;
}

on timer Timer_ESP_LDC_Disp_Rq_ESP_AR
{
	@sysvar::CH_Nodes::CH__STPDU_ESP_LDC_Disp_Rq_ESP_AR = 0;
}

on timer Timer_ESP_PARK_Brk_Rs_AR2
{
	@sysvar::CH_Nodes::CH__STPDU_ESP_PARK_Brk_Rs_AR2 = 0;
}

on timer Timer_ESP_PARK_Drv_Rq_ESP_AR2
{
	@sysvar::CH_Nodes::CH__STPDU_ESP_PARK_Drv_Rq_ESP_AR2 = 0;
}

on timer Timer_ESP_PresfCtrl_Rq_ESP_AR2
{
	@sysvar::CH_Nodes::CH__STPDU_ESP_PresfCtrl_Rq_ESP_AR2 = 0;
}

on timer Timer_ESP_PT_Rq_ESP_AR2
{
	@sysvar::CH_Nodes::CH__STPDU_ESP_PT_Rq_ESP_AR2 = 0;
}

on timer Timer_ESP_ROE_ESP
{
	@sysvar::CH_Nodes::CH__STPDU_ESP_ROE_ESP = 0;
}

on timer Timer_ESP_SADR_Trgr_ESP_AR2
{
	@sysvar::CH_Nodes::CH__STPDU_ESP_SADR_Trgr_ESP_AR2 = 0;
}

on timer Timer_ESP_St_Rq_STA_AR2
{
	@sysvar::CH_Nodes::CH__STPDU_ESP_St_Rq_STA_AR2 = 0;
}

on timer Timer_ESP_TBCSC_ESP_DAC_AR2
{
	@sysvar::CH_Nodes::CH__STPDU_ESP_TBCSC_ESP_DAC_AR2 = 0;
}

on timer Timer_ESP_TBCSC_Rs1_ESP_AR2
{
	@sysvar::CH_Nodes::CH__STPDU_ESP_TBCSC_Rs1_ESP_AR2 = 0;
}

on timer Timer_ESP_TBCSC_Rs2_ESP_AR2
{
	@sysvar::CH_Nodes::CH__STPDU_ESP_TBCSC_Rs2_ESP_AR2 = 0;
}

on timer Timer_ESP_VehAccel_X_Rs1_AR2
{
	@sysvar::CH_Nodes::CH__STPDU_ESP_VehAccel_X_Rs1_AR2 = 0;
}

on timer Timer_ESP_VehAccel_X_Rs2_AR2
{
	@sysvar::CH_Nodes::CH__STPDU_ESP_VehAccel_X_Rs2_AR2 = 0;
}

on timer Timer_ESP_VehDyn_Stat1_AR2
{
	@sysvar::CH_Nodes::CH__STPDU_ESP_VehDyn_Stat1_AR2 = 0;
}

on timer Timer_ESP_VehDyn_Stat2_AR2
{
	@sysvar::CH_Nodes::CH__STPDU_ESP_VehDyn_Stat2_AR2 = 0;
}

on timer Timer_ESP_VehSpd_X_AR2
{
	@sysvar::CH_Nodes::CH__STPDU_ESP_VehSpd_X_AR2 = 0;
}

on timer Timer_ESP_Whl_Lt_Stat_AR2
{
	@sysvar::CH_Nodes::CH__STPDU_ESP_Whl_Lt_Stat_AR2 = 0;
}

on timer Timer_ESP_Whl_Rt_Stat_AR2
{
	@sysvar::CH_Nodes::CH__STPDU_ESP_Whl_Rt_Stat_AR2 = 0;
}

on timer Timer_ESP_WhlPlsCnt_TPM_AR2
{
	@sysvar::CH_Nodes::CH__STPDU_ESP_WhlPlsCnt_TPM_AR2 = 0;
}

on timer Timer_ESP_WUDOP_ESP_FR
{
	@sysvar::CH_Nodes::CH__STPDU_ESP_WUDOP_ESP_FR = 0;
}

on timer Timer_ESP_YMAS_Rs_AR2
{
	@sysvar::CH_Nodes::CH__STPDU_ESP_YMAS_Rs_AR2 = 0;
}



on sysvar sysvar::CH_Nodes::CH__STPDU_ESP_AWD_TCASE_Rq_ESP_AR2
{
	long res;
	long tDelay;
	switch (@this)
	{
		case (0):
			res = ResetTimingCyclic("AWD_TCASE_Rq_ESP_AR2");
			res = ResetTimingEvtTrg("AWD_TCASE_Rq_ESP_AR2");
			res = EnableTimingCyclic("AWD_TCASE_Rq_ESP_AR2", 1);
			res = EnableTimingEvtTrg("AWD_TCASE_Rq_ESP_AR2", 1);
			break;
		case (1):
			tDelay = @sysvar::CH_Nodes::CH__STPDU_T_ESP_AWD_TCASE_Rq_ESP_AR2;
			if (tDelay > 0)
			{
				if (isTimerActive(Timer_ESP_AWD_TCASE_Rq_ESP_AR2) == 0)
				{
					res = SetTimingCyclic("AWD_TCASE_Rq_ESP_AR2", 1, tDelay, 1);
					setTimer (Timer_ESP_AWD_TCASE_Rq_ESP_AR2, tDelay);
					@sysvar::CH_Nodes::CH__STPDU_ESP_AWD_TCASE_Rq_ESP_AR2 = 2;
				}
			}
			else if (tDelay == 0)
			{
				if (isTimerActive(Timer_ESP_AWD_TCASE_Rq_ESP_AR2) == 0)
				{
					res = EnableTimingCyclic("AWD_TCASE_Rq_ESP_AR2", 0);
					res = EnableTimingEvtTrg("AWD_TCASE_Rq_ESP_AR2", 0);
				}
			}
			break;
		case (2):
			break;
		default:
			Write("error: wrong parameter (%d)", @this);
			stop();
			break;
	}
}

on sysvar sysvar::CH_Nodes::CH__STPDU_ESP_BrkSys_Stat_AR2
{
	long res;
	long tDelay;
	switch (@this)
	{
		case (0):
			res = ResetTimingCyclic("BrkSys_Stat_AR2");
			res = ResetTimingEvtTrg("BrkSys_Stat_AR2");
			res = EnableTimingCyclic("BrkSys_Stat_AR2", 1);
			res = EnableTimingEvtTrg("BrkSys_Stat_AR2", 1);
			break;
		case (1):
			tDelay = @sysvar::CH_Nodes::CH__STPDU_T_ESP_BrkSys_Stat_AR2;
			if (tDelay > 0)
			{
				if (isTimerActive(Timer_ESP_BrkSys_Stat_AR2) == 0)
				{
					res = SetTimingCyclic("BrkSys_Stat_AR2", 1, tDelay, 1);
					setTimer (Timer_ESP_BrkSys_Stat_AR2, tDelay);
					@sysvar::CH_Nodes::CH__STPDU_ESP_BrkSys_Stat_AR2 = 2;
				}
			}
			else if (tDelay == 0)
			{
				if (isTimerActive(Timer_ESP_BrkSys_Stat_AR2) == 0)
				{
					res = EnableTimingCyclic("BrkSys_Stat_AR2", 0);
					res = EnableTimingEvtTrg("BrkSys_Stat_AR2", 0);
				}
			}
			break;
		case (2):
			break;
		default:
			Write("error: wrong parameter (%d)", @this);
			stop();
			break;
	}
}

on sysvar sysvar::CH_Nodes::CH__STPDU_ESP_DPC_Disp_Rq_AR2
{
	long res;
	long tDelay;
	switch (@this)
	{
		case (0):
			res = ResetTimingCyclic("DPC_Disp_Rq_AR2");
			res = ResetTimingEvtTrg("DPC_Disp_Rq_AR2");
			res = EnableTimingCyclic("DPC_Disp_Rq_AR2", 1);
			res = EnableTimingEvtTrg("DPC_Disp_Rq_AR2", 1);
			break;
		case (1):
			tDelay = @sysvar::CH_Nodes::CH__STPDU_T_ESP_DPC_Disp_Rq_AR2;
			if (tDelay > 0)
			{
				if (isTimerActive(Timer_ESP_DPC_Disp_Rq_AR2) == 0)
				{
					res = SetTimingCyclic("DPC_Disp_Rq_AR2", 1, tDelay, 1);
					setTimer (Timer_ESP_DPC_Disp_Rq_AR2, tDelay);
					@sysvar::CH_Nodes::CH__STPDU_ESP_DPC_Disp_Rq_AR2 = 2;
				}
			}
			else if (tDelay == 0)
			{
				if (isTimerActive(Timer_ESP_DPC_Disp_Rq_AR2) == 0)
				{
					res = EnableTimingCyclic("DPC_Disp_Rq_AR2", 0);
					res = EnableTimingEvtTrg("DPC_Disp_Rq_AR2", 0);
				}
			}
			break;
		case (2):
			break;
		default:
			Write("error: wrong parameter (%d)", @this);
			stop();
			break;
	}
}

on sysvar sysvar::CH_Nodes::CH__STPDU_ESP_DPC_IndMd_Stat_AR2
{
	long res;
	long tDelay;
	switch (@this)
	{
		case (0):
			res = ResetTimingCyclic("DPC_IndMd_Stat_AR2");
			res = ResetTimingEvtTrg("DPC_IndMd_Stat_AR2");
			res = EnableTimingCyclic("DPC_IndMd_Stat_AR2", 1);
			res = EnableTimingEvtTrg("DPC_IndMd_Stat_AR2", 1);
			break;
		case (1):
			tDelay = @sysvar::CH_Nodes::CH__STPDU_T_ESP_DPC_IndMd_Stat_AR2;
			if (tDelay > 0)
			{
				if (isTimerActive(Timer_ESP_DPC_IndMd_Stat_AR2) == 0)
				{
					res = SetTimingCyclic("DPC_IndMd_Stat_AR2", 1, tDelay, 1);
					setTimer (Timer_ESP_DPC_IndMd_Stat_AR2, tDelay);
					@sysvar::CH_Nodes::CH__STPDU_ESP_DPC_IndMd_Stat_AR2 = 2;
				}
			}
			else if (tDelay == 0)
			{
				if (isTimerActive(Timer_ESP_DPC_IndMd_Stat_AR2) == 0)
				{
					res = EnableTimingCyclic("DPC_IndMd_Stat_AR2", 0);
					res = EnableTimingEvtTrg("DPC_IndMd_Stat_AR2", 0);
				}
			}
			break;
		case (2):
			break;
		default:
			Write("error: wrong parameter (%d)", @this);
			stop();
			break;
	}
}

on sysvar sysvar::CH_Nodes::CH__STPDU_ESP_DPC_IndMd_Style2_AR2
{
	long res;
	long tDelay;
	switch (@this)
	{
		case (0):
			res = ResetTimingCyclic("DPC_IndMd_Style2_AR2");
			res = ResetTimingEvtTrg("DPC_IndMd_Style2_AR2");
			res = EnableTimingCyclic("DPC_IndMd_Style2_AR2", 1);
			res = EnableTimingEvtTrg("DPC_IndMd_Style2_AR2", 1);
			break;
		case (1):
			tDelay = @sysvar::CH_Nodes::CH__STPDU_T_ESP_DPC_IndMd_Style2_AR2;
			if (tDelay > 0)
			{
				if (isTimerActive(Timer_ESP_DPC_IndMd_Style2_AR2) == 0)
				{
					res = SetTimingCyclic("DPC_IndMd_Style2_AR2", 1, tDelay, 1);
					setTimer (Timer_ESP_DPC_IndMd_Style2_AR2, tDelay);
					@sysvar::CH_Nodes::CH__STPDU_ESP_DPC_IndMd_Style2_AR2 = 2;
				}
			}
			else if (tDelay == 0)
			{
				if (isTimerActive(Timer_ESP_DPC_IndMd_Style2_AR2) == 0)
				{
					res = EnableTimingCyclic("DPC_IndMd_Style2_AR2", 0);
					res = EnableTimingEvtTrg("DPC_IndMd_Style2_AR2", 0);
				}
			}
			break;
		case (2):
			break;
		default:
			Write("error: wrong parameter (%d)", @this);
			stop();
			break;
	}
}

on sysvar sysvar::CH_Nodes::CH__STPDU_ESP_DPC_IndMd_Style_AR2
{
	long res;
	long tDelay;
	switch (@this)
	{
		case (0):
			res = ResetTimingCyclic("DPC_IndMd_Style_AR2");
			res = ResetTimingEvtTrg("DPC_IndMd_Style_AR2");
			res = EnableTimingCyclic("DPC_IndMd_Style_AR2", 1);
			res = EnableTimingEvtTrg("DPC_IndMd_Style_AR2", 1);
			break;
		case (1):
			tDelay = @sysvar::CH_Nodes::CH__STPDU_T_ESP_DPC_IndMd_Style_AR2;
			if (tDelay > 0)
			{
				if (isTimerActive(Timer_ESP_DPC_IndMd_Style_AR2) == 0)
				{
					res = SetTimingCyclic("DPC_IndMd_Style_AR2", 1, tDelay, 1);
					setTimer (Timer_ESP_DPC_IndMd_Style_AR2, tDelay);
					@sysvar::CH_Nodes::CH__STPDU_ESP_DPC_IndMd_Style_AR2 = 2;
				}
			}
			else if (tDelay == 0)
			{
				if (isTimerActive(Timer_ESP_DPC_IndMd_Style_AR2) == 0)
				{
					res = EnableTimingCyclic("DPC_IndMd_Style_AR2", 0);
					res = EnableTimingEvtTrg("DPC_IndMd_Style_AR2", 0);
				}
			}
			break;
		case (2):
			break;
		default:
			Write("error: wrong parameter (%d)", @this);
			stop();
			break;
	}
}

on sysvar sysvar::CH_Nodes::CH__STPDU_ESP_DPC_Master_Rq_AR2
{
	long res;
	long tDelay;
	switch (@this)
	{
		case (0):
			res = ResetTimingCyclic("DPC_Master_Rq_AR2");
			res = ResetTimingEvtTrg("DPC_Master_Rq_AR2");
			res = EnableTimingCyclic("DPC_Master_Rq_AR2", 1);
			res = EnableTimingEvtTrg("DPC_Master_Rq_AR2", 1);
			break;
		case (1):
			tDelay = @sysvar::CH_Nodes::CH__STPDU_T_ESP_DPC_Master_Rq_AR2;
			if (tDelay > 0)
			{
				if (isTimerActive(Timer_ESP_DPC_Master_Rq_AR2) == 0)
				{
					res = SetTimingCyclic("DPC_Master_Rq_AR2", 1, tDelay, 1);
					setTimer (Timer_ESP_DPC_Master_Rq_AR2, tDelay);
					@sysvar::CH_Nodes::CH__STPDU_ESP_DPC_Master_Rq_AR2 = 2;
				}
			}
			else if (tDelay == 0)
			{
				if (isTimerActive(Timer_ESP_DPC_Master_Rq_AR2) == 0)
				{
					res = EnableTimingCyclic("DPC_Master_Rq_AR2", 0);
					res = EnableTimingEvtTrg("DPC_Master_Rq_AR2", 0);
				}
			}
			break;
		case (2):
			break;
		default:
			Write("error: wrong parameter (%d)", @this);
			stop();
			break;
	}
}

on sysvar sysvar::CH_Nodes::CH__STPDU_ESP_Eng_Susp_Rq_AS_AR2
{
	long res;
	long tDelay;
	switch (@this)
	{
		case (0):
			res = ResetTimingCyclic("Eng_Susp_Rq_AS_AR2");
			res = ResetTimingEvtTrg("Eng_Susp_Rq_AS_AR2");
			res = EnableTimingCyclic("Eng_Susp_Rq_AS_AR2", 1);
			res = EnableTimingEvtTrg("Eng_Susp_Rq_AS_AR2", 1);
			break;
		case (1):
			tDelay = @sysvar::CH_Nodes::CH__STPDU_T_ESP_Eng_Susp_Rq_AS_AR2;
			if (tDelay > 0)
			{
				if (isTimerActive(Timer_ESP_Eng_Susp_Rq_AS_AR2) == 0)
				{
					res = SetTimingCyclic("Eng_Susp_Rq_AS_AR2", 1, tDelay, 1);
					setTimer (Timer_ESP_Eng_Susp_Rq_AS_AR2, tDelay);
					@sysvar::CH_Nodes::CH__STPDU_ESP_Eng_Susp_Rq_AS_AR2 = 2;
				}
			}
			else if (tDelay == 0)
			{
				if (isTimerActive(Timer_ESP_Eng_Susp_Rq_AS_AR2) == 0)
				{
					res = EnableTimingCyclic("Eng_Susp_Rq_AS_AR2", 0);
					res = EnableTimingEvtTrg("Eng_Susp_Rq_AS_AR2", 0);
				}
			}
			break;
		case (2):
			break;
		default:
			Write("error: wrong parameter (%d)", @this);
			stop();
			break;
	}
}

on sysvar sysvar::CH_Nodes::CH__STPDU_ESP_EPKB_Disp_IndLmp_Rq_2_AR2
{
	long res;
	long tDelay;
	switch (@this)
	{
		case (0):
			res = ResetTimingCyclic("EPKB_Disp_IndLmp_Rq_2_AR2");
			res = ResetTimingEvtTrg("EPKB_Disp_IndLmp_Rq_2_AR2");
			res = EnableTimingCyclic("EPKB_Disp_IndLmp_Rq_2_AR2", 1);
			res = EnableTimingEvtTrg("EPKB_Disp_IndLmp_Rq_2_AR2", 1);
			break;
		case (1):
			tDelay = @sysvar::CH_Nodes::CH__STPDU_T_ESP_EPKB_Disp_IndLmp_Rq_2_AR2;
			if (tDelay > 0)
			{
				if (isTimerActive(Timer_ESP_EPKB_Disp_IndLmp_Rq_2_AR2) == 0)
				{
					res = SetTimingCyclic("EPKB_Disp_IndLmp_Rq_2_AR2", 1, tDelay, 1);
					setTimer (Timer_ESP_EPKB_Disp_IndLmp_Rq_2_AR2, tDelay);
					@sysvar::CH_Nodes::CH__STPDU_ESP_EPKB_Disp_IndLmp_Rq_2_AR2 = 2;
				}
			}
			else if (tDelay == 0)
			{
				if (isTimerActive(Timer_ESP_EPKB_Disp_IndLmp_Rq_2_AR2) == 0)
				{
					res = EnableTimingCyclic("EPKB_Disp_IndLmp_Rq_2_AR2", 0);
					res = EnableTimingEvtTrg("EPKB_Disp_IndLmp_Rq_2_AR2", 0);
				}
			}
			break;
		case (2):
			break;
		default:
			Write("error: wrong parameter (%d)", @this);
			stop();
			break;
	}
}

on sysvar sysvar::CH_Nodes::CH__STPDU_ESP_EPKB_Stat_Gw_AR2
{
	long res;
	long tDelay;
	switch (@this)
	{
		case (0):
			res = ResetTimingCyclic("EPKB_Stat_Gw_AR2");
			res = ResetTimingEvtTrg("EPKB_Stat_Gw_AR2");
			res = EnableTimingCyclic("EPKB_Stat_Gw_AR2", 1);
			res = EnableTimingEvtTrg("EPKB_Stat_Gw_AR2", 1);
			break;
		case (1):
			tDelay = @sysvar::CH_Nodes::CH__STPDU_T_ESP_EPKB_Stat_Gw_AR2;
			if (tDelay > 0)
			{
				if (isTimerActive(Timer_ESP_EPKB_Stat_Gw_AR2) == 0)
				{
					res = SetTimingCyclic("EPKB_Stat_Gw_AR2", 1, tDelay, 1);
					setTimer (Timer_ESP_EPKB_Stat_Gw_AR2, tDelay);
					@sysvar::CH_Nodes::CH__STPDU_ESP_EPKB_Stat_Gw_AR2 = 2;
				}
			}
			else if (tDelay == 0)
			{
				if (isTimerActive(Timer_ESP_EPKB_Stat_Gw_AR2) == 0)
				{
					res = EnableTimingCyclic("EPKB_Stat_Gw_AR2", 0);
					res = EnableTimingEvtTrg("EPKB_Stat_Gw_AR2", 0);
				}
			}
			break;
		case (2):
			break;
		default:
			Write("error: wrong parameter (%d)", @this);
			stop();
			break;
	}
}

on sysvar sysvar::CH_Nodes::CH__STPDU_ESP_ESP_Disp_Rq2_AR2
{
	long res;
	long tDelay;
	switch (@this)
	{
		case (0):
			res = ResetTimingCyclic("ESP_Disp_Rq2_AR2");
			res = ResetTimingEvtTrg("ESP_Disp_Rq2_AR2");
			res = EnableTimingCyclic("ESP_Disp_Rq2_AR2", 1);
			res = EnableTimingEvtTrg("ESP_Disp_Rq2_AR2", 1);
			break;
		case (1):
			tDelay = @sysvar::CH_Nodes::CH__STPDU_T_ESP_ESP_Disp_Rq2_AR2;
			if (tDelay > 0)
			{
				if (isTimerActive(Timer_ESP_ESP_Disp_Rq2_AR2) == 0)
				{
					res = SetTimingCyclic("ESP_Disp_Rq2_AR2", 1, tDelay, 1);
					setTimer (Timer_ESP_ESP_Disp_Rq2_AR2, tDelay);
					@sysvar::CH_Nodes::CH__STPDU_ESP_ESP_Disp_Rq2_AR2 = 2;
				}
			}
			else if (tDelay == 0)
			{
				if (isTimerActive(Timer_ESP_ESP_Disp_Rq2_AR2) == 0)
				{
					res = EnableTimingCyclic("ESP_Disp_Rq2_AR2", 0);
					res = EnableTimingEvtTrg("ESP_Disp_Rq2_AR2", 0);
				}
			}
			break;
		case (2):
			break;
		default:
			Write("error: wrong parameter (%d)", @this);
			stop();
			break;
	}
}

on sysvar sysvar::CH_Nodes::CH__STPDU_ESP_ESP_Disp_Rq3_AR
{
	long res;
	long tDelay;
	switch (@this)
	{
		case (0):
			res = ResetTimingCyclic("ESP_Disp_Rq3_AR");
			res = ResetTimingEvtTrg("ESP_Disp_Rq3_AR");
			res = EnableTimingCyclic("ESP_Disp_Rq3_AR", 1);
			res = EnableTimingEvtTrg("ESP_Disp_Rq3_AR", 1);
			break;
		case (1):
			tDelay = @sysvar::CH_Nodes::CH__STPDU_T_ESP_ESP_Disp_Rq3_AR;
			if (tDelay > 0)
			{
				if (isTimerActive(Timer_ESP_ESP_Disp_Rq3_AR) == 0)
				{
					res = SetTimingCyclic("ESP_Disp_Rq3_AR", 1, tDelay, 1);
					setTimer (Timer_ESP_ESP_Disp_Rq3_AR, tDelay);
					@sysvar::CH_Nodes::CH__STPDU_ESP_ESP_Disp_Rq3_AR = 2;
				}
			}
			else if (tDelay == 0)
			{
				if (isTimerActive(Timer_ESP_ESP_Disp_Rq3_AR) == 0)
				{
					res = EnableTimingCyclic("ESP_Disp_Rq3_AR", 0);
					res = EnableTimingEvtTrg("ESP_Disp_Rq3_AR", 0);
				}
			}
			break;
		case (2):
			break;
		default:
			Write("error: wrong parameter (%d)", @this);
			stop();
			break;
	}
}

on sysvar sysvar::CH_Nodes::CH__STPDU_ESP_ESP_Disp_Rq_AMG_AR2
{
	long res;
	long tDelay;
	switch (@this)
	{
		case (0):
			res = ResetTimingCyclic("ESP_Disp_Rq_AMG_AR2");
			res = ResetTimingEvtTrg("ESP_Disp_Rq_AMG_AR2");
			res = EnableTimingCyclic("ESP_Disp_Rq_AMG_AR2", 1);
			res = EnableTimingEvtTrg("ESP_Disp_Rq_AMG_AR2", 1);
			break;
		case (1):
			tDelay = @sysvar::CH_Nodes::CH__STPDU_T_ESP_ESP_Disp_Rq_AMG_AR2;
			if (tDelay > 0)
			{
				if (isTimerActive(Timer_ESP_ESP_Disp_Rq_AMG_AR2) == 0)
				{
					res = SetTimingCyclic("ESP_Disp_Rq_AMG_AR2", 1, tDelay, 1);
					setTimer (Timer_ESP_ESP_Disp_Rq_AMG_AR2, tDelay);
					@sysvar::CH_Nodes::CH__STPDU_ESP_ESP_Disp_Rq_AMG_AR2 = 2;
				}
			}
			else if (tDelay == 0)
			{
				if (isTimerActive(Timer_ESP_ESP_Disp_Rq_AMG_AR2) == 0)
				{
					res = EnableTimingCyclic("ESP_Disp_Rq_AMG_AR2", 0);
					res = EnableTimingEvtTrg("ESP_Disp_Rq_AMG_AR2", 0);
				}
			}
			break;
		case (2):
			break;
		default:
			Write("error: wrong parameter (%d)", @this);
			stop();
			break;
	}
}

on sysvar sysvar::CH_Nodes::CH__STPDU_ESP_ESP_Disp_Rq_AR2
{
	long res;
	long tDelay;
	switch (@this)
	{
		case (0):
			res = ResetTimingCyclic("ESP_Disp_Rq_AR2");
			res = ResetTimingEvtTrg("ESP_Disp_Rq_AR2");
			res = EnableTimingCyclic("ESP_Disp_Rq_AR2", 1);
			res = EnableTimingEvtTrg("ESP_Disp_Rq_AR2", 1);
			break;
		case (1):
			tDelay = @sysvar::CH_Nodes::CH__STPDU_T_ESP_ESP_Disp_Rq_AR2;
			if (tDelay > 0)
			{
				if (isTimerActive(Timer_ESP_ESP_Disp_Rq_AR2) == 0)
				{
					res = SetTimingCyclic("ESP_Disp_Rq_AR2", 1, tDelay, 1);
					setTimer (Timer_ESP_ESP_Disp_Rq_AR2, tDelay);
					@sysvar::CH_Nodes::CH__STPDU_ESP_ESP_Disp_Rq_AR2 = 2;
				}
			}
			else if (tDelay == 0)
			{
				if (isTimerActive(Timer_ESP_ESP_Disp_Rq_AR2) == 0)
				{
					res = EnableTimingCyclic("ESP_Disp_Rq_AR2", 0);
					res = EnableTimingEvtTrg("ESP_Disp_Rq_AR2", 0);
				}
			}
			break;
		case (2):
			break;
		default:
			Write("error: wrong parameter (%d)", @this);
			stop();
			break;
	}
}

on sysvar sysvar::CH_Nodes::CH__STPDU_ESP_ESP_OBD_Stat_AR
{
	long res;
	long tDelay;
	switch (@this)
	{
		case (0):
			res = ResetTimingCyclic("ESP_OBD_Stat_AR");
			res = ResetTimingEvtTrg("ESP_OBD_Stat_AR");
			res = EnableTimingCyclic("ESP_OBD_Stat_AR", 1);
			res = EnableTimingEvtTrg("ESP_OBD_Stat_AR", 1);
			break;
		case (1):
			tDelay = @sysvar::CH_Nodes::CH__STPDU_T_ESP_ESP_OBD_Stat_AR;
			if (tDelay > 0)
			{
				if (isTimerActive(Timer_ESP_ESP_OBD_Stat_AR) == 0)
				{
					res = SetTimingCyclic("ESP_OBD_Stat_AR", 1, tDelay, 1);
					setTimer (Timer_ESP_ESP_OBD_Stat_AR, tDelay);
					@sysvar::CH_Nodes::CH__STPDU_ESP_ESP_OBD_Stat_AR = 2;
				}
			}
			else if (tDelay == 0)
			{
				if (isTimerActive(Timer_ESP_ESP_OBD_Stat_AR) == 0)
				{
					res = EnableTimingCyclic("ESP_OBD_Stat_AR", 0);
					res = EnableTimingEvtTrg("ESP_OBD_Stat_AR", 0);
				}
			}
			break;
		case (2):
			break;
		default:
			Write("error: wrong parameter (%d)", @this);
			stop();
			break;
	}
}

on sysvar sysvar::CH_Nodes::CH__STPDU_ESP_ESP_Stat1_AR2
{
	long res;
	long tDelay;
	switch (@this)
	{
		case (0):
			res = ResetTimingCyclic("ESP_Stat1_AR2");
			res = ResetTimingEvtTrg("ESP_Stat1_AR2");
			res = EnableTimingCyclic("ESP_Stat1_AR2", 1);
			res = EnableTimingEvtTrg("ESP_Stat1_AR2", 1);
			break;
		case (1):
			tDelay = @sysvar::CH_Nodes::CH__STPDU_T_ESP_ESP_Stat1_AR2;
			if (tDelay > 0)
			{
				if (isTimerActive(Timer_ESP_ESP_Stat1_AR2) == 0)
				{
					res = SetTimingCyclic("ESP_Stat1_AR2", 1, tDelay, 1);
					setTimer (Timer_ESP_ESP_Stat1_AR2, tDelay);
					@sysvar::CH_Nodes::CH__STPDU_ESP_ESP_Stat1_AR2 = 2;
				}
			}
			else if (tDelay == 0)
			{
				if (isTimerActive(Timer_ESP_ESP_Stat1_AR2) == 0)
				{
					res = EnableTimingCyclic("ESP_Stat1_AR2", 0);
					res = EnableTimingEvtTrg("ESP_Stat1_AR2", 0);
				}
			}
			break;
		case (2):
			break;
		default:
			Write("error: wrong parameter (%d)", @this);
			stop();
			break;
	}
}

on sysvar sysvar::CH_Nodes::CH__STPDU_ESP_LDC_Disp_Rq_ESP_AR
{
	long res;
	long tDelay;
	switch (@this)
	{
		case (0):
			res = ResetTimingCyclic("LDC_Disp_Rq_ESP_AR");
			res = ResetTimingEvtTrg("LDC_Disp_Rq_ESP_AR");
			res = EnableTimingCyclic("LDC_Disp_Rq_ESP_AR", 1);
			res = EnableTimingEvtTrg("LDC_Disp_Rq_ESP_AR", 1);
			break;
		case (1):
			tDelay = @sysvar::CH_Nodes::CH__STPDU_T_ESP_LDC_Disp_Rq_ESP_AR;
			if (tDelay > 0)
			{
				if (isTimerActive(Timer_ESP_LDC_Disp_Rq_ESP_AR) == 0)
				{
					res = SetTimingCyclic("LDC_Disp_Rq_ESP_AR", 1, tDelay, 1);
					setTimer (Timer_ESP_LDC_Disp_Rq_ESP_AR, tDelay);
					@sysvar::CH_Nodes::CH__STPDU_ESP_LDC_Disp_Rq_ESP_AR = 2;
				}
			}
			else if (tDelay == 0)
			{
				if (isTimerActive(Timer_ESP_LDC_Disp_Rq_ESP_AR) == 0)
				{
					res = EnableTimingCyclic("LDC_Disp_Rq_ESP_AR", 0);
					res = EnableTimingEvtTrg("LDC_Disp_Rq_ESP_AR", 0);
				}
			}
			break;
		case (2):
			break;
		default:
			Write("error: wrong parameter (%d)", @this);
			stop();
			break;
	}
}

on sysvar sysvar::CH_Nodes::CH__STPDU_ESP_PARK_Brk_Rs_AR2
{
	long res;
	long tDelay;
	switch (@this)
	{
		case (0):
			res = ResetTimingCyclic("PARK_Brk_Rs_AR2");
			res = ResetTimingEvtTrg("PARK_Brk_Rs_AR2");
			res = EnableTimingCyclic("PARK_Brk_Rs_AR2", 1);
			res = EnableTimingEvtTrg("PARK_Brk_Rs_AR2", 1);
			break;
		case (1):
			tDelay = @sysvar::CH_Nodes::CH__STPDU_T_ESP_PARK_Brk_Rs_AR2;
			if (tDelay > 0)
			{
				if (isTimerActive(Timer_ESP_PARK_Brk_Rs_AR2) == 0)
				{
					res = SetTimingCyclic("PARK_Brk_Rs_AR2", 1, tDelay, 1);
					setTimer (Timer_ESP_PARK_Brk_Rs_AR2, tDelay);
					@sysvar::CH_Nodes::CH__STPDU_ESP_PARK_Brk_Rs_AR2 = 2;
				}
			}
			else if (tDelay == 0)
			{
				if (isTimerActive(Timer_ESP_PARK_Brk_Rs_AR2) == 0)
				{
					res = EnableTimingCyclic("PARK_Brk_Rs_AR2", 0);
					res = EnableTimingEvtTrg("PARK_Brk_Rs_AR2", 0);
				}
			}
			break;
		case (2):
			break;
		default:
			Write("error: wrong parameter (%d)", @this);
			stop();
			break;
	}
}

on sysvar sysvar::CH_Nodes::CH__STPDU_ESP_PARK_Drv_Rq_ESP_AR2
{
	long res;
	long tDelay;
	switch (@this)
	{
		case (0):
			res = ResetTimingCyclic("PARK_Drv_Rq_ESP_AR2");
			res = ResetTimingEvtTrg("PARK_Drv_Rq_ESP_AR2");
			res = EnableTimingCyclic("PARK_Drv_Rq_ESP_AR2", 1);
			res = EnableTimingEvtTrg("PARK_Drv_Rq_ESP_AR2", 1);
			break;
		case (1):
			tDelay = @sysvar::CH_Nodes::CH__STPDU_T_ESP_PARK_Drv_Rq_ESP_AR2;
			if (tDelay > 0)
			{
				if (isTimerActive(Timer_ESP_PARK_Drv_Rq_ESP_AR2) == 0)
				{
					res = SetTimingCyclic("PARK_Drv_Rq_ESP_AR2", 1, tDelay, 1);
					setTimer (Timer_ESP_PARK_Drv_Rq_ESP_AR2, tDelay);
					@sysvar::CH_Nodes::CH__STPDU_ESP_PARK_Drv_Rq_ESP_AR2 = 2;
				}
			}
			else if (tDelay == 0)
			{
				if (isTimerActive(Timer_ESP_PARK_Drv_Rq_ESP_AR2) == 0)
				{
					res = EnableTimingCyclic("PARK_Drv_Rq_ESP_AR2", 0);
					res = EnableTimingEvtTrg("PARK_Drv_Rq_ESP_AR2", 0);
				}
			}
			break;
		case (2):
			break;
		default:
			Write("error: wrong parameter (%d)", @this);
			stop();
			break;
	}
}

on sysvar sysvar::CH_Nodes::CH__STPDU_ESP_PresfCtrl_Rq_ESP_AR2
{
	long res;
	long tDelay;
	switch (@this)
	{
		case (0):
			res = ResetTimingCyclic("PresfCtrl_Rq_ESP_AR2");
			res = ResetTimingEvtTrg("PresfCtrl_Rq_ESP_AR2");
			res = EnableTimingCyclic("PresfCtrl_Rq_ESP_AR2", 1);
			res = EnableTimingEvtTrg("PresfCtrl_Rq_ESP_AR2", 1);
			break;
		case (1):
			tDelay = @sysvar::CH_Nodes::CH__STPDU_T_ESP_PresfCtrl_Rq_ESP_AR2;
			if (tDelay > 0)
			{
				if (isTimerActive(Timer_ESP_PresfCtrl_Rq_ESP_AR2) == 0)
				{
					res = SetTimingCyclic("PresfCtrl_Rq_ESP_AR2", 1, tDelay, 1);
					setTimer (Timer_ESP_PresfCtrl_Rq_ESP_AR2, tDelay);
					@sysvar::CH_Nodes::CH__STPDU_ESP_PresfCtrl_Rq_ESP_AR2 = 2;
				}
			}
			else if (tDelay == 0)
			{
				if (isTimerActive(Timer_ESP_PresfCtrl_Rq_ESP_AR2) == 0)
				{
					res = EnableTimingCyclic("PresfCtrl_Rq_ESP_AR2", 0);
					res = EnableTimingEvtTrg("PresfCtrl_Rq_ESP_AR2", 0);
				}
			}
			break;
		case (2):
			break;
		default:
			Write("error: wrong parameter (%d)", @this);
			stop();
			break;
	}
}

on sysvar sysvar::CH_Nodes::CH__STPDU_ESP_PT_Rq_ESP_AR2
{
	long res;
	long tDelay;
	switch (@this)
	{
		case (0):
			res = ResetTimingCyclic("PT_Rq_ESP_AR2");
			res = ResetTimingEvtTrg("PT_Rq_ESP_AR2");
			res = EnableTimingCyclic("PT_Rq_ESP_AR2", 1);
			res = EnableTimingEvtTrg("PT_Rq_ESP_AR2", 1);
			break;
		case (1):
			tDelay = @sysvar::CH_Nodes::CH__STPDU_T_ESP_PT_Rq_ESP_AR2;
			if (tDelay > 0)
			{
				if (isTimerActive(Timer_ESP_PT_Rq_ESP_AR2) == 0)
				{
					res = SetTimingCyclic("PT_Rq_ESP_AR2", 1, tDelay, 1);
					setTimer (Timer_ESP_PT_Rq_ESP_AR2, tDelay);
					@sysvar::CH_Nodes::CH__STPDU_ESP_PT_Rq_ESP_AR2 = 2;
				}
			}
			else if (tDelay == 0)
			{
				if (isTimerActive(Timer_ESP_PT_Rq_ESP_AR2) == 0)
				{
					res = EnableTimingCyclic("PT_Rq_ESP_AR2", 0);
					res = EnableTimingEvtTrg("PT_Rq_ESP_AR2", 0);
				}
			}
			break;
		case (2):
			break;
		default:
			Write("error: wrong parameter (%d)", @this);
			stop();
			break;
	}
}

on sysvar sysvar::CH_Nodes::CH__STPDU_ESP_ROE_ESP
{
	long res;
	long tDelay;
	switch (@this)
	{
		case (0):
			res = ResetTimingCyclic("ROE_ESP");
			res = ResetTimingEvtTrg("ROE_ESP");
			res = EnableTimingCyclic("ROE_ESP", 1);
			res = EnableTimingEvtTrg("ROE_ESP", 1);
			break;
		case (1):
			tDelay = @sysvar::CH_Nodes::CH__STPDU_T_ESP_ROE_ESP;
			if (tDelay > 0)
			{
				if (isTimerActive(Timer_ESP_ROE_ESP) == 0)
				{
					res = SetTimingCyclic("ROE_ESP", 1, tDelay, 1);
					setTimer (Timer_ESP_ROE_ESP, tDelay);
					@sysvar::CH_Nodes::CH__STPDU_ESP_ROE_ESP = 2;
				}
			}
			else if (tDelay == 0)
			{
				if (isTimerActive(Timer_ESP_ROE_ESP) == 0)
				{
					res = EnableTimingCyclic("ROE_ESP", 0);
					res = EnableTimingEvtTrg("ROE_ESP", 0);
				}
			}
			break;
		case (2):
			break;
		default:
			Write("error: wrong parameter (%d)", @this);
			stop();
			break;
	}
}

on sysvar sysvar::CH_Nodes::CH__STPDU_ESP_SADR_Trgr_ESP_AR2
{
	long res;
	long tDelay;
	switch (@this)
	{
		case (0):
			res = ResetTimingCyclic("SADR_Trgr_ESP_AR2");
			res = ResetTimingEvtTrg("SADR_Trgr_ESP_AR2");
			res = EnableTimingCyclic("SADR_Trgr_ESP_AR2", 1);
			res = EnableTimingEvtTrg("SADR_Trgr_ESP_AR2", 1);
			break;
		case (1):
			tDelay = @sysvar::CH_Nodes::CH__STPDU_T_ESP_SADR_Trgr_ESP_AR2;
			if (tDelay > 0)
			{
				if (isTimerActive(Timer_ESP_SADR_Trgr_ESP_AR2) == 0)
				{
					res = SetTimingCyclic("SADR_Trgr_ESP_AR2", 1, tDelay, 1);
					setTimer (Timer_ESP_SADR_Trgr_ESP_AR2, tDelay);
					@sysvar::CH_Nodes::CH__STPDU_ESP_SADR_Trgr_ESP_AR2 = 2;
				}
			}
			else if (tDelay == 0)
			{
				if (isTimerActive(Timer_ESP_SADR_Trgr_ESP_AR2) == 0)
				{
					res = EnableTimingCyclic("SADR_Trgr_ESP_AR2", 0);
					res = EnableTimingEvtTrg("SADR_Trgr_ESP_AR2", 0);
				}
			}
			break;
		case (2):
			break;
		default:
			Write("error: wrong parameter (%d)", @this);
			stop();
			break;
	}
}

on sysvar sysvar::CH_Nodes::CH__STPDU_ESP_St_Rq_STA_AR2
{
	long res;
	long tDelay;
	switch (@this)
	{
		case (0):
			res = ResetTimingCyclic("St_Rq_STA_AR2");
			res = ResetTimingEvtTrg("St_Rq_STA_AR2");
			res = EnableTimingCyclic("St_Rq_STA_AR2", 1);
			res = EnableTimingEvtTrg("St_Rq_STA_AR2", 1);
			break;
		case (1):
			tDelay = @sysvar::CH_Nodes::CH__STPDU_T_ESP_St_Rq_STA_AR2;
			if (tDelay > 0)
			{
				if (isTimerActive(Timer_ESP_St_Rq_STA_AR2) == 0)
				{
					res = SetTimingCyclic("St_Rq_STA_AR2", 1, tDelay, 1);
					setTimer (Timer_ESP_St_Rq_STA_AR2, tDelay);
					@sysvar::CH_Nodes::CH__STPDU_ESP_St_Rq_STA_AR2 = 2;
				}
			}
			else if (tDelay == 0)
			{
				if (isTimerActive(Timer_ESP_St_Rq_STA_AR2) == 0)
				{
					res = EnableTimingCyclic("St_Rq_STA_AR2", 0);
					res = EnableTimingEvtTrg("St_Rq_STA_AR2", 0);
				}
			}
			break;
		case (2):
			break;
		default:
			Write("error: wrong parameter (%d)", @this);
			stop();
			break;
	}
}

on sysvar sysvar::CH_Nodes::CH__STPDU_ESP_TBCSC_ESP_DAC_AR2
{
	long res;
	long tDelay;
	switch (@this)
	{
		case (0):
			res = ResetTimingCyclic("TBCSC_ESP_DAC_AR2");
			res = ResetTimingEvtTrg("TBCSC_ESP_DAC_AR2");
			res = EnableTimingCyclic("TBCSC_ESP_DAC_AR2", 1);
			res = EnableTimingEvtTrg("TBCSC_ESP_DAC_AR2", 1);
			break;
		case (1):
			tDelay = @sysvar::CH_Nodes::CH__STPDU_T_ESP_TBCSC_ESP_DAC_AR2;
			if (tDelay > 0)
			{
				if (isTimerActive(Timer_ESP_TBCSC_ESP_DAC_AR2) == 0)
				{
					res = SetTimingCyclic("TBCSC_ESP_DAC_AR2", 1, tDelay, 1);
					setTimer (Timer_ESP_TBCSC_ESP_DAC_AR2, tDelay);
					@sysvar::CH_Nodes::CH__STPDU_ESP_TBCSC_ESP_DAC_AR2 = 2;
				}
			}
			else if (tDelay == 0)
			{
				if (isTimerActive(Timer_ESP_TBCSC_ESP_DAC_AR2) == 0)
				{
					res = EnableTimingCyclic("TBCSC_ESP_DAC_AR2", 0);
					res = EnableTimingEvtTrg("TBCSC_ESP_DAC_AR2", 0);
				}
			}
			break;
		case (2):
			break;
		default:
			Write("error: wrong parameter (%d)", @this);
			stop();
			break;
	}
}

on sysvar sysvar::CH_Nodes::CH__STPDU_ESP_TBCSC_Rs1_ESP_AR2
{
	long res;
	long tDelay;
	switch (@this)
	{
		case (0):
			res = ResetTimingCyclic("TBCSC_Rs1_ESP_AR2");
			res = ResetTimingEvtTrg("TBCSC_Rs1_ESP_AR2");
			res = EnableTimingCyclic("TBCSC_Rs1_ESP_AR2", 1);
			res = EnableTimingEvtTrg("TBCSC_Rs1_ESP_AR2", 1);
			break;
		case (1):
			tDelay = @sysvar::CH_Nodes::CH__STPDU_T_ESP_TBCSC_Rs1_ESP_AR2;
			if (tDelay > 0)
			{
				if (isTimerActive(Timer_ESP_TBCSC_Rs1_ESP_AR2) == 0)
				{
					res = SetTimingCyclic("TBCSC_Rs1_ESP_AR2", 1, tDelay, 1);
					setTimer (Timer_ESP_TBCSC_Rs1_ESP_AR2, tDelay);
					@sysvar::CH_Nodes::CH__STPDU_ESP_TBCSC_Rs1_ESP_AR2 = 2;
				}
			}
			else if (tDelay == 0)
			{
				if (isTimerActive(Timer_ESP_TBCSC_Rs1_ESP_AR2) == 0)
				{
					res = EnableTimingCyclic("TBCSC_Rs1_ESP_AR2", 0);
					res = EnableTimingEvtTrg("TBCSC_Rs1_ESP_AR2", 0);
				}
			}
			break;
		case (2):
			break;
		default:
			Write("error: wrong parameter (%d)", @this);
			stop();
			break;
	}
}

on sysvar sysvar::CH_Nodes::CH__STPDU_ESP_TBCSC_Rs2_ESP_AR2
{
	long res;
	long tDelay;
	switch (@this)
	{
		case (0):
			res = ResetTimingCyclic("TBCSC_Rs2_ESP_AR2");
			res = ResetTimingEvtTrg("TBCSC_Rs2_ESP_AR2");
			res = EnableTimingCyclic("TBCSC_Rs2_ESP_AR2", 1);
			res = EnableTimingEvtTrg("TBCSC_Rs2_ESP_AR2", 1);
			break;
		case (1):
			tDelay = @sysvar::CH_Nodes::CH__STPDU_T_ESP_TBCSC_Rs2_ESP_AR2;
			if (tDelay > 0)
			{
				if (isTimerActive(Timer_ESP_TBCSC_Rs2_ESP_AR2) == 0)
				{
					res = SetTimingCyclic("TBCSC_Rs2_ESP_AR2", 1, tDelay, 1);
					setTimer (Timer_ESP_TBCSC_Rs2_ESP_AR2, tDelay);
					@sysvar::CH_Nodes::CH__STPDU_ESP_TBCSC_Rs2_ESP_AR2 = 2;
				}
			}
			else if (tDelay == 0)
			{
				if (isTimerActive(Timer_ESP_TBCSC_Rs2_ESP_AR2) == 0)
				{
					res = EnableTimingCyclic("TBCSC_Rs2_ESP_AR2", 0);
					res = EnableTimingEvtTrg("TBCSC_Rs2_ESP_AR2", 0);
				}
			}
			break;
		case (2):
			break;
		default:
			Write("error: wrong parameter (%d)", @this);
			stop();
			break;
	}
}

on sysvar sysvar::CH_Nodes::CH__STPDU_ESP_VehAccel_X_Rs1_AR2
{
	long res;
	long tDelay;
	switch (@this)
	{
		case (0):
			res = ResetTimingCyclic("VehAccel_X_Rs1_AR2");
			res = ResetTimingEvtTrg("VehAccel_X_Rs1_AR2");
			res = EnableTimingCyclic("VehAccel_X_Rs1_AR2", 1);
			res = EnableTimingEvtTrg("VehAccel_X_Rs1_AR2", 1);
			break;
		case (1):
			tDelay = @sysvar::CH_Nodes::CH__STPDU_T_ESP_VehAccel_X_Rs1_AR2;
			if (tDelay > 0)
			{
				if (isTimerActive(Timer_ESP_VehAccel_X_Rs1_AR2) == 0)
				{
					res = SetTimingCyclic("VehAccel_X_Rs1_AR2", 1, tDelay, 1);
					setTimer (Timer_ESP_VehAccel_X_Rs1_AR2, tDelay);
					@sysvar::CH_Nodes::CH__STPDU_ESP_VehAccel_X_Rs1_AR2 = 2;
				}
			}
			else if (tDelay == 0)
			{
				if (isTimerActive(Timer_ESP_VehAccel_X_Rs1_AR2) == 0)
				{
					res = EnableTimingCyclic("VehAccel_X_Rs1_AR2", 0);
					res = EnableTimingEvtTrg("VehAccel_X_Rs1_AR2", 0);
				}
			}
			break;
		case (2):
			break;
		default:
			Write("error: wrong parameter (%d)", @this);
			stop();
			break;
	}
}

on sysvar sysvar::CH_Nodes::CH__STPDU_ESP_VehAccel_X_Rs2_AR2
{
	long res;
	long tDelay;
	switch (@this)
	{
		case (0):
			res = ResetTimingCyclic("VehAccel_X_Rs2_AR2");
			res = ResetTimingEvtTrg("VehAccel_X_Rs2_AR2");
			res = EnableTimingCyclic("VehAccel_X_Rs2_AR2", 1);
			res = EnableTimingEvtTrg("VehAccel_X_Rs2_AR2", 1);
			break;
		case (1):
			tDelay = @sysvar::CH_Nodes::CH__STPDU_T_ESP_VehAccel_X_Rs2_AR2;
			if (tDelay > 0)
			{
				if (isTimerActive(Timer_ESP_VehAccel_X_Rs2_AR2) == 0)
				{
					res = SetTimingCyclic("VehAccel_X_Rs2_AR2", 1, tDelay, 1);
					setTimer (Timer_ESP_VehAccel_X_Rs2_AR2, tDelay);
					@sysvar::CH_Nodes::CH__STPDU_ESP_VehAccel_X_Rs2_AR2 = 2;
				}
			}
			else if (tDelay == 0)
			{
				if (isTimerActive(Timer_ESP_VehAccel_X_Rs2_AR2) == 0)
				{
					res = EnableTimingCyclic("VehAccel_X_Rs2_AR2", 0);
					res = EnableTimingEvtTrg("VehAccel_X_Rs2_AR2", 0);
				}
			}
			break;
		case (2):
			break;
		default:
			Write("error: wrong parameter (%d)", @this);
			stop();
			break;
	}
}

on sysvar sysvar::CH_Nodes::CH__STPDU_ESP_VehDyn_Stat1_AR2
{
	long res;
	long tDelay;
	switch (@this)
	{
		case (0):
			res = ResetTimingCyclic("VehDyn_Stat1_AR2");
			res = ResetTimingEvtTrg("VehDyn_Stat1_AR2");
			res = EnableTimingCyclic("VehDyn_Stat1_AR2", 1);
			res = EnableTimingEvtTrg("VehDyn_Stat1_AR2", 1);
			break;
		case (1):
			tDelay = @sysvar::CH_Nodes::CH__STPDU_T_ESP_VehDyn_Stat1_AR2;
			if (tDelay > 0)
			{
				if (isTimerActive(Timer_ESP_VehDyn_Stat1_AR2) == 0)
				{
					res = SetTimingCyclic("VehDyn_Stat1_AR2", 1, tDelay, 1);
					setTimer (Timer_ESP_VehDyn_Stat1_AR2, tDelay);
					@sysvar::CH_Nodes::CH__STPDU_ESP_VehDyn_Stat1_AR2 = 2;
				}
			}
			else if (tDelay == 0)
			{
				if (isTimerActive(Timer_ESP_VehDyn_Stat1_AR2) == 0)
				{
					res = EnableTimingCyclic("VehDyn_Stat1_AR2", 0);
					res = EnableTimingEvtTrg("VehDyn_Stat1_AR2", 0);
				}
			}
			break;
		case (2):
			break;
		default:
			Write("error: wrong parameter (%d)", @this);
			stop();
			break;
	}
}

on sysvar sysvar::CH_Nodes::CH__STPDU_ESP_VehDyn_Stat2_AR2
{
	long res;
	long tDelay;
	switch (@this)
	{
		case (0):
			res = ResetTimingCyclic("VehDyn_Stat2_AR2");
			res = ResetTimingEvtTrg("VehDyn_Stat2_AR2");
			res = EnableTimingCyclic("VehDyn_Stat2_AR2", 1);
			res = EnableTimingEvtTrg("VehDyn_Stat2_AR2", 1);
			break;
		case (1):
			tDelay = @sysvar::CH_Nodes::CH__STPDU_T_ESP_VehDyn_Stat2_AR2;
			if (tDelay > 0)
			{
				if (isTimerActive(Timer_ESP_VehDyn_Stat2_AR2) == 0)
				{
					res = SetTimingCyclic("VehDyn_Stat2_AR2", 1, tDelay, 1);
					setTimer (Timer_ESP_VehDyn_Stat2_AR2, tDelay);
					@sysvar::CH_Nodes::CH__STPDU_ESP_VehDyn_Stat2_AR2 = 2;
				}
			}
			else if (tDelay == 0)
			{
				if (isTimerActive(Timer_ESP_VehDyn_Stat2_AR2) == 0)
				{
					res = EnableTimingCyclic("VehDyn_Stat2_AR2", 0);
					res = EnableTimingEvtTrg("VehDyn_Stat2_AR2", 0);
				}
			}
			break;
		case (2):
			break;
		default:
			Write("error: wrong parameter (%d)", @this);
			stop();
			break;
	}
}

on sysvar sysvar::CH_Nodes::CH__STPDU_ESP_VehSpd_X_AR2
{
	long res;
	long tDelay;
	switch (@this)
	{
		case (0):
			res = ResetTimingCyclic("VehSpd_X_AR2");
			res = ResetTimingEvtTrg("VehSpd_X_AR2");
			res = EnableTimingCyclic("VehSpd_X_AR2", 1);
			res = EnableTimingEvtTrg("VehSpd_X_AR2", 1);
			break;
		case (1):
			tDelay = @sysvar::CH_Nodes::CH__STPDU_T_ESP_VehSpd_X_AR2;
			if (tDelay > 0)
			{
				if (isTimerActive(Timer_ESP_VehSpd_X_AR2) == 0)
				{
					res = SetTimingCyclic("VehSpd_X_AR2", 1, tDelay, 1);
					setTimer (Timer_ESP_VehSpd_X_AR2, tDelay);
					@sysvar::CH_Nodes::CH__STPDU_ESP_VehSpd_X_AR2 = 2;
				}
			}
			else if (tDelay == 0)
			{
				if (isTimerActive(Timer_ESP_VehSpd_X_AR2) == 0)
				{
					res = EnableTimingCyclic("VehSpd_X_AR2", 0);
					res = EnableTimingEvtTrg("VehSpd_X_AR2", 0);
				}
			}
			break;
		case (2):
			break;
		default:
			Write("error: wrong parameter (%d)", @this);
			stop();
			break;
	}
}

on sysvar sysvar::CH_Nodes::CH__STPDU_ESP_Whl_Lt_Stat_AR2
{
	long res;
	long tDelay;
	switch (@this)
	{
		case (0):
			res = ResetTimingCyclic("Whl_Lt_Stat_AR2");
			res = ResetTimingEvtTrg("Whl_Lt_Stat_AR2");
			res = EnableTimingCyclic("Whl_Lt_Stat_AR2", 1);
			res = EnableTimingEvtTrg("Whl_Lt_Stat_AR2", 1);
			break;
		case (1):
			tDelay = @sysvar::CH_Nodes::CH__STPDU_T_ESP_Whl_Lt_Stat_AR2;
			if (tDelay > 0)
			{
				if (isTimerActive(Timer_ESP_Whl_Lt_Stat_AR2) == 0)
				{
					res = SetTimingCyclic("Whl_Lt_Stat_AR2", 1, tDelay, 1);
					setTimer (Timer_ESP_Whl_Lt_Stat_AR2, tDelay);
					@sysvar::CH_Nodes::CH__STPDU_ESP_Whl_Lt_Stat_AR2 = 2;
				}
			}
			else if (tDelay == 0)
			{
				if (isTimerActive(Timer_ESP_Whl_Lt_Stat_AR2) == 0)
				{
					res = EnableTimingCyclic("Whl_Lt_Stat_AR2", 0);
					res = EnableTimingEvtTrg("Whl_Lt_Stat_AR2", 0);
				}
			}
			break;
		case (2):
			break;
		default:
			Write("error: wrong parameter (%d)", @this);
			stop();
			break;
	}
}

on sysvar sysvar::CH_Nodes::CH__STPDU_ESP_Whl_Rt_Stat_AR2
{
	long res;
	long tDelay;
	switch (@this)
	{
		case (0):
			res = ResetTimingCyclic("Whl_Rt_Stat_AR2");
			res = ResetTimingEvtTrg("Whl_Rt_Stat_AR2");
			res = EnableTimingCyclic("Whl_Rt_Stat_AR2", 1);
			res = EnableTimingEvtTrg("Whl_Rt_Stat_AR2", 1);
			break;
		case (1):
			tDelay = @sysvar::CH_Nodes::CH__STPDU_T_ESP_Whl_Rt_Stat_AR2;
			if (tDelay > 0)
			{
				if (isTimerActive(Timer_ESP_Whl_Rt_Stat_AR2) == 0)
				{
					res = SetTimingCyclic("Whl_Rt_Stat_AR2", 1, tDelay, 1);
					setTimer (Timer_ESP_Whl_Rt_Stat_AR2, tDelay);
					@sysvar::CH_Nodes::CH__STPDU_ESP_Whl_Rt_Stat_AR2 = 2;
				}
			}
			else if (tDelay == 0)
			{
				if (isTimerActive(Timer_ESP_Whl_Rt_Stat_AR2) == 0)
				{
					res = EnableTimingCyclic("Whl_Rt_Stat_AR2", 0);
					res = EnableTimingEvtTrg("Whl_Rt_Stat_AR2", 0);
				}
			}
			break;
		case (2):
			break;
		default:
			Write("error: wrong parameter (%d)", @this);
			stop();
			break;
	}
}

on sysvar sysvar::CH_Nodes::CH__STPDU_ESP_WhlPlsCnt_TPM_AR2
{
	long res;
	long tDelay;
	switch (@this)
	{
		case (0):
			res = ResetTimingCyclic("WhlPlsCnt_TPM_AR2");
			res = ResetTimingEvtTrg("WhlPlsCnt_TPM_AR2");
			res = EnableTimingCyclic("WhlPlsCnt_TPM_AR2", 1);
			res = EnableTimingEvtTrg("WhlPlsCnt_TPM_AR2", 1);
			break;
		case (1):
			tDelay = @sysvar::CH_Nodes::CH__STPDU_T_ESP_WhlPlsCnt_TPM_AR2;
			if (tDelay > 0)
			{
				if (isTimerActive(Timer_ESP_WhlPlsCnt_TPM_AR2) == 0)
				{
					res = SetTimingCyclic("WhlPlsCnt_TPM_AR2", 1, tDelay, 1);
					setTimer (Timer_ESP_WhlPlsCnt_TPM_AR2, tDelay);
					@sysvar::CH_Nodes::CH__STPDU_ESP_WhlPlsCnt_TPM_AR2 = 2;
				}
			}
			else if (tDelay == 0)
			{
				if (isTimerActive(Timer_ESP_WhlPlsCnt_TPM_AR2) == 0)
				{
					res = EnableTimingCyclic("WhlPlsCnt_TPM_AR2", 0);
					res = EnableTimingEvtTrg("WhlPlsCnt_TPM_AR2", 0);
				}
			}
			break;
		case (2):
			break;
		default:
			Write("error: wrong parameter (%d)", @this);
			stop();
			break;
	}
}

on sysvar sysvar::CH_Nodes::CH__STPDU_ESP_WUDOP_ESP_FR
{
	long res;
	long tDelay;
	switch (@this)
	{
		case (0):
			res = ResetTimingCyclic("WUDOP_ESP_FR");
			res = ResetTimingEvtTrg("WUDOP_ESP_FR");
			res = EnableTimingCyclic("WUDOP_ESP_FR", 1);
			res = EnableTimingEvtTrg("WUDOP_ESP_FR", 1);
			break;
		case (1):
			tDelay = @sysvar::CH_Nodes::CH__STPDU_T_ESP_WUDOP_ESP_FR;
			if (tDelay > 0)
			{
				if (isTimerActive(Timer_ESP_WUDOP_ESP_FR) == 0)
				{
					res = SetTimingCyclic("WUDOP_ESP_FR", 1, tDelay, 1);
					setTimer (Timer_ESP_WUDOP_ESP_FR, tDelay);
					@sysvar::CH_Nodes::CH__STPDU_ESP_WUDOP_ESP_FR = 2;
				}
			}
			else if (tDelay == 0)
			{
				if (isTimerActive(Timer_ESP_WUDOP_ESP_FR) == 0)
				{
					res = EnableTimingCyclic("WUDOP_ESP_FR", 0);
					res = EnableTimingEvtTrg("WUDOP_ESP_FR", 0);
				}
			}
			break;
		case (2):
			break;
		default:
			Write("error: wrong parameter (%d)", @this);
			stop();
			break;
	}
}

on sysvar sysvar::CH_Nodes::CH__STPDU_ESP_YMAS_Rs_AR2
{
	long res;
	long tDelay;
	switch (@this)
	{
		case (0):
			res = ResetTimingCyclic("YMAS_Rs_AR2");
			res = ResetTimingEvtTrg("YMAS_Rs_AR2");
			res = EnableTimingCyclic("YMAS_Rs_AR2", 1);
			res = EnableTimingEvtTrg("YMAS_Rs_AR2", 1);
			break;
		case (1):
			tDelay = @sysvar::CH_Nodes::CH__STPDU_T_ESP_YMAS_Rs_AR2;
			if (tDelay > 0)
			{
				if (isTimerActive(Timer_ESP_YMAS_Rs_AR2) == 0)
				{
					res = SetTimingCyclic("YMAS_Rs_AR2", 1, tDelay, 1);
					setTimer (Timer_ESP_YMAS_Rs_AR2, tDelay);
					@sysvar::CH_Nodes::CH__STPDU_ESP_YMAS_Rs_AR2 = 2;
				}
			}
			else if (tDelay == 0)
			{
				if (isTimerActive(Timer_ESP_YMAS_Rs_AR2) == 0)
				{
					res = EnableTimingCyclic("YMAS_Rs_AR2", 0);
					res = EnableTimingEvtTrg("YMAS_Rs_AR2", 0);
				}
			}
			break;
		case (2):
			break;
		default:
			Write("error: wrong parameter (%d)", @this);
			stop();
			break;
	}
}


on sysvar sysvar::CH_Nodes::CH_ESPAWD_TCASE_Rq_ESP_A_UB_AUTO
{
	switch (@sysvar::CH_Nodes::CH_ESPAWD_TCASE_Rq_ESP_A_UB_AUTO)
	{
		case (0):
			enableControl("AWD_TCASE_Rq_ESP_AR2", "CH_ESPAWD_TCASE_Rq_ESP_AR2_UB_", 0); //1: enable; 0: disable
			@sysvar::CH_Nodes::CH_ESPAWD_TCASE_Rq_ESP_AR2_UB_ = 1;
			break;
		case (1):
			enableControl("AWD_TCASE_Rq_ESP_AR2", "CH_ESPAWD_TCASE_Rq_ESP_AR2_UB_", 1); //1: enable; 0: disable
			break;
		case (2):
			enableControl("AWD_TCASE_Rq_ESP_AR2", "CH_ESPAWD_TCASE_Rq_ESP_AR2_UB_", 0); //1: enable; 0: disable
			@sysvar::CH_Nodes::CH_ESPAWD_TCASE_Rq_ESP_AR2_UB_ = 1;
			break;
		case (3):
			enableControl("AWD_TCASE_Rq_ESP_AR2", "CH_ESPAWD_TCASE_Rq_ESP_AR2_UB_", 0); //1: enable; 0: disable
			@sysvar::CH_Nodes::CH_ESPAWD_TCASE_Rq_ESP_AR2_UB_ = 0;
			break;
	}
}

on sysvar sysvar::CH_Nodes::CH_ESPCRC_AWD_TCASE_Rq_ESP__AUTO
{
//	EnableCRC("AWD_TCASE_Rq_ESP_AR2",  "AWD_TCASE_Rq_ESP_Pr2", !@this); // 1 = on, 0 = off 
	enableControl("AWD_TCASE_Rq_ESP_AR2", "CH_ESPCRC_AWD_TCASE_Rq_ESP_Pr2A_", @this); //1: enable; 0: disable
	CRC_AWD_TCASE_Rq_ESP_Pr2 = @sysvar::CH_Nodes::CH_ESPCRC_AWD_TCASE_Rq_ESP__AUTO;
}

on sysvar sysvar::CH_Nodes::CH_ESPSQC_AWD_TCASE_Rq_ESP__AUTO
{
//	EnableSQC("AWD_TCASE_Rq_ESP_AR2",  "AWD_TCASE_Rq_ESP_Pr2", !@this); // 1 = on, 0 = off 
	enableControl("AWD_TCASE_Rq_ESP_AR2", "CH_ESPSQC_AWD_TCASE_Rq_ESP_Pr2A_", @this); //1: enable; 0: disable
	SQC_AWD_TCASE_Rq_ESP_Pr2 = @sysvar::CH_Nodes::CH_ESPSQC_AWD_TCASE_Rq_ESP__AUTO;
}

on sysvar sysvar::CH_Nodes::CH_ESPBrkSys_Stat_AR2_UB_AUTO_01
{
	switch (@sysvar::CH_Nodes::CH_ESPBrkSys_Stat_AR2_UB_AUTO_01)
	{
		case (0):
			enableControl("BrkSys_Stat_AR2", "CH_ESPBrkSys_Stat_AR2_UB__01", 0); //1: enable; 0: disable
			@sysvar::CH_Nodes::CH_ESPBrkSys_Stat_AR2_UB__01 = 1;
			break;
		case (1):
			enableControl("BrkSys_Stat_AR2", "CH_ESPBrkSys_Stat_AR2_UB__01", 1); //1: enable; 0: disable
			break;
		case (2):
			enableControl("BrkSys_Stat_AR2", "CH_ESPBrkSys_Stat_AR2_UB__01", 0); //1: enable; 0: disable
			@sysvar::CH_Nodes::CH_ESPBrkSys_Stat_AR2_UB__01 = 1;
			break;
		case (3):
			enableControl("BrkSys_Stat_AR2", "CH_ESPBrkSys_Stat_AR2_UB__01", 0); //1: enable; 0: disable
			@sysvar::CH_Nodes::CH_ESPBrkSys_Stat_AR2_UB__01 = 0;
			break;
	}
}

on sysvar sysvar::CH_Nodes::CH_ESPCRC_BrkSys_Stat_Pr2Br_AUTO
{
//	EnableCRC("BrkSys_Stat_AR2",  "BrkSys_Stat_Pr2", !@this); // 1 = on, 0 = off 
	enableControl("BrkSys_Stat_AR2", "CH_ESPCRC_BrkSys_Stat_Pr2BrkSys_", @this); //1: enable; 0: disable
	CRC_BrkSys_Stat_Pr2 = @sysvar::CH_Nodes::CH_ESPCRC_BrkSys_Stat_Pr2Br_AUTO;
}

on sysvar sysvar::CH_Nodes::CH_ESPSQC_BrkSys_Stat_Pr2Br_AUTO
{
//	EnableSQC("BrkSys_Stat_AR2",  "BrkSys_Stat_Pr2", !@this); // 1 = on, 0 = off 
	enableControl("BrkSys_Stat_AR2", "CH_ESPSQC_BrkSys_Stat_Pr2BrkSys_", @this); //1: enable; 0: disable
	SQC_BrkSys_Stat_Pr2 = @sysvar::CH_Nodes::CH_ESPSQC_BrkSys_Stat_Pr2Br_AUTO;
}

on sysvar sysvar::CH_Nodes::CH_ESPDPC_Disp_Rq_AR2_UB_AUTO_01
{
	switch (@sysvar::CH_Nodes::CH_ESPDPC_Disp_Rq_AR2_UB_AUTO_01)
	{
		case (0):
			enableControl("DPC_Disp_Rq_AR2", "CH_ESPDPC_Disp_Rq_AR2_UB__01", 0); //1: enable; 0: disable
			@sysvar::CH_Nodes::CH_ESPDPC_Disp_Rq_AR2_UB__01 = 1;
			break;
		case (1):
			enableControl("DPC_Disp_Rq_AR2", "CH_ESPDPC_Disp_Rq_AR2_UB__01", 1); //1: enable; 0: disable
			break;
		case (2):
			enableControl("DPC_Disp_Rq_AR2", "CH_ESPDPC_Disp_Rq_AR2_UB__01", 0); //1: enable; 0: disable
			@sysvar::CH_Nodes::CH_ESPDPC_Disp_Rq_AR2_UB__01 = 1;
			break;
		case (3):
			enableControl("DPC_Disp_Rq_AR2", "CH_ESPDPC_Disp_Rq_AR2_UB__01", 0); //1: enable; 0: disable
			@sysvar::CH_Nodes::CH_ESPDPC_Disp_Rq_AR2_UB__01 = 0;
			break;
	}
}

on sysvar sysvar::CH_Nodes::CH_ESPCRC_DPC_Disp_Rq_Pr2DP_AUTO
{
//	EnableCRC("DPC_Disp_Rq_AR2",  "DPC_Disp_Rq_Pr2", !@this); // 1 = on, 0 = off 
	enableControl("DPC_Disp_Rq_AR2", "CH_ESPCRC_DPC_Disp_Rq_Pr2DPC_Di_", @this); //1: enable; 0: disable
	CRC_DPC_Disp_Rq_Pr2 = @sysvar::CH_Nodes::CH_ESPCRC_DPC_Disp_Rq_Pr2DP_AUTO;
}

on sysvar sysvar::CH_Nodes::CH_ESPSQC_DPC_Disp_Rq_Pr2DP_AUTO
{
//	EnableSQC("DPC_Disp_Rq_AR2",  "DPC_Disp_Rq_Pr2", !@this); // 1 = on, 0 = off 
	enableControl("DPC_Disp_Rq_AR2", "CH_ESPSQC_DPC_Disp_Rq_Pr2DPC_Di_", @this); //1: enable; 0: disable
	SQC_DPC_Disp_Rq_Pr2 = @sysvar::CH_Nodes::CH_ESPSQC_DPC_Disp_Rq_Pr2DP_AUTO;
}

on sysvar sysvar::CH_Nodes::CH_ESPDPC_IndMd_Stat_AR2_UB_A_01
{
	switch (@sysvar::CH_Nodes::CH_ESPDPC_IndMd_Stat_AR2_UB_A_01)
	{
		case (0):
			enableControl("DPC_IndMd_Stat_AR2", "CH_ESPDPC_IndMd_Stat_AR2_UB__01", 0); //1: enable; 0: disable
			@sysvar::CH_Nodes::CH_ESPDPC_IndMd_Stat_AR2_UB__01 = 1;
			break;
		case (1):
			enableControl("DPC_IndMd_Stat_AR2", "CH_ESPDPC_IndMd_Stat_AR2_UB__01", 1); //1: enable; 0: disable
			break;
		case (2):
			enableControl("DPC_IndMd_Stat_AR2", "CH_ESPDPC_IndMd_Stat_AR2_UB__01", 0); //1: enable; 0: disable
			@sysvar::CH_Nodes::CH_ESPDPC_IndMd_Stat_AR2_UB__01 = 1;
			break;
		case (3):
			enableControl("DPC_IndMd_Stat_AR2", "CH_ESPDPC_IndMd_Stat_AR2_UB__01", 0); //1: enable; 0: disable
			@sysvar::CH_Nodes::CH_ESPDPC_IndMd_Stat_AR2_UB__01 = 0;
			break;
	}
}

on sysvar sysvar::CH_Nodes::CH_ESPCRC_DPC_IndMd_Stat_Pr_AUTO
{
//	EnableCRC("DPC_IndMd_Stat_AR2",  "DPC_IndMd_Stat_Pr2", !@this); // 1 = on, 0 = off 
	enableControl("DPC_IndMd_Stat_AR2", "CH_ESPCRC_DPC_IndMd_Stat_Pr2DPC_", @this); //1: enable; 0: disable
	CRC_DPC_IndMd_Stat_Pr2 = @sysvar::CH_Nodes::CH_ESPCRC_DPC_IndMd_Stat_Pr_AUTO;
}

on sysvar sysvar::CH_Nodes::CH_ESPSQC_DPC_IndMd_Stat_Pr_AUTO
{
//	EnableSQC("DPC_IndMd_Stat_AR2",  "DPC_IndMd_Stat_Pr2", !@this); // 1 = on, 0 = off 
	enableControl("DPC_IndMd_Stat_AR2", "CH_ESPSQC_DPC_IndMd_Stat_Pr2DPC_", @this); //1: enable; 0: disable
	SQC_DPC_IndMd_Stat_Pr2 = @sysvar::CH_Nodes::CH_ESPSQC_DPC_IndMd_Stat_Pr_AUTO;
}

on sysvar sysvar::CH_Nodes::CH_ESPDPC_IndMd_Style2_A_UB_A_01
{
	switch (@sysvar::CH_Nodes::CH_ESPDPC_IndMd_Style2_A_UB_A_01)
	{
		case (0):
			enableControl("DPC_IndMd_Style2_AR2", "CH_ESPDPC_IndMd_Style2_AR2_UB_01", 0); //1: enable; 0: disable
			@sysvar::CH_Nodes::CH_ESPDPC_IndMd_Style2_AR2_UB_01 = 1;
			break;
		case (1):
			enableControl("DPC_IndMd_Style2_AR2", "CH_ESPDPC_IndMd_Style2_AR2_UB_01", 1); //1: enable; 0: disable
			break;
		case (2):
			enableControl("DPC_IndMd_Style2_AR2", "CH_ESPDPC_IndMd_Style2_AR2_UB_01", 0); //1: enable; 0: disable
			@sysvar::CH_Nodes::CH_ESPDPC_IndMd_Style2_AR2_UB_01 = 1;
			break;
		case (3):
			enableControl("DPC_IndMd_Style2_AR2", "CH_ESPDPC_IndMd_Style2_AR2_UB_01", 0); //1: enable; 0: disable
			@sysvar::CH_Nodes::CH_ESPDPC_IndMd_Style2_AR2_UB_01 = 0;
			break;
	}
}

on sysvar sysvar::CH_Nodes::CH_ESPCRC_DPC_IndMd_Style2__AUTO
{
//	EnableCRC("DPC_IndMd_Style2_AR2",  "DPC_IndMd_Style2_Pr2", !@this); // 1 = on, 0 = off 
	enableControl("DPC_IndMd_Style2_AR2", "CH_ESPCRC_DPC_IndMd_Style2_Pr2D_", @this); //1: enable; 0: disable
	CRC_DPC_IndMd_Style2_Pr2 = @sysvar::CH_Nodes::CH_ESPCRC_DPC_IndMd_Style2__AUTO;
}

on sysvar sysvar::CH_Nodes::CH_ESPSQC_DPC_IndMd_Style2__AUTO
{
//	EnableSQC("DPC_IndMd_Style2_AR2",  "DPC_IndMd_Style2_Pr2", !@this); // 1 = on, 0 = off 
	enableControl("DPC_IndMd_Style2_AR2", "CH_ESPSQC_DPC_IndMd_Style2_Pr2D_", @this); //1: enable; 0: disable
	SQC_DPC_IndMd_Style2_Pr2 = @sysvar::CH_Nodes::CH_ESPSQC_DPC_IndMd_Style2__AUTO;
}

on sysvar sysvar::CH_Nodes::CH_ESPDPC_IndMd_Style_AR_UB_A_01
{
	switch (@sysvar::CH_Nodes::CH_ESPDPC_IndMd_Style_AR_UB_A_01)
	{
		case (0):
			enableControl("DPC_IndMd_Style_AR2", "CH_ESPDPC_IndMd_Style_AR2_UB__01", 0); //1: enable; 0: disable
			@sysvar::CH_Nodes::CH_ESPDPC_IndMd_Style_AR2_UB__01 = 1;
			break;
		case (1):
			enableControl("DPC_IndMd_Style_AR2", "CH_ESPDPC_IndMd_Style_AR2_UB__01", 1); //1: enable; 0: disable
			break;
		case (2):
			enableControl("DPC_IndMd_Style_AR2", "CH_ESPDPC_IndMd_Style_AR2_UB__01", 0); //1: enable; 0: disable
			@sysvar::CH_Nodes::CH_ESPDPC_IndMd_Style_AR2_UB__01 = 1;
			break;
		case (3):
			enableControl("DPC_IndMd_Style_AR2", "CH_ESPDPC_IndMd_Style_AR2_UB__01", 0); //1: enable; 0: disable
			@sysvar::CH_Nodes::CH_ESPDPC_IndMd_Style_AR2_UB__01 = 0;
			break;
	}
}

on sysvar sysvar::CH_Nodes::CH_ESPCRC_DPC_IndMd_Style_P_AUTO
{
//	EnableCRC("DPC_IndMd_Style_AR2",  "DPC_IndMd_Style_Pr2", !@this); // 1 = on, 0 = off 
	enableControl("DPC_IndMd_Style_AR2", "CH_ESPCRC_DPC_IndMd_Style_Pr2DP_", @this); //1: enable; 0: disable
	CRC_DPC_IndMd_Style_Pr2 = @sysvar::CH_Nodes::CH_ESPCRC_DPC_IndMd_Style_P_AUTO;
}

on sysvar sysvar::CH_Nodes::CH_ESPSQC_DPC_IndMd_Style_P_AUTO
{
//	EnableSQC("DPC_IndMd_Style_AR2",  "DPC_IndMd_Style_Pr2", !@this); // 1 = on, 0 = off 
	enableControl("DPC_IndMd_Style_AR2", "CH_ESPSQC_DPC_IndMd_Style_Pr2DP_", @this); //1: enable; 0: disable
	SQC_DPC_IndMd_Style_Pr2 = @sysvar::CH_Nodes::CH_ESPSQC_DPC_IndMd_Style_P_AUTO;
}

on sysvar sysvar::CH_Nodes::CH_ESPDPC_Master_Rq_AR2_UB_AU_01
{
	switch (@sysvar::CH_Nodes::CH_ESPDPC_Master_Rq_AR2_UB_AU_01)
	{
		case (0):
			enableControl("DPC_Master_Rq_AR2", "CH_ESPDPC_Master_Rq_AR2_UB__01", 0); //1: enable; 0: disable
			@sysvar::CH_Nodes::CH_ESPDPC_Master_Rq_AR2_UB__01 = 1;
			break;
		case (1):
			enableControl("DPC_Master_Rq_AR2", "CH_ESPDPC_Master_Rq_AR2_UB__01", 1); //1: enable; 0: disable
			break;
		case (2):
			enableControl("DPC_Master_Rq_AR2", "CH_ESPDPC_Master_Rq_AR2_UB__01", 0); //1: enable; 0: disable
			@sysvar::CH_Nodes::CH_ESPDPC_Master_Rq_AR2_UB__01 = 1;
			break;
		case (3):
			enableControl("DPC_Master_Rq_AR2", "CH_ESPDPC_Master_Rq_AR2_UB__01", 0); //1: enable; 0: disable
			@sysvar::CH_Nodes::CH_ESPDPC_Master_Rq_AR2_UB__01 = 0;
			break;
	}
}

on sysvar sysvar::CH_Nodes::CH_ESPCRC_DPC_Master_Rq_Pr2_AUTO
{
//	EnableCRC("DPC_Master_Rq_AR2",  "DPC_Master_Rq_Pr2", !@this); // 1 = on, 0 = off 
	enableControl("DPC_Master_Rq_AR2", "CH_ESPCRC_DPC_Master_Rq_Pr2DPC__", @this); //1: enable; 0: disable
	CRC_DPC_Master_Rq_Pr2 = @sysvar::CH_Nodes::CH_ESPCRC_DPC_Master_Rq_Pr2_AUTO;
}

on sysvar sysvar::CH_Nodes::CH_ESPSQC_DPC_Master_Rq_Pr2_AUTO
{
//	EnableSQC("DPC_Master_Rq_AR2",  "DPC_Master_Rq_Pr2", !@this); // 1 = on, 0 = off 
	enableControl("DPC_Master_Rq_AR2", "CH_ESPSQC_DPC_Master_Rq_Pr2DPC__", @this); //1: enable; 0: disable
	SQC_DPC_Master_Rq_Pr2 = @sysvar::CH_Nodes::CH_ESPSQC_DPC_Master_Rq_Pr2_AUTO;
}

on sysvar sysvar::CH_Nodes::CH_ESPEng_Susp_Rq_AS_AR2_UB_A_01
{
	switch (@sysvar::CH_Nodes::CH_ESPEng_Susp_Rq_AS_AR2_UB_A_01)
	{
		case (0):
			enableControl("Eng_Susp_Rq_AS_AR2", "CH_ESPEng_Susp_Rq_AS_AR2_UB__01", 0); //1: enable; 0: disable
			@sysvar::CH_Nodes::CH_ESPEng_Susp_Rq_AS_AR2_UB__01 = 1;
			break;
		case (1):
			enableControl("Eng_Susp_Rq_AS_AR2", "CH_ESPEng_Susp_Rq_AS_AR2_UB__01", 1); //1: enable; 0: disable
			break;
		case (2):
			enableControl("Eng_Susp_Rq_AS_AR2", "CH_ESPEng_Susp_Rq_AS_AR2_UB__01", 0); //1: enable; 0: disable
			@sysvar::CH_Nodes::CH_ESPEng_Susp_Rq_AS_AR2_UB__01 = 1;
			break;
		case (3):
			enableControl("Eng_Susp_Rq_AS_AR2", "CH_ESPEng_Susp_Rq_AS_AR2_UB__01", 0); //1: enable; 0: disable
			@sysvar::CH_Nodes::CH_ESPEng_Susp_Rq_AS_AR2_UB__01 = 0;
			break;
	}
}

on sysvar sysvar::CH_Nodes::CH_ESPCRC_Eng_Susp_Rq_AS_Pr_AUTO
{
//	EnableCRC("Eng_Susp_Rq_AS_AR2",  "Eng_Susp_Rq_AS_Pr2", !@this); // 1 = on, 0 = off 
	enableControl("Eng_Susp_Rq_AS_AR2", "CH_ESPCRC_Eng_Susp_Rq_AS_Pr2Eng_", @this); //1: enable; 0: disable
	CRC_Eng_Susp_Rq_AS_Pr2 = @sysvar::CH_Nodes::CH_ESPCRC_Eng_Susp_Rq_AS_Pr_AUTO;
}

on sysvar sysvar::CH_Nodes::CH_ESPSQC_Eng_Susp_Rq_AS_Pr_AUTO
{
//	EnableSQC("Eng_Susp_Rq_AS_AR2",  "Eng_Susp_Rq_AS_Pr2", !@this); // 1 = on, 0 = off 
	enableControl("Eng_Susp_Rq_AS_AR2", "CH_ESPSQC_Eng_Susp_Rq_AS_Pr2Eng_", @this); //1: enable; 0: disable
	SQC_Eng_Susp_Rq_AS_Pr2 = @sysvar::CH_Nodes::CH_ESPSQC_Eng_Susp_Rq_AS_Pr_AUTO;
}

on sysvar sysvar::CH_Nodes::CH_ESPEPKB_Disp_IndLmp_R_UB_A_01
{
	switch (@sysvar::CH_Nodes::CH_ESPEPKB_Disp_IndLmp_R_UB_A_01)
	{
		case (0):
			enableControl("EPKB_Disp_IndLmp_Rq_2_AR2", "CH_ESPEPKB_Disp_IndLmp_Rq_2___01", 0); //1: enable; 0: disable
			@sysvar::CH_Nodes::CH_ESPEPKB_Disp_IndLmp_Rq_2___01 = 1;
			break;
		case (1):
			enableControl("EPKB_Disp_IndLmp_Rq_2_AR2", "CH_ESPEPKB_Disp_IndLmp_Rq_2___01", 1); //1: enable; 0: disable
			break;
		case (2):
			enableControl("EPKB_Disp_IndLmp_Rq_2_AR2", "CH_ESPEPKB_Disp_IndLmp_Rq_2___01", 0); //1: enable; 0: disable
			@sysvar::CH_Nodes::CH_ESPEPKB_Disp_IndLmp_Rq_2___01 = 1;
			break;
		case (3):
			enableControl("EPKB_Disp_IndLmp_Rq_2_AR2", "CH_ESPEPKB_Disp_IndLmp_Rq_2___01", 0); //1: enable; 0: disable
			@sysvar::CH_Nodes::CH_ESPEPKB_Disp_IndLmp_Rq_2___01 = 0;
			break;
	}
}

on sysvar sysvar::CH_Nodes::CH_ESPCRC_EPKB_Disp_IndLmp__AUTO
{
//	EnableCRC("EPKB_Disp_IndLmp_Rq_2_AR2",  "EPKB_Disp_IndLmp_Rq_Pr2", !@this); // 1 = on, 0 = off 
	enableControl("EPKB_Disp_IndLmp_Rq_2_AR2", "CH_ESPCRC_EPKB_Disp_IndLmp_Rq_P_", @this); //1: enable; 0: disable
	CRC_EPKB_Disp_IndLmp_Rq_Pr2 = @sysvar::CH_Nodes::CH_ESPCRC_EPKB_Disp_IndLmp__AUTO;
}

on sysvar sysvar::CH_Nodes::CH_ESPSQC_EPKB_Disp_IndLmp__AUTO
{
//	EnableSQC("EPKB_Disp_IndLmp_Rq_2_AR2",  "EPKB_Disp_IndLmp_Rq_Pr2", !@this); // 1 = on, 0 = off 
	enableControl("EPKB_Disp_IndLmp_Rq_2_AR2", "CH_ESPSQC_EPKB_Disp_IndLmp_Rq_P_", @this); //1: enable; 0: disable
	SQC_EPKB_Disp_IndLmp_Rq_Pr2 = @sysvar::CH_Nodes::CH_ESPSQC_EPKB_Disp_IndLmp__AUTO;
}

on sysvar sysvar::CH_Nodes::CH_ESPEPKB_Stat_Gw_AR2_UB_AUT_01
{
	switch (@sysvar::CH_Nodes::CH_ESPEPKB_Stat_Gw_AR2_UB_AUT_01)
	{
		case (0):
			enableControl("EPKB_Stat_Gw_AR2", "CH_ESPEPKB_Stat_Gw_AR2_UB__01", 0); //1: enable; 0: disable
			@sysvar::CH_Nodes::CH_ESPEPKB_Stat_Gw_AR2_UB__01 = 1;
			break;
		case (1):
			enableControl("EPKB_Stat_Gw_AR2", "CH_ESPEPKB_Stat_Gw_AR2_UB__01", 1); //1: enable; 0: disable
			break;
		case (2):
			enableControl("EPKB_Stat_Gw_AR2", "CH_ESPEPKB_Stat_Gw_AR2_UB__01", 0); //1: enable; 0: disable
			@sysvar::CH_Nodes::CH_ESPEPKB_Stat_Gw_AR2_UB__01 = 1;
			break;
		case (3):
			enableControl("EPKB_Stat_Gw_AR2", "CH_ESPEPKB_Stat_Gw_AR2_UB__01", 0); //1: enable; 0: disable
			@sysvar::CH_Nodes::CH_ESPEPKB_Stat_Gw_AR2_UB__01 = 0;
			break;
	}
}

on sysvar sysvar::CH_Nodes::CH_ESPCRC_EPKB_Stat_Pr2EPKB_AUTO
{
//	EnableCRC("EPKB_Stat_Gw_AR2",  "EPKB_Stat_Pr2", !@this); // 1 = on, 0 = off 
	enableControl("EPKB_Stat_Gw_AR2", "CH_ESPCRC_EPKB_Stat_Pr2EPKB_Sta_", @this); //1: enable; 0: disable
	CRC_EPKB_Stat_Pr2 = @sysvar::CH_Nodes::CH_ESPCRC_EPKB_Stat_Pr2EPKB_AUTO;
}

on sysvar sysvar::CH_Nodes::CH_ESPSQC_EPKB_Stat_Pr2EPKB_AUTO
{
//	EnableSQC("EPKB_Stat_Gw_AR2",  "EPKB_Stat_Pr2", !@this); // 1 = on, 0 = off 
	enableControl("EPKB_Stat_Gw_AR2", "CH_ESPSQC_EPKB_Stat_Pr2EPKB_Sta_", @this); //1: enable; 0: disable
	SQC_EPKB_Stat_Pr2 = @sysvar::CH_Nodes::CH_ESPSQC_EPKB_Stat_Pr2EPKB_AUTO;
}

on sysvar sysvar::CH_Nodes::CH_ESPESP_Disp_Rq2_AR2_UB_AUT_01
{
	switch (@sysvar::CH_Nodes::CH_ESPESP_Disp_Rq2_AR2_UB_AUT_01)
	{
		case (0):
			enableControl("ESP_Disp_Rq2_AR2", "CH_ESPESP_Disp_Rq2_AR2_UB__01", 0); //1: enable; 0: disable
			@sysvar::CH_Nodes::CH_ESPESP_Disp_Rq2_AR2_UB__01 = 1;
			break;
		case (1):
			enableControl("ESP_Disp_Rq2_AR2", "CH_ESPESP_Disp_Rq2_AR2_UB__01", 1); //1: enable; 0: disable
			break;
		case (2):
			enableControl("ESP_Disp_Rq2_AR2", "CH_ESPESP_Disp_Rq2_AR2_UB__01", 0); //1: enable; 0: disable
			@sysvar::CH_Nodes::CH_ESPESP_Disp_Rq2_AR2_UB__01 = 1;
			break;
		case (3):
			enableControl("ESP_Disp_Rq2_AR2", "CH_ESPESP_Disp_Rq2_AR2_UB__01", 0); //1: enable; 0: disable
			@sysvar::CH_Nodes::CH_ESPESP_Disp_Rq2_AR2_UB__01 = 0;
			break;
	}
}

on sysvar sysvar::CH_Nodes::CH_ESPCRC_DSR_Disp_Rq_Pr2ES_AUTO
{
//	EnableCRC("ESP_Disp_Rq2_AR2",  "DSR_Disp_Rq_Pr2", !@this); // 1 = on, 0 = off 
	enableControl("ESP_Disp_Rq2_AR2", "CH_ESPCRC_DSR_Disp_Rq_Pr2ESP_Di_", @this); //1: enable; 0: disable
	CRC_DSR_Disp_Rq_Pr2 = @sysvar::CH_Nodes::CH_ESPCRC_DSR_Disp_Rq_Pr2ES_AUTO;
}

on sysvar sysvar::CH_Nodes::CH_ESPSQC_DSR_Disp_Rq_Pr2ES_AUTO
{
//	EnableSQC("ESP_Disp_Rq2_AR2",  "DSR_Disp_Rq_Pr2", !@this); // 1 = on, 0 = off 
	enableControl("ESP_Disp_Rq2_AR2", "CH_ESPSQC_DSR_Disp_Rq_Pr2ESP_Di_", @this); //1: enable; 0: disable
	SQC_DSR_Disp_Rq_Pr2 = @sysvar::CH_Nodes::CH_ESPSQC_DSR_Disp_Rq_Pr2ES_AUTO;
}

on sysvar sysvar::CH_Nodes::CH_ESPESP_Disp_Rq3_AR_UB_AUTO_01
{
	switch (@sysvar::CH_Nodes::CH_ESPESP_Disp_Rq3_AR_UB_AUTO_01)
	{
		case (0):
			enableControl("ESP_Disp_Rq3_AR", "CH_ESPESP_Disp_Rq3_AR_UB__01", 0); //1: enable; 0: disable
			@sysvar::CH_Nodes::CH_ESPESP_Disp_Rq3_AR_UB__01 = 1;
			break;
		case (1):
			enableControl("ESP_Disp_Rq3_AR", "CH_ESPESP_Disp_Rq3_AR_UB__01", 1); //1: enable; 0: disable
			break;
		case (2):
			enableControl("ESP_Disp_Rq3_AR", "CH_ESPESP_Disp_Rq3_AR_UB__01", 0); //1: enable; 0: disable
			@sysvar::CH_Nodes::CH_ESPESP_Disp_Rq3_AR_UB__01 = 1;
			break;
		case (3):
			enableControl("ESP_Disp_Rq3_AR", "CH_ESPESP_Disp_Rq3_AR_UB__01", 0); //1: enable; 0: disable
			@sysvar::CH_Nodes::CH_ESPESP_Disp_Rq3_AR_UB__01 = 0;
			break;
	}
}

on sysvar sysvar::CH_Nodes::CH_ESPESP_Disp_Rq_AR2_UB_AUTO_01
{
	switch (@sysvar::CH_Nodes::CH_ESPESP_Disp_Rq_AR2_UB_AUTO_01)
	{
		case (0):
			enableControl("ESP_Disp_Rq_AR2", "CH_ESPESP_Disp_Rq_AR2_UB__01", 0); //1: enable; 0: disable
			@sysvar::CH_Nodes::CH_ESPESP_Disp_Rq_AR2_UB__01 = 1;
			break;
		case (1):
			enableControl("ESP_Disp_Rq_AR2", "CH_ESPESP_Disp_Rq_AR2_UB__01", 1); //1: enable; 0: disable
			break;
		case (2):
			enableControl("ESP_Disp_Rq_AR2", "CH_ESPESP_Disp_Rq_AR2_UB__01", 0); //1: enable; 0: disable
			@sysvar::CH_Nodes::CH_ESPESP_Disp_Rq_AR2_UB__01 = 1;
			break;
		case (3):
			enableControl("ESP_Disp_Rq_AR2", "CH_ESPESP_Disp_Rq_AR2_UB__01", 0); //1: enable; 0: disable
			@sysvar::CH_Nodes::CH_ESPESP_Disp_Rq_AR2_UB__01 = 0;
			break;
	}
}

on sysvar sysvar::CH_Nodes::CH_ESPCRC_ESP_Disp_Rq_Pr2ES_AUTO
{
//	EnableCRC("ESP_Disp_Rq_AR2",  "ESP_Disp_Rq_Pr2", !@this); // 1 = on, 0 = off 
	enableControl("ESP_Disp_Rq_AR2", "CH_ESPCRC_ESP_Disp_Rq_Pr2ESP_Di_", @this); //1: enable; 0: disable
	CRC_ESP_Disp_Rq_Pr2 = @sysvar::CH_Nodes::CH_ESPCRC_ESP_Disp_Rq_Pr2ES_AUTO;
}

on sysvar sysvar::CH_Nodes::CH_ESPSQC_ESP_Disp_Rq_Pr2ES_AUTO
{
//	EnableSQC("ESP_Disp_Rq_AR2",  "ESP_Disp_Rq_Pr2", !@this); // 1 = on, 0 = off 
	enableControl("ESP_Disp_Rq_AR2", "CH_ESPSQC_ESP_Disp_Rq_Pr2ESP_Di_", @this); //1: enable; 0: disable
	SQC_ESP_Disp_Rq_Pr2 = @sysvar::CH_Nodes::CH_ESPSQC_ESP_Disp_Rq_Pr2ES_AUTO;
}

on sysvar sysvar::CH_Nodes::CH_ESPESP_OBD_Stat_AR_UB_AUTO_01
{
	switch (@sysvar::CH_Nodes::CH_ESPESP_OBD_Stat_AR_UB_AUTO_01)
	{
		case (0):
			enableControl("ESP_OBD_Stat_AR", "CH_ESPESP_OBD_Stat_AR_UB__01", 0); //1: enable; 0: disable
			@sysvar::CH_Nodes::CH_ESPESP_OBD_Stat_AR_UB__01 = 1;
			break;
		case (1):
			enableControl("ESP_OBD_Stat_AR", "CH_ESPESP_OBD_Stat_AR_UB__01", 1); //1: enable; 0: disable
			break;
		case (2):
			enableControl("ESP_OBD_Stat_AR", "CH_ESPESP_OBD_Stat_AR_UB__01", 0); //1: enable; 0: disable
			@sysvar::CH_Nodes::CH_ESPESP_OBD_Stat_AR_UB__01 = 1;
			break;
		case (3):
			enableControl("ESP_OBD_Stat_AR", "CH_ESPESP_OBD_Stat_AR_UB__01", 0); //1: enable; 0: disable
			@sysvar::CH_Nodes::CH_ESPESP_OBD_Stat_AR_UB__01 = 0;
			break;
	}
}

on sysvar sysvar::CH_Nodes::CH_ESPLDC_Disp_Rq_ESP_AR_UB_A_01
{
	switch (@sysvar::CH_Nodes::CH_ESPLDC_Disp_Rq_ESP_AR_UB_A_01)
	{
		case (0):
			enableControl("LDC_Disp_Rq_ESP_AR", "CH_ESPLDC_Disp_Rq_ESP_AR_UB__01", 0); //1: enable; 0: disable
			@sysvar::CH_Nodes::CH_ESPLDC_Disp_Rq_ESP_AR_UB__01 = 1;
			break;
		case (1):
			enableControl("LDC_Disp_Rq_ESP_AR", "CH_ESPLDC_Disp_Rq_ESP_AR_UB__01", 1); //1: enable; 0: disable
			break;
		case (2):
			enableControl("LDC_Disp_Rq_ESP_AR", "CH_ESPLDC_Disp_Rq_ESP_AR_UB__01", 0); //1: enable; 0: disable
			@sysvar::CH_Nodes::CH_ESPLDC_Disp_Rq_ESP_AR_UB__01 = 1;
			break;
		case (3):
			enableControl("LDC_Disp_Rq_ESP_AR", "CH_ESPLDC_Disp_Rq_ESP_AR_UB__01", 0); //1: enable; 0: disable
			@sysvar::CH_Nodes::CH_ESPLDC_Disp_Rq_ESP_AR_UB__01 = 0;
			break;
	}
}

on sysvar sysvar::CH_Nodes::CH_ESPPARK_Brk_Rs_AR2_UB_AUTO_01
{
	switch (@sysvar::CH_Nodes::CH_ESPPARK_Brk_Rs_AR2_UB_AUTO_01)
	{
		case (0):
			enableControl("PARK_Brk_Rs_AR2", "CH_ESPPARK_Brk_Rs_AR2_UB__01", 0); //1: enable; 0: disable
			@sysvar::CH_Nodes::CH_ESPPARK_Brk_Rs_AR2_UB__01 = 1;
			break;
		case (1):
			enableControl("PARK_Brk_Rs_AR2", "CH_ESPPARK_Brk_Rs_AR2_UB__01", 1); //1: enable; 0: disable
			break;
		case (2):
			enableControl("PARK_Brk_Rs_AR2", "CH_ESPPARK_Brk_Rs_AR2_UB__01", 0); //1: enable; 0: disable
			@sysvar::CH_Nodes::CH_ESPPARK_Brk_Rs_AR2_UB__01 = 1;
			break;
		case (3):
			enableControl("PARK_Brk_Rs_AR2", "CH_ESPPARK_Brk_Rs_AR2_UB__01", 0); //1: enable; 0: disable
			@sysvar::CH_Nodes::CH_ESPPARK_Brk_Rs_AR2_UB__01 = 0;
			break;
	}
}

on sysvar sysvar::CH_Nodes::CH_ESPCRC_PARK_Brk_Rs_Pr2PA_AUTO
{
//	EnableCRC("PARK_Brk_Rs_AR2",  "PARK_Brk_Rs_Pr2", !@this); // 1 = on, 0 = off 
	enableControl("PARK_Brk_Rs_AR2", "CH_ESPCRC_PARK_Brk_Rs_Pr2PARK_B_", @this); //1: enable; 0: disable
	CRC_PARK_Brk_Rs_Pr2 = @sysvar::CH_Nodes::CH_ESPCRC_PARK_Brk_Rs_Pr2PA_AUTO;
}

on sysvar sysvar::CH_Nodes::CH_ESPSQC_PARK_Brk_Rs_Pr2PA_AUTO
{
//	EnableSQC("PARK_Brk_Rs_AR2",  "PARK_Brk_Rs_Pr2", !@this); // 1 = on, 0 = off 
	enableControl("PARK_Brk_Rs_AR2", "CH_ESPSQC_PARK_Brk_Rs_Pr2PARK_B_", @this); //1: enable; 0: disable
	SQC_PARK_Brk_Rs_Pr2 = @sysvar::CH_Nodes::CH_ESPSQC_PARK_Brk_Rs_Pr2PA_AUTO;
}

on sysvar sysvar::CH_Nodes::CH_ESPPARK_Drv_Rq_ESP_AR_UB_A_01
{
	switch (@sysvar::CH_Nodes::CH_ESPPARK_Drv_Rq_ESP_AR_UB_A_01)
	{
		case (0):
			enableControl("PARK_Drv_Rq_ESP_AR2", "CH_ESPPARK_Drv_Rq_ESP_AR2_UB__01", 0); //1: enable; 0: disable
			@sysvar::CH_Nodes::CH_ESPPARK_Drv_Rq_ESP_AR2_UB__01 = 1;
			break;
		case (1):
			enableControl("PARK_Drv_Rq_ESP_AR2", "CH_ESPPARK_Drv_Rq_ESP_AR2_UB__01", 1); //1: enable; 0: disable
			break;
		case (2):
			enableControl("PARK_Drv_Rq_ESP_AR2", "CH_ESPPARK_Drv_Rq_ESP_AR2_UB__01", 0); //1: enable; 0: disable
			@sysvar::CH_Nodes::CH_ESPPARK_Drv_Rq_ESP_AR2_UB__01 = 1;
			break;
		case (3):
			enableControl("PARK_Drv_Rq_ESP_AR2", "CH_ESPPARK_Drv_Rq_ESP_AR2_UB__01", 0); //1: enable; 0: disable
			@sysvar::CH_Nodes::CH_ESPPARK_Drv_Rq_ESP_AR2_UB__01 = 0;
			break;
	}
}

on sysvar sysvar::CH_Nodes::CH_ESPCRC_PARK_Drv_Rq_ESP_P_AUTO
{
//	EnableCRC("PARK_Drv_Rq_ESP_AR2",  "PARK_Drv_Rq_ESP_Pr2", !@this); // 1 = on, 0 = off 
	enableControl("PARK_Drv_Rq_ESP_AR2", "CH_ESPCRC_PARK_Drv_Rq_ESP_Pr2PA_", @this); //1: enable; 0: disable
	CRC_PARK_Drv_Rq_ESP_Pr2 = @sysvar::CH_Nodes::CH_ESPCRC_PARK_Drv_Rq_ESP_P_AUTO;
}

on sysvar sysvar::CH_Nodes::CH_ESPSQC_PARK_Drv_Rq_ESP_P_AUTO
{
//	EnableSQC("PARK_Drv_Rq_ESP_AR2",  "PARK_Drv_Rq_ESP_Pr2", !@this); // 1 = on, 0 = off 
	enableControl("PARK_Drv_Rq_ESP_AR2", "CH_ESPSQC_PARK_Drv_Rq_ESP_Pr2PA_", @this); //1: enable; 0: disable
	SQC_PARK_Drv_Rq_ESP_Pr2 = @sysvar::CH_Nodes::CH_ESPSQC_PARK_Drv_Rq_ESP_P_AUTO;
}

on sysvar sysvar::CH_Nodes::CH_ESPPresfCtrl_Rq_ESP_A_UB_A_01
{
	switch (@sysvar::CH_Nodes::CH_ESPPresfCtrl_Rq_ESP_A_UB_A_01)
	{
		case (0):
			enableControl("PresfCtrl_Rq_ESP_AR2", "CH_ESPPresfCtrl_Rq_ESP_AR2_UB_01", 0); //1: enable; 0: disable
			@sysvar::CH_Nodes::CH_ESPPresfCtrl_Rq_ESP_AR2_UB_01 = 1;
			break;
		case (1):
			enableControl("PresfCtrl_Rq_ESP_AR2", "CH_ESPPresfCtrl_Rq_ESP_AR2_UB_01", 1); //1: enable; 0: disable
			break;
		case (2):
			enableControl("PresfCtrl_Rq_ESP_AR2", "CH_ESPPresfCtrl_Rq_ESP_AR2_UB_01", 0); //1: enable; 0: disable
			@sysvar::CH_Nodes::CH_ESPPresfCtrl_Rq_ESP_AR2_UB_01 = 1;
			break;
		case (3):
			enableControl("PresfCtrl_Rq_ESP_AR2", "CH_ESPPresfCtrl_Rq_ESP_AR2_UB_01", 0); //1: enable; 0: disable
			@sysvar::CH_Nodes::CH_ESPPresfCtrl_Rq_ESP_AR2_UB_01 = 0;
			break;
	}
}

on sysvar sysvar::CH_Nodes::CH_ESPCRC_PresfCtrl_Rq_ESP__AUTO
{
//	EnableCRC("PresfCtrl_Rq_ESP_AR2",  "PresfCtrl_Rq_ESP_Pr2", !@this); // 1 = on, 0 = off 
	enableControl("PresfCtrl_Rq_ESP_AR2", "CH_ESPCRC_PresfCtrl_Rq_ESP_Pr2P_", @this); //1: enable; 0: disable
	CRC_PresfCtrl_Rq_ESP_Pr2 = @sysvar::CH_Nodes::CH_ESPCRC_PresfCtrl_Rq_ESP__AUTO;
}

on sysvar sysvar::CH_Nodes::CH_ESPSQC_PresfCtrl_Rq_ESP__AUTO
{
//	EnableSQC("PresfCtrl_Rq_ESP_AR2",  "PresfCtrl_Rq_ESP_Pr2", !@this); // 1 = on, 0 = off 
	enableControl("PresfCtrl_Rq_ESP_AR2", "CH_ESPSQC_PresfCtrl_Rq_ESP_Pr2P_", @this); //1: enable; 0: disable
	SQC_PresfCtrl_Rq_ESP_Pr2 = @sysvar::CH_Nodes::CH_ESPSQC_PresfCtrl_Rq_ESP__AUTO;
}

on sysvar sysvar::CH_Nodes::CH_ESPPresfAct_Adj_TglPresf_AUTO
{
//	EnableTGL("PresfCtrl_Rq_ESP_AR2",  "resfAct_Adj_", !@this); // 1 = on, 0 = off 
	enableControl("PresfCtrl_Rq_ESP_AR2", "CH_ESPPresfAct_Adj_TglPresfCtrl_", @this); //1: enable; 0: disable
	TGL_resfAct_Adj_ = @sysvar::CH_Nodes::CH_ESPPresfAct_Adj_TglPresf_AUTO;
}

on sysvar sysvar::CH_Nodes::CH_ESPPT_Rq_ESP_AR2_UB_AUTO_01
{
	switch (@sysvar::CH_Nodes::CH_ESPPT_Rq_ESP_AR2_UB_AUTO_01)
	{
		case (0):
			enableControl("PT_Rq_ESP_AR2", "CH_ESPPT_Rq_ESP_AR2_UB__01", 0); //1: enable; 0: disable
			@sysvar::CH_Nodes::CH_ESPPT_Rq_ESP_AR2_UB__01 = 1;
			break;
		case (1):
			enableControl("PT_Rq_ESP_AR2", "CH_ESPPT_Rq_ESP_AR2_UB__01", 1); //1: enable; 0: disable
			break;
		case (2):
			enableControl("PT_Rq_ESP_AR2", "CH_ESPPT_Rq_ESP_AR2_UB__01", 0); //1: enable; 0: disable
			@sysvar::CH_Nodes::CH_ESPPT_Rq_ESP_AR2_UB__01 = 1;
			break;
		case (3):
			enableControl("PT_Rq_ESP_AR2", "CH_ESPPT_Rq_ESP_AR2_UB__01", 0); //1: enable; 0: disable
			@sysvar::CH_Nodes::CH_ESPPT_Rq_ESP_AR2_UB__01 = 0;
			break;
	}
}

on sysvar sysvar::CH_Nodes::CH_ESPCRC_PT_Rq_ESP_Pr2PT_R_AUTO
{
//	EnableCRC("PT_Rq_ESP_AR2",  "PT_Rq_ESP_Pr2", !@this); // 1 = on, 0 = off 
	enableControl("PT_Rq_ESP_AR2", "CH_ESPCRC_PT_Rq_ESP_Pr2PT_Rq_ES_", @this); //1: enable; 0: disable
	CRC_PT_Rq_ESP_Pr2 = @sysvar::CH_Nodes::CH_ESPCRC_PT_Rq_ESP_Pr2PT_R_AUTO;
}

on sysvar sysvar::CH_Nodes::CH_ESPSQC_PT_Rq_ESP_Pr2PT_R_AUTO
{
//	EnableSQC("PT_Rq_ESP_AR2",  "PT_Rq_ESP_Pr2", !@this); // 1 = on, 0 = off 
	enableControl("PT_Rq_ESP_AR2", "CH_ESPSQC_PT_Rq_ESP_Pr2PT_Rq_ES_", @this); //1: enable; 0: disable
	SQC_PT_Rq_ESP_Pr2 = @sysvar::CH_Nodes::CH_ESPSQC_PT_Rq_ESP_Pr2PT_R_AUTO;
}

on sysvar sysvar::CH_Nodes::CH_ESPCRC_SADR_Trgr_ESP_Pr2_AUTO
{
//	EnableCRC("SADR_Trgr_ESP_AR2",  "SADR_Trgr_ESP_Pr2", !@this); // 1 = on, 0 = off 
	enableControl("SADR_Trgr_ESP_AR2", "CH_ESPCRC_SADR_Trgr_ESP_Pr2SADR_", @this); //1: enable; 0: disable
	CRC_SADR_Trgr_ESP_Pr2 = @sysvar::CH_Nodes::CH_ESPCRC_SADR_Trgr_ESP_Pr2_AUTO;
}

on sysvar sysvar::CH_Nodes::CH_ESPSQC_SADR_Trgr_ESP_Pr2_AUTO
{
//	EnableSQC("SADR_Trgr_ESP_AR2",  "SADR_Trgr_ESP_Pr2", !@this); // 1 = on, 0 = off 
	enableControl("SADR_Trgr_ESP_AR2", "CH_ESPSQC_SADR_Trgr_ESP_Pr2SADR_", @this); //1: enable; 0: disable
	SQC_SADR_Trgr_ESP_Pr2 = @sysvar::CH_Nodes::CH_ESPSQC_SADR_Trgr_ESP_Pr2_AUTO;
}

on sysvar sysvar::CH_Nodes::CH_ESPSt_Rq_STA_AR2_UB_AUTO_01
{
	switch (@sysvar::CH_Nodes::CH_ESPSt_Rq_STA_AR2_UB_AUTO_01)
	{
		case (0):
			enableControl("St_Rq_STA_AR2", "CH_ESPSt_Rq_STA_AR2_UB__01", 0); //1: enable; 0: disable
			@sysvar::CH_Nodes::CH_ESPSt_Rq_STA_AR2_UB__01 = 1;
			break;
		case (1):
			enableControl("St_Rq_STA_AR2", "CH_ESPSt_Rq_STA_AR2_UB__01", 1); //1: enable; 0: disable
			break;
		case (2):
			enableControl("St_Rq_STA_AR2", "CH_ESPSt_Rq_STA_AR2_UB__01", 0); //1: enable; 0: disable
			@sysvar::CH_Nodes::CH_ESPSt_Rq_STA_AR2_UB__01 = 1;
			break;
		case (3):
			enableControl("St_Rq_STA_AR2", "CH_ESPSt_Rq_STA_AR2_UB__01", 0); //1: enable; 0: disable
			@sysvar::CH_Nodes::CH_ESPSt_Rq_STA_AR2_UB__01 = 0;
			break;
	}
}

on sysvar sysvar::CH_Nodes::CH_ESPCRC_St_Rq_STA_Pr2St_R_AUTO
{
//	EnableCRC("St_Rq_STA_AR2",  "St_Rq_STA_Pr2", !@this); // 1 = on, 0 = off 
	enableControl("St_Rq_STA_AR2", "CH_ESPCRC_St_Rq_STA_Pr2St_Rq_ST_", @this); //1: enable; 0: disable
	CRC_St_Rq_STA_Pr2 = @sysvar::CH_Nodes::CH_ESPCRC_St_Rq_STA_Pr2St_R_AUTO;
}

on sysvar sysvar::CH_Nodes::CH_ESPSQC_St_Rq_STA_Pr2St_R_AUTO
{
//	EnableSQC("St_Rq_STA_AR2",  "St_Rq_STA_Pr2", !@this); // 1 = on, 0 = off 
	enableControl("St_Rq_STA_AR2", "CH_ESPSQC_St_Rq_STA_Pr2St_Rq_ST_", @this); //1: enable; 0: disable
	SQC_St_Rq_STA_Pr2 = @sysvar::CH_Nodes::CH_ESPSQC_St_Rq_STA_Pr2St_R_AUTO;
}

on sysvar sysvar::CH_Nodes::CH_ESPTBCSC_Rs1_ESP_AR2_UB_AU_01
{
	switch (@sysvar::CH_Nodes::CH_ESPTBCSC_Rs1_ESP_AR2_UB_AU_01)
	{
		case (0):
			enableControl("TBCSC_Rs1_ESP_AR2", "CH_ESPTBCSC_Rs1_ESP_AR2_UB__01", 0); //1: enable; 0: disable
			@sysvar::CH_Nodes::CH_ESPTBCSC_Rs1_ESP_AR2_UB__01 = 1;
			break;
		case (1):
			enableControl("TBCSC_Rs1_ESP_AR2", "CH_ESPTBCSC_Rs1_ESP_AR2_UB__01", 1); //1: enable; 0: disable
			break;
		case (2):
			enableControl("TBCSC_Rs1_ESP_AR2", "CH_ESPTBCSC_Rs1_ESP_AR2_UB__01", 0); //1: enable; 0: disable
			@sysvar::CH_Nodes::CH_ESPTBCSC_Rs1_ESP_AR2_UB__01 = 1;
			break;
		case (3):
			enableControl("TBCSC_Rs1_ESP_AR2", "CH_ESPTBCSC_Rs1_ESP_AR2_UB__01", 0); //1: enable; 0: disable
			@sysvar::CH_Nodes::CH_ESPTBCSC_Rs1_ESP_AR2_UB__01 = 0;
			break;
	}
}

on sysvar sysvar::CH_Nodes::CH_ESPCRC_TBCSC_Rs1_ESP_Pr2_AUTO
{
//	EnableCRC("TBCSC_Rs1_ESP_AR2",  "TBCSC_Rs1_ESP_Pr2", !@this); // 1 = on, 0 = off 
	enableControl("TBCSC_Rs1_ESP_AR2", "CH_ESPCRC_TBCSC_Rs1_ESP_Pr2TBCS_", @this); //1: enable; 0: disable
	CRC_TBCSC_Rs1_ESP_Pr2 = @sysvar::CH_Nodes::CH_ESPCRC_TBCSC_Rs1_ESP_Pr2_AUTO;
}

on sysvar sysvar::CH_Nodes::CH_ESPSQC_TBCSC_Rs1_ESP_Pr2_AUTO
{
//	EnableSQC("TBCSC_Rs1_ESP_AR2",  "TBCSC_Rs1_ESP_Pr2", !@this); // 1 = on, 0 = off 
	enableControl("TBCSC_Rs1_ESP_AR2", "CH_ESPSQC_TBCSC_Rs1_ESP_Pr2TBCS_", @this); //1: enable; 0: disable
	SQC_TBCSC_Rs1_ESP_Pr2 = @sysvar::CH_Nodes::CH_ESPSQC_TBCSC_Rs1_ESP_Pr2_AUTO;
}

on sysvar sysvar::CH_Nodes::CH_ESPTBCSC_Rs2_ESP_AR2_UB_AU_01
{
	switch (@sysvar::CH_Nodes::CH_ESPTBCSC_Rs2_ESP_AR2_UB_AU_01)
	{
		case (0):
			enableControl("TBCSC_Rs2_ESP_AR2", "CH_ESPTBCSC_Rs2_ESP_AR2_UB__01", 0); //1: enable; 0: disable
			@sysvar::CH_Nodes::CH_ESPTBCSC_Rs2_ESP_AR2_UB__01 = 1;
			break;
		case (1):
			enableControl("TBCSC_Rs2_ESP_AR2", "CH_ESPTBCSC_Rs2_ESP_AR2_UB__01", 1); //1: enable; 0: disable
			break;
		case (2):
			enableControl("TBCSC_Rs2_ESP_AR2", "CH_ESPTBCSC_Rs2_ESP_AR2_UB__01", 0); //1: enable; 0: disable
			@sysvar::CH_Nodes::CH_ESPTBCSC_Rs2_ESP_AR2_UB__01 = 1;
			break;
		case (3):
			enableControl("TBCSC_Rs2_ESP_AR2", "CH_ESPTBCSC_Rs2_ESP_AR2_UB__01", 0); //1: enable; 0: disable
			@sysvar::CH_Nodes::CH_ESPTBCSC_Rs2_ESP_AR2_UB__01 = 0;
			break;
	}
}

on sysvar sysvar::CH_Nodes::CH_ESPCRC_TBCSC_Rs2_ESP_Pr2_AUTO
{
//	EnableCRC("TBCSC_Rs2_ESP_AR2",  "TBCSC_Rs2_ESP_Pr2", !@this); // 1 = on, 0 = off 
	enableControl("TBCSC_Rs2_ESP_AR2", "CH_ESPCRC_TBCSC_Rs2_ESP_Pr2TBCS_", @this); //1: enable; 0: disable
	CRC_TBCSC_Rs2_ESP_Pr2 = @sysvar::CH_Nodes::CH_ESPCRC_TBCSC_Rs2_ESP_Pr2_AUTO;
}

on sysvar sysvar::CH_Nodes::CH_ESPSQC_TBCSC_Rs2_ESP_Pr2_AUTO
{
//	EnableSQC("TBCSC_Rs2_ESP_AR2",  "TBCSC_Rs2_ESP_Pr2", !@this); // 1 = on, 0 = off 
	enableControl("TBCSC_Rs2_ESP_AR2", "CH_ESPSQC_TBCSC_Rs2_ESP_Pr2TBCS_", @this); //1: enable; 0: disable
	SQC_TBCSC_Rs2_ESP_Pr2 = @sysvar::CH_Nodes::CH_ESPSQC_TBCSC_Rs2_ESP_Pr2_AUTO;
}

on sysvar sysvar::CH_Nodes::CH_ESPVehAccel_X_Rs1_AR2_UB_A_01
{
	switch (@sysvar::CH_Nodes::CH_ESPVehAccel_X_Rs1_AR2_UB_A_01)
	{
		case (0):
			enableControl("VehAccel_X_Rs1_AR2", "CH_ESPVehAccel_X_Rs1_AR2_UB__01", 0); //1: enable; 0: disable
			@sysvar::CH_Nodes::CH_ESPVehAccel_X_Rs1_AR2_UB__01 = 1;
			break;
		case (1):
			enableControl("VehAccel_X_Rs1_AR2", "CH_ESPVehAccel_X_Rs1_AR2_UB__01", 1); //1: enable; 0: disable
			break;
		case (2):
			enableControl("VehAccel_X_Rs1_AR2", "CH_ESPVehAccel_X_Rs1_AR2_UB__01", 0); //1: enable; 0: disable
			@sysvar::CH_Nodes::CH_ESPVehAccel_X_Rs1_AR2_UB__01 = 1;
			break;
		case (3):
			enableControl("VehAccel_X_Rs1_AR2", "CH_ESPVehAccel_X_Rs1_AR2_UB__01", 0); //1: enable; 0: disable
			@sysvar::CH_Nodes::CH_ESPVehAccel_X_Rs1_AR2_UB__01 = 0;
			break;
	}
}

on sysvar sysvar::CH_Nodes::CH_ESPCRC_VehAccel_X_Rs1_Pr_AUTO
{
//	EnableCRC("VehAccel_X_Rs1_AR2",  "VehAccel_X_Rs1_Pr2", !@this); // 1 = on, 0 = off 
	enableControl("VehAccel_X_Rs1_AR2", "CH_ESPCRC_VehAccel_X_Rs1_Pr2Veh_", @this); //1: enable; 0: disable
	CRC_VehAccel_X_Rs1_Pr2 = @sysvar::CH_Nodes::CH_ESPCRC_VehAccel_X_Rs1_Pr_AUTO;
}

on sysvar sysvar::CH_Nodes::CH_ESPSQC_VehAccel_X_Rs1_Pr_AUTO
{
//	EnableSQC("VehAccel_X_Rs1_AR2",  "VehAccel_X_Rs1_Pr2", !@this); // 1 = on, 0 = off 
	enableControl("VehAccel_X_Rs1_AR2", "CH_ESPSQC_VehAccel_X_Rs1_Pr2Veh_", @this); //1: enable; 0: disable
	SQC_VehAccel_X_Rs1_Pr2 = @sysvar::CH_Nodes::CH_ESPSQC_VehAccel_X_Rs1_Pr_AUTO;
}

on sysvar sysvar::CH_Nodes::CH_ESPVehAccel_X_Rs2_AR2_UB_A_01
{
	switch (@sysvar::CH_Nodes::CH_ESPVehAccel_X_Rs2_AR2_UB_A_01)
	{
		case (0):
			enableControl("VehAccel_X_Rs2_AR2", "CH_ESPVehAccel_X_Rs2_AR2_UB__01", 0); //1: enable; 0: disable
			@sysvar::CH_Nodes::CH_ESPVehAccel_X_Rs2_AR2_UB__01 = 1;
			break;
		case (1):
			enableControl("VehAccel_X_Rs2_AR2", "CH_ESPVehAccel_X_Rs2_AR2_UB__01", 1); //1: enable; 0: disable
			break;
		case (2):
			enableControl("VehAccel_X_Rs2_AR2", "CH_ESPVehAccel_X_Rs2_AR2_UB__01", 0); //1: enable; 0: disable
			@sysvar::CH_Nodes::CH_ESPVehAccel_X_Rs2_AR2_UB__01 = 1;
			break;
		case (3):
			enableControl("VehAccel_X_Rs2_AR2", "CH_ESPVehAccel_X_Rs2_AR2_UB__01", 0); //1: enable; 0: disable
			@sysvar::CH_Nodes::CH_ESPVehAccel_X_Rs2_AR2_UB__01 = 0;
			break;
	}
}

on sysvar sysvar::CH_Nodes::CH_ESPCRC_VehAccel_X_Rs2_Pr_AUTO
{
//	EnableCRC("VehAccel_X_Rs2_AR2",  "VehAccel_X_Rs2_Pr2", !@this); // 1 = on, 0 = off 
	enableControl("VehAccel_X_Rs2_AR2", "CH_ESPCRC_VehAccel_X_Rs2_Pr2Veh_", @this); //1: enable; 0: disable
	CRC_VehAccel_X_Rs2_Pr2 = @sysvar::CH_Nodes::CH_ESPCRC_VehAccel_X_Rs2_Pr_AUTO;
}

on sysvar sysvar::CH_Nodes::CH_ESPSQC_VehAccel_X_Rs2_Pr_AUTO
{
//	EnableSQC("VehAccel_X_Rs2_AR2",  "VehAccel_X_Rs2_Pr2", !@this); // 1 = on, 0 = off 
	enableControl("VehAccel_X_Rs2_AR2", "CH_ESPSQC_VehAccel_X_Rs2_Pr2Veh_", @this); //1: enable; 0: disable
	SQC_VehAccel_X_Rs2_Pr2 = @sysvar::CH_Nodes::CH_ESPSQC_VehAccel_X_Rs2_Pr_AUTO;
}

on sysvar sysvar::CH_Nodes::CH_ESPVehDyn_Stat1_AR2_UB_AUT_01
{
	switch (@sysvar::CH_Nodes::CH_ESPVehDyn_Stat1_AR2_UB_AUT_01)
	{
		case (0):
			enableControl("VehDyn_Stat1_AR2", "CH_ESPVehDyn_Stat1_AR2_UB__01", 0); //1: enable; 0: disable
			@sysvar::CH_Nodes::CH_ESPVehDyn_Stat1_AR2_UB__01 = 1;
			break;
		case (1):
			enableControl("VehDyn_Stat1_AR2", "CH_ESPVehDyn_Stat1_AR2_UB__01", 1); //1: enable; 0: disable
			break;
		case (2):
			enableControl("VehDyn_Stat1_AR2", "CH_ESPVehDyn_Stat1_AR2_UB__01", 0); //1: enable; 0: disable
			@sysvar::CH_Nodes::CH_ESPVehDyn_Stat1_AR2_UB__01 = 1;
			break;
		case (3):
			enableControl("VehDyn_Stat1_AR2", "CH_ESPVehDyn_Stat1_AR2_UB__01", 0); //1: enable; 0: disable
			@sysvar::CH_Nodes::CH_ESPVehDyn_Stat1_AR2_UB__01 = 0;
			break;
	}
}

on sysvar sysvar::CH_Nodes::CH_ESPCRC_VehDyn_Stat1_Pr2V_AUTO
{
//	EnableCRC("VehDyn_Stat1_AR2",  "VehDyn_Stat1_Pr2", !@this); // 1 = on, 0 = off 
	enableControl("VehDyn_Stat1_AR2", "CH_ESPCRC_VehDyn_Stat1_Pr2VehDy_", @this); //1: enable; 0: disable
	CRC_VehDyn_Stat1_Pr2 = @sysvar::CH_Nodes::CH_ESPCRC_VehDyn_Stat1_Pr2V_AUTO;
}

on sysvar sysvar::CH_Nodes::CH_ESPSQC_VehDyn_Stat1_Pr2V_AUTO
{
//	EnableSQC("VehDyn_Stat1_AR2",  "VehDyn_Stat1_Pr2", !@this); // 1 = on, 0 = off 
	enableControl("VehDyn_Stat1_AR2", "CH_ESPSQC_VehDyn_Stat1_Pr2VehDy_", @this); //1: enable; 0: disable
	SQC_VehDyn_Stat1_Pr2 = @sysvar::CH_Nodes::CH_ESPSQC_VehDyn_Stat1_Pr2V_AUTO;
}

on sysvar sysvar::CH_Nodes::CH_ESPVehDyn_Stat2_AR2_UB_AUT_01
{
	switch (@sysvar::CH_Nodes::CH_ESPVehDyn_Stat2_AR2_UB_AUT_01)
	{
		case (0):
			enableControl("VehDyn_Stat2_AR2", "CH_ESPVehDyn_Stat2_AR2_UB__01", 0); //1: enable; 0: disable
			@sysvar::CH_Nodes::CH_ESPVehDyn_Stat2_AR2_UB__01 = 1;
			break;
		case (1):
			enableControl("VehDyn_Stat2_AR2", "CH_ESPVehDyn_Stat2_AR2_UB__01", 1); //1: enable; 0: disable
			break;
		case (2):
			enableControl("VehDyn_Stat2_AR2", "CH_ESPVehDyn_Stat2_AR2_UB__01", 0); //1: enable; 0: disable
			@sysvar::CH_Nodes::CH_ESPVehDyn_Stat2_AR2_UB__01 = 1;
			break;
		case (3):
			enableControl("VehDyn_Stat2_AR2", "CH_ESPVehDyn_Stat2_AR2_UB__01", 0); //1: enable; 0: disable
			@sysvar::CH_Nodes::CH_ESPVehDyn_Stat2_AR2_UB__01 = 0;
			break;
	}
}

on sysvar sysvar::CH_Nodes::CH_ESPCRC_VehDyn_Stat2_Pr2V_AUTO
{
//	EnableCRC("VehDyn_Stat2_AR2",  "VehDyn_Stat2_Pr2", !@this); // 1 = on, 0 = off 
	enableControl("VehDyn_Stat2_AR2", "CH_ESPCRC_VehDyn_Stat2_Pr2VehDy_", @this); //1: enable; 0: disable
	CRC_VehDyn_Stat2_Pr2 = @sysvar::CH_Nodes::CH_ESPCRC_VehDyn_Stat2_Pr2V_AUTO;
}

on sysvar sysvar::CH_Nodes::CH_ESPSQC_VehDyn_Stat2_Pr2V_AUTO
{
//	EnableSQC("VehDyn_Stat2_AR2",  "VehDyn_Stat2_Pr2", !@this); // 1 = on, 0 = off 
	enableControl("VehDyn_Stat2_AR2", "CH_ESPSQC_VehDyn_Stat2_Pr2VehDy_", @this); //1: enable; 0: disable
	SQC_VehDyn_Stat2_Pr2 = @sysvar::CH_Nodes::CH_ESPSQC_VehDyn_Stat2_Pr2V_AUTO;
}

on sysvar sysvar::CH_Nodes::CH_ESPVehSpd_X_AR2_UB_AUTO_01
{
	switch (@sysvar::CH_Nodes::CH_ESPVehSpd_X_AR2_UB_AUTO_01)
	{
		case (0):
			enableControl("VehSpd_X_AR2", "CH_ESPVehSpd_X_AR2_UB__01", 0); //1: enable; 0: disable
			@sysvar::CH_Nodes::CH_ESPVehSpd_X_AR2_UB__01 = 1;
			break;
		case (1):
			enableControl("VehSpd_X_AR2", "CH_ESPVehSpd_X_AR2_UB__01", 1); //1: enable; 0: disable
			break;
		case (2):
			enableControl("VehSpd_X_AR2", "CH_ESPVehSpd_X_AR2_UB__01", 0); //1: enable; 0: disable
			@sysvar::CH_Nodes::CH_ESPVehSpd_X_AR2_UB__01 = 1;
			break;
		case (3):
			enableControl("VehSpd_X_AR2", "CH_ESPVehSpd_X_AR2_UB__01", 0); //1: enable; 0: disable
			@sysvar::CH_Nodes::CH_ESPVehSpd_X_AR2_UB__01 = 0;
			break;
	}
}

on sysvar sysvar::CH_Nodes::CH_ESPCRC_VehSpd_X_Pr2VehSp_AUTO
{
//	EnableCRC("VehSpd_X_AR2",  "VehSpd_X_Pr2", !@this); // 1 = on, 0 = off 
	enableControl("VehSpd_X_AR2", "CH_ESPCRC_VehSpd_X_Pr2VehSpd_X__", @this); //1: enable; 0: disable
	CRC_VehSpd_X_Pr2 = @sysvar::CH_Nodes::CH_ESPCRC_VehSpd_X_Pr2VehSp_AUTO;
}

on sysvar sysvar::CH_Nodes::CH_ESPSQC_VehSpd_X_Pr2VehSp_AUTO
{
//	EnableSQC("VehSpd_X_AR2",  "VehSpd_X_Pr2", !@this); // 1 = on, 0 = off 
	enableControl("VehSpd_X_AR2", "CH_ESPSQC_VehSpd_X_Pr2VehSpd_X__", @this); //1: enable; 0: disable
	SQC_VehSpd_X_Pr2 = @sysvar::CH_Nodes::CH_ESPSQC_VehSpd_X_Pr2VehSp_AUTO;
}

on sysvar sysvar::CH_Nodes::CH_ESPWhl_Lt_Stat_AR2_UB_AUTO_01
{
	switch (@sysvar::CH_Nodes::CH_ESPWhl_Lt_Stat_AR2_UB_AUTO_01)
	{
		case (0):
			enableControl("Whl_Lt_Stat_AR2", "CH_ESPWhl_Lt_Stat_AR2_UB__01", 0); //1: enable; 0: disable
			@sysvar::CH_Nodes::CH_ESPWhl_Lt_Stat_AR2_UB__01 = 1;
			break;
		case (1):
			enableControl("Whl_Lt_Stat_AR2", "CH_ESPWhl_Lt_Stat_AR2_UB__01", 1); //1: enable; 0: disable
			break;
		case (2):
			enableControl("Whl_Lt_Stat_AR2", "CH_ESPWhl_Lt_Stat_AR2_UB__01", 0); //1: enable; 0: disable
			@sysvar::CH_Nodes::CH_ESPWhl_Lt_Stat_AR2_UB__01 = 1;
			break;
		case (3):
			enableControl("Whl_Lt_Stat_AR2", "CH_ESPWhl_Lt_Stat_AR2_UB__01", 0); //1: enable; 0: disable
			@sysvar::CH_Nodes::CH_ESPWhl_Lt_Stat_AR2_UB__01 = 0;
			break;
	}
}

on sysvar sysvar::CH_Nodes::CH_ESPCRC_Whl_Lt_Stat_Pr2Wh_AUTO
{
//	EnableCRC("Whl_Lt_Stat_AR2",  "Whl_Lt_Stat_Pr2", !@this); // 1 = on, 0 = off 
	enableControl("Whl_Lt_Stat_AR2", "CH_ESPCRC_Whl_Lt_Stat_Pr2Whl_Lt_", @this); //1: enable; 0: disable
	CRC_Whl_Lt_Stat_Pr2 = @sysvar::CH_Nodes::CH_ESPCRC_Whl_Lt_Stat_Pr2Wh_AUTO;
}

on sysvar sysvar::CH_Nodes::CH_ESPSQC_Whl_Lt_Stat_Pr2Wh_AUTO
{
//	EnableSQC("Whl_Lt_Stat_AR2",  "Whl_Lt_Stat_Pr2", !@this); // 1 = on, 0 = off 
	enableControl("Whl_Lt_Stat_AR2", "CH_ESPSQC_Whl_Lt_Stat_Pr2Whl_Lt_", @this); //1: enable; 0: disable
	SQC_Whl_Lt_Stat_Pr2 = @sysvar::CH_Nodes::CH_ESPSQC_Whl_Lt_Stat_Pr2Wh_AUTO;
}

on sysvar sysvar::CH_Nodes::CH_ESPWhl_Rt_Stat_AR2_UB_AUTO_01
{
	switch (@sysvar::CH_Nodes::CH_ESPWhl_Rt_Stat_AR2_UB_AUTO_01)
	{
		case (0):
			enableControl("Whl_Rt_Stat_AR2", "CH_ESPWhl_Rt_Stat_AR2_UB__01", 0); //1: enable; 0: disable
			@sysvar::CH_Nodes::CH_ESPWhl_Rt_Stat_AR2_UB__01 = 1;
			break;
		case (1):
			enableControl("Whl_Rt_Stat_AR2", "CH_ESPWhl_Rt_Stat_AR2_UB__01", 1); //1: enable; 0: disable
			break;
		case (2):
			enableControl("Whl_Rt_Stat_AR2", "CH_ESPWhl_Rt_Stat_AR2_UB__01", 0); //1: enable; 0: disable
			@sysvar::CH_Nodes::CH_ESPWhl_Rt_Stat_AR2_UB__01 = 1;
			break;
		case (3):
			enableControl("Whl_Rt_Stat_AR2", "CH_ESPWhl_Rt_Stat_AR2_UB__01", 0); //1: enable; 0: disable
			@sysvar::CH_Nodes::CH_ESPWhl_Rt_Stat_AR2_UB__01 = 0;
			break;
	}
}

on sysvar sysvar::CH_Nodes::CH_ESPCRC_Whl_Rt_Stat_Pr2Wh_AUTO
{
//	EnableCRC("Whl_Rt_Stat_AR2",  "Whl_Rt_Stat_Pr2", !@this); // 1 = on, 0 = off 
	enableControl("Whl_Rt_Stat_AR2", "CH_ESPCRC_Whl_Rt_Stat_Pr2Whl_Rt_", @this); //1: enable; 0: disable
	CRC_Whl_Rt_Stat_Pr2 = @sysvar::CH_Nodes::CH_ESPCRC_Whl_Rt_Stat_Pr2Wh_AUTO;
}

on sysvar sysvar::CH_Nodes::CH_ESPSQC_Whl_Rt_Stat_Pr2Wh_AUTO
{
//	EnableSQC("Whl_Rt_Stat_AR2",  "Whl_Rt_Stat_Pr2", !@this); // 1 = on, 0 = off 
	enableControl("Whl_Rt_Stat_AR2", "CH_ESPSQC_Whl_Rt_Stat_Pr2Whl_Rt_", @this); //1: enable; 0: disable
	SQC_Whl_Rt_Stat_Pr2 = @sysvar::CH_Nodes::CH_ESPSQC_Whl_Rt_Stat_Pr2Wh_AUTO;
}

on sysvar sysvar::CH_Nodes::CH_ESPWhlPlsCnt_TPM_AR2_UB_AU_01
{
	switch (@sysvar::CH_Nodes::CH_ESPWhlPlsCnt_TPM_AR2_UB_AU_01)
	{
		case (0):
			enableControl("WhlPlsCnt_TPM_AR2", "CH_ESPWhlPlsCnt_TPM_AR2_UB__01", 0); //1: enable; 0: disable
			@sysvar::CH_Nodes::CH_ESPWhlPlsCnt_TPM_AR2_UB__01 = 1;
			break;
		case (1):
			enableControl("WhlPlsCnt_TPM_AR2", "CH_ESPWhlPlsCnt_TPM_AR2_UB__01", 1); //1: enable; 0: disable
			break;
		case (2):
			enableControl("WhlPlsCnt_TPM_AR2", "CH_ESPWhlPlsCnt_TPM_AR2_UB__01", 0); //1: enable; 0: disable
			@sysvar::CH_Nodes::CH_ESPWhlPlsCnt_TPM_AR2_UB__01 = 1;
			break;
		case (3):
			enableControl("WhlPlsCnt_TPM_AR2", "CH_ESPWhlPlsCnt_TPM_AR2_UB__01", 0); //1: enable; 0: disable
			@sysvar::CH_Nodes::CH_ESPWhlPlsCnt_TPM_AR2_UB__01 = 0;
			break;
	}
}

on sysvar sysvar::CH_Nodes::CH_ESPCRC_WhlPlsCnt_TPM_Pr2_AUTO
{
//	EnableCRC("WhlPlsCnt_TPM_AR2",  "WhlPlsCnt_TPM_Pr2", !@this); // 1 = on, 0 = off 
	enableControl("WhlPlsCnt_TPM_AR2", "CH_ESPCRC_WhlPlsCnt_TPM_Pr2WhlP_", @this); //1: enable; 0: disable
	CRC_WhlPlsCnt_TPM_Pr2 = @sysvar::CH_Nodes::CH_ESPCRC_WhlPlsCnt_TPM_Pr2_AUTO;
}

on sysvar sysvar::CH_Nodes::CH_ESPSQC_WhlPlsCnt_TPM_Pr2_AUTO
{
//	EnableSQC("WhlPlsCnt_TPM_AR2",  "WhlPlsCnt_TPM_Pr2", !@this); // 1 = on, 0 = off 
	enableControl("WhlPlsCnt_TPM_AR2", "CH_ESPSQC_WhlPlsCnt_TPM_Pr2WhlP_", @this); //1: enable; 0: disable
	SQC_WhlPlsCnt_TPM_Pr2 = @sysvar::CH_Nodes::CH_ESPSQC_WhlPlsCnt_TPM_Pr2_AUTO;
}

on sysvar sysvar::CH_Nodes::CH_ESPYMAS_Rs_AR2_UB_AUTO_01
{
	switch (@sysvar::CH_Nodes::CH_ESPYMAS_Rs_AR2_UB_AUTO_01)
	{
		case (0):
			enableControl("YMAS_Rs_AR2", "CH_ESPYMAS_Rs_AR2_UB__01", 0); //1: enable; 0: disable
			@sysvar::CH_Nodes::CH_ESPYMAS_Rs_AR2_UB__01 = 1;
			break;
		case (1):
			enableControl("YMAS_Rs_AR2", "CH_ESPYMAS_Rs_AR2_UB__01", 1); //1: enable; 0: disable
			break;
		case (2):
			enableControl("YMAS_Rs_AR2", "CH_ESPYMAS_Rs_AR2_UB__01", 0); //1: enable; 0: disable
			@sysvar::CH_Nodes::CH_ESPYMAS_Rs_AR2_UB__01 = 1;
			break;
		case (3):
			enableControl("YMAS_Rs_AR2", "CH_ESPYMAS_Rs_AR2_UB__01", 0); //1: enable; 0: disable
			@sysvar::CH_Nodes::CH_ESPYMAS_Rs_AR2_UB__01 = 0;
			break;
	}
}

on sysvar sysvar::CH_Nodes::CH_ESPCRC_YMAS_Rs_Pr2YMAS_R_AUTO
{
//	EnableCRC("YMAS_Rs_AR2",  "YMAS_Rs_Pr2", !@this); // 1 = on, 0 = off 
	enableControl("YMAS_Rs_AR2", "CH_ESPCRC_YMAS_Rs_Pr2YMAS_Rs_AR_", @this); //1: enable; 0: disable
	CRC_YMAS_Rs_Pr2 = @sysvar::CH_Nodes::CH_ESPCRC_YMAS_Rs_Pr2YMAS_R_AUTO;
}

on sysvar sysvar::CH_Nodes::CH_ESPSQC_YMAS_Rs_Pr2YMAS_R_AUTO
{
//	EnableSQC("YMAS_Rs_AR2",  "YMAS_Rs_Pr2", !@this); // 1 = on, 0 = off 
	enableControl("YMAS_Rs_AR2", "CH_ESPSQC_YMAS_Rs_Pr2YMAS_Rs_AR_", @this); //1: enable; 0: disable
	SQC_YMAS_Rs_Pr2 = @sysvar::CH_Nodes::CH_ESPSQC_YMAS_Rs_Pr2YMAS_R_AUTO;
}

CH_ESPAWD_TCASE_Rq_ESP_AR2()
{
	switch (@sysvar::CH_Nodes::CH_ESPAWD_TCASE_Rq_ESP_A_UB_AUTO)
	{
		case (0):
			//Updatebit wird mit 1 gesendet; entspricht Standard
			break;
		case (1):
			//nur wenn manueller Wert gleich 0 ist, muss was gemacht werden
			if (@sysvar::CH_Nodes::CH_ESPAWD_TCASE_Rq_ESP_A_UB_AUTO == 0)
				DisturbPDUUB("AWD_TCASE_Rq_ESP_AR2", 1, 0); //Updatebit wird einmal auf Null gesetzt
			break;
		case (2):
			//Updatebit wird mit 1 gesendet; entspricht Standard
			break;
		case (3):
			DisturbPDUUB("AWD_TCASE_Rq_ESP_AR2", 1, 0); //Updatebit wird einmal auf Null gesetzt
			break;
	}
}

CH_ESPBrkSys_Stat_AR2()
{
	switch (@sysvar::CH_Nodes::CH_ESPBrkSys_Stat_AR2_UB_AUTO_01)
	{
		case (0):
			//Updatebit wird mit 1 gesendet; entspricht Standard
			break;
		case (1):
			//nur wenn manueller Wert gleich 0 ist, muss was gemacht werden
			if (@sysvar::CH_Nodes::CH_ESPBrkSys_Stat_AR2_UB_AUTO_01 == 0)
				DisturbPDUUB("BrkSys_Stat_AR2", 1, 0); //Updatebit wird einmal auf Null gesetzt
			break;
		case (2):
			//Updatebit wird mit 1 gesendet; entspricht Standard
			break;
		case (3):
			DisturbPDUUB("BrkSys_Stat_AR2", 1, 0); //Updatebit wird einmal auf Null gesetzt
			break;
	}
}

CH_ESPDPC_Disp_Rq_AR2()
{
	switch (@sysvar::CH_Nodes::CH_ESPDPC_Disp_Rq_AR2_UB_AUTO_01)
	{
		case (0):
			//Updatebit wird mit 1 gesendet; entspricht Standard
			break;
		case (1):
			//nur wenn manueller Wert gleich 0 ist, muss was gemacht werden
			if (@sysvar::CH_Nodes::CH_ESPDPC_Disp_Rq_AR2_UB_AUTO_01 == 0)
				DisturbPDUUB("DPC_Disp_Rq_AR2", 1, 0); //Updatebit wird einmal auf Null gesetzt
			break;
		case (2):
			//Updatebit wird mit 1 gesendet; entspricht Standard
			break;
		case (3):
			DisturbPDUUB("DPC_Disp_Rq_AR2", 1, 0); //Updatebit wird einmal auf Null gesetzt
			break;
	}
}

CH_ESPDPC_IndMd_Stat_AR2()
{
	switch (@sysvar::CH_Nodes::CH_ESPDPC_IndMd_Stat_AR2_UB_A_01)
	{
		case (0):
			//Updatebit wird mit 1 gesendet; entspricht Standard
			break;
		case (1):
			//nur wenn manueller Wert gleich 0 ist, muss was gemacht werden
			if (@sysvar::CH_Nodes::CH_ESPDPC_IndMd_Stat_AR2_UB_A_01 == 0)
				DisturbPDUUB("DPC_IndMd_Stat_AR2", 1, 0); //Updatebit wird einmal auf Null gesetzt
			break;
		case (2):
			//Updatebit wird mit 1 gesendet; entspricht Standard
			break;
		case (3):
			DisturbPDUUB("DPC_IndMd_Stat_AR2", 1, 0); //Updatebit wird einmal auf Null gesetzt
			break;
	}
}

CH_ESPDPC_IndMd_Style2_AR2()
{
	switch (@sysvar::CH_Nodes::CH_ESPDPC_IndMd_Style2_A_UB_A_01)
	{
		case (0):
			//Updatebit wird mit 1 gesendet; entspricht Standard
			break;
		case (1):
			//nur wenn manueller Wert gleich 0 ist, muss was gemacht werden
			if (@sysvar::CH_Nodes::CH_ESPDPC_IndMd_Style2_A_UB_A_01 == 0)
				DisturbPDUUB("DPC_IndMd_Style2_AR2", 1, 0); //Updatebit wird einmal auf Null gesetzt
			break;
		case (2):
			//Updatebit wird mit 1 gesendet; entspricht Standard
			break;
		case (3):
			DisturbPDUUB("DPC_IndMd_Style2_AR2", 1, 0); //Updatebit wird einmal auf Null gesetzt
			break;
	}
}

CH_ESPDPC_IndMd_Style_AR2()
{
	switch (@sysvar::CH_Nodes::CH_ESPDPC_IndMd_Style_AR_UB_A_01)
	{
		case (0):
			//Updatebit wird mit 1 gesendet; entspricht Standard
			break;
		case (1):
			//nur wenn manueller Wert gleich 0 ist, muss was gemacht werden
			if (@sysvar::CH_Nodes::CH_ESPDPC_IndMd_Style_AR_UB_A_01 == 0)
				DisturbPDUUB("DPC_IndMd_Style_AR2", 1, 0); //Updatebit wird einmal auf Null gesetzt
			break;
		case (2):
			//Updatebit wird mit 1 gesendet; entspricht Standard
			break;
		case (3):
			DisturbPDUUB("DPC_IndMd_Style_AR2", 1, 0); //Updatebit wird einmal auf Null gesetzt
			break;
	}
}

CH_ESPDPC_Master_Rq_AR2()
{
	switch (@sysvar::CH_Nodes::CH_ESPDPC_Master_Rq_AR2_UB_AU_01)
	{
		case (0):
			//Updatebit wird mit 1 gesendet; entspricht Standard
			break;
		case (1):
			//nur wenn manueller Wert gleich 0 ist, muss was gemacht werden
			if (@sysvar::CH_Nodes::CH_ESPDPC_Master_Rq_AR2_UB_AU_01 == 0)
				DisturbPDUUB("DPC_Master_Rq_AR2", 1, 0); //Updatebit wird einmal auf Null gesetzt
			break;
		case (2):
			//Updatebit wird mit 1 gesendet; entspricht Standard
			break;
		case (3):
			DisturbPDUUB("DPC_Master_Rq_AR2", 1, 0); //Updatebit wird einmal auf Null gesetzt
			break;
	}
}

CH_ESPEng_Susp_Rq_AS_AR2()
{
	switch (@sysvar::CH_Nodes::CH_ESPEng_Susp_Rq_AS_AR2_UB_A_01)
	{
		case (0):
			//Updatebit wird mit 1 gesendet; entspricht Standard
			break;
		case (1):
			//nur wenn manueller Wert gleich 0 ist, muss was gemacht werden
			if (@sysvar::CH_Nodes::CH_ESPEng_Susp_Rq_AS_AR2_UB_A_01 == 0)
				DisturbPDUUB("Eng_Susp_Rq_AS_AR2", 1, 0); //Updatebit wird einmal auf Null gesetzt
			break;
		case (2):
			//Updatebit wird mit 1 gesendet; entspricht Standard
			break;
		case (3):
			DisturbPDUUB("Eng_Susp_Rq_AS_AR2", 1, 0); //Updatebit wird einmal auf Null gesetzt
			break;
	}
}

CH_ESPEPKB_Disp_IndLmp_Rq_2_AR2()
{
	switch (@sysvar::CH_Nodes::CH_ESPEPKB_Disp_IndLmp_R_UB_A_01)
	{
		case (0):
			//Updatebit wird mit 1 gesendet; entspricht Standard
			break;
		case (1):
			//nur wenn manueller Wert gleich 0 ist, muss was gemacht werden
			if (@sysvar::CH_Nodes::CH_ESPEPKB_Disp_IndLmp_R_UB_A_01 == 0)
				DisturbPDUUB("EPKB_Disp_IndLmp_Rq_2_AR2", 1, 0); //Updatebit wird einmal auf Null gesetzt
			break;
		case (2):
			//Updatebit wird mit 1 gesendet; entspricht Standard
			break;
		case (3):
			DisturbPDUUB("EPKB_Disp_IndLmp_Rq_2_AR2", 1, 0); //Updatebit wird einmal auf Null gesetzt
			break;
	}
}

CH_ESPEPKB_Stat_Gw_AR2()
{
	switch (@sysvar::CH_Nodes::CH_ESPEPKB_Stat_Gw_AR2_UB_AUT_01)
	{
		case (0):
			//Updatebit wird mit 1 gesendet; entspricht Standard
			break;
		case (1):
			//nur wenn manueller Wert gleich 0 ist, muss was gemacht werden
			if (@sysvar::CH_Nodes::CH_ESPEPKB_Stat_Gw_AR2_UB_AUT_01 == 0)
				DisturbPDUUB("EPKB_Stat_Gw_AR2", 1, 0); //Updatebit wird einmal auf Null gesetzt
			break;
		case (2):
			//Updatebit wird mit 1 gesendet; entspricht Standard
			break;
		case (3):
			DisturbPDUUB("EPKB_Stat_Gw_AR2", 1, 0); //Updatebit wird einmal auf Null gesetzt
			break;
	}
}

CH_ESPESP_Disp_Rq2_AR2()
{
	switch (@sysvar::CH_Nodes::CH_ESPESP_Disp_Rq2_AR2_UB_AUT_01)
	{
		case (0):
			//Updatebit wird mit 1 gesendet; entspricht Standard
			break;
		case (1):
			//nur wenn manueller Wert gleich 0 ist, muss was gemacht werden
			if (@sysvar::CH_Nodes::CH_ESPESP_Disp_Rq2_AR2_UB_AUT_01 == 0)
				DisturbPDUUB("ESP_Disp_Rq2_AR2", 1, 0); //Updatebit wird einmal auf Null gesetzt
			break;
		case (2):
			//Updatebit wird mit 1 gesendet; entspricht Standard
			break;
		case (3):
			DisturbPDUUB("ESP_Disp_Rq2_AR2", 1, 0); //Updatebit wird einmal auf Null gesetzt
			break;
	}
}

CH_ESPESP_Disp_Rq3_AR()
{
	switch (@sysvar::CH_Nodes::CH_ESPESP_Disp_Rq3_AR_UB_AUTO_01)
	{
		case (0):
			//Updatebit wird mit 1 gesendet; entspricht Standard
			break;
		case (1):
			//nur wenn manueller Wert gleich 0 ist, muss was gemacht werden
			if (@sysvar::CH_Nodes::CH_ESPESP_Disp_Rq3_AR_UB_AUTO_01 == 0)
				DisturbPDUUB("ESP_Disp_Rq3_AR", 1, 0); //Updatebit wird einmal auf Null gesetzt
			break;
		case (2):
			//Updatebit wird mit 1 gesendet; entspricht Standard
			break;
		case (3):
			DisturbPDUUB("ESP_Disp_Rq3_AR", 1, 0); //Updatebit wird einmal auf Null gesetzt
			break;
	}
}

CH_ESPESP_Disp_Rq_AR2()
{
	switch (@sysvar::CH_Nodes::CH_ESPESP_Disp_Rq_AR2_UB_AUTO_01)
	{
		case (0):
			//Updatebit wird mit 1 gesendet; entspricht Standard
			break;
		case (1):
			//nur wenn manueller Wert gleich 0 ist, muss was gemacht werden
			if (@sysvar::CH_Nodes::CH_ESPESP_Disp_Rq_AR2_UB_AUTO_01 == 0)
				DisturbPDUUB("ESP_Disp_Rq_AR2", 1, 0); //Updatebit wird einmal auf Null gesetzt
			break;
		case (2):
			//Updatebit wird mit 1 gesendet; entspricht Standard
			break;
		case (3):
			DisturbPDUUB("ESP_Disp_Rq_AR2", 1, 0); //Updatebit wird einmal auf Null gesetzt
			break;
	}
}

CH_ESPESP_OBD_Stat_AR()
{
	switch (@sysvar::CH_Nodes::CH_ESPESP_OBD_Stat_AR_UB_AUTO_01)
	{
		case (0):
			//Updatebit wird mit 1 gesendet; entspricht Standard
			break;
		case (1):
			//nur wenn manueller Wert gleich 0 ist, muss was gemacht werden
			if (@sysvar::CH_Nodes::CH_ESPESP_OBD_Stat_AR_UB_AUTO_01 == 0)
				DisturbPDUUB("ESP_OBD_Stat_AR", 1, 0); //Updatebit wird einmal auf Null gesetzt
			break;
		case (2):
			//Updatebit wird mit 1 gesendet; entspricht Standard
			break;
		case (3):
			DisturbPDUUB("ESP_OBD_Stat_AR", 1, 0); //Updatebit wird einmal auf Null gesetzt
			break;
	}
}

CH_ESPLDC_Disp_Rq_ESP_AR()
{
	switch (@sysvar::CH_Nodes::CH_ESPLDC_Disp_Rq_ESP_AR_UB_A_01)
	{
		case (0):
			//Updatebit wird mit 1 gesendet; entspricht Standard
			break;
		case (1):
			//nur wenn manueller Wert gleich 0 ist, muss was gemacht werden
			if (@sysvar::CH_Nodes::CH_ESPLDC_Disp_Rq_ESP_AR_UB_A_01 == 0)
				DisturbPDUUB("LDC_Disp_Rq_ESP_AR", 1, 0); //Updatebit wird einmal auf Null gesetzt
			break;
		case (2):
			//Updatebit wird mit 1 gesendet; entspricht Standard
			break;
		case (3):
			DisturbPDUUB("LDC_Disp_Rq_ESP_AR", 1, 0); //Updatebit wird einmal auf Null gesetzt
			break;
	}
}

CH_ESPPARK_Brk_Rs_AR2()
{
	switch (@sysvar::CH_Nodes::CH_ESPPARK_Brk_Rs_AR2_UB_AUTO_01)
	{
		case (0):
			//Updatebit wird mit 1 gesendet; entspricht Standard
			break;
		case (1):
			//nur wenn manueller Wert gleich 0 ist, muss was gemacht werden
			if (@sysvar::CH_Nodes::CH_ESPPARK_Brk_Rs_AR2_UB_AUTO_01 == 0)
				DisturbPDUUB("PARK_Brk_Rs_AR2", 1, 0); //Updatebit wird einmal auf Null gesetzt
			break;
		case (2):
			//Updatebit wird mit 1 gesendet; entspricht Standard
			break;
		case (3):
			DisturbPDUUB("PARK_Brk_Rs_AR2", 1, 0); //Updatebit wird einmal auf Null gesetzt
			break;
	}
}

CH_ESPPARK_Drv_Rq_ESP_AR2()
{
	switch (@sysvar::CH_Nodes::CH_ESPPARK_Drv_Rq_ESP_AR_UB_A_01)
	{
		case (0):
			//Updatebit wird mit 1 gesendet; entspricht Standard
			break;
		case (1):
			//nur wenn manueller Wert gleich 0 ist, muss was gemacht werden
			if (@sysvar::CH_Nodes::CH_ESPPARK_Drv_Rq_ESP_AR_UB_A_01 == 0)
				DisturbPDUUB("PARK_Drv_Rq_ESP_AR2", 1, 0); //Updatebit wird einmal auf Null gesetzt
			break;
		case (2):
			//Updatebit wird mit 1 gesendet; entspricht Standard
			break;
		case (3):
			DisturbPDUUB("PARK_Drv_Rq_ESP_AR2", 1, 0); //Updatebit wird einmal auf Null gesetzt
			break;
	}
}

CH_ESPPresfCtrl_Rq_ESP_AR2()
{
	switch (@sysvar::CH_Nodes::CH_ESPPresfCtrl_Rq_ESP_A_UB_A_01)
	{
		case (0):
			//Updatebit wird mit 1 gesendet; entspricht Standard
			break;
		case (1):
			//nur wenn manueller Wert gleich 0 ist, muss was gemacht werden
			if (@sysvar::CH_Nodes::CH_ESPPresfCtrl_Rq_ESP_A_UB_A_01 == 0)
				DisturbPDUUB("PresfCtrl_Rq_ESP_AR2", 1, 0); //Updatebit wird einmal auf Null gesetzt
			break;
		case (2):
			//Updatebit wird mit 1 gesendet; entspricht Standard
			break;
		case (3):
			DisturbPDUUB("PresfCtrl_Rq_ESP_AR2", 1, 0); //Updatebit wird einmal auf Null gesetzt
			break;
	}
}

CH_ESPPT_Rq_ESP_AR2()
{
	switch (@sysvar::CH_Nodes::CH_ESPPT_Rq_ESP_AR2_UB_AUTO_01)
	{
		case (0):
			//Updatebit wird mit 1 gesendet; entspricht Standard
			break;
		case (1):
			//nur wenn manueller Wert gleich 0 ist, muss was gemacht werden
			if (@sysvar::CH_Nodes::CH_ESPPT_Rq_ESP_AR2_UB_AUTO_01 == 0)
				DisturbPDUUB("PT_Rq_ESP_AR2", 1, 0); //Updatebit wird einmal auf Null gesetzt
			break;
		case (2):
			//Updatebit wird mit 1 gesendet; entspricht Standard
			break;
		case (3):
			DisturbPDUUB("PT_Rq_ESP_AR2", 1, 0); //Updatebit wird einmal auf Null gesetzt
			break;
	}
}

CH_ESPSt_Rq_STA_AR2()
{
	switch (@sysvar::CH_Nodes::CH_ESPSt_Rq_STA_AR2_UB_AUTO_01)
	{
		case (0):
			//Updatebit wird mit 1 gesendet; entspricht Standard
			break;
		case (1):
			//nur wenn manueller Wert gleich 0 ist, muss was gemacht werden
			if (@sysvar::CH_Nodes::CH_ESPSt_Rq_STA_AR2_UB_AUTO_01 == 0)
				DisturbPDUUB("St_Rq_STA_AR2", 1, 0); //Updatebit wird einmal auf Null gesetzt
			break;
		case (2):
			//Updatebit wird mit 1 gesendet; entspricht Standard
			break;
		case (3):
			DisturbPDUUB("St_Rq_STA_AR2", 1, 0); //Updatebit wird einmal auf Null gesetzt
			break;
	}
}

CH_ESPTBCSC_Rs1_ESP_AR2()
{
	switch (@sysvar::CH_Nodes::CH_ESPTBCSC_Rs1_ESP_AR2_UB_AU_01)
	{
		case (0):
			//Updatebit wird mit 1 gesendet; entspricht Standard
			break;
		case (1):
			//nur wenn manueller Wert gleich 0 ist, muss was gemacht werden
			if (@sysvar::CH_Nodes::CH_ESPTBCSC_Rs1_ESP_AR2_UB_AU_01 == 0)
				DisturbPDUUB("TBCSC_Rs1_ESP_AR2", 1, 0); //Updatebit wird einmal auf Null gesetzt
			break;
		case (2):
			//Updatebit wird mit 1 gesendet; entspricht Standard
			break;
		case (3):
			DisturbPDUUB("TBCSC_Rs1_ESP_AR2", 1, 0); //Updatebit wird einmal auf Null gesetzt
			break;
	}
}

CH_ESPTBCSC_Rs2_ESP_AR2()
{
	switch (@sysvar::CH_Nodes::CH_ESPTBCSC_Rs2_ESP_AR2_UB_AU_01)
	{
		case (0):
			//Updatebit wird mit 1 gesendet; entspricht Standard
			break;
		case (1):
			//nur wenn manueller Wert gleich 0 ist, muss was gemacht werden
			if (@sysvar::CH_Nodes::CH_ESPTBCSC_Rs2_ESP_AR2_UB_AU_01 == 0)
				DisturbPDUUB("TBCSC_Rs2_ESP_AR2", 1, 0); //Updatebit wird einmal auf Null gesetzt
			break;
		case (2):
			//Updatebit wird mit 1 gesendet; entspricht Standard
			break;
		case (3):
			DisturbPDUUB("TBCSC_Rs2_ESP_AR2", 1, 0); //Updatebit wird einmal auf Null gesetzt
			break;
	}
}

CH_ESPVehAccel_X_Rs1_AR2()
{
	switch (@sysvar::CH_Nodes::CH_ESPVehAccel_X_Rs1_AR2_UB_A_01)
	{
		case (0):
			//Updatebit wird mit 1 gesendet; entspricht Standard
			break;
		case (1):
			//nur wenn manueller Wert gleich 0 ist, muss was gemacht werden
			if (@sysvar::CH_Nodes::CH_ESPVehAccel_X_Rs1_AR2_UB_A_01 == 0)
				DisturbPDUUB("VehAccel_X_Rs1_AR2", 1, 0); //Updatebit wird einmal auf Null gesetzt
			break;
		case (2):
			//Updatebit wird mit 1 gesendet; entspricht Standard
			break;
		case (3):
			DisturbPDUUB("VehAccel_X_Rs1_AR2", 1, 0); //Updatebit wird einmal auf Null gesetzt
			break;
	}
}

CH_ESPVehAccel_X_Rs2_AR2()
{
	switch (@sysvar::CH_Nodes::CH_ESPVehAccel_X_Rs2_AR2_UB_A_01)
	{
		case (0):
			//Updatebit wird mit 1 gesendet; entspricht Standard
			break;
		case (1):
			//nur wenn manueller Wert gleich 0 ist, muss was gemacht werden
			if (@sysvar::CH_Nodes::CH_ESPVehAccel_X_Rs2_AR2_UB_A_01 == 0)
				DisturbPDUUB("VehAccel_X_Rs2_AR2", 1, 0); //Updatebit wird einmal auf Null gesetzt
			break;
		case (2):
			//Updatebit wird mit 1 gesendet; entspricht Standard
			break;
		case (3):
			DisturbPDUUB("VehAccel_X_Rs2_AR2", 1, 0); //Updatebit wird einmal auf Null gesetzt
			break;
	}
}

CH_ESPVehDyn_Stat1_AR2()
{
	switch (@sysvar::CH_Nodes::CH_ESPVehDyn_Stat1_AR2_UB_AUT_01)
	{
		case (0):
			//Updatebit wird mit 1 gesendet; entspricht Standard
			break;
		case (1):
			//nur wenn manueller Wert gleich 0 ist, muss was gemacht werden
			if (@sysvar::CH_Nodes::CH_ESPVehDyn_Stat1_AR2_UB_AUT_01 == 0)
				DisturbPDUUB("VehDyn_Stat1_AR2", 1, 0); //Updatebit wird einmal auf Null gesetzt
			break;
		case (2):
			//Updatebit wird mit 1 gesendet; entspricht Standard
			break;
		case (3):
			DisturbPDUUB("VehDyn_Stat1_AR2", 1, 0); //Updatebit wird einmal auf Null gesetzt
			break;
	}
}

CH_ESPVehDyn_Stat2_AR2()
{
	switch (@sysvar::CH_Nodes::CH_ESPVehDyn_Stat2_AR2_UB_AUT_01)
	{
		case (0):
			//Updatebit wird mit 1 gesendet; entspricht Standard
			break;
		case (1):
			//nur wenn manueller Wert gleich 0 ist, muss was gemacht werden
			if (@sysvar::CH_Nodes::CH_ESPVehDyn_Stat2_AR2_UB_AUT_01 == 0)
				DisturbPDUUB("VehDyn_Stat2_AR2", 1, 0); //Updatebit wird einmal auf Null gesetzt
			break;
		case (2):
			//Updatebit wird mit 1 gesendet; entspricht Standard
			break;
		case (3):
			DisturbPDUUB("VehDyn_Stat2_AR2", 1, 0); //Updatebit wird einmal auf Null gesetzt
			break;
	}
}

CH_ESPVehSpd_X_AR2()
{
	switch (@sysvar::CH_Nodes::CH_ESPVehSpd_X_AR2_UB_AUTO_01)
	{
		case (0):
			//Updatebit wird mit 1 gesendet; entspricht Standard
			break;
		case (1):
			//nur wenn manueller Wert gleich 0 ist, muss was gemacht werden
			if (@sysvar::CH_Nodes::CH_ESPVehSpd_X_AR2_UB_AUTO_01 == 0)
				DisturbPDUUB("VehSpd_X_AR2", 1, 0); //Updatebit wird einmal auf Null gesetzt
			break;
		case (2):
			//Updatebit wird mit 1 gesendet; entspricht Standard
			break;
		case (3):
			DisturbPDUUB("VehSpd_X_AR2", 1, 0); //Updatebit wird einmal auf Null gesetzt
			break;
	}
}

CH_ESPWhl_Lt_Stat_AR2()
{
	switch (@sysvar::CH_Nodes::CH_ESPWhl_Lt_Stat_AR2_UB_AUTO_01)
	{
		case (0):
			//Updatebit wird mit 1 gesendet; entspricht Standard
			break;
		case (1):
			//nur wenn manueller Wert gleich 0 ist, muss was gemacht werden
			if (@sysvar::CH_Nodes::CH_ESPWhl_Lt_Stat_AR2_UB_AUTO_01 == 0)
				DisturbPDUUB("Whl_Lt_Stat_AR2", 1, 0); //Updatebit wird einmal auf Null gesetzt
			break;
		case (2):
			//Updatebit wird mit 1 gesendet; entspricht Standard
			break;
		case (3):
			DisturbPDUUB("Whl_Lt_Stat_AR2", 1, 0); //Updatebit wird einmal auf Null gesetzt
			break;
	}
}

SetWhl_Lt_Stat_AR2 ()
{
	$Whl_Lt_Stat_AR2::WhlPlsCnt_FL = Whl_Lt_Stat_AR2_WhlPlsCnt_FL_Count;
	$Whl_Lt_Stat_AR2::WhlPlsCnt_RL = Whl_Lt_Stat_AR2_WhlPlsCnt_RL_Count;
}

CH_ESPWhl_Rt_Stat_AR2()
{
	switch (@sysvar::CH_Nodes::CH_ESPWhl_Rt_Stat_AR2_UB_AUTO_01)
	{
		case (0):
			//Updatebit wird mit 1 gesendet; entspricht Standard
			break;
		case (1):
			//nur wenn manueller Wert gleich 0 ist, muss was gemacht werden
			if (@sysvar::CH_Nodes::CH_ESPWhl_Rt_Stat_AR2_UB_AUTO_01 == 0)
				DisturbPDUUB("Whl_Rt_Stat_AR2", 1, 0); //Updatebit wird einmal auf Null gesetzt
			break;
		case (2):
			//Updatebit wird mit 1 gesendet; entspricht Standard
			break;
		case (3):
			DisturbPDUUB("Whl_Rt_Stat_AR2", 1, 0); //Updatebit wird einmal auf Null gesetzt
			break;
	}
}

SetWhl_Rt_Stat_AR2 ()
{
	$Whl_Rt_Stat_AR2::WhlPlsCnt_FR = Whl_Rt_Stat_AR2_WhlPlsCnt_FR_Count;
	$Whl_Rt_Stat_AR2::WhlPlsCnt_RR = Whl_Rt_Stat_AR2_WhlPlsCnt_RR_Count;
}

CH_ESPWhlPlsCnt_TPM_AR2()
{
	switch (@sysvar::CH_Nodes::CH_ESPWhlPlsCnt_TPM_AR2_UB_AU_01)
	{
		case (0):
			//Updatebit wird mit 1 gesendet; entspricht Standard
			break;
		case (1):
			//nur wenn manueller Wert gleich 0 ist, muss was gemacht werden
			if (@sysvar::CH_Nodes::CH_ESPWhlPlsCnt_TPM_AR2_UB_AU_01 == 0)
				DisturbPDUUB("WhlPlsCnt_TPM_AR2", 1, 0); //Updatebit wird einmal auf Null gesetzt
			break;
		case (2):
			//Updatebit wird mit 1 gesendet; entspricht Standard
			break;
		case (3):
			DisturbPDUUB("WhlPlsCnt_TPM_AR2", 1, 0); //Updatebit wird einmal auf Null gesetzt
			break;
	}
}

CH_ESPYMAS_Rs_AR2()
{
	switch (@sysvar::CH_Nodes::CH_ESPYMAS_Rs_AR2_UB_AUTO_01)
	{
		case (0):
			//Updatebit wird mit 1 gesendet; entspricht Standard
			break;
		case (1):
			//nur wenn manueller Wert gleich 0 ist, muss was gemacht werden
			if (@sysvar::CH_Nodes::CH_ESPYMAS_Rs_AR2_UB_AUTO_01 == 0)
				DisturbPDUUB("YMAS_Rs_AR2", 1, 0); //Updatebit wird einmal auf Null gesetzt
			break;
		case (2):
			//Updatebit wird mit 1 gesendet; entspricht Standard
			break;
		case (3):
			DisturbPDUUB("YMAS_Rs_AR2", 1, 0); //Updatebit wird einmal auf Null gesetzt
			break;
	}
}

void FrILTxPending(char pduName[], long len, byte payload[], long TxAck)
{
	byte crc;
	dword SQC;
	dword MC;
	dword Tgl;
	dword i;

	if (strncmp (pduName, "AWD_TCASE_Rq_ESP_AR2", strLen(pduName)+strLen("AWD_TCASE_Rq_ESP_AR2")) == 0)
	{
		if (TxAck == 1)
		{
			if (@sysvar::CH_Nodes::CH_ESPSQC_AWD_TCASE_Rq_ESP__AUTO == 0)
			{
				//SQC automatisch ändern
				SQC_VAL_AWD_TCASE_Rq_ESP_Pr2 = (SQC_VAL_AWD_TCASE_Rq_ESP_Pr2 + 1) % 16;
			}
			else
			{
				//SQC manuel veränderbar
			}

		}
		else
		{
			if (@sysvar::CH_Nodes::CH_ESPSQC_AWD_TCASE_Rq_ESP__AUTO == 0)
			{
				//SQC automatisch ändern
				//SQC für CRC speichern
				CounterValForCRC_AWD_TCASE_Rq_ESP_Pr2 = SQC_VAL_AWD_TCASE_Rq_ESP_Pr2;
				//SQC in Byte schreiben
				payload[1] = (payload[1] & ~0x0F) |  SQC_VAL_AWD_TCASE_Rq_ESP_Pr2;
			}
			else
			{
				//SQC manuel veränderbar
			}

			if (@sysvar::CH_Nodes::CH_ESPCRC_AWD_TCASE_Rq_ESP__AUTO == 0)
			{
				//CRC automatisch berechnen
				crc = 0xFF;
				crc = crctableProfTwo[crc ^ payload[1]];
				crc = crctableProfTwo[crc ^ payload[2]];
				crc = crctableProfTwo[crc ^ payload[3]];
				switch (CounterValForCRC_AWD_TCASE_Rq_ESP_Pr2)
				{
					case(0) :
						crc = crctableProfTwo[crc ^ 43];
						break;
					case(1) :
						crc = crctableProfTwo[crc ^ 98];
						break;
					case(2) :
						crc = crctableProfTwo[crc ^ 153];
						break;
					case(3) :
						crc = crctableProfTwo[crc ^ 208];
						break;
					case(4) :
						crc = crctableProfTwo[crc ^ 12];
						break;
					case(5) :
						crc = crctableProfTwo[crc ^ 67];
						break;
					case(6) :
						crc = crctableProfTwo[crc ^ 122];
						break;
					case(7) :
						crc = crctableProfTwo[crc ^ 177];
						break;
					case(8) :
						crc = crctableProfTwo[crc ^ 232];
						break;
					case(9) :
						crc = crctableProfTwo[crc ^ 36];
						break;
					case(10) :
						crc = crctableProfTwo[crc ^ 91];
						break;
					case(11) :
						crc = crctableProfTwo[crc ^ 146];
						break;
					case(12) :
						crc = crctableProfTwo[crc ^ 201];
						break;
					case(13) :
						crc = crctableProfTwo[crc ^ 5];
						break;
					case(14) :
						crc = crctableProfTwo[crc ^ 60];
						break;
					case(15) :
						crc = crctableProfTwo[crc ^ 115];
						break;
					default :
//						write("error: wrong parameter (%d)",CounterValForCRC_AWD_TCASE_Rq_ESP_Pr2); stop();
						break;
				}
				crc = (crc ^ 0xFF);
				payload[0] = crc;
			}
			else
			{
				//CRC manuel veränderbar
			}

			CH_ESPAWD_TCASE_Rq_ESP_AR2();
		}
	}
	if (strncmp (pduName, "BrkSys_Stat_AR2", strLen(pduName)+strLen("BrkSys_Stat_AR2")) == 0)
	{
		if (TxAck == 1)
		{
			if (@sysvar::CH_Nodes::CH_ESPSQC_BrkSys_Stat_Pr2Br_AUTO == 0)
			{
				//SQC automatisch ändern
				SQC_VAL_BrkSys_Stat_Pr2 = (SQC_VAL_BrkSys_Stat_Pr2 + 1) % 16;
			}
			else
			{
				//SQC manuel veränderbar
			}

		}
		else
		{
			if (@sysvar::CH_Nodes::CH_ESPSQC_BrkSys_Stat_Pr2Br_AUTO == 0)
			{
				//SQC automatisch ändern
				//SQC für CRC speichern
				CounterValForCRC_BrkSys_Stat_Pr2 = SQC_VAL_BrkSys_Stat_Pr2;
				//SQC in Byte schreiben
				payload[1] = (payload[1] & ~0x0F) |  SQC_VAL_BrkSys_Stat_Pr2;
			}
			else
			{
				//SQC manuel veränderbar
			}

			if (@sysvar::CH_Nodes::CH_ESPCRC_BrkSys_Stat_Pr2Br_AUTO == 0)
			{
				//CRC automatisch berechnen
				crc = 0xFF;
				crc = crctableProfTwo[crc ^ payload[1]];
				crc = crctableProfTwo[crc ^ payload[2]];
				crc = crctableProfTwo[crc ^ payload[3]];
				crc = crctableProfTwo[crc ^ payload[4]];
				crc = crctableProfTwo[crc ^ payload[5]];
				crc = crctableProfTwo[crc ^ payload[6]];
				crc = crctableProfTwo[crc ^ payload[7]];
				switch (CounterValForCRC_BrkSys_Stat_Pr2)
				{
					case(0) :
						crc = crctableProfTwo[crc ^ 61];
						break;
					case(1) :
						crc = crctableProfTwo[crc ^ 57];
						break;
					case(2) :
						crc = crctableProfTwo[crc ^ 53];
						break;
					case(3) :
						crc = crctableProfTwo[crc ^ 49];
						break;
					case(4) :
						crc = crctableProfTwo[crc ^ 45];
						break;
					case(5) :
						crc = crctableProfTwo[crc ^ 41];
						break;
					case(6) :
						crc = crctableProfTwo[crc ^ 37];
						break;
					case(7) :
						crc = crctableProfTwo[crc ^ 33];
						break;
					case(8) :
						crc = crctableProfTwo[crc ^ 29];
						break;
					case(9) :
						crc = crctableProfTwo[crc ^ 25];
						break;
					case(10) :
						crc = crctableProfTwo[crc ^ 21];
						break;
					case(11) :
						crc = crctableProfTwo[crc ^ 17];
						break;
					case(12) :
						crc = crctableProfTwo[crc ^ 13];
						break;
					case(13) :
						crc = crctableProfTwo[crc ^ 9];
						break;
					case(14) :
						crc = crctableProfTwo[crc ^ 5];
						break;
					case(15) :
						crc = crctableProfTwo[crc ^ 252];
						break;
					default :
//						write("error: wrong parameter (%d)",CounterValForCRC_BrkSys_Stat_Pr2); stop();
						break;
				}
				crc = (crc ^ 0xFF);
				payload[0] = crc;
			}
			else
			{
				//CRC manuel veränderbar
			}

			CH_ESPBrkSys_Stat_AR2();
			CH_ESPSt_Rq_STA_AR2();
		}
	}
	if (strncmp (pduName, "DPC_Disp_Rq_AR2", strLen(pduName)+strLen("DPC_Disp_Rq_AR2")) == 0)
	{
		if (TxAck == 1)
		{
			if (@sysvar::CH_Nodes::CH_ESPSQC_DPC_Disp_Rq_Pr2DP_AUTO == 0)
			{
				//SQC automatisch ändern
				SQC_VAL_DPC_Disp_Rq_Pr2 = (SQC_VAL_DPC_Disp_Rq_Pr2 + 1) % 16;
			}
			else
			{
				//SQC manuel veränderbar
			}

		}
		else
		{
			if (@sysvar::CH_Nodes::CH_ESPSQC_DPC_Disp_Rq_Pr2DP_AUTO == 0)
			{
				//SQC automatisch ändern
				//SQC für CRC speichern
				CounterValForCRC_DPC_Disp_Rq_Pr2 = SQC_VAL_DPC_Disp_Rq_Pr2;
				//SQC in Byte schreiben
				payload[1] = (payload[1] & ~0x0F) |  SQC_VAL_DPC_Disp_Rq_Pr2;
			}
			else
			{
				//SQC manuel veränderbar
			}

			if (@sysvar::CH_Nodes::CH_ESPCRC_DPC_Disp_Rq_Pr2DP_AUTO == 0)
			{
				//CRC automatisch berechnen
				crc = 0xFF;
				crc = crctableProfTwo[crc ^ payload[1]];
				crc = crctableProfTwo[crc ^ payload[2]];
				crc = crctableProfTwo[crc ^ payload[3]];
				crc = crctableProfTwo[crc ^ payload[4]];
				crc = crctableProfTwo[crc ^ payload[5]];
				switch (CounterValForCRC_DPC_Disp_Rq_Pr2)
				{
					case(0) :
						crc = crctableProfTwo[crc ^ 12];
						break;
					case(1) :
						crc = crctableProfTwo[crc ^ 195];
						break;
					case(2) :
						crc = crctableProfTwo[crc ^ 127];
						break;
					case(3) :
						crc = crctableProfTwo[crc ^ 59];
						break;
					case(4) :
						crc = crctableProfTwo[crc ^ 242];
						break;
					case(5) :
						crc = crctableProfTwo[crc ^ 174];
						break;
					case(6) :
						crc = crctableProfTwo[crc ^ 106];
						break;
					case(7) :
						crc = crctableProfTwo[crc ^ 38];
						break;
					case(8) :
						crc = crctableProfTwo[crc ^ 221];
						break;
					case(9) :
						crc = crctableProfTwo[crc ^ 153];
						break;
					case(10) :
						crc = crctableProfTwo[crc ^ 85];
						break;
					case(11) :
						crc = crctableProfTwo[crc ^ 17];
						break;
					case(12) :
						crc = crctableProfTwo[crc ^ 200];
						break;
					case(13) :
						crc = crctableProfTwo[crc ^ 132];
						break;
					case(14) :
						crc = crctableProfTwo[crc ^ 64];
						break;
					case(15) :
						crc = crctableProfTwo[crc ^ 247];
						break;
					default :
//						write("error: wrong parameter (%d)",CounterValForCRC_DPC_Disp_Rq_Pr2); stop();
						break;
				}
				crc = (crc ^ 0xFF);
				payload[0] = crc;
			}
			else
			{
				//CRC manuel veränderbar
			}

			CH_ESPDPC_IndMd_Style_AR2();
			CH_ESPDPC_IndMd_Stat_AR2();
			CH_ESPDPC_Disp_Rq_AR2();
			CH_ESPDPC_IndMd_Style2_AR2();
			CH_ESPDPC_Master_Rq_AR2();
		}
	}
	if (strncmp (pduName, "DPC_IndMd_Stat_AR2", strLen(pduName)+strLen("DPC_IndMd_Stat_AR2")) == 0)
	{
		if (TxAck == 1)
		{
			if (@sysvar::CH_Nodes::CH_ESPSQC_DPC_IndMd_Stat_Pr_AUTO == 0)
			{
				//SQC automatisch ändern
				SQC_VAL_DPC_IndMd_Stat_Pr2 = (SQC_VAL_DPC_IndMd_Stat_Pr2 + 1) % 16;
			}
			else
			{
				//SQC manuel veränderbar
			}

		}
		else
		{
			if (@sysvar::CH_Nodes::CH_ESPSQC_DPC_IndMd_Stat_Pr_AUTO == 0)
			{
				//SQC automatisch ändern
				//SQC für CRC speichern
				CounterValForCRC_DPC_IndMd_Stat_Pr2 = SQC_VAL_DPC_IndMd_Stat_Pr2;
				//SQC in Byte schreiben
				payload[1] = (payload[1] & ~0x0F) |  SQC_VAL_DPC_IndMd_Stat_Pr2;
			}
			else
			{
				//SQC manuel veränderbar
			}

			if (@sysvar::CH_Nodes::CH_ESPCRC_DPC_IndMd_Stat_Pr_AUTO == 0)
			{
				//CRC automatisch berechnen
				crc = 0xFF;
				crc = crctableProfTwo[crc ^ payload[1]];
				crc = crctableProfTwo[crc ^ payload[2]];
				crc = crctableProfTwo[crc ^ payload[3]];
				crc = crctableProfTwo[crc ^ payload[4]];
				crc = crctableProfTwo[crc ^ payload[5]];
				crc = crctableProfTwo[crc ^ payload[6]];
				crc = crctableProfTwo[crc ^ payload[7]];
				switch (CounterValForCRC_DPC_IndMd_Stat_Pr2)
				{
					case(0) :
						crc = crctableProfTwo[crc ^ 175];
						break;
					case(1) :
						crc = crctableProfTwo[crc ^ 159];
						break;
					case(2) :
						crc = crctableProfTwo[crc ^ 143];
						break;
					case(3) :
						crc = crctableProfTwo[crc ^ 127];
						break;
					case(4) :
						crc = crctableProfTwo[crc ^ 111];
						break;
					case(5) :
						crc = crctableProfTwo[crc ^ 95];
						break;
					case(6) :
						crc = crctableProfTwo[crc ^ 79];
						break;
					case(7) :
						crc = crctableProfTwo[crc ^ 63];
						break;
					case(8) :
						crc = crctableProfTwo[crc ^ 47];
						break;
					case(9) :
						crc = crctableProfTwo[crc ^ 31];
						break;
					case(10) :
						crc = crctableProfTwo[crc ^ 15];
						break;
					case(11) :
						crc = crctableProfTwo[crc ^ 250];
						break;
					case(12) :
						crc = crctableProfTwo[crc ^ 234];
						break;
					case(13) :
						crc = crctableProfTwo[crc ^ 218];
						break;
					case(14) :
						crc = crctableProfTwo[crc ^ 202];
						break;
					case(15) :
						crc = crctableProfTwo[crc ^ 186];
						break;
					default :
//						write("error: wrong parameter (%d)",CounterValForCRC_DPC_IndMd_Stat_Pr2); stop();
						break;
				}
				crc = (crc ^ 0xFF);
				payload[0] = crc;
			}
			else
			{
				//CRC manuel veränderbar
			}

			CH_ESPDPC_IndMd_Style_AR2();
			CH_ESPDPC_IndMd_Stat_AR2();
			CH_ESPDPC_Disp_Rq_AR2();
			CH_ESPDPC_IndMd_Style2_AR2();
			CH_ESPDPC_Master_Rq_AR2();
		}
	}
	if (strncmp (pduName, "DPC_IndMd_Style2_AR2", strLen(pduName)+strLen("DPC_IndMd_Style2_AR2")) == 0)
	{
		if (TxAck == 1)
		{
			if (@sysvar::CH_Nodes::CH_ESPSQC_DPC_IndMd_Style2__AUTO == 0)
			{
				//SQC automatisch ändern
				SQC_VAL_DPC_IndMd_Style2_Pr2 = (SQC_VAL_DPC_IndMd_Style2_Pr2 + 1) % 16;
			}
			else
			{
				//SQC manuel veränderbar
			}

		}
		else
		{
			if (@sysvar::CH_Nodes::CH_ESPSQC_DPC_IndMd_Style2__AUTO == 0)
			{
				//SQC automatisch ändern
				//SQC für CRC speichern
				CounterValForCRC_DPC_IndMd_Style2_Pr2 = SQC_VAL_DPC_IndMd_Style2_Pr2;
				//SQC in Byte schreiben
				payload[1] = (payload[1] & ~0x0F) |  SQC_VAL_DPC_IndMd_Style2_Pr2;
			}
			else
			{
				//SQC manuel veränderbar
			}

			if (@sysvar::CH_Nodes::CH_ESPCRC_DPC_IndMd_Style2__AUTO == 0)
			{
				//CRC automatisch berechnen
				crc = 0xFF;
				crc = crctableProfTwo[crc ^ payload[1]];
				crc = crctableProfTwo[crc ^ payload[2]];
				crc = crctableProfTwo[crc ^ payload[3]];
				crc = crctableProfTwo[crc ^ payload[4]];
				crc = crctableProfTwo[crc ^ payload[5]];
				crc = crctableProfTwo[crc ^ payload[6]];
				crc = crctableProfTwo[crc ^ payload[7]];
				switch (CounterValForCRC_DPC_IndMd_Style2_Pr2)
				{
					case(0) :
						crc = crctableProfTwo[crc ^ 44];
						break;
					case(1) :
						crc = crctableProfTwo[crc ^ 42];
						break;
					case(2) :
						crc = crctableProfTwo[crc ^ 40];
						break;
					case(3) :
						crc = crctableProfTwo[crc ^ 38];
						break;
					case(4) :
						crc = crctableProfTwo[crc ^ 36];
						break;
					case(5) :
						crc = crctableProfTwo[crc ^ 34];
						break;
					case(6) :
						crc = crctableProfTwo[crc ^ 32];
						break;
					case(7) :
						crc = crctableProfTwo[crc ^ 30];
						break;
					case(8) :
						crc = crctableProfTwo[crc ^ 28];
						break;
					case(9) :
						crc = crctableProfTwo[crc ^ 26];
						break;
					case(10) :
						crc = crctableProfTwo[crc ^ 24];
						break;
					case(11) :
						crc = crctableProfTwo[crc ^ 22];
						break;
					case(12) :
						crc = crctableProfTwo[crc ^ 20];
						break;
					case(13) :
						crc = crctableProfTwo[crc ^ 18];
						break;
					case(14) :
						crc = crctableProfTwo[crc ^ 16];
						break;
					case(15) :
						crc = crctableProfTwo[crc ^ 14];
						break;
					default :
//						write("error: wrong parameter (%d)",CounterValForCRC_DPC_IndMd_Style2_Pr2); stop();
						break;
				}
				crc = (crc ^ 0xFF);
				payload[0] = crc;
			}
			else
			{
				//CRC manuel veränderbar
			}

			CH_ESPDPC_IndMd_Style_AR2();
			CH_ESPDPC_IndMd_Stat_AR2();
			CH_ESPDPC_Disp_Rq_AR2();
			CH_ESPDPC_IndMd_Style2_AR2();
			CH_ESPDPC_Master_Rq_AR2();
		}
	}
	if (strncmp (pduName, "DPC_IndMd_Style_AR2", strLen(pduName)+strLen("DPC_IndMd_Style_AR2")) == 0)
	{
		if (TxAck == 1)
		{
			if (@sysvar::CH_Nodes::CH_ESPSQC_DPC_IndMd_Style_P_AUTO == 0)
			{
				//SQC automatisch ändern
				SQC_VAL_DPC_IndMd_Style_Pr2 = (SQC_VAL_DPC_IndMd_Style_Pr2 + 1) % 16;
			}
			else
			{
				//SQC manuel veränderbar
			}

		}
		else
		{
			if (@sysvar::CH_Nodes::CH_ESPSQC_DPC_IndMd_Style_P_AUTO == 0)
			{
				//SQC automatisch ändern
				//SQC für CRC speichern
				CounterValForCRC_DPC_IndMd_Style_Pr2 = SQC_VAL_DPC_IndMd_Style_Pr2;
				//SQC in Byte schreiben
				payload[1] = (payload[1] & ~0x0F) |  SQC_VAL_DPC_IndMd_Style_Pr2;
			}
			else
			{
				//SQC manuel veränderbar
			}

			if (@sysvar::CH_Nodes::CH_ESPCRC_DPC_IndMd_Style_P_AUTO == 0)
			{
				//CRC automatisch berechnen
				crc = 0xFF;
				crc = crctableProfTwo[crc ^ payload[1]];
				crc = crctableProfTwo[crc ^ payload[2]];
				crc = crctableProfTwo[crc ^ payload[3]];
				crc = crctableProfTwo[crc ^ payload[4]];
				crc = crctableProfTwo[crc ^ payload[5]];
				crc = crctableProfTwo[crc ^ payload[6]];
				crc = crctableProfTwo[crc ^ payload[7]];
				switch (CounterValForCRC_DPC_IndMd_Style_Pr2)
				{
					case(0) :
						crc = crctableProfTwo[crc ^ 18];
						break;
					case(1) :
						crc = crctableProfTwo[crc ^ 30];
						break;
					case(2) :
						crc = crctableProfTwo[crc ^ 42];
						break;
					case(3) :
						crc = crctableProfTwo[crc ^ 54];
						break;
					case(4) :
						crc = crctableProfTwo[crc ^ 66];
						break;
					case(5) :
						crc = crctableProfTwo[crc ^ 78];
						break;
					case(6) :
						crc = crctableProfTwo[crc ^ 90];
						break;
					case(7) :
						crc = crctableProfTwo[crc ^ 102];
						break;
					case(8) :
						crc = crctableProfTwo[crc ^ 114];
						break;
					case(9) :
						crc = crctableProfTwo[crc ^ 126];
						break;
					case(10) :
						crc = crctableProfTwo[crc ^ 138];
						break;
					case(11) :
						crc = crctableProfTwo[crc ^ 150];
						break;
					case(12) :
						crc = crctableProfTwo[crc ^ 162];
						break;
					case(13) :
						crc = crctableProfTwo[crc ^ 174];
						break;
					case(14) :
						crc = crctableProfTwo[crc ^ 186];
						break;
					case(15) :
						crc = crctableProfTwo[crc ^ 198];
						break;
					default :
//						write("error: wrong parameter (%d)",CounterValForCRC_DPC_IndMd_Style_Pr2); stop();
						break;
				}
				crc = (crc ^ 0xFF);
				payload[0] = crc;
			}
			else
			{
				//CRC manuel veränderbar
			}

			CH_ESPDPC_IndMd_Style_AR2();
			CH_ESPDPC_IndMd_Stat_AR2();
			CH_ESPDPC_Disp_Rq_AR2();
			CH_ESPDPC_IndMd_Style2_AR2();
			CH_ESPDPC_Master_Rq_AR2();
		}
	}
	if (strncmp (pduName, "DPC_Master_Rq_AR2", strLen(pduName)+strLen("DPC_Master_Rq_AR2")) == 0)
	{
		if (TxAck == 1)
		{
			if (@sysvar::CH_Nodes::CH_ESPSQC_DPC_Master_Rq_Pr2_AUTO == 0)
			{
				//SQC automatisch ändern
				SQC_VAL_DPC_Master_Rq_Pr2 = (SQC_VAL_DPC_Master_Rq_Pr2 + 1) % 16;
			}
			else
			{
				//SQC manuel veränderbar
			}

		}
		else
		{
			if (@sysvar::CH_Nodes::CH_ESPSQC_DPC_Master_Rq_Pr2_AUTO == 0)
			{
				//SQC automatisch ändern
				//SQC für CRC speichern
				CounterValForCRC_DPC_Master_Rq_Pr2 = SQC_VAL_DPC_Master_Rq_Pr2;
				//SQC in Byte schreiben
				payload[1] = (payload[1] & ~0x0F) |  SQC_VAL_DPC_Master_Rq_Pr2;
			}
			else
			{
				//SQC manuel veränderbar
			}

			if (@sysvar::CH_Nodes::CH_ESPCRC_DPC_Master_Rq_Pr2_AUTO == 0)
			{
				//CRC automatisch berechnen
				crc = 0xFF;
				crc = crctableProfTwo[crc ^ payload[1]];
				crc = crctableProfTwo[crc ^ payload[2]];
				crc = crctableProfTwo[crc ^ payload[3]];
				crc = crctableProfTwo[crc ^ payload[4]];
				crc = crctableProfTwo[crc ^ payload[5]];
				crc = crctableProfTwo[crc ^ payload[6]];
				crc = crctableProfTwo[crc ^ payload[7]];
				switch (CounterValForCRC_DPC_Master_Rq_Pr2)
				{
					case(0) :
						crc = crctableProfTwo[crc ^ 109];
						break;
					case(1) :
						crc = crctableProfTwo[crc ^ 219];
						break;
					case(2) :
						crc = crctableProfTwo[crc ^ 78];
						break;
					case(3) :
						crc = crctableProfTwo[crc ^ 188];
						break;
					case(4) :
						crc = crctableProfTwo[crc ^ 47];
						break;
					case(5) :
						crc = crctableProfTwo[crc ^ 157];
						break;
					case(6) :
						crc = crctableProfTwo[crc ^ 16];
						break;
					case(7) :
						crc = crctableProfTwo[crc ^ 126];
						break;
					case(8) :
						crc = crctableProfTwo[crc ^ 236];
						break;
					case(9) :
						crc = crctableProfTwo[crc ^ 95];
						break;
					case(10) :
						crc = crctableProfTwo[crc ^ 205];
						break;
					case(11) :
						crc = crctableProfTwo[crc ^ 64];
						break;
					case(12) :
						crc = crctableProfTwo[crc ^ 174];
						break;
					case(13) :
						crc = crctableProfTwo[crc ^ 33];
						break;
					case(14) :
						crc = crctableProfTwo[crc ^ 143];
						break;
					case(15) :
						crc = crctableProfTwo[crc ^ 253];
						break;
					default :
//						write("error: wrong parameter (%d)",CounterValForCRC_DPC_Master_Rq_Pr2); stop();
						break;
				}
				crc = (crc ^ 0xFF);
				payload[0] = crc;
			}
			else
			{
				//CRC manuel veränderbar
			}

			CH_ESPDPC_IndMd_Style_AR2();
			CH_ESPDPC_IndMd_Stat_AR2();
			CH_ESPDPC_Disp_Rq_AR2();
			CH_ESPDPC_IndMd_Style2_AR2();
			CH_ESPDPC_Master_Rq_AR2();
		}
	}
	if (strncmp (pduName, "Eng_Susp_Rq_AS_AR2", strLen(pduName)+strLen("Eng_Susp_Rq_AS_AR2")) == 0)
	{
		if (TxAck == 1)
		{
			if (@sysvar::CH_Nodes::CH_ESPSQC_Eng_Susp_Rq_AS_Pr_AUTO == 0)
			{
				//SQC automatisch ändern
				SQC_VAL_Eng_Susp_Rq_AS_Pr2 = (SQC_VAL_Eng_Susp_Rq_AS_Pr2 + 1) % 16;
			}
			else
			{
				//SQC manuel veränderbar
			}

		}
		else
		{
			if (@sysvar::CH_Nodes::CH_ESPSQC_Eng_Susp_Rq_AS_Pr_AUTO == 0)
			{
				//SQC automatisch ändern
				//SQC für CRC speichern
				CounterValForCRC_Eng_Susp_Rq_AS_Pr2 = SQC_VAL_Eng_Susp_Rq_AS_Pr2;
				//SQC in Byte schreiben
				payload[1] = (payload[1] & ~0x0F) |  SQC_VAL_Eng_Susp_Rq_AS_Pr2;
			}
			else
			{
				//SQC manuel veränderbar
			}

			if (@sysvar::CH_Nodes::CH_ESPCRC_Eng_Susp_Rq_AS_Pr_AUTO == 0)
			{
				//CRC automatisch berechnen
				crc = 0xFF;
				crc = crctableProfTwo[crc ^ payload[1]];
				crc = crctableProfTwo[crc ^ payload[2]];
				crc = crctableProfTwo[crc ^ payload[3]];
				crc = crctableProfTwo[crc ^ payload[4]];
				crc = crctableProfTwo[crc ^ payload[5]];
				crc = crctableProfTwo[crc ^ payload[6]];
				crc = crctableProfTwo[crc ^ payload[7]];
				switch (CounterValForCRC_Eng_Susp_Rq_AS_Pr2)
				{
					case(0) :
						crc = crctableProfTwo[crc ^ 17];
						break;
					case(1) :
						crc = crctableProfTwo[crc ^ 14];
						break;
					case(2) :
						crc = crctableProfTwo[crc ^ 11];
						break;
					case(3) :
						crc = crctableProfTwo[crc ^ 8];
						break;
					case(4) :
						crc = crctableProfTwo[crc ^ 5];
						break;
					case(5) :
						crc = crctableProfTwo[crc ^ 253];
						break;
					case(6) :
						crc = crctableProfTwo[crc ^ 250];
						break;
					case(7) :
						crc = crctableProfTwo[crc ^ 247];
						break;
					case(8) :
						crc = crctableProfTwo[crc ^ 244];
						break;
					case(9) :
						crc = crctableProfTwo[crc ^ 241];
						break;
					case(10) :
						crc = crctableProfTwo[crc ^ 238];
						break;
					case(11) :
						crc = crctableProfTwo[crc ^ 235];
						break;
					case(12) :
						crc = crctableProfTwo[crc ^ 232];
						break;
					case(13) :
						crc = crctableProfTwo[crc ^ 229];
						break;
					case(14) :
						crc = crctableProfTwo[crc ^ 226];
						break;
					case(15) :
						crc = crctableProfTwo[crc ^ 223];
						break;
					default :
//						write("error: wrong parameter (%d)",CounterValForCRC_Eng_Susp_Rq_AS_Pr2); stop();
						break;
				}
				crc = (crc ^ 0xFF);
				payload[0] = crc;
			}
			else
			{
				//CRC manuel veränderbar
			}

			CH_ESPEng_Susp_Rq_AS_AR2();
			CH_ESPPT_Rq_ESP_AR2();
		}
	}
	if (strncmp (pduName, "EPKB_Disp_IndLmp_Rq_2_AR2", strLen(pduName)+strLen("EPKB_Disp_IndLmp_Rq_2_AR2")) == 0)
	{
		if (TxAck == 1)
		{
			if (@sysvar::CH_Nodes::CH_ESPSQC_EPKB_Disp_IndLmp__AUTO == 0)
			{
				//SQC automatisch ändern
				SQC_VAL_EPKB_Disp_IndLmp_Rq_Pr2 = (SQC_VAL_EPKB_Disp_IndLmp_Rq_Pr2 + 1) % 16;
			}
			else
			{
				//SQC manuel veränderbar
			}

		}
		else
		{
			if (@sysvar::CH_Nodes::CH_ESPSQC_EPKB_Disp_IndLmp__AUTO == 0)
			{
				//SQC automatisch ändern
				//SQC für CRC speichern
				CounterValForCRC_EPKB_Disp_IndLmp_Rq_Pr2 = SQC_VAL_EPKB_Disp_IndLmp_Rq_Pr2;
				//SQC in Byte schreiben
				payload[1] = (payload[1] & ~0x0F) |  SQC_VAL_EPKB_Disp_IndLmp_Rq_Pr2;
			}
			else
			{
				//SQC manuel veränderbar
			}

			if (@sysvar::CH_Nodes::CH_ESPCRC_EPKB_Disp_IndLmp__AUTO == 0)
			{
				//CRC automatisch berechnen
				crc = 0xFF;
				crc = crctableProfTwo[crc ^ payload[1]];
				crc = crctableProfTwo[crc ^ payload[2]];
				crc = crctableProfTwo[crc ^ payload[3]];
				switch (CounterValForCRC_EPKB_Disp_IndLmp_Rq_Pr2)
				{
					case(0) :
						crc = crctableProfTwo[crc ^ 5];
						break;
					case(1) :
						crc = crctableProfTwo[crc ^ 63];
						break;
					case(2) :
						crc = crctableProfTwo[crc ^ 121];
						break;
					case(3) :
						crc = crctableProfTwo[crc ^ 179];
						break;
					case(4) :
						crc = crctableProfTwo[crc ^ 237];
						break;
					case(5) :
						crc = crctableProfTwo[crc ^ 44];
						break;
					case(6) :
						crc = crctableProfTwo[crc ^ 102];
						break;
					case(7) :
						crc = crctableProfTwo[crc ^ 160];
						break;
					case(8) :
						crc = crctableProfTwo[crc ^ 218];
						break;
					case(9) :
						crc = crctableProfTwo[crc ^ 25];
						break;
					case(10) :
						crc = crctableProfTwo[crc ^ 83];
						break;
					case(11) :
						crc = crctableProfTwo[crc ^ 141];
						break;
					case(12) :
						crc = crctableProfTwo[crc ^ 199];
						break;
					case(13) :
						crc = crctableProfTwo[crc ^ 6];
						break;
					case(14) :
						crc = crctableProfTwo[crc ^ 64];
						break;
					case(15) :
						crc = crctableProfTwo[crc ^ 122];
						break;
					default :
//						write("error: wrong parameter (%d)",CounterValForCRC_EPKB_Disp_IndLmp_Rq_Pr2); stop();
						break;
				}
				crc = (crc ^ 0xFF);
				payload[0] = crc;
			}
			else
			{
				//CRC manuel veränderbar
			}

			CH_ESPEPKB_Disp_IndLmp_Rq_2_AR2();
			CH_ESPEPKB_Stat_Gw_AR2();
		}
	}
	if (strncmp (pduName, "EPKB_Stat_Gw_AR2", strLen(pduName)+strLen("EPKB_Stat_Gw_AR2")) == 0)
	{
		if (TxAck == 1)
		{
			if (@sysvar::CH_Nodes::CH_ESPSQC_EPKB_Stat_Pr2EPKB_AUTO == 0)
			{
				//SQC automatisch ändern
				SQC_VAL_EPKB_Stat_Pr2 = (SQC_VAL_EPKB_Stat_Pr2 + 1) % 16;
			}
			else
			{
				//SQC manuel veränderbar
			}

		}
		else
		{
			if (@sysvar::CH_Nodes::CH_ESPSQC_EPKB_Stat_Pr2EPKB_AUTO == 0)
			{
				//SQC automatisch ändern
				//SQC für CRC speichern
				CounterValForCRC_EPKB_Stat_Pr2 = SQC_VAL_EPKB_Stat_Pr2;
				//SQC in Byte schreiben
				payload[1] = (payload[1] & ~0x0F) |  SQC_VAL_EPKB_Stat_Pr2;
			}
			else
			{
				//SQC manuel veränderbar
			}

			if (@sysvar::CH_Nodes::CH_ESPCRC_EPKB_Stat_Pr2EPKB_AUTO == 0)
			{
				//CRC automatisch berechnen
				crc = 0xFF;
				crc = crctableProfTwo[crc ^ payload[1]];
				crc = crctableProfTwo[crc ^ payload[2]];
				crc = crctableProfTwo[crc ^ payload[3]];
				crc = crctableProfTwo[crc ^ payload[4]];
				crc = crctableProfTwo[crc ^ payload[5]];
				crc = crctableProfTwo[crc ^ payload[6]];
				crc = crctableProfTwo[crc ^ payload[7]];
				switch (CounterValForCRC_EPKB_Stat_Pr2)
				{
					case(0) :
						crc = crctableProfTwo[crc ^ 27];
						break;
					case(1) :
						crc = crctableProfTwo[crc ^ 58];
						break;
					case(2) :
						crc = crctableProfTwo[crc ^ 89];
						break;
					case(3) :
						crc = crctableProfTwo[crc ^ 120];
						break;
					case(4) :
						crc = crctableProfTwo[crc ^ 151];
						break;
					case(5) :
						crc = crctableProfTwo[crc ^ 182];
						break;
					case(6) :
						crc = crctableProfTwo[crc ^ 213];
						break;
					case(7) :
						crc = crctableProfTwo[crc ^ 244];
						break;
					case(8) :
						crc = crctableProfTwo[crc ^ 24];
						break;
					case(9) :
						crc = crctableProfTwo[crc ^ 55];
						break;
					case(10) :
						crc = crctableProfTwo[crc ^ 86];
						break;
					case(11) :
						crc = crctableProfTwo[crc ^ 117];
						break;
					case(12) :
						crc = crctableProfTwo[crc ^ 148];
						break;
					case(13) :
						crc = crctableProfTwo[crc ^ 179];
						break;
					case(14) :
						crc = crctableProfTwo[crc ^ 210];
						break;
					case(15) :
						crc = crctableProfTwo[crc ^ 241];
						break;
					default :
//						write("error: wrong parameter (%d)",CounterValForCRC_EPKB_Stat_Pr2); stop();
						break;
				}
				crc = (crc ^ 0xFF);
				payload[0] = crc;
			}
			else
			{
				//CRC manuel veränderbar
			}

			CH_ESPEPKB_Disp_IndLmp_Rq_2_AR2();
			CH_ESPEPKB_Stat_Gw_AR2();
		}
	}
	if (strncmp (pduName, "ESP_Disp_Rq2_AR2", strLen(pduName)+strLen("ESP_Disp_Rq2_AR2")) == 0)
	{
		if (TxAck == 1)
		{
			if (@sysvar::CH_Nodes::CH_ESPSQC_DSR_Disp_Rq_Pr2ES_AUTO == 0)
			{
				//SQC automatisch ändern
				SQC_VAL_DSR_Disp_Rq_Pr2 = (SQC_VAL_DSR_Disp_Rq_Pr2 + 1) % 16;
			}
			else
			{
				//SQC manuel veränderbar
			}

		}
		else
		{
			if (@sysvar::CH_Nodes::CH_ESPSQC_DSR_Disp_Rq_Pr2ES_AUTO == 0)
			{
				//SQC automatisch ändern
				//SQC für CRC speichern
				CounterValForCRC_DSR_Disp_Rq_Pr2 = SQC_VAL_DSR_Disp_Rq_Pr2;
				//SQC in Byte schreiben
				payload[5] = (payload[5] & ~0x0F) |  SQC_VAL_DSR_Disp_Rq_Pr2;
			}
			else
			{
				//SQC manuel veränderbar
			}

			if (@sysvar::CH_Nodes::CH_ESPCRC_DSR_Disp_Rq_Pr2ES_AUTO == 0)
			{
				//CRC automatisch berechnen
				crc = 0xFF;
				crc = crctableProfTwo[crc ^ payload[5]];
				crc = crctableProfTwo[crc ^ payload[6]];
				switch (CounterValForCRC_DSR_Disp_Rq_Pr2)
				{
					case(0) :
						crc = crctableProfTwo[crc ^ 161];
						break;
					case(1) :
						crc = crctableProfTwo[crc ^ 8];
						break;
					case(2) :
						crc = crctableProfTwo[crc ^ 106];
						break;
					case(3) :
						crc = crctableProfTwo[crc ^ 204];
						break;
					case(4) :
						crc = crctableProfTwo[crc ^ 51];
						break;
					case(5) :
						crc = crctableProfTwo[crc ^ 149];
						break;
					case(6) :
						crc = crctableProfTwo[crc ^ 247];
						break;
					case(7) :
						crc = crctableProfTwo[crc ^ 94];
						break;
					case(8) :
						crc = crctableProfTwo[crc ^ 192];
						break;
					case(9) :
						crc = crctableProfTwo[crc ^ 39];
						break;
					case(10) :
						crc = crctableProfTwo[crc ^ 137];
						break;
					case(11) :
						crc = crctableProfTwo[crc ^ 235];
						break;
					case(12) :
						crc = crctableProfTwo[crc ^ 82];
						break;
					case(13) :
						crc = crctableProfTwo[crc ^ 180];
						break;
					case(14) :
						crc = crctableProfTwo[crc ^ 27];
						break;
					case(15) :
						crc = crctableProfTwo[crc ^ 125];
						break;
					default :
//						write("error: wrong parameter (%d)",CounterValForCRC_DSR_Disp_Rq_Pr2); stop();
						break;
				}
				crc = (crc ^ 0xFF);
				payload[4] = crc;
			}
			else
			{
				//CRC manuel veränderbar
			}

			CH_ESPLDC_Disp_Rq_ESP_AR();
			CH_ESPESP_Disp_Rq2_AR2();
			CH_ESPESP_Disp_Rq3_AR();
			CH_ESPESP_Disp_Rq_AR2();
		}
	}
	if (strncmp (pduName, "ESP_Disp_Rq3_AR", strLen(pduName)+strLen("ESP_Disp_Rq3_AR")) == 0)
	{
		if (TxAck == 1)
		{
		}
		else
		{
			CH_ESPLDC_Disp_Rq_ESP_AR();
			CH_ESPESP_Disp_Rq2_AR2();
			CH_ESPESP_Disp_Rq3_AR();
			CH_ESPESP_Disp_Rq_AR2();
		}
	}
	if (strncmp (pduName, "ESP_Disp_Rq_AMG_AR2", strLen(pduName)+strLen("ESP_Disp_Rq_AMG_AR2")) == 0)
	{
		if (TxAck == 1)
		{
		}
		else
		{
		}
	}
	if (strncmp (pduName, "ESP_Disp_Rq_AR2", strLen(pduName)+strLen("ESP_Disp_Rq_AR2")) == 0)
	{
		if (TxAck == 1)
		{
			if (@sysvar::CH_Nodes::CH_ESPSQC_ESP_Disp_Rq_Pr2ES_AUTO == 0)
			{
				//SQC automatisch ändern
				SQC_VAL_ESP_Disp_Rq_Pr2 = (SQC_VAL_ESP_Disp_Rq_Pr2 + 1) % 16;
			}
			else
			{
				//SQC manuel veränderbar
			}

		}
		else
		{
			if (@sysvar::CH_Nodes::CH_ESPSQC_ESP_Disp_Rq_Pr2ES_AUTO == 0)
			{
				//SQC automatisch ändern
				//SQC für CRC speichern
				CounterValForCRC_ESP_Disp_Rq_Pr2 = SQC_VAL_ESP_Disp_Rq_Pr2;
				//SQC in Byte schreiben
				payload[1] = (payload[1] & ~0x0F) |  SQC_VAL_ESP_Disp_Rq_Pr2;
			}
			else
			{
				//SQC manuel veränderbar
			}

			if (@sysvar::CH_Nodes::CH_ESPCRC_ESP_Disp_Rq_Pr2ES_AUTO == 0)
			{
				//CRC automatisch berechnen
				crc = 0xFF;
				crc = crctableProfTwo[crc ^ payload[1]];
				crc = crctableProfTwo[crc ^ payload[2]];
				crc = crctableProfTwo[crc ^ payload[3]];
				crc = crctableProfTwo[crc ^ payload[4]];
				crc = crctableProfTwo[crc ^ payload[5]];
				switch (CounterValForCRC_ESP_Disp_Rq_Pr2)
				{
					case(0) :
						crc = crctableProfTwo[crc ^ 117];
						break;
					case(1) :
						crc = crctableProfTwo[crc ^ 92];
						break;
					case(2) :
						crc = crctableProfTwo[crc ^ 67];
						break;
					case(3) :
						crc = crctableProfTwo[crc ^ 42];
						break;
					case(4) :
						crc = crctableProfTwo[crc ^ 17];
						break;
					case(5) :
						crc = crctableProfTwo[crc ^ 243];
						break;
					case(6) :
						crc = crctableProfTwo[crc ^ 218];
						break;
					case(7) :
						crc = crctableProfTwo[crc ^ 193];
						break;
					case(8) :
						crc = crctableProfTwo[crc ^ 168];
						break;
					case(9) :
						crc = crctableProfTwo[crc ^ 143];
						break;
					case(10) :
						crc = crctableProfTwo[crc ^ 118];
						break;
					case(11) :
						crc = crctableProfTwo[crc ^ 93];
						break;
					case(12) :
						crc = crctableProfTwo[crc ^ 68];
						break;
					case(13) :
						crc = crctableProfTwo[crc ^ 43];
						break;
					case(14) :
						crc = crctableProfTwo[crc ^ 18];
						break;
					case(15) :
						crc = crctableProfTwo[crc ^ 244];
						break;
					default :
//						write("error: wrong parameter (%d)",CounterValForCRC_ESP_Disp_Rq_Pr2); stop();
						break;
				}
				crc = (crc ^ 0xFF);
				payload[0] = crc;
			}
			else
			{
				//CRC manuel veränderbar
			}

			CH_ESPLDC_Disp_Rq_ESP_AR();
			CH_ESPESP_Disp_Rq2_AR2();
			CH_ESPESP_Disp_Rq3_AR();
			CH_ESPESP_Disp_Rq_AR2();
		}
	}
	if (strncmp (pduName, "ESP_OBD_Stat_AR", strLen(pduName)+strLen("ESP_OBD_Stat_AR")) == 0)
	{
		if (TxAck == 1)
		{
		}
		else
		{
			CH_ESPESP_OBD_Stat_AR();
			CH_ESPPresfCtrl_Rq_ESP_AR2();
		}
	}
	if (strncmp (pduName, "ESP_Stat1_AR2", strLen(pduName)+strLen("ESP_Stat1_AR2")) == 0)
	{
		if (TxAck == 1)
		{
		}
		else
		{
		}
	}
	if (strncmp (pduName, "LDC_Disp_Rq_ESP_AR", strLen(pduName)+strLen("LDC_Disp_Rq_ESP_AR")) == 0)
	{
		if (TxAck == 1)
		{
		}
		else
		{
			CH_ESPLDC_Disp_Rq_ESP_AR();
			CH_ESPESP_Disp_Rq2_AR2();
			CH_ESPESP_Disp_Rq3_AR();
			CH_ESPESP_Disp_Rq_AR2();
		}
	}
	if (strncmp (pduName, "PARK_Brk_Rs_AR2", strLen(pduName)+strLen("PARK_Brk_Rs_AR2")) == 0)
	{
		if (TxAck == 1)
		{
			if (@sysvar::CH_Nodes::CH_ESPSQC_PARK_Brk_Rs_Pr2PA_AUTO == 0)
			{
				//SQC automatisch ändern
				SQC_VAL_PARK_Brk_Rs_Pr2 = (SQC_VAL_PARK_Brk_Rs_Pr2 + 1) % 16;
			}
			else
			{
				//SQC manuel veränderbar
			}

		}
		else
		{
			if (@sysvar::CH_Nodes::CH_ESPSQC_PARK_Brk_Rs_Pr2PA_AUTO == 0)
			{
				//SQC automatisch ändern
				//SQC für CRC speichern
				CounterValForCRC_PARK_Brk_Rs_Pr2 = SQC_VAL_PARK_Brk_Rs_Pr2;
				//SQC in Byte schreiben
				payload[1] = (payload[1] & ~0x0F) |  SQC_VAL_PARK_Brk_Rs_Pr2;
			}
			else
			{
				//SQC manuel veränderbar
			}

			if (@sysvar::CH_Nodes::CH_ESPCRC_PARK_Brk_Rs_Pr2PA_AUTO == 0)
			{
				//CRC automatisch berechnen
				crc = 0xFF;
				crc = crctableProfTwo[crc ^ payload[1]];
				crc = crctableProfTwo[crc ^ payload[2]];
				crc = crctableProfTwo[crc ^ payload[3]];
				crc = crctableProfTwo[crc ^ payload[4]];
				crc = crctableProfTwo[crc ^ payload[5]];
				crc = crctableProfTwo[crc ^ payload[6]];
				crc = crctableProfTwo[crc ^ payload[7]];
				switch (CounterValForCRC_PARK_Brk_Rs_Pr2)
				{
					case(0) :
						crc = crctableProfTwo[crc ^ 36];
						break;
					case(1) :
						crc = crctableProfTwo[crc ^ 67];
						break;
					case(2) :
						crc = crctableProfTwo[crc ^ 98];
						break;
					case(3) :
						crc = crctableProfTwo[crc ^ 129];
						break;
					case(4) :
						crc = crctableProfTwo[crc ^ 160];
						break;
					case(5) :
						crc = crctableProfTwo[crc ^ 191];
						break;
					case(6) :
						crc = crctableProfTwo[crc ^ 222];
						break;
					case(7) :
						crc = crctableProfTwo[crc ^ 253];
						break;
					case(8) :
						crc = crctableProfTwo[crc ^ 33];
						break;
					case(9) :
						crc = crctableProfTwo[crc ^ 64];
						break;
					case(10) :
						crc = crctableProfTwo[crc ^ 95];
						break;
					case(11) :
						crc = crctableProfTwo[crc ^ 126];
						break;
					case(12) :
						crc = crctableProfTwo[crc ^ 157];
						break;
					case(13) :
						crc = crctableProfTwo[crc ^ 188];
						break;
					case(14) :
						crc = crctableProfTwo[crc ^ 219];
						break;
					case(15) :
						crc = crctableProfTwo[crc ^ 250];
						break;
					default :
//						write("error: wrong parameter (%d)",CounterValForCRC_PARK_Brk_Rs_Pr2); stop();
						break;
				}
				crc = (crc ^ 0xFF);
				payload[0] = crc;
			}
			else
			{
				//CRC manuel veränderbar
			}

			CH_ESPYMAS_Rs_AR2();
			CH_ESPPARK_Brk_Rs_AR2();
		}
	}
	if (strncmp (pduName, "PARK_Drv_Rq_ESP_AR2", strLen(pduName)+strLen("PARK_Drv_Rq_ESP_AR2")) == 0)
	{
		if (TxAck == 1)
		{
			if (@sysvar::CH_Nodes::CH_ESPSQC_PARK_Drv_Rq_ESP_P_AUTO == 0)
			{
				//SQC automatisch ändern
				SQC_VAL_PARK_Drv_Rq_ESP_Pr2 = (SQC_VAL_PARK_Drv_Rq_ESP_Pr2 + 1) % 16;
			}
			else
			{
				//SQC manuel veränderbar
			}

		}
		else
		{
			if (@sysvar::CH_Nodes::CH_ESPSQC_PARK_Drv_Rq_ESP_P_AUTO == 0)
			{
				//SQC automatisch ändern
				//SQC für CRC speichern
				CounterValForCRC_PARK_Drv_Rq_ESP_Pr2 = SQC_VAL_PARK_Drv_Rq_ESP_Pr2;
				//SQC in Byte schreiben
				payload[1] = (payload[1] & ~0x0F) |  SQC_VAL_PARK_Drv_Rq_ESP_Pr2;
			}
			else
			{
				//SQC manuel veränderbar
			}

			if (@sysvar::CH_Nodes::CH_ESPCRC_PARK_Drv_Rq_ESP_P_AUTO == 0)
			{
				//CRC automatisch berechnen
				crc = 0xFF;
				crc = crctableProfTwo[crc ^ payload[1]];
				crc = crctableProfTwo[crc ^ payload[2]];
				crc = crctableProfTwo[crc ^ payload[3]];
				crc = crctableProfTwo[crc ^ payload[4]];
				crc = crctableProfTwo[crc ^ payload[5]];
				crc = crctableProfTwo[crc ^ payload[6]];
				crc = crctableProfTwo[crc ^ payload[7]];
				switch (CounterValForCRC_PARK_Drv_Rq_ESP_Pr2)
				{
					case(0) :
						crc = crctableProfTwo[crc ^ 126];
						break;
					case(1) :
						crc = crctableProfTwo[crc ^ 20];
						break;
					case(2) :
						crc = crctableProfTwo[crc ^ 165];
						break;
					case(3) :
						crc = crctableProfTwo[crc ^ 59];
						break;
					case(4) :
						crc = crctableProfTwo[crc ^ 204];
						break;
					case(5) :
						crc = crctableProfTwo[crc ^ 98];
						break;
					case(6) :
						crc = crctableProfTwo[crc ^ 243];
						break;
					case(7) :
						crc = crctableProfTwo[crc ^ 137];
						break;
					case(8) :
						crc = crctableProfTwo[crc ^ 31];
						break;
					case(9) :
						crc = crctableProfTwo[crc ^ 176];
						break;
					case(10) :
						crc = crctableProfTwo[crc ^ 70];
						break;
					case(11) :
						crc = crctableProfTwo[crc ^ 215];
						break;
					case(12) :
						crc = crctableProfTwo[crc ^ 109];
						break;
					case(13) :
						crc = crctableProfTwo[crc ^ 3];
						break;
					case(14) :
						crc = crctableProfTwo[crc ^ 148];
						break;
					case(15) :
						crc = crctableProfTwo[crc ^ 42];
						break;
					default :
//						write("error: wrong parameter (%d)",CounterValForCRC_PARK_Drv_Rq_ESP_Pr2); stop();
						break;
				}
				crc = (crc ^ 0xFF);
				payload[0] = crc;
			}
			else
			{
				//CRC manuel veränderbar
			}

			CH_ESPPARK_Drv_Rq_ESP_AR2();
		}
	}
	if (strncmp (pduName, "PresfCtrl_Rq_ESP_AR2", strLen(pduName)+strLen("PresfCtrl_Rq_ESP_AR2")) == 0)
	{
		if (TxAck == 1)
		{
			if (@sysvar::CH_Nodes::CH_ESPSQC_PresfCtrl_Rq_ESP__AUTO == 0)
			{
				//SQC automatisch ändern
				SQC_VAL_PresfCtrl_Rq_ESP_Pr2 = (SQC_VAL_PresfCtrl_Rq_ESP_Pr2 + 1) % 16;
			}
			else
			{
				//SQC manuel veränderbar
			}
			if (@sysvar::CH_Nodes::CH_ESPPresfAct_Adj_TglPresf_AUTO == 0)
			{
				//TGL automatisch ändern
				TGL_VAL_resfAct_Adj_ = (TGL_VAL_resfAct_Adj_ + 1) % 2;
			}
			else
			{
				//TGL manuel veränderbar
			}

		}
		else
		{
			if (@sysvar::CH_Nodes::CH_ESPSQC_PresfCtrl_Rq_ESP__AUTO == 0)
			{
				//SQC automatisch ändern
				//SQC für CRC speichern
				CounterValForCRC_PresfCtrl_Rq_ESP_Pr2 = SQC_VAL_PresfCtrl_Rq_ESP_Pr2;
				//SQC in Byte schreiben
				payload[1] = (payload[1] & ~0x0F) |  SQC_VAL_PresfCtrl_Rq_ESP_Pr2;
			}
			else
			{
				//SQC manuel veränderbar
			}
			if (@sysvar::CH_Nodes::CH_ESPPresfAct_Adj_TglPresf_AUTO == 0)
			{
				//TGL automatisch ändern
				//TGL an richtige Position 'schieben'
				for (i = 0; i < 7; i++)
				{
					TGL_VAL_resfAct_Adj_ = TGL_VAL_resfAct_Adj_ << 1;
				}
				//TGL in Byte schreiben
				payload[1] = (payload[1] & ~0x80) |  TGL_VAL_resfAct_Adj_;
				//TGL wieder zurück 'schieben'
				for (i = 0; i < 7; i++)
				{
					TGL_VAL_resfAct_Adj_ = TGL_VAL_resfAct_Adj_ >> 1;
				}
			}
			else
			{
				//TGL manuel veränderbar
			}

			if (@sysvar::CH_Nodes::CH_ESPCRC_PresfCtrl_Rq_ESP__AUTO == 0)
			{
				//CRC automatisch berechnen
				crc = 0xFF;
				crc = crctableProfTwo[crc ^ payload[1]];
				crc = crctableProfTwo[crc ^ payload[2]];
				crc = crctableProfTwo[crc ^ payload[3]];
				crc = crctableProfTwo[crc ^ payload[4]];
				crc = crctableProfTwo[crc ^ payload[5]];
				crc = crctableProfTwo[crc ^ payload[6]];
				crc = crctableProfTwo[crc ^ payload[7]];
				switch (CounterValForCRC_PresfCtrl_Rq_ESP_Pr2)
				{
					case(0) :
						crc = crctableProfTwo[crc ^ 103];
						break;
					case(1) :
						crc = crctableProfTwo[crc ^ 114];
						break;
					case(2) :
						crc = crctableProfTwo[crc ^ 125];
						break;
					case(3) :
						crc = crctableProfTwo[crc ^ 136];
						break;
					case(4) :
						crc = crctableProfTwo[crc ^ 147];
						break;
					case(5) :
						crc = crctableProfTwo[crc ^ 158];
						break;
					case(6) :
						crc = crctableProfTwo[crc ^ 169];
						break;
					case(7) :
						crc = crctableProfTwo[crc ^ 180];
						break;
					case(8) :
						crc = crctableProfTwo[crc ^ 191];
						break;
					case(9) :
						crc = crctableProfTwo[crc ^ 202];
						break;
					case(10) :
						crc = crctableProfTwo[crc ^ 213];
						break;
					case(11) :
						crc = crctableProfTwo[crc ^ 224];
						break;
					case(12) :
						crc = crctableProfTwo[crc ^ 235];
						break;
					case(13) :
						crc = crctableProfTwo[crc ^ 246];
						break;
					case(14) :
						crc = crctableProfTwo[crc ^ 6];
						break;
					case(15) :
						crc = crctableProfTwo[crc ^ 17];
						break;
					default :
//						write("error: wrong parameter (%d)",CounterValForCRC_PresfCtrl_Rq_ESP_Pr2); stop();
						break;
				}
				crc = (crc ^ 0xFF);
				payload[0] = crc;
			}
			else
			{
				//CRC manuel veränderbar
			}

			CH_ESPESP_OBD_Stat_AR();
			CH_ESPPresfCtrl_Rq_ESP_AR2();
		}
	}
	if (strncmp (pduName, "PT_Rq_ESP_AR2", strLen(pduName)+strLen("PT_Rq_ESP_AR2")) == 0)
	{
		if (TxAck == 1)
		{
			if (@sysvar::CH_Nodes::CH_ESPSQC_PT_Rq_ESP_Pr2PT_R_AUTO == 0)
			{
				//SQC automatisch ändern
				SQC_VAL_PT_Rq_ESP_Pr2 = (SQC_VAL_PT_Rq_ESP_Pr2 + 1) % 16;
			}
			else
			{
				//SQC manuel veränderbar
			}

		}
		else
		{
			if (@sysvar::CH_Nodes::CH_ESPSQC_PT_Rq_ESP_Pr2PT_R_AUTO == 0)
			{
				//SQC automatisch ändern
				//SQC für CRC speichern
				CounterValForCRC_PT_Rq_ESP_Pr2 = SQC_VAL_PT_Rq_ESP_Pr2;
				//SQC in Byte schreiben
				payload[1] = (payload[1] & ~0x0F) |  SQC_VAL_PT_Rq_ESP_Pr2;
			}
			else
			{
				//SQC manuel veränderbar
			}

			if (@sysvar::CH_Nodes::CH_ESPCRC_PT_Rq_ESP_Pr2PT_R_AUTO == 0)
			{
				//CRC automatisch berechnen
				crc = 0xFF;
				crc = crctableProfTwo[crc ^ payload[1]];
				crc = crctableProfTwo[crc ^ payload[2]];
				crc = crctableProfTwo[crc ^ payload[3]];
				crc = crctableProfTwo[crc ^ payload[4]];
				crc = crctableProfTwo[crc ^ payload[5]];
				crc = crctableProfTwo[crc ^ payload[6]];
				crc = crctableProfTwo[crc ^ payload[7]];
				switch (CounterValForCRC_PT_Rq_ESP_Pr2)
				{
					case(0) :
						crc = crctableProfTwo[crc ^ 36];
						break;
					case(1) :
						crc = crctableProfTwo[crc ^ 16];
						break;
					case(2) :
						crc = crctableProfTwo[crc ^ 247];
						break;
					case(3) :
						crc = crctableProfTwo[crc ^ 227];
						break;
					case(4) :
						crc = crctableProfTwo[crc ^ 207];
						break;
					case(5) :
						crc = crctableProfTwo[crc ^ 187];
						break;
					case(6) :
						crc = crctableProfTwo[crc ^ 167];
						break;
					case(7) :
						crc = crctableProfTwo[crc ^ 147];
						break;
					case(8) :
						crc = crctableProfTwo[crc ^ 127];
						break;
					case(9) :
						crc = crctableProfTwo[crc ^ 107];
						break;
					case(10) :
						crc = crctableProfTwo[crc ^ 87];
						break;
					case(11) :
						crc = crctableProfTwo[crc ^ 67];
						break;
					case(12) :
						crc = crctableProfTwo[crc ^ 47];
						break;
					case(13) :
						crc = crctableProfTwo[crc ^ 27];
						break;
					case(14) :
						crc = crctableProfTwo[crc ^ 7];
						break;
					case(15) :
						crc = crctableProfTwo[crc ^ 238];
						break;
					default :
//						write("error: wrong parameter (%d)",CounterValForCRC_PT_Rq_ESP_Pr2); stop();
						break;
				}
				crc = (crc ^ 0xFF);
				payload[0] = crc;
			}
			else
			{
				//CRC manuel veränderbar
			}

			CH_ESPEng_Susp_Rq_AS_AR2();
			CH_ESPPT_Rq_ESP_AR2();
		}
	}
	if (strncmp (pduName, "ROE_ESP", strLen(pduName)+strLen("ROE_ESP")) == 0)
	{
		if (TxAck == 1)
		{
		}
		else
		{
		}
	}
	if (strncmp (pduName, "SADR_Trgr_ESP_AR2", strLen(pduName)+strLen("SADR_Trgr_ESP_AR2")) == 0)
	{
		if (TxAck == 1)
		{
			if (@sysvar::CH_Nodes::CH_ESPSQC_SADR_Trgr_ESP_Pr2_AUTO == 0)
			{
				//SQC automatisch ändern
				SQC_VAL_SADR_Trgr_ESP_Pr2 = (SQC_VAL_SADR_Trgr_ESP_Pr2 + 1) % 16;
			}
			else
			{
				//SQC manuel veränderbar
			}

		}
		else
		{
			if (@sysvar::CH_Nodes::CH_ESPSQC_SADR_Trgr_ESP_Pr2_AUTO == 0)
			{
				//SQC automatisch ändern
				//SQC für CRC speichern
				CounterValForCRC_SADR_Trgr_ESP_Pr2 = SQC_VAL_SADR_Trgr_ESP_Pr2;
				//SQC in Byte schreiben
				payload[1] = (payload[1] & ~0x0F) |  SQC_VAL_SADR_Trgr_ESP_Pr2;
			}
			else
			{
				//SQC manuel veränderbar
			}

			if (@sysvar::CH_Nodes::CH_ESPCRC_SADR_Trgr_ESP_Pr2_AUTO == 0)
			{
				//CRC automatisch berechnen
				crc = 0xFF;
				crc = crctableProfTwo[crc ^ payload[1]];
				crc = crctableProfTwo[crc ^ payload[2]];
				crc = crctableProfTwo[crc ^ payload[3]];
				switch (CounterValForCRC_SADR_Trgr_ESP_Pr2)
				{
					case(0) :
						crc = crctableProfTwo[crc ^ 74];
						break;
					case(1) :
						crc = crctableProfTwo[crc ^ 209];
						break;
					case(2) :
						crc = crctableProfTwo[crc ^ 93];
						break;
					case(3) :
						crc = crctableProfTwo[crc ^ 228];
						break;
					case(4) :
						crc = crctableProfTwo[crc ^ 112];
						break;
					case(5) :
						crc = crctableProfTwo[crc ^ 247];
						break;
					case(6) :
						crc = crctableProfTwo[crc ^ 131];
						break;
					case(7) :
						crc = crctableProfTwo[crc ^ 15];
						break;
					case(8) :
						crc = crctableProfTwo[crc ^ 150];
						break;
					case(9) :
						crc = crctableProfTwo[crc ^ 34];
						break;
					case(10) :
						crc = crctableProfTwo[crc ^ 169];
						break;
					case(11) :
						crc = crctableProfTwo[crc ^ 53];
						break;
					case(12) :
						crc = crctableProfTwo[crc ^ 188];
						break;
					case(13) :
						crc = crctableProfTwo[crc ^ 72];
						break;
					case(14) :
						crc = crctableProfTwo[crc ^ 207];
						break;
					case(15) :
						crc = crctableProfTwo[crc ^ 91];
						break;
					default :
//						write("error: wrong parameter (%d)",CounterValForCRC_SADR_Trgr_ESP_Pr2); stop();
						break;
				}
				crc = (crc ^ 0xFF);
				payload[0] = crc;
			}
			else
			{
				//CRC manuel veränderbar
			}

		}
	}
	if (strncmp (pduName, "St_Rq_STA_AR2", strLen(pduName)+strLen("St_Rq_STA_AR2")) == 0)
	{
		if (TxAck == 1)
		{
			if (@sysvar::CH_Nodes::CH_ESPSQC_St_Rq_STA_Pr2St_R_AUTO == 0)
			{
				//SQC automatisch ändern
				SQC_VAL_St_Rq_STA_Pr2 = (SQC_VAL_St_Rq_STA_Pr2 + 1) % 16;
			}
			else
			{
				//SQC manuel veränderbar
			}

		}
		else
		{
			if (@sysvar::CH_Nodes::CH_ESPSQC_St_Rq_STA_Pr2St_R_AUTO == 0)
			{
				//SQC automatisch ändern
				//SQC für CRC speichern
				CounterValForCRC_St_Rq_STA_Pr2 = SQC_VAL_St_Rq_STA_Pr2;
				//SQC in Byte schreiben
				payload[1] = (payload[1] & ~0x0F) |  SQC_VAL_St_Rq_STA_Pr2;
			}
			else
			{
				//SQC manuel veränderbar
			}

			if (@sysvar::CH_Nodes::CH_ESPCRC_St_Rq_STA_Pr2St_R_AUTO == 0)
			{
				//CRC automatisch berechnen
				crc = 0xFF;
				crc = crctableProfTwo[crc ^ payload[1]];
				crc = crctableProfTwo[crc ^ payload[2]];
				crc = crctableProfTwo[crc ^ payload[3]];
				crc = crctableProfTwo[crc ^ payload[4]];
				crc = crctableProfTwo[crc ^ payload[5]];
				crc = crctableProfTwo[crc ^ payload[6]];
				crc = crctableProfTwo[crc ^ payload[7]];
				switch (CounterValForCRC_St_Rq_STA_Pr2)
				{
					case(0) :
						crc = crctableProfTwo[crc ^ 75];
						break;
					case(1) :
						crc = crctableProfTwo[crc ^ 152];
						break;
					case(2) :
						crc = crctableProfTwo[crc ^ 229];
						break;
					case(3) :
						crc = crctableProfTwo[crc ^ 55];
						break;
					case(4) :
						crc = crctableProfTwo[crc ^ 132];
						break;
					case(5) :
						crc = crctableProfTwo[crc ^ 209];
						break;
					case(6) :
						crc = crctableProfTwo[crc ^ 35];
						break;
					case(7) :
						crc = crctableProfTwo[crc ^ 112];
						break;
					case(8) :
						crc = crctableProfTwo[crc ^ 189];
						break;
					case(9) :
						crc = crctableProfTwo[crc ^ 15];
						break;
					case(10) :
						crc = crctableProfTwo[crc ^ 92];
						break;
					case(11) :
						crc = crctableProfTwo[crc ^ 169];
						break;
					case(12) :
						crc = crctableProfTwo[crc ^ 246];
						break;
					case(13) :
						crc = crctableProfTwo[crc ^ 72];
						break;
					case(14) :
						crc = crctableProfTwo[crc ^ 149];
						break;
					case(15) :
						crc = crctableProfTwo[crc ^ 226];
						break;
					default :
//						write("error: wrong parameter (%d)",CounterValForCRC_St_Rq_STA_Pr2); stop();
						break;
				}
				crc = (crc ^ 0xFF);
				payload[0] = crc;
			}
			else
			{
				//CRC manuel veränderbar
			}

			CH_ESPBrkSys_Stat_AR2();
			CH_ESPSt_Rq_STA_AR2();
		}
	}
	if (strncmp (pduName, "TBCSC_ESP_DAC_AR2", strLen(pduName)+strLen("TBCSC_ESP_DAC_AR2")) == 0)
	{
		if (TxAck == 1)
		{
		}
		else
		{
		}
	}
	if (strncmp (pduName, "TBCSC_Rs1_ESP_AR2", strLen(pduName)+strLen("TBCSC_Rs1_ESP_AR2")) == 0)
	{
		if (TxAck == 1)
		{
			if (@sysvar::CH_Nodes::CH_ESPSQC_TBCSC_Rs1_ESP_Pr2_AUTO == 0)
			{
				//SQC automatisch ändern
				SQC_VAL_TBCSC_Rs1_ESP_Pr2 = (SQC_VAL_TBCSC_Rs1_ESP_Pr2 + 1) % 16;
			}
			else
			{
				//SQC manuel veränderbar
			}

		}
		else
		{
			if (@sysvar::CH_Nodes::CH_ESPSQC_TBCSC_Rs1_ESP_Pr2_AUTO == 0)
			{
				//SQC automatisch ändern
				//SQC für CRC speichern
				CounterValForCRC_TBCSC_Rs1_ESP_Pr2 = SQC_VAL_TBCSC_Rs1_ESP_Pr2;
				//SQC in Byte schreiben
				payload[1] = (payload[1] & ~0x0F) |  SQC_VAL_TBCSC_Rs1_ESP_Pr2;
			}
			else
			{
				//SQC manuel veränderbar
			}

			if (@sysvar::CH_Nodes::CH_ESPCRC_TBCSC_Rs1_ESP_Pr2_AUTO == 0)
			{
				//CRC automatisch berechnen
				crc = 0xFF;
				crc = crctableProfTwo[crc ^ payload[1]];
				crc = crctableProfTwo[crc ^ payload[2]];
				crc = crctableProfTwo[crc ^ payload[3]];
				crc = crctableProfTwo[crc ^ payload[4]];
				crc = crctableProfTwo[crc ^ payload[5]];
				crc = crctableProfTwo[crc ^ payload[6]];
				crc = crctableProfTwo[crc ^ payload[7]];
				switch (CounterValForCRC_TBCSC_Rs1_ESP_Pr2)
				{
					case(0) :
						crc = crctableProfTwo[crc ^ 27];
						break;
					case(1) :
						crc = crctableProfTwo[crc ^ 100];
						break;
					case(2) :
						crc = crctableProfTwo[crc ^ 173];
						break;
					case(3) :
						crc = crctableProfTwo[crc ^ 246];
						break;
					case(4) :
						crc = crctableProfTwo[crc ^ 68];
						break;
					case(5) :
						crc = crctableProfTwo[crc ^ 141];
						break;
					case(6) :
						crc = crctableProfTwo[crc ^ 214];
						break;
					case(7) :
						crc = crctableProfTwo[crc ^ 36];
						break;
					case(8) :
						crc = crctableProfTwo[crc ^ 109];
						break;
					case(9) :
						crc = crctableProfTwo[crc ^ 182];
						break;
					case(10) :
						crc = crctableProfTwo[crc ^ 4];
						break;
					case(11) :
						crc = crctableProfTwo[crc ^ 77];
						break;
					case(12) :
						crc = crctableProfTwo[crc ^ 150];
						break;
					case(13) :
						crc = crctableProfTwo[crc ^ 223];
						break;
					case(14) :
						crc = crctableProfTwo[crc ^ 45];
						break;
					case(15) :
						crc = crctableProfTwo[crc ^ 118];
						break;
					default :
//						write("error: wrong parameter (%d)",CounterValForCRC_TBCSC_Rs1_ESP_Pr2); stop();
						break;
				}
				crc = (crc ^ 0xFF);
				payload[0] = crc;
			}
			else
			{
				//CRC manuel veränderbar
			}

			CH_ESPTBCSC_Rs1_ESP_AR2();
			CH_ESPTBCSC_Rs2_ESP_AR2();
		}
	}
	if (strncmp (pduName, "TBCSC_Rs2_ESP_AR2", strLen(pduName)+strLen("TBCSC_Rs2_ESP_AR2")) == 0)
	{
		if (TxAck == 1)
		{
			if (@sysvar::CH_Nodes::CH_ESPSQC_TBCSC_Rs2_ESP_Pr2_AUTO == 0)
			{
				//SQC automatisch ändern
				SQC_VAL_TBCSC_Rs2_ESP_Pr2 = (SQC_VAL_TBCSC_Rs2_ESP_Pr2 + 1) % 16;
			}
			else
			{
				//SQC manuel veränderbar
			}

		}
		else
		{
			if (@sysvar::CH_Nodes::CH_ESPSQC_TBCSC_Rs2_ESP_Pr2_AUTO == 0)
			{
				//SQC automatisch ändern
				//SQC für CRC speichern
				CounterValForCRC_TBCSC_Rs2_ESP_Pr2 = SQC_VAL_TBCSC_Rs2_ESP_Pr2;
				//SQC in Byte schreiben
				payload[1] = (payload[1] & ~0x0F) |  SQC_VAL_TBCSC_Rs2_ESP_Pr2;
			}
			else
			{
				//SQC manuel veränderbar
			}

			if (@sysvar::CH_Nodes::CH_ESPCRC_TBCSC_Rs2_ESP_Pr2_AUTO == 0)
			{
				//CRC automatisch berechnen
				crc = 0xFF;
				crc = crctableProfTwo[crc ^ payload[1]];
				crc = crctableProfTwo[crc ^ payload[2]];
				crc = crctableProfTwo[crc ^ payload[3]];
				crc = crctableProfTwo[crc ^ payload[4]];
				crc = crctableProfTwo[crc ^ payload[5]];
				crc = crctableProfTwo[crc ^ payload[6]];
				crc = crctableProfTwo[crc ^ payload[7]];
				switch (CounterValForCRC_TBCSC_Rs2_ESP_Pr2)
				{
					case(0) :
						crc = crctableProfTwo[crc ^ 130];
						break;
					case(1) :
						crc = crctableProfTwo[crc ^ 109];
						break;
					case(2) :
						crc = crctableProfTwo[crc ^ 88];
						break;
					case(3) :
						crc = crctableProfTwo[crc ^ 67];
						break;
					case(4) :
						crc = crctableProfTwo[crc ^ 46];
						break;
					case(5) :
						crc = crctableProfTwo[crc ^ 25];
						break;
					case(6) :
						crc = crctableProfTwo[crc ^ 4];
						break;
					case(7) :
						crc = crctableProfTwo[crc ^ 234];
						break;
					case(8) :
						crc = crctableProfTwo[crc ^ 213];
						break;
					case(9) :
						crc = crctableProfTwo[crc ^ 192];
						break;
					case(10) :
						crc = crctableProfTwo[crc ^ 171];
						break;
					case(11) :
						crc = crctableProfTwo[crc ^ 150];
						break;
					case(12) :
						crc = crctableProfTwo[crc ^ 129];
						break;
					case(13) :
						crc = crctableProfTwo[crc ^ 108];
						break;
					case(14) :
						crc = crctableProfTwo[crc ^ 87];
						break;
					case(15) :
						crc = crctableProfTwo[crc ^ 66];
						break;
					default :
//						write("error: wrong parameter (%d)",CounterValForCRC_TBCSC_Rs2_ESP_Pr2); stop();
						break;
				}
				crc = (crc ^ 0xFF);
				payload[0] = crc;
			}
			else
			{
				//CRC manuel veränderbar
			}

			CH_ESPTBCSC_Rs1_ESP_AR2();
			CH_ESPTBCSC_Rs2_ESP_AR2();
		}
	}
	if (strncmp (pduName, "VehAccel_X_Rs1_AR2", strLen(pduName)+strLen("VehAccel_X_Rs1_AR2")) == 0)
	{
		if (TxAck == 1)
		{
			if (@sysvar::CH_Nodes::CH_ESPSQC_VehAccel_X_Rs1_Pr_AUTO == 0)
			{
				//SQC automatisch ändern
				SQC_VAL_VehAccel_X_Rs1_Pr2 = (SQC_VAL_VehAccel_X_Rs1_Pr2 + 1) % 16;
			}
			else
			{
				//SQC manuel veränderbar
			}

		}
		else
		{
			if (@sysvar::CH_Nodes::CH_ESPSQC_VehAccel_X_Rs1_Pr_AUTO == 0)
			{
				//SQC automatisch ändern
				//SQC für CRC speichern
				CounterValForCRC_VehAccel_X_Rs1_Pr2 = SQC_VAL_VehAccel_X_Rs1_Pr2;
				//SQC in Byte schreiben
				payload[1] = (payload[1] & ~0x0F) |  SQC_VAL_VehAccel_X_Rs1_Pr2;
			}
			else
			{
				//SQC manuel veränderbar
			}

			if (@sysvar::CH_Nodes::CH_ESPCRC_VehAccel_X_Rs1_Pr_AUTO == 0)
			{
				//CRC automatisch berechnen
				crc = 0xFF;
				crc = crctableProfTwo[crc ^ payload[1]];
				crc = crctableProfTwo[crc ^ payload[2]];
				crc = crctableProfTwo[crc ^ payload[3]];
				crc = crctableProfTwo[crc ^ payload[4]];
				crc = crctableProfTwo[crc ^ payload[5]];
				crc = crctableProfTwo[crc ^ payload[6]];
				crc = crctableProfTwo[crc ^ payload[7]];
				switch (CounterValForCRC_VehAccel_X_Rs1_Pr2)
				{
					case(0) :
						crc = crctableProfTwo[crc ^ 8];
						break;
					case(1) :
						crc = crctableProfTwo[crc ^ 10];
						break;
					case(2) :
						crc = crctableProfTwo[crc ^ 12];
						break;
					case(3) :
						crc = crctableProfTwo[crc ^ 14];
						break;
					case(4) :
						crc = crctableProfTwo[crc ^ 16];
						break;
					case(5) :
						crc = crctableProfTwo[crc ^ 18];
						break;
					case(6) :
						crc = crctableProfTwo[crc ^ 20];
						break;
					case(7) :
						crc = crctableProfTwo[crc ^ 22];
						break;
					case(8) :
						crc = crctableProfTwo[crc ^ 24];
						break;
					case(9) :
						crc = crctableProfTwo[crc ^ 26];
						break;
					case(10) :
						crc = crctableProfTwo[crc ^ 28];
						break;
					case(11) :
						crc = crctableProfTwo[crc ^ 30];
						break;
					case(12) :
						crc = crctableProfTwo[crc ^ 32];
						break;
					case(13) :
						crc = crctableProfTwo[crc ^ 34];
						break;
					case(14) :
						crc = crctableProfTwo[crc ^ 36];
						break;
					case(15) :
						crc = crctableProfTwo[crc ^ 38];
						break;
					default :
//						write("error: wrong parameter (%d)",CounterValForCRC_VehAccel_X_Rs1_Pr2); stop();
						break;
				}
				crc = (crc ^ 0xFF);
				payload[0] = crc;
			}
			else
			{
				//CRC manuel veränderbar
			}

			CH_ESPVehAccel_X_Rs1_AR2();
			CH_ESPWhl_Lt_Stat_AR2();
		}
	}
	if (strncmp (pduName, "VehAccel_X_Rs2_AR2", strLen(pduName)+strLen("VehAccel_X_Rs2_AR2")) == 0)
	{
		if (TxAck == 1)
		{
			if (@sysvar::CH_Nodes::CH_ESPSQC_VehAccel_X_Rs2_Pr_AUTO == 0)
			{
				//SQC automatisch ändern
				SQC_VAL_VehAccel_X_Rs2_Pr2 = (SQC_VAL_VehAccel_X_Rs2_Pr2 + 1) % 16;
			}
			else
			{
				//SQC manuel veränderbar
			}

		}
		else
		{
			if (@sysvar::CH_Nodes::CH_ESPSQC_VehAccel_X_Rs2_Pr_AUTO == 0)
			{
				//SQC automatisch ändern
				//SQC für CRC speichern
				CounterValForCRC_VehAccel_X_Rs2_Pr2 = SQC_VAL_VehAccel_X_Rs2_Pr2;
				//SQC in Byte schreiben
				payload[1] = (payload[1] & ~0x0F) |  SQC_VAL_VehAccel_X_Rs2_Pr2;
			}
			else
			{
				//SQC manuel veränderbar
			}

			if (@sysvar::CH_Nodes::CH_ESPCRC_VehAccel_X_Rs2_Pr_AUTO == 0)
			{
				//CRC automatisch berechnen
				crc = 0xFF;
				crc = crctableProfTwo[crc ^ payload[1]];
				crc = crctableProfTwo[crc ^ payload[2]];
				crc = crctableProfTwo[crc ^ payload[3]];
				crc = crctableProfTwo[crc ^ payload[4]];
				crc = crctableProfTwo[crc ^ payload[5]];
				crc = crctableProfTwo[crc ^ payload[6]];
				crc = crctableProfTwo[crc ^ payload[7]];
				switch (CounterValForCRC_VehAccel_X_Rs2_Pr2)
				{
					case(0) :
						crc = crctableProfTwo[crc ^ 118];
						break;
					case(1) :
						crc = crctableProfTwo[crc ^ 134];
						break;
					case(2) :
						crc = crctableProfTwo[crc ^ 150];
						break;
					case(3) :
						crc = crctableProfTwo[crc ^ 166];
						break;
					case(4) :
						crc = crctableProfTwo[crc ^ 182];
						break;
					case(5) :
						crc = crctableProfTwo[crc ^ 198];
						break;
					case(6) :
						crc = crctableProfTwo[crc ^ 214];
						break;
					case(7) :
						crc = crctableProfTwo[crc ^ 230];
						break;
					case(8) :
						crc = crctableProfTwo[crc ^ 246];
						break;
					case(9) :
						crc = crctableProfTwo[crc ^ 11];
						break;
					case(10) :
						crc = crctableProfTwo[crc ^ 27];
						break;
					case(11) :
						crc = crctableProfTwo[crc ^ 43];
						break;
					case(12) :
						crc = crctableProfTwo[crc ^ 59];
						break;
					case(13) :
						crc = crctableProfTwo[crc ^ 75];
						break;
					case(14) :
						crc = crctableProfTwo[crc ^ 91];
						break;
					case(15) :
						crc = crctableProfTwo[crc ^ 107];
						break;
					default :
//						write("error: wrong parameter (%d)",CounterValForCRC_VehAccel_X_Rs2_Pr2); stop();
						break;
				}
				crc = (crc ^ 0xFF);
				payload[0] = crc;
			}
			else
			{
				//CRC manuel veränderbar
			}

			CH_ESPWhl_Rt_Stat_AR2();
			CH_ESPVehAccel_X_Rs2_AR2();
		}
	}
	if (strncmp (pduName, "VehDyn_Stat1_AR2", strLen(pduName)+strLen("VehDyn_Stat1_AR2")) == 0)
	{
		if (TxAck == 1)
		{
			if (@sysvar::CH_Nodes::CH_ESPSQC_VehDyn_Stat1_Pr2V_AUTO == 0)
			{
				//SQC automatisch ändern
				SQC_VAL_VehDyn_Stat1_Pr2 = (SQC_VAL_VehDyn_Stat1_Pr2 + 1) % 16;
			}
			else
			{
				//SQC manuel veränderbar
			}

		}
		else
		{
			if (@sysvar::CH_Nodes::CH_ESPSQC_VehDyn_Stat1_Pr2V_AUTO == 0)
			{
				//SQC automatisch ändern
				//SQC für CRC speichern
				CounterValForCRC_VehDyn_Stat1_Pr2 = SQC_VAL_VehDyn_Stat1_Pr2;
				//SQC in Byte schreiben
				payload[1] = (payload[1] & ~0x0F) |  SQC_VAL_VehDyn_Stat1_Pr2;
			}
			else
			{
				//SQC manuel veränderbar
			}

			if (@sysvar::CH_Nodes::CH_ESPCRC_VehDyn_Stat1_Pr2V_AUTO == 0)
			{
				//CRC automatisch berechnen
				crc = 0xFF;
				crc = crctableProfTwo[crc ^ payload[1]];
				crc = crctableProfTwo[crc ^ payload[2]];
				crc = crctableProfTwo[crc ^ payload[3]];
				crc = crctableProfTwo[crc ^ payload[4]];
				crc = crctableProfTwo[crc ^ payload[5]];
				crc = crctableProfTwo[crc ^ payload[6]];
				crc = crctableProfTwo[crc ^ payload[7]];
				switch (CounterValForCRC_VehDyn_Stat1_Pr2)
				{
					case(0) :
						crc = crctableProfTwo[crc ^ 124];
						break;
					case(1) :
						crc = crctableProfTwo[crc ^ 120];
						break;
					case(2) :
						crc = crctableProfTwo[crc ^ 116];
						break;
					case(3) :
						crc = crctableProfTwo[crc ^ 112];
						break;
					case(4) :
						crc = crctableProfTwo[crc ^ 108];
						break;
					case(5) :
						crc = crctableProfTwo[crc ^ 104];
						break;
					case(6) :
						crc = crctableProfTwo[crc ^ 100];
						break;
					case(7) :
						crc = crctableProfTwo[crc ^ 96];
						break;
					case(8) :
						crc = crctableProfTwo[crc ^ 92];
						break;
					case(9) :
						crc = crctableProfTwo[crc ^ 88];
						break;
					case(10) :
						crc = crctableProfTwo[crc ^ 84];
						break;
					case(11) :
						crc = crctableProfTwo[crc ^ 80];
						break;
					case(12) :
						crc = crctableProfTwo[crc ^ 76];
						break;
					case(13) :
						crc = crctableProfTwo[crc ^ 72];
						break;
					case(14) :
						crc = crctableProfTwo[crc ^ 68];
						break;
					case(15) :
						crc = crctableProfTwo[crc ^ 64];
						break;
					default :
//						write("error: wrong parameter (%d)",CounterValForCRC_VehDyn_Stat1_Pr2); stop();
						break;
				}
				crc = (crc ^ 0xFF);
				payload[0] = crc;
			}
			else
			{
				//CRC manuel veränderbar
			}

			CH_ESPVehDyn_Stat2_AR2();
			CH_ESPVehDyn_Stat1_AR2();
		}
	}
	if (strncmp (pduName, "VehDyn_Stat2_AR2", strLen(pduName)+strLen("VehDyn_Stat2_AR2")) == 0)
	{
		if (TxAck == 1)
		{
			if (@sysvar::CH_Nodes::CH_ESPSQC_VehDyn_Stat2_Pr2V_AUTO == 0)
			{
				//SQC automatisch ändern
				SQC_VAL_VehDyn_Stat2_Pr2 = (SQC_VAL_VehDyn_Stat2_Pr2 + 1) % 16;
			}
			else
			{
				//SQC manuel veränderbar
			}

		}
		else
		{
			if (@sysvar::CH_Nodes::CH_ESPSQC_VehDyn_Stat2_Pr2V_AUTO == 0)
			{
				//SQC automatisch ändern
				//SQC für CRC speichern
				CounterValForCRC_VehDyn_Stat2_Pr2 = SQC_VAL_VehDyn_Stat2_Pr2;
				//SQC in Byte schreiben
				payload[1] = (payload[1] & ~0x0F) |  SQC_VAL_VehDyn_Stat2_Pr2;
			}
			else
			{
				//SQC manuel veränderbar
			}

			if (@sysvar::CH_Nodes::CH_ESPCRC_VehDyn_Stat2_Pr2V_AUTO == 0)
			{
				//CRC automatisch berechnen
				crc = 0xFF;
				crc = crctableProfTwo[crc ^ payload[1]];
				crc = crctableProfTwo[crc ^ payload[2]];
				crc = crctableProfTwo[crc ^ payload[3]];
				crc = crctableProfTwo[crc ^ payload[4]];
				crc = crctableProfTwo[crc ^ payload[5]];
				crc = crctableProfTwo[crc ^ payload[6]];
				crc = crctableProfTwo[crc ^ payload[7]];
				switch (CounterValForCRC_VehDyn_Stat2_Pr2)
				{
					case(0) :
						crc = crctableProfTwo[crc ^ 163];
						break;
					case(1) :
						crc = crctableProfTwo[crc ^ 16];
						break;
					case(2) :
						crc = crctableProfTwo[crc ^ 120];
						break;
					case(3) :
						crc = crctableProfTwo[crc ^ 224];
						break;
					case(4) :
						crc = crctableProfTwo[crc ^ 77];
						break;
					case(5) :
						crc = crctableProfTwo[crc ^ 181];
						break;
					case(6) :
						crc = crctableProfTwo[crc ^ 34];
						break;
					case(7) :
						crc = crctableProfTwo[crc ^ 138];
						break;
					case(8) :
						crc = crctableProfTwo[crc ^ 242];
						break;
					case(9) :
						crc = crctableProfTwo[crc ^ 95];
						break;
					case(10) :
						crc = crctableProfTwo[crc ^ 199];
						break;
					case(11) :
						crc = crctableProfTwo[crc ^ 52];
						break;
					case(12) :
						crc = crctableProfTwo[crc ^ 156];
						break;
					case(13) :
						crc = crctableProfTwo[crc ^ 9];
						break;
					case(14) :
						crc = crctableProfTwo[crc ^ 113];
						break;
					case(15) :
						crc = crctableProfTwo[crc ^ 217];
						break;
					default :
//						write("error: wrong parameter (%d)",CounterValForCRC_VehDyn_Stat2_Pr2); stop();
						break;
				}
				crc = (crc ^ 0xFF);
				payload[0] = crc;
			}
			else
			{
				//CRC manuel veränderbar
			}

			CH_ESPVehDyn_Stat2_AR2();
			CH_ESPVehDyn_Stat1_AR2();
		}
	}
	if (strncmp (pduName, "VehSpd_X_AR2", strLen(pduName)+strLen("VehSpd_X_AR2")) == 0)
	{
		if (TxAck == 1)
		{
			if (@sysvar::CH_Nodes::CH_ESPSQC_VehSpd_X_Pr2VehSp_AUTO == 0)
			{
				//SQC automatisch ändern
				SQC_VAL_VehSpd_X_Pr2 = (SQC_VAL_VehSpd_X_Pr2 + getValue(VSys_SQC_Jump_VehSpd_X)) % 16;
			}
			else
			{
				//SQC manuel veränderbar
			}

		}
		else
		{
			if (@sysvar::CH_Nodes::CH_ESPSQC_VehSpd_X_Pr2VehSp_AUTO == 0)
			{
				//SQC automatisch ändern
				//SQC für CRC speichern
				CounterValForCRC_VehSpd_X_Pr2 = SQC_VAL_VehSpd_X_Pr2;
				//SQC in Byte schreiben
				payload[1] = (payload[1] & ~0x0F) |  SQC_VAL_VehSpd_X_Pr2;
			}
			else
			{
				//SQC manuel veränderbar
			}

			if (@sysvar::CH_Nodes::CH_ESPCRC_VehSpd_X_Pr2VehSp_AUTO == 0)
			{
				//CRC automatisch berechnen
				crc = 0xFF;
				crc = crctableProfTwo[crc ^ payload[1]];
				crc = crctableProfTwo[crc ^ payload[2]];
				crc = crctableProfTwo[crc ^ payload[3]];
				crc = crctableProfTwo[crc ^ payload[4]];
				crc = crctableProfTwo[crc ^ payload[5]];
				crc = crctableProfTwo[crc ^ payload[6]];
				crc = crctableProfTwo[crc ^ payload[7]];
				switch (CounterValForCRC_VehSpd_X_Pr2)
				{
					case(0) :
						crc = crctableProfTwo[crc ^ 59];
						break;
					case(1) :
						crc = crctableProfTwo[crc ^ 75];
						break;
					case(2) :
						crc = crctableProfTwo[crc ^ 91];
						break;
					case(3) :
						crc = crctableProfTwo[crc ^ 107];
						break;
					case(4) :
						crc = crctableProfTwo[crc ^ 123];
						break;
					case(5) :
						crc = crctableProfTwo[crc ^ 139];
						break;
					case(6) :
						crc = crctableProfTwo[crc ^ 155];
						break;
					case(7) :
						crc = crctableProfTwo[crc ^ 171];
						break;
					case(8) :
						crc = crctableProfTwo[crc ^ 187];
						break;
					case(9) :
						crc = crctableProfTwo[crc ^ 203];
						break;
					case(10) :
						crc = crctableProfTwo[crc ^ 219];
						break;
					case(11) :
						crc = crctableProfTwo[crc ^ 235];
						break;
					case(12) :
						crc = crctableProfTwo[crc ^ 251];
						break;
					case(13) :
						crc = crctableProfTwo[crc ^ 16];
						break;
					case(14) :
						crc = crctableProfTwo[crc ^ 32];
						break;
					case(15) :
						crc = crctableProfTwo[crc ^ 48];
						break;
					default :
//						write("error: wrong parameter (%d)",CounterValForCRC_VehSpd_X_Pr2); stop();
						break;
				}
				crc = (crc ^ 0xFF);
				payload[0] = crc;
			}
			else
			{
				//CRC manuel veränderbar
			}

			CH_ESPVehSpd_X_AR2();
			CH_ESPWhlPlsCnt_TPM_AR2();
		}
	}
	if (strncmp (pduName, "Whl_Lt_Stat_AR2", strLen(pduName)+strLen("Whl_Lt_Stat_AR2")) == 0)
	{
		if (TxAck == 1)
		{
			if (@sysvar::CH_Nodes::CH_ESPSQC_Whl_Lt_Stat_Pr2Wh_AUTO == 0)
			{
				//SQC automatisch ändern
				SQC_VAL_Whl_Lt_Stat_Pr2 = (SQC_VAL_Whl_Lt_Stat_Pr2 + 1) % 16;
			}
			else
			{
				//SQC manuel veränderbar
			}

			Whl_Lt_Stat_AR2_WhlPlsCnt_FL_Count = (int)(Whl_Lt_Stat_AR2_WhlPlsCnt_FL_Count + @sysvar::CH_Nodes::CH__ESP_WhlPlsCnt_FL) % 254;
			Whl_Lt_Stat_AR2_WhlPlsCnt_RL_Count = (int)(Whl_Lt_Stat_AR2_WhlPlsCnt_RL_Count + @sysvar::CH_Nodes::CH__ESP_WhlPlsCnt_RL) % 254;
			//SetWhl_Lt_Stat_AR2 ();
		}
		else
		{
			if (@sysvar::CH_Nodes::CH_ESPSQC_Whl_Lt_Stat_Pr2Wh_AUTO == 0)
			{
				//SQC automatisch ändern
				//SQC für CRC speichern
				CounterValForCRC_Whl_Lt_Stat_Pr2 = SQC_VAL_Whl_Lt_Stat_Pr2;
				//SQC in Byte schreiben
				payload[1] = (payload[1] & ~0x0F) |  SQC_VAL_Whl_Lt_Stat_Pr2;
			}
			else
			{
				//SQC manuel veränderbar
			}

			if (@sysvar::CH_Nodes::CH_ESPCRC_Whl_Lt_Stat_Pr2Wh_AUTO == 0)
			{
				//CRC automatisch berechnen
				crc = 0xFF;
				crc = crctableProfTwo[crc ^ payload[1]];
				crc = crctableProfTwo[crc ^ payload[2]];
				crc = crctableProfTwo[crc ^ payload[3]];
				crc = crctableProfTwo[crc ^ payload[4]];
				crc = crctableProfTwo[crc ^ payload[5]];
				crc = crctableProfTwo[crc ^ payload[6]];
				crc = crctableProfTwo[crc ^ payload[7]];
				switch (CounterValForCRC_Whl_Lt_Stat_Pr2)
				{
					case(0) :
						crc = crctableProfTwo[crc ^ 135];
						break;
					case(1) :
						crc = crctableProfTwo[crc ^ 212];
						break;
					case(2) :
						crc = crctableProfTwo[crc ^ 38];
						break;
					case(3) :
						crc = crctableProfTwo[crc ^ 115];
						break;
					case(4) :
						crc = crctableProfTwo[crc ^ 192];
						break;
					case(5) :
						crc = crctableProfTwo[crc ^ 18];
						break;
					case(6) :
						crc = crctableProfTwo[crc ^ 95];
						break;
					case(7) :
						crc = crctableProfTwo[crc ^ 172];
						break;
					case(8) :
						crc = crctableProfTwo[crc ^ 249];
						break;
					case(9) :
						crc = crctableProfTwo[crc ^ 75];
						break;
					case(10) :
						crc = crctableProfTwo[crc ^ 152];
						break;
					case(11) :
						crc = crctableProfTwo[crc ^ 229];
						break;
					case(12) :
						crc = crctableProfTwo[crc ^ 55];
						break;
					case(13) :
						crc = crctableProfTwo[crc ^ 132];
						break;
					case(14) :
						crc = crctableProfTwo[crc ^ 209];
						break;
					case(15) :
						crc = crctableProfTwo[crc ^ 35];
						break;
					default :
//						write("error: wrong parameter (%d)",CounterValForCRC_Whl_Lt_Stat_Pr2); stop();
						break;
				}
				crc = (crc ^ 0xFF);
				payload[0] = crc;
			}
			else
			{
				//CRC manuel veränderbar
			}

			CH_ESPVehAccel_X_Rs1_AR2();
			CH_ESPWhl_Lt_Stat_AR2();
		}
	}
	if (strncmp (pduName, "Whl_Rt_Stat_AR2", strLen(pduName)+strLen("Whl_Rt_Stat_AR2")) == 0)
	{
		if (TxAck == 1)
		{
			if (@sysvar::CH_Nodes::CH_ESPSQC_Whl_Rt_Stat_Pr2Wh_AUTO == 0)
			{
				//SQC automatisch ändern
				SQC_VAL_Whl_Rt_Stat_Pr2 = (SQC_VAL_Whl_Rt_Stat_Pr2 + 1) % 16;
			}
			else
			{
				//SQC manuel veränderbar
			}

			Whl_Rt_Stat_AR2_WhlPlsCnt_FR_Count = (int)(Whl_Rt_Stat_AR2_WhlPlsCnt_FR_Count + @sysvar::CH_Nodes::CH__ESP_WhlPlsCnt_FR) % 254;
			Whl_Rt_Stat_AR2_WhlPlsCnt_RR_Count = (int)(Whl_Rt_Stat_AR2_WhlPlsCnt_RR_Count + @sysvar::CH_Nodes::CH__ESP_WhlPlsCnt_RR) % 254;
			//SetWhl_Rt_Stat_AR2 ();
		}
		else
		{
			if (@sysvar::CH_Nodes::CH_ESPSQC_Whl_Rt_Stat_Pr2Wh_AUTO == 0)
			{
				//SQC automatisch ändern
				//SQC für CRC speichern
				CounterValForCRC_Whl_Rt_Stat_Pr2 = SQC_VAL_Whl_Rt_Stat_Pr2;
				//SQC in Byte schreiben
				payload[1] = (payload[1] & ~0x0F) |  SQC_VAL_Whl_Rt_Stat_Pr2;
			}
			else
			{
				//SQC manuel veränderbar
			}

			if (@sysvar::CH_Nodes::CH_ESPCRC_Whl_Rt_Stat_Pr2Wh_AUTO == 0)
			{
				//CRC automatisch berechnen
				crc = 0xFF;
				crc = crctableProfTwo[crc ^ payload[1]];
				crc = crctableProfTwo[crc ^ payload[2]];
				crc = crctableProfTwo[crc ^ payload[3]];
				crc = crctableProfTwo[crc ^ payload[4]];
				crc = crctableProfTwo[crc ^ payload[5]];
				crc = crctableProfTwo[crc ^ payload[6]];
				crc = crctableProfTwo[crc ^ payload[7]];
				switch (CounterValForCRC_Whl_Rt_Stat_Pr2)
				{
					case(0) :
						crc = crctableProfTwo[crc ^ 39];
						break;
					case(1) :
						crc = crctableProfTwo[crc ^ 128];
						break;
					case(2) :
						crc = crctableProfTwo[crc ^ 217];
						break;
					case(3) :
						crc = crctableProfTwo[crc ^ 55];
						break;
					case(4) :
						crc = crctableProfTwo[crc ^ 144];
						break;
					case(5) :
						crc = crctableProfTwo[crc ^ 233];
						break;
					case(6) :
						crc = crctableProfTwo[crc ^ 71];
						break;
					case(7) :
						crc = crctableProfTwo[crc ^ 160];
						break;
					case(8) :
						crc = crctableProfTwo[crc ^ 249];
						break;
					case(9) :
						crc = crctableProfTwo[crc ^ 87];
						break;
					case(10) :
						crc = crctableProfTwo[crc ^ 176];
						break;
					case(11) :
						crc = crctableProfTwo[crc ^ 14];
						break;
					case(12) :
						crc = crctableProfTwo[crc ^ 103];
						break;
					case(13) :
						crc = crctableProfTwo[crc ^ 192];
						break;
					case(14) :
						crc = crctableProfTwo[crc ^ 30];
						break;
					case(15) :
						crc = crctableProfTwo[crc ^ 119];
						break;
					default :
//						write("error: wrong parameter (%d)",CounterValForCRC_Whl_Rt_Stat_Pr2); stop();
						break;
				}
				crc = (crc ^ 0xFF);
				payload[0] = crc;
			}
			else
			{
				//CRC manuel veränderbar
			}

			CH_ESPWhl_Rt_Stat_AR2();
			CH_ESPVehAccel_X_Rs2_AR2();
		}
	}
	if (strncmp (pduName, "WhlPlsCnt_TPM_AR2", strLen(pduName)+strLen("WhlPlsCnt_TPM_AR2")) == 0)
	{
		if (TxAck == 1)
		{
			if (@sysvar::CH_Nodes::CH_ESPSQC_WhlPlsCnt_TPM_Pr2_AUTO == 0)
			{
				//SQC automatisch ändern
				SQC_VAL_WhlPlsCnt_TPM_Pr2 = (SQC_VAL_WhlPlsCnt_TPM_Pr2 + 1) % 16;
			}
			else
			{
				//SQC manuel veränderbar
			}

		}
		else
		{
			if (@sysvar::CH_Nodes::CH_ESPSQC_WhlPlsCnt_TPM_Pr2_AUTO == 0)
			{
				//SQC automatisch ändern
				//SQC für CRC speichern
				CounterValForCRC_WhlPlsCnt_TPM_Pr2 = SQC_VAL_WhlPlsCnt_TPM_Pr2;
				//SQC in Byte schreiben
				payload[1] = (payload[1] & ~0x0F) |  SQC_VAL_WhlPlsCnt_TPM_Pr2;
			}
			else
			{
				//SQC manuel veränderbar
			}

			if (@sysvar::CH_Nodes::CH_ESPCRC_WhlPlsCnt_TPM_Pr2_AUTO == 0)
			{
				//CRC automatisch berechnen
				crc = 0xFF;
				crc = crctableProfTwo[crc ^ payload[1]];
				crc = crctableProfTwo[crc ^ payload[2]];
				crc = crctableProfTwo[crc ^ payload[3]];
				crc = crctableProfTwo[crc ^ payload[4]];
				crc = crctableProfTwo[crc ^ payload[5]];
				crc = crctableProfTwo[crc ^ payload[6]];
				crc = crctableProfTwo[crc ^ payload[7]];
				switch (CounterValForCRC_WhlPlsCnt_TPM_Pr2)
				{
					case(0) :
						crc = crctableProfTwo[crc ^ 136];
						break;
					case(1) :
						crc = crctableProfTwo[crc ^ 194];
						break;
					case(2) :
						crc = crctableProfTwo[crc ^ 252];
						break;
					case(3) :
						crc = crctableProfTwo[crc ^ 59];
						break;
					case(4) :
						crc = crctableProfTwo[crc ^ 117];
						break;
					case(5) :
						crc = crctableProfTwo[crc ^ 175];
						break;
					case(6) :
						crc = crctableProfTwo[crc ^ 233];
						break;
					case(7) :
						crc = crctableProfTwo[crc ^ 40];
						break;
					case(8) :
						crc = crctableProfTwo[crc ^ 98];
						break;
					case(9) :
						crc = crctableProfTwo[crc ^ 156];
						break;
					case(10) :
						crc = crctableProfTwo[crc ^ 214];
						break;
					case(11) :
						crc = crctableProfTwo[crc ^ 21];
						break;
					case(12) :
						crc = crctableProfTwo[crc ^ 79];
						break;
					case(13) :
						crc = crctableProfTwo[crc ^ 137];
						break;
					case(14) :
						crc = crctableProfTwo[crc ^ 195];
						break;
					case(15) :
						crc = crctableProfTwo[crc ^ 253];
						break;
					default :
//						write("error: wrong parameter (%d)",CounterValForCRC_WhlPlsCnt_TPM_Pr2); stop();
						break;
				}
				crc = (crc ^ 0xFF);
				payload[0] = crc;
			}
			else
			{
				//CRC manuel veränderbar
			}

			CH_ESPVehSpd_X_AR2();
			CH_ESPWhlPlsCnt_TPM_AR2();
		}
	}
	if (strncmp (pduName, "WUDOP_ESP_FR", strLen(pduName)+strLen("WUDOP_ESP_FR")) == 0)
	{
		if (TxAck == 1)
		{
		}
		else
		{
		}
	}
	if (strncmp (pduName, "YMAS_Rs_AR2", strLen(pduName)+strLen("YMAS_Rs_AR2")) == 0)
	{
		if (TxAck == 1)
		{
			if (@sysvar::CH_Nodes::CH_ESPSQC_YMAS_Rs_Pr2YMAS_R_AUTO == 0)
			{
				//SQC automatisch ändern
				SQC_VAL_YMAS_Rs_Pr2 = (SQC_VAL_YMAS_Rs_Pr2 + 1) % 16;
			}
			else
			{
				//SQC manuel veränderbar
			}

		}
		else
		{
			if (@sysvar::CH_Nodes::CH_ESPSQC_YMAS_Rs_Pr2YMAS_R_AUTO == 0)
			{
				//SQC automatisch ändern
				//SQC für CRC speichern
				CounterValForCRC_YMAS_Rs_Pr2 = SQC_VAL_YMAS_Rs_Pr2;
				//SQC in Byte schreiben
				payload[1] = (payload[1] & ~0x0F) |  SQC_VAL_YMAS_Rs_Pr2;
			}
			else
			{
				//SQC manuel veränderbar
			}

			if (@sysvar::CH_Nodes::CH_ESPCRC_YMAS_Rs_Pr2YMAS_R_AUTO == 0)
			{
				//CRC automatisch berechnen
				crc = 0xFF;
				crc = crctableProfTwo[crc ^ payload[1]];
				crc = crctableProfTwo[crc ^ payload[2]];
				crc = crctableProfTwo[crc ^ payload[3]];
				crc = crctableProfTwo[crc ^ payload[4]];
				crc = crctableProfTwo[crc ^ payload[5]];
				crc = crctableProfTwo[crc ^ payload[6]];
				crc = crctableProfTwo[crc ^ payload[7]];
				switch (CounterValForCRC_YMAS_Rs_Pr2)
				{
					case(0) :
						crc = crctableProfTwo[crc ^ 84];
						break;
					case(1) :
						crc = crctableProfTwo[crc ^ 55];
						break;
					case(2) :
						crc = crctableProfTwo[crc ^ 26];
						break;
					case(3) :
						crc = crctableProfTwo[crc ^ 248];
						break;
					case(4) :
						crc = crctableProfTwo[crc ^ 219];
						break;
					case(5) :
						crc = crctableProfTwo[crc ^ 190];
						break;
					case(6) :
						crc = crctableProfTwo[crc ^ 161];
						break;
					case(7) :
						crc = crctableProfTwo[crc ^ 132];
						break;
					case(8) :
						crc = crctableProfTwo[crc ^ 103];
						break;
					case(9) :
						crc = crctableProfTwo[crc ^ 74];
						break;
					case(10) :
						crc = crctableProfTwo[crc ^ 45];
						break;
					case(11) :
						crc = crctableProfTwo[crc ^ 16];
						break;
					case(12) :
						crc = crctableProfTwo[crc ^ 238];
						break;
					case(13) :
						crc = crctableProfTwo[crc ^ 209];
						break;
					case(14) :
						crc = crctableProfTwo[crc ^ 180];
						break;
					case(15) :
						crc = crctableProfTwo[crc ^ 151];
						break;
					default :
//						write("error: wrong parameter (%d)",CounterValForCRC_YMAS_Rs_Pr2); stop();
						break;
				}
				crc = (crc ^ 0xFF);
				payload[0] = crc;
			}
			else
			{
				//CRC manuel veränderbar
			}

			CH_ESPYMAS_Rs_AR2();
			CH_ESPPARK_Brk_Rs_AR2();
		}
	}
}

StartSim(int BusAktiv)
{
	result = EnableCRC("", 0); // 1 = on, 0 = off
	result = EnableTGL("", 0); // 1 = on, 0 = off 
	result = EnableSQC("", 0); // 1 = on, 0 = off 
	result = EnableMC("", 0); // 1 = on, 0 = off 
	switch (@sysvar::CH_Nodes::CH_ESPAWD_TCASE_Rq_ESP_A_UB_AUTO)
	{
		case (0):
			enableControl("AWD_TCASE_Rq_ESP_AR2", "CH_ESPAWD_TCASE_Rq_ESP_AR2_UB_", 0); //1: enable; 0: disable
			@sysvar::CH_Nodes::CH_ESPAWD_TCASE_Rq_ESP_AR2_UB_ = 1;
			break;
		case (1):
			enableControl("AWD_TCASE_Rq_ESP_AR2", "CH_ESPAWD_TCASE_Rq_ESP_AR2_UB_", 1); //1: enable; 0: disable
			break;
		case (2):
			enableControl("AWD_TCASE_Rq_ESP_AR2", "CH_ESPAWD_TCASE_Rq_ESP_AR2_UB_", 0); //1: enable; 0: disable
			@sysvar::CH_Nodes::CH_ESPAWD_TCASE_Rq_ESP_AR2_UB_ = 1;
			break;
		case (3):
			enableControl("AWD_TCASE_Rq_ESP_AR2", "CH_ESPAWD_TCASE_Rq_ESP_AR2_UB_", 0); //1: enable; 0: disable
			@sysvar::CH_Nodes::CH_ESPAWD_TCASE_Rq_ESP_AR2_UB_ = 0;
			break;
	}

	CRC_AWD_TCASE_Rq_ESP_Pr2 = 0;
	SQC_VAL_AWD_TCASE_Rq_ESP_Pr2 = 0;
	SQC_AWD_TCASE_Rq_ESP_Pr2 = 0;
	switch (@sysvar::CH_Nodes::CH_ESPBrkSys_Stat_AR2_UB_AUTO_01)
	{
		case (0):
			enableControl("BrkSys_Stat_AR2", "CH_ESPBrkSys_Stat_AR2_UB__01", 0); //1: enable; 0: disable
			@sysvar::CH_Nodes::CH_ESPBrkSys_Stat_AR2_UB__01 = 1;
			break;
		case (1):
			enableControl("BrkSys_Stat_AR2", "CH_ESPBrkSys_Stat_AR2_UB__01", 1); //1: enable; 0: disable
			break;
		case (2):
			enableControl("BrkSys_Stat_AR2", "CH_ESPBrkSys_Stat_AR2_UB__01", 0); //1: enable; 0: disable
			@sysvar::CH_Nodes::CH_ESPBrkSys_Stat_AR2_UB__01 = 1;
			break;
		case (3):
			enableControl("BrkSys_Stat_AR2", "CH_ESPBrkSys_Stat_AR2_UB__01", 0); //1: enable; 0: disable
			@sysvar::CH_Nodes::CH_ESPBrkSys_Stat_AR2_UB__01 = 0;
			break;
	}

	CRC_BrkSys_Stat_Pr2 = 0;
	SQC_VAL_BrkSys_Stat_Pr2 = 0;
	SQC_BrkSys_Stat_Pr2 = 0;
	switch (@sysvar::CH_Nodes::CH_ESPDPC_Disp_Rq_AR2_UB_AUTO_01)
	{
		case (0):
			enableControl("DPC_Disp_Rq_AR2", "CH_ESPDPC_Disp_Rq_AR2_UB__01", 0); //1: enable; 0: disable
			@sysvar::CH_Nodes::CH_ESPDPC_Disp_Rq_AR2_UB__01 = 1;
			break;
		case (1):
			enableControl("DPC_Disp_Rq_AR2", "CH_ESPDPC_Disp_Rq_AR2_UB__01", 1); //1: enable; 0: disable
			break;
		case (2):
			enableControl("DPC_Disp_Rq_AR2", "CH_ESPDPC_Disp_Rq_AR2_UB__01", 0); //1: enable; 0: disable
			@sysvar::CH_Nodes::CH_ESPDPC_Disp_Rq_AR2_UB__01 = 1;
			break;
		case (3):
			enableControl("DPC_Disp_Rq_AR2", "CH_ESPDPC_Disp_Rq_AR2_UB__01", 0); //1: enable; 0: disable
			@sysvar::CH_Nodes::CH_ESPDPC_Disp_Rq_AR2_UB__01 = 0;
			break;
	}

	CRC_DPC_Disp_Rq_Pr2 = 0;
	SQC_VAL_DPC_Disp_Rq_Pr2 = 0;
	SQC_DPC_Disp_Rq_Pr2 = 0;
	switch (@sysvar::CH_Nodes::CH_ESPDPC_IndMd_Stat_AR2_UB_A_01)
	{
		case (0):
			enableControl("DPC_IndMd_Stat_AR2", "CH_ESPDPC_IndMd_Stat_AR2_UB__01", 0); //1: enable; 0: disable
			@sysvar::CH_Nodes::CH_ESPDPC_IndMd_Stat_AR2_UB__01 = 1;
			break;
		case (1):
			enableControl("DPC_IndMd_Stat_AR2", "CH_ESPDPC_IndMd_Stat_AR2_UB__01", 1); //1: enable; 0: disable
			break;
		case (2):
			enableControl("DPC_IndMd_Stat_AR2", "CH_ESPDPC_IndMd_Stat_AR2_UB__01", 0); //1: enable; 0: disable
			@sysvar::CH_Nodes::CH_ESPDPC_IndMd_Stat_AR2_UB__01 = 1;
			break;
		case (3):
			enableControl("DPC_IndMd_Stat_AR2", "CH_ESPDPC_IndMd_Stat_AR2_UB__01", 0); //1: enable; 0: disable
			@sysvar::CH_Nodes::CH_ESPDPC_IndMd_Stat_AR2_UB__01 = 0;
			break;
	}

	CRC_DPC_IndMd_Stat_Pr2 = 0;
	SQC_VAL_DPC_IndMd_Stat_Pr2 = 0;
	SQC_DPC_IndMd_Stat_Pr2 = 0;
	switch (@sysvar::CH_Nodes::CH_ESPDPC_IndMd_Style2_A_UB_A_01)
	{
		case (0):
			enableControl("DPC_IndMd_Style2_AR2", "CH_ESPDPC_IndMd_Style2_AR2_UB_01", 0); //1: enable; 0: disable
			@sysvar::CH_Nodes::CH_ESPDPC_IndMd_Style2_AR2_UB_01 = 1;
			break;
		case (1):
			enableControl("DPC_IndMd_Style2_AR2", "CH_ESPDPC_IndMd_Style2_AR2_UB_01", 1); //1: enable; 0: disable
			break;
		case (2):
			enableControl("DPC_IndMd_Style2_AR2", "CH_ESPDPC_IndMd_Style2_AR2_UB_01", 0); //1: enable; 0: disable
			@sysvar::CH_Nodes::CH_ESPDPC_IndMd_Style2_AR2_UB_01 = 1;
			break;
		case (3):
			enableControl("DPC_IndMd_Style2_AR2", "CH_ESPDPC_IndMd_Style2_AR2_UB_01", 0); //1: enable; 0: disable
			@sysvar::CH_Nodes::CH_ESPDPC_IndMd_Style2_AR2_UB_01 = 0;
			break;
	}

	CRC_DPC_IndMd_Style2_Pr2 = 0;
	SQC_VAL_DPC_IndMd_Style2_Pr2 = 0;
	SQC_DPC_IndMd_Style2_Pr2 = 0;
	switch (@sysvar::CH_Nodes::CH_ESPDPC_IndMd_Style_AR_UB_A_01)
	{
		case (0):
			enableControl("DPC_IndMd_Style_AR2", "CH_ESPDPC_IndMd_Style_AR2_UB__01", 0); //1: enable; 0: disable
			@sysvar::CH_Nodes::CH_ESPDPC_IndMd_Style_AR2_UB__01 = 1;
			break;
		case (1):
			enableControl("DPC_IndMd_Style_AR2", "CH_ESPDPC_IndMd_Style_AR2_UB__01", 1); //1: enable; 0: disable
			break;
		case (2):
			enableControl("DPC_IndMd_Style_AR2", "CH_ESPDPC_IndMd_Style_AR2_UB__01", 0); //1: enable; 0: disable
			@sysvar::CH_Nodes::CH_ESPDPC_IndMd_Style_AR2_UB__01 = 1;
			break;
		case (3):
			enableControl("DPC_IndMd_Style_AR2", "CH_ESPDPC_IndMd_Style_AR2_UB__01", 0); //1: enable; 0: disable
			@sysvar::CH_Nodes::CH_ESPDPC_IndMd_Style_AR2_UB__01 = 0;
			break;
	}

	CRC_DPC_IndMd_Style_Pr2 = 0;
	SQC_VAL_DPC_IndMd_Style_Pr2 = 0;
	SQC_DPC_IndMd_Style_Pr2 = 0;
	switch (@sysvar::CH_Nodes::CH_ESPDPC_Master_Rq_AR2_UB_AU_01)
	{
		case (0):
			enableControl("DPC_Master_Rq_AR2", "CH_ESPDPC_Master_Rq_AR2_UB__01", 0); //1: enable; 0: disable
			@sysvar::CH_Nodes::CH_ESPDPC_Master_Rq_AR2_UB__01 = 1;
			break;
		case (1):
			enableControl("DPC_Master_Rq_AR2", "CH_ESPDPC_Master_Rq_AR2_UB__01", 1); //1: enable; 0: disable
			break;
		case (2):
			enableControl("DPC_Master_Rq_AR2", "CH_ESPDPC_Master_Rq_AR2_UB__01", 0); //1: enable; 0: disable
			@sysvar::CH_Nodes::CH_ESPDPC_Master_Rq_AR2_UB__01 = 1;
			break;
		case (3):
			enableControl("DPC_Master_Rq_AR2", "CH_ESPDPC_Master_Rq_AR2_UB__01", 0); //1: enable; 0: disable
			@sysvar::CH_Nodes::CH_ESPDPC_Master_Rq_AR2_UB__01 = 0;
			break;
	}

	CRC_DPC_Master_Rq_Pr2 = 0;
	SQC_VAL_DPC_Master_Rq_Pr2 = 0;
	SQC_DPC_Master_Rq_Pr2 = 0;
	switch (@sysvar::CH_Nodes::CH_ESPEng_Susp_Rq_AS_AR2_UB_A_01)
	{
		case (0):
			enableControl("Eng_Susp_Rq_AS_AR2", "CH_ESPEng_Susp_Rq_AS_AR2_UB__01", 0); //1: enable; 0: disable
			@sysvar::CH_Nodes::CH_ESPEng_Susp_Rq_AS_AR2_UB__01 = 1;
			break;
		case (1):
			enableControl("Eng_Susp_Rq_AS_AR2", "CH_ESPEng_Susp_Rq_AS_AR2_UB__01", 1); //1: enable; 0: disable
			break;
		case (2):
			enableControl("Eng_Susp_Rq_AS_AR2", "CH_ESPEng_Susp_Rq_AS_AR2_UB__01", 0); //1: enable; 0: disable
			@sysvar::CH_Nodes::CH_ESPEng_Susp_Rq_AS_AR2_UB__01 = 1;
			break;
		case (3):
			enableControl("Eng_Susp_Rq_AS_AR2", "CH_ESPEng_Susp_Rq_AS_AR2_UB__01", 0); //1: enable; 0: disable
			@sysvar::CH_Nodes::CH_ESPEng_Susp_Rq_AS_AR2_UB__01 = 0;
			break;
	}

	CRC_Eng_Susp_Rq_AS_Pr2 = 0;
	SQC_VAL_Eng_Susp_Rq_AS_Pr2 = 0;
	SQC_Eng_Susp_Rq_AS_Pr2 = 0;
	switch (@sysvar::CH_Nodes::CH_ESPEPKB_Disp_IndLmp_R_UB_A_01)
	{
		case (0):
			enableControl("EPKB_Disp_IndLmp_Rq_2_AR2", "CH_ESPEPKB_Disp_IndLmp_Rq_2___01", 0); //1: enable; 0: disable
			@sysvar::CH_Nodes::CH_ESPEPKB_Disp_IndLmp_Rq_2___01 = 1;
			break;
		case (1):
			enableControl("EPKB_Disp_IndLmp_Rq_2_AR2", "CH_ESPEPKB_Disp_IndLmp_Rq_2___01", 1); //1: enable; 0: disable
			break;
		case (2):
			enableControl("EPKB_Disp_IndLmp_Rq_2_AR2", "CH_ESPEPKB_Disp_IndLmp_Rq_2___01", 0); //1: enable; 0: disable
			@sysvar::CH_Nodes::CH_ESPEPKB_Disp_IndLmp_Rq_2___01 = 1;
			break;
		case (3):
			enableControl("EPKB_Disp_IndLmp_Rq_2_AR2", "CH_ESPEPKB_Disp_IndLmp_Rq_2___01", 0); //1: enable; 0: disable
			@sysvar::CH_Nodes::CH_ESPEPKB_Disp_IndLmp_Rq_2___01 = 0;
			break;
	}

	CRC_EPKB_Disp_IndLmp_Rq_Pr2 = 0;
	SQC_VAL_EPKB_Disp_IndLmp_Rq_Pr2 = 0;
	SQC_EPKB_Disp_IndLmp_Rq_Pr2 = 0;
	switch (@sysvar::CH_Nodes::CH_ESPEPKB_Stat_Gw_AR2_UB_AUT_01)
	{
		case (0):
			enableControl("EPKB_Stat_Gw_AR2", "CH_ESPEPKB_Stat_Gw_AR2_UB__01", 0); //1: enable; 0: disable
			@sysvar::CH_Nodes::CH_ESPEPKB_Stat_Gw_AR2_UB__01 = 1;
			break;
		case (1):
			enableControl("EPKB_Stat_Gw_AR2", "CH_ESPEPKB_Stat_Gw_AR2_UB__01", 1); //1: enable; 0: disable
			break;
		case (2):
			enableControl("EPKB_Stat_Gw_AR2", "CH_ESPEPKB_Stat_Gw_AR2_UB__01", 0); //1: enable; 0: disable
			@sysvar::CH_Nodes::CH_ESPEPKB_Stat_Gw_AR2_UB__01 = 1;
			break;
		case (3):
			enableControl("EPKB_Stat_Gw_AR2", "CH_ESPEPKB_Stat_Gw_AR2_UB__01", 0); //1: enable; 0: disable
			@sysvar::CH_Nodes::CH_ESPEPKB_Stat_Gw_AR2_UB__01 = 0;
			break;
	}

	CRC_EPKB_Stat_Pr2 = 0;
	SQC_VAL_EPKB_Stat_Pr2 = 0;
	SQC_EPKB_Stat_Pr2 = 0;
	switch (@sysvar::CH_Nodes::CH_ESPESP_Disp_Rq2_AR2_UB_AUT_01)
	{
		case (0):
			enableControl("ESP_Disp_Rq2_AR2", "CH_ESPESP_Disp_Rq2_AR2_UB__01", 0); //1: enable; 0: disable
			@sysvar::CH_Nodes::CH_ESPESP_Disp_Rq2_AR2_UB__01 = 1;
			break;
		case (1):
			enableControl("ESP_Disp_Rq2_AR2", "CH_ESPESP_Disp_Rq2_AR2_UB__01", 1); //1: enable; 0: disable
			break;
		case (2):
			enableControl("ESP_Disp_Rq2_AR2", "CH_ESPESP_Disp_Rq2_AR2_UB__01", 0); //1: enable; 0: disable
			@sysvar::CH_Nodes::CH_ESPESP_Disp_Rq2_AR2_UB__01 = 1;
			break;
		case (3):
			enableControl("ESP_Disp_Rq2_AR2", "CH_ESPESP_Disp_Rq2_AR2_UB__01", 0); //1: enable; 0: disable
			@sysvar::CH_Nodes::CH_ESPESP_Disp_Rq2_AR2_UB__01 = 0;
			break;
	}

	CRC_DSR_Disp_Rq_Pr2 = 0;
	SQC_VAL_DSR_Disp_Rq_Pr2 = 0;
	SQC_DSR_Disp_Rq_Pr2 = 0;
	switch (@sysvar::CH_Nodes::CH_ESPESP_Disp_Rq3_AR_UB_AUTO_01)
	{
		case (0):
			enableControl("ESP_Disp_Rq3_AR", "CH_ESPESP_Disp_Rq3_AR_UB__01", 0); //1: enable; 0: disable
			@sysvar::CH_Nodes::CH_ESPESP_Disp_Rq3_AR_UB__01 = 1;
			break;
		case (1):
			enableControl("ESP_Disp_Rq3_AR", "CH_ESPESP_Disp_Rq3_AR_UB__01", 1); //1: enable; 0: disable
			break;
		case (2):
			enableControl("ESP_Disp_Rq3_AR", "CH_ESPESP_Disp_Rq3_AR_UB__01", 0); //1: enable; 0: disable
			@sysvar::CH_Nodes::CH_ESPESP_Disp_Rq3_AR_UB__01 = 1;
			break;
		case (3):
			enableControl("ESP_Disp_Rq3_AR", "CH_ESPESP_Disp_Rq3_AR_UB__01", 0); //1: enable; 0: disable
			@sysvar::CH_Nodes::CH_ESPESP_Disp_Rq3_AR_UB__01 = 0;
			break;
	}

	switch (@sysvar::CH_Nodes::CH_ESPESP_Disp_Rq_AR2_UB_AUTO_01)
	{
		case (0):
			enableControl("ESP_Disp_Rq_AR2", "CH_ESPESP_Disp_Rq_AR2_UB__01", 0); //1: enable; 0: disable
			@sysvar::CH_Nodes::CH_ESPESP_Disp_Rq_AR2_UB__01 = 1;
			break;
		case (1):
			enableControl("ESP_Disp_Rq_AR2", "CH_ESPESP_Disp_Rq_AR2_UB__01", 1); //1: enable; 0: disable
			break;
		case (2):
			enableControl("ESP_Disp_Rq_AR2", "CH_ESPESP_Disp_Rq_AR2_UB__01", 0); //1: enable; 0: disable
			@sysvar::CH_Nodes::CH_ESPESP_Disp_Rq_AR2_UB__01 = 1;
			break;
		case (3):
			enableControl("ESP_Disp_Rq_AR2", "CH_ESPESP_Disp_Rq_AR2_UB__01", 0); //1: enable; 0: disable
			@sysvar::CH_Nodes::CH_ESPESP_Disp_Rq_AR2_UB__01 = 0;
			break;
	}

	CRC_ESP_Disp_Rq_Pr2 = 0;
	SQC_VAL_ESP_Disp_Rq_Pr2 = 0;
	SQC_ESP_Disp_Rq_Pr2 = 0;
	switch (@sysvar::CH_Nodes::CH_ESPESP_OBD_Stat_AR_UB_AUTO_01)
	{
		case (0):
			enableControl("ESP_OBD_Stat_AR", "CH_ESPESP_OBD_Stat_AR_UB__01", 0); //1: enable; 0: disable
			@sysvar::CH_Nodes::CH_ESPESP_OBD_Stat_AR_UB__01 = 1;
			break;
		case (1):
			enableControl("ESP_OBD_Stat_AR", "CH_ESPESP_OBD_Stat_AR_UB__01", 1); //1: enable; 0: disable
			break;
		case (2):
			enableControl("ESP_OBD_Stat_AR", "CH_ESPESP_OBD_Stat_AR_UB__01", 0); //1: enable; 0: disable
			@sysvar::CH_Nodes::CH_ESPESP_OBD_Stat_AR_UB__01 = 1;
			break;
		case (3):
			enableControl("ESP_OBD_Stat_AR", "CH_ESPESP_OBD_Stat_AR_UB__01", 0); //1: enable; 0: disable
			@sysvar::CH_Nodes::CH_ESPESP_OBD_Stat_AR_UB__01 = 0;
			break;
	}

	switch (@sysvar::CH_Nodes::CH_ESPLDC_Disp_Rq_ESP_AR_UB_A_01)
	{
		case (0):
			enableControl("LDC_Disp_Rq_ESP_AR", "CH_ESPLDC_Disp_Rq_ESP_AR_UB__01", 0); //1: enable; 0: disable
			@sysvar::CH_Nodes::CH_ESPLDC_Disp_Rq_ESP_AR_UB__01 = 1;
			break;
		case (1):
			enableControl("LDC_Disp_Rq_ESP_AR", "CH_ESPLDC_Disp_Rq_ESP_AR_UB__01", 1); //1: enable; 0: disable
			break;
		case (2):
			enableControl("LDC_Disp_Rq_ESP_AR", "CH_ESPLDC_Disp_Rq_ESP_AR_UB__01", 0); //1: enable; 0: disable
			@sysvar::CH_Nodes::CH_ESPLDC_Disp_Rq_ESP_AR_UB__01 = 1;
			break;
		case (3):
			enableControl("LDC_Disp_Rq_ESP_AR", "CH_ESPLDC_Disp_Rq_ESP_AR_UB__01", 0); //1: enable; 0: disable
			@sysvar::CH_Nodes::CH_ESPLDC_Disp_Rq_ESP_AR_UB__01 = 0;
			break;
	}

	switch (@sysvar::CH_Nodes::CH_ESPPARK_Brk_Rs_AR2_UB_AUTO_01)
	{
		case (0):
			enableControl("PARK_Brk_Rs_AR2", "CH_ESPPARK_Brk_Rs_AR2_UB__01", 0); //1: enable; 0: disable
			@sysvar::CH_Nodes::CH_ESPPARK_Brk_Rs_AR2_UB__01 = 1;
			break;
		case (1):
			enableControl("PARK_Brk_Rs_AR2", "CH_ESPPARK_Brk_Rs_AR2_UB__01", 1); //1: enable; 0: disable
			break;
		case (2):
			enableControl("PARK_Brk_Rs_AR2", "CH_ESPPARK_Brk_Rs_AR2_UB__01", 0); //1: enable; 0: disable
			@sysvar::CH_Nodes::CH_ESPPARK_Brk_Rs_AR2_UB__01 = 1;
			break;
		case (3):
			enableControl("PARK_Brk_Rs_AR2", "CH_ESPPARK_Brk_Rs_AR2_UB__01", 0); //1: enable; 0: disable
			@sysvar::CH_Nodes::CH_ESPPARK_Brk_Rs_AR2_UB__01 = 0;
			break;
	}

	CRC_PARK_Brk_Rs_Pr2 = 0;
	SQC_VAL_PARK_Brk_Rs_Pr2 = 0;
	SQC_PARK_Brk_Rs_Pr2 = 0;
	switch (@sysvar::CH_Nodes::CH_ESPPARK_Drv_Rq_ESP_AR_UB_A_01)
	{
		case (0):
			enableControl("PARK_Drv_Rq_ESP_AR2", "CH_ESPPARK_Drv_Rq_ESP_AR2_UB__01", 0); //1: enable; 0: disable
			@sysvar::CH_Nodes::CH_ESPPARK_Drv_Rq_ESP_AR2_UB__01 = 1;
			break;
		case (1):
			enableControl("PARK_Drv_Rq_ESP_AR2", "CH_ESPPARK_Drv_Rq_ESP_AR2_UB__01", 1); //1: enable; 0: disable
			break;
		case (2):
			enableControl("PARK_Drv_Rq_ESP_AR2", "CH_ESPPARK_Drv_Rq_ESP_AR2_UB__01", 0); //1: enable; 0: disable
			@sysvar::CH_Nodes::CH_ESPPARK_Drv_Rq_ESP_AR2_UB__01 = 1;
			break;
		case (3):
			enableControl("PARK_Drv_Rq_ESP_AR2", "CH_ESPPARK_Drv_Rq_ESP_AR2_UB__01", 0); //1: enable; 0: disable
			@sysvar::CH_Nodes::CH_ESPPARK_Drv_Rq_ESP_AR2_UB__01 = 0;
			break;
	}

	CRC_PARK_Drv_Rq_ESP_Pr2 = 0;
	SQC_VAL_PARK_Drv_Rq_ESP_Pr2 = 0;
	SQC_PARK_Drv_Rq_ESP_Pr2 = 0;
	switch (@sysvar::CH_Nodes::CH_ESPPresfCtrl_Rq_ESP_A_UB_A_01)
	{
		case (0):
			enableControl("PresfCtrl_Rq_ESP_AR2", "CH_ESPPresfCtrl_Rq_ESP_AR2_UB_01", 0); //1: enable; 0: disable
			@sysvar::CH_Nodes::CH_ESPPresfCtrl_Rq_ESP_AR2_UB_01 = 1;
			break;
		case (1):
			enableControl("PresfCtrl_Rq_ESP_AR2", "CH_ESPPresfCtrl_Rq_ESP_AR2_UB_01", 1); //1: enable; 0: disable
			break;
		case (2):
			enableControl("PresfCtrl_Rq_ESP_AR2", "CH_ESPPresfCtrl_Rq_ESP_AR2_UB_01", 0); //1: enable; 0: disable
			@sysvar::CH_Nodes::CH_ESPPresfCtrl_Rq_ESP_AR2_UB_01 = 1;
			break;
		case (3):
			enableControl("PresfCtrl_Rq_ESP_AR2", "CH_ESPPresfCtrl_Rq_ESP_AR2_UB_01", 0); //1: enable; 0: disable
			@sysvar::CH_Nodes::CH_ESPPresfCtrl_Rq_ESP_AR2_UB_01 = 0;
			break;
	}

	CRC_PresfCtrl_Rq_ESP_Pr2 = 0;
	SQC_VAL_PresfCtrl_Rq_ESP_Pr2 = 0;
	SQC_PresfCtrl_Rq_ESP_Pr2 = 0;
	TGL_VAL_resfAct_Adj_ = 0;
	TGL_resfAct_Adj_ = 0;
	switch (@sysvar::CH_Nodes::CH_ESPPT_Rq_ESP_AR2_UB_AUTO_01)
	{
		case (0):
			enableControl("PT_Rq_ESP_AR2", "CH_ESPPT_Rq_ESP_AR2_UB__01", 0); //1: enable; 0: disable
			@sysvar::CH_Nodes::CH_ESPPT_Rq_ESP_AR2_UB__01 = 1;
			break;
		case (1):
			enableControl("PT_Rq_ESP_AR2", "CH_ESPPT_Rq_ESP_AR2_UB__01", 1); //1: enable; 0: disable
			break;
		case (2):
			enableControl("PT_Rq_ESP_AR2", "CH_ESPPT_Rq_ESP_AR2_UB__01", 0); //1: enable; 0: disable
			@sysvar::CH_Nodes::CH_ESPPT_Rq_ESP_AR2_UB__01 = 1;
			break;
		case (3):
			enableControl("PT_Rq_ESP_AR2", "CH_ESPPT_Rq_ESP_AR2_UB__01", 0); //1: enable; 0: disable
			@sysvar::CH_Nodes::CH_ESPPT_Rq_ESP_AR2_UB__01 = 0;
			break;
	}

	CRC_PT_Rq_ESP_Pr2 = 0;
	SQC_VAL_PT_Rq_ESP_Pr2 = 0;
	SQC_PT_Rq_ESP_Pr2 = 0;
	CRC_SADR_Trgr_ESP_Pr2 = 0;
	SQC_VAL_SADR_Trgr_ESP_Pr2 = 0;
	SQC_SADR_Trgr_ESP_Pr2 = 0;
	switch (@sysvar::CH_Nodes::CH_ESPSt_Rq_STA_AR2_UB_AUTO_01)
	{
		case (0):
			enableControl("St_Rq_STA_AR2", "CH_ESPSt_Rq_STA_AR2_UB__01", 0); //1: enable; 0: disable
			@sysvar::CH_Nodes::CH_ESPSt_Rq_STA_AR2_UB__01 = 1;
			break;
		case (1):
			enableControl("St_Rq_STA_AR2", "CH_ESPSt_Rq_STA_AR2_UB__01", 1); //1: enable; 0: disable
			break;
		case (2):
			enableControl("St_Rq_STA_AR2", "CH_ESPSt_Rq_STA_AR2_UB__01", 0); //1: enable; 0: disable
			@sysvar::CH_Nodes::CH_ESPSt_Rq_STA_AR2_UB__01 = 1;
			break;
		case (3):
			enableControl("St_Rq_STA_AR2", "CH_ESPSt_Rq_STA_AR2_UB__01", 0); //1: enable; 0: disable
			@sysvar::CH_Nodes::CH_ESPSt_Rq_STA_AR2_UB__01 = 0;
			break;
	}

	CRC_St_Rq_STA_Pr2 = 0;
	SQC_VAL_St_Rq_STA_Pr2 = 0;
	SQC_St_Rq_STA_Pr2 = 0;
	switch (@sysvar::CH_Nodes::CH_ESPTBCSC_Rs1_ESP_AR2_UB_AU_01)
	{
		case (0):
			enableControl("TBCSC_Rs1_ESP_AR2", "CH_ESPTBCSC_Rs1_ESP_AR2_UB__01", 0); //1: enable; 0: disable
			@sysvar::CH_Nodes::CH_ESPTBCSC_Rs1_ESP_AR2_UB__01 = 1;
			break;
		case (1):
			enableControl("TBCSC_Rs1_ESP_AR2", "CH_ESPTBCSC_Rs1_ESP_AR2_UB__01", 1); //1: enable; 0: disable
			break;
		case (2):
			enableControl("TBCSC_Rs1_ESP_AR2", "CH_ESPTBCSC_Rs1_ESP_AR2_UB__01", 0); //1: enable; 0: disable
			@sysvar::CH_Nodes::CH_ESPTBCSC_Rs1_ESP_AR2_UB__01 = 1;
			break;
		case (3):
			enableControl("TBCSC_Rs1_ESP_AR2", "CH_ESPTBCSC_Rs1_ESP_AR2_UB__01", 0); //1: enable; 0: disable
			@sysvar::CH_Nodes::CH_ESPTBCSC_Rs1_ESP_AR2_UB__01 = 0;
			break;
	}

	CRC_TBCSC_Rs1_ESP_Pr2 = 0;
	SQC_VAL_TBCSC_Rs1_ESP_Pr2 = 0;
	SQC_TBCSC_Rs1_ESP_Pr2 = 0;
	switch (@sysvar::CH_Nodes::CH_ESPTBCSC_Rs2_ESP_AR2_UB_AU_01)
	{
		case (0):
			enableControl("TBCSC_Rs2_ESP_AR2", "CH_ESPTBCSC_Rs2_ESP_AR2_UB__01", 0); //1: enable; 0: disable
			@sysvar::CH_Nodes::CH_ESPTBCSC_Rs2_ESP_AR2_UB__01 = 1;
			break;
		case (1):
			enableControl("TBCSC_Rs2_ESP_AR2", "CH_ESPTBCSC_Rs2_ESP_AR2_UB__01", 1); //1: enable; 0: disable
			break;
		case (2):
			enableControl("TBCSC_Rs2_ESP_AR2", "CH_ESPTBCSC_Rs2_ESP_AR2_UB__01", 0); //1: enable; 0: disable
			@sysvar::CH_Nodes::CH_ESPTBCSC_Rs2_ESP_AR2_UB__01 = 1;
			break;
		case (3):
			enableControl("TBCSC_Rs2_ESP_AR2", "CH_ESPTBCSC_Rs2_ESP_AR2_UB__01", 0); //1: enable; 0: disable
			@sysvar::CH_Nodes::CH_ESPTBCSC_Rs2_ESP_AR2_UB__01 = 0;
			break;
	}

	CRC_TBCSC_Rs2_ESP_Pr2 = 0;
	SQC_VAL_TBCSC_Rs2_ESP_Pr2 = 0;
	SQC_TBCSC_Rs2_ESP_Pr2 = 0;
	switch (@sysvar::CH_Nodes::CH_ESPVehAccel_X_Rs1_AR2_UB_A_01)
	{
		case (0):
			enableControl("VehAccel_X_Rs1_AR2", "CH_ESPVehAccel_X_Rs1_AR2_UB__01", 0); //1: enable; 0: disable
			@sysvar::CH_Nodes::CH_ESPVehAccel_X_Rs1_AR2_UB__01 = 1;
			break;
		case (1):
			enableControl("VehAccel_X_Rs1_AR2", "CH_ESPVehAccel_X_Rs1_AR2_UB__01", 1); //1: enable; 0: disable
			break;
		case (2):
			enableControl("VehAccel_X_Rs1_AR2", "CH_ESPVehAccel_X_Rs1_AR2_UB__01", 0); //1: enable; 0: disable
			@sysvar::CH_Nodes::CH_ESPVehAccel_X_Rs1_AR2_UB__01 = 1;
			break;
		case (3):
			enableControl("VehAccel_X_Rs1_AR2", "CH_ESPVehAccel_X_Rs1_AR2_UB__01", 0); //1: enable; 0: disable
			@sysvar::CH_Nodes::CH_ESPVehAccel_X_Rs1_AR2_UB__01 = 0;
			break;
	}

	CRC_VehAccel_X_Rs1_Pr2 = 0;
	SQC_VAL_VehAccel_X_Rs1_Pr2 = 0;
	SQC_VehAccel_X_Rs1_Pr2 = 0;
	switch (@sysvar::CH_Nodes::CH_ESPVehAccel_X_Rs2_AR2_UB_A_01)
	{
		case (0):
			enableControl("VehAccel_X_Rs2_AR2", "CH_ESPVehAccel_X_Rs2_AR2_UB__01", 0); //1: enable; 0: disable
			@sysvar::CH_Nodes::CH_ESPVehAccel_X_Rs2_AR2_UB__01 = 1;
			break;
		case (1):
			enableControl("VehAccel_X_Rs2_AR2", "CH_ESPVehAccel_X_Rs2_AR2_UB__01", 1); //1: enable; 0: disable
			break;
		case (2):
			enableControl("VehAccel_X_Rs2_AR2", "CH_ESPVehAccel_X_Rs2_AR2_UB__01", 0); //1: enable; 0: disable
			@sysvar::CH_Nodes::CH_ESPVehAccel_X_Rs2_AR2_UB__01 = 1;
			break;
		case (3):
			enableControl("VehAccel_X_Rs2_AR2", "CH_ESPVehAccel_X_Rs2_AR2_UB__01", 0); //1: enable; 0: disable
			@sysvar::CH_Nodes::CH_ESPVehAccel_X_Rs2_AR2_UB__01 = 0;
			break;
	}

	CRC_VehAccel_X_Rs2_Pr2 = 0;
	SQC_VAL_VehAccel_X_Rs2_Pr2 = 0;
	SQC_VehAccel_X_Rs2_Pr2 = 0;
	switch (@sysvar::CH_Nodes::CH_ESPVehDyn_Stat1_AR2_UB_AUT_01)
	{
		case (0):
			enableControl("VehDyn_Stat1_AR2", "CH_ESPVehDyn_Stat1_AR2_UB__01", 0); //1: enable; 0: disable
			@sysvar::CH_Nodes::CH_ESPVehDyn_Stat1_AR2_UB__01 = 1;
			break;
		case (1):
			enableControl("VehDyn_Stat1_AR2", "CH_ESPVehDyn_Stat1_AR2_UB__01", 1); //1: enable; 0: disable
			break;
		case (2):
			enableControl("VehDyn_Stat1_AR2", "CH_ESPVehDyn_Stat1_AR2_UB__01", 0); //1: enable; 0: disable
			@sysvar::CH_Nodes::CH_ESPVehDyn_Stat1_AR2_UB__01 = 1;
			break;
		case (3):
			enableControl("VehDyn_Stat1_AR2", "CH_ESPVehDyn_Stat1_AR2_UB__01", 0); //1: enable; 0: disable
			@sysvar::CH_Nodes::CH_ESPVehDyn_Stat1_AR2_UB__01 = 0;
			break;
	}

	CRC_VehDyn_Stat1_Pr2 = 0;
	SQC_VAL_VehDyn_Stat1_Pr2 = 0;
	SQC_VehDyn_Stat1_Pr2 = 0;
	switch (@sysvar::CH_Nodes::CH_ESPVehDyn_Stat2_AR2_UB_AUT_01)
	{
		case (0):
			enableControl("VehDyn_Stat2_AR2", "CH_ESPVehDyn_Stat2_AR2_UB__01", 0); //1: enable; 0: disable
			@sysvar::CH_Nodes::CH_ESPVehDyn_Stat2_AR2_UB__01 = 1;
			break;
		case (1):
			enableControl("VehDyn_Stat2_AR2", "CH_ESPVehDyn_Stat2_AR2_UB__01", 1); //1: enable; 0: disable
			break;
		case (2):
			enableControl("VehDyn_Stat2_AR2", "CH_ESPVehDyn_Stat2_AR2_UB__01", 0); //1: enable; 0: disable
			@sysvar::CH_Nodes::CH_ESPVehDyn_Stat2_AR2_UB__01 = 1;
			break;
		case (3):
			enableControl("VehDyn_Stat2_AR2", "CH_ESPVehDyn_Stat2_AR2_UB__01", 0); //1: enable; 0: disable
			@sysvar::CH_Nodes::CH_ESPVehDyn_Stat2_AR2_UB__01 = 0;
			break;
	}

	CRC_VehDyn_Stat2_Pr2 = 0;
	SQC_VAL_VehDyn_Stat2_Pr2 = 0;
	SQC_VehDyn_Stat2_Pr2 = 0;
	switch (@sysvar::CH_Nodes::CH_ESPVehSpd_X_AR2_UB_AUTO_01)
	{
		case (0):
			enableControl("VehSpd_X_AR2", "CH_ESPVehSpd_X_AR2_UB__01", 0); //1: enable; 0: disable
			@sysvar::CH_Nodes::CH_ESPVehSpd_X_AR2_UB__01 = 1;
			break;
		case (1):
			enableControl("VehSpd_X_AR2", "CH_ESPVehSpd_X_AR2_UB__01", 1); //1: enable; 0: disable
			break;
		case (2):
			enableControl("VehSpd_X_AR2", "CH_ESPVehSpd_X_AR2_UB__01", 0); //1: enable; 0: disable
			@sysvar::CH_Nodes::CH_ESPVehSpd_X_AR2_UB__01 = 1;
			break;
		case (3):
			enableControl("VehSpd_X_AR2", "CH_ESPVehSpd_X_AR2_UB__01", 0); //1: enable; 0: disable
			@sysvar::CH_Nodes::CH_ESPVehSpd_X_AR2_UB__01 = 0;
			break;
	}

	CRC_VehSpd_X_Pr2 = 0;
	SQC_VAL_VehSpd_X_Pr2 = 0;
	SQC_VehSpd_X_Pr2 = 0;
	switch (@sysvar::CH_Nodes::CH_ESPWhl_Lt_Stat_AR2_UB_AUTO_01)
	{
		case (0):
			enableControl("Whl_Lt_Stat_AR2", "CH_ESPWhl_Lt_Stat_AR2_UB__01", 0); //1: enable; 0: disable
			@sysvar::CH_Nodes::CH_ESPWhl_Lt_Stat_AR2_UB__01 = 1;
			break;
		case (1):
			enableControl("Whl_Lt_Stat_AR2", "CH_ESPWhl_Lt_Stat_AR2_UB__01", 1); //1: enable; 0: disable
			break;
		case (2):
			enableControl("Whl_Lt_Stat_AR2", "CH_ESPWhl_Lt_Stat_AR2_UB__01", 0); //1: enable; 0: disable
			@sysvar::CH_Nodes::CH_ESPWhl_Lt_Stat_AR2_UB__01 = 1;
			break;
		case (3):
			enableControl("Whl_Lt_Stat_AR2", "CH_ESPWhl_Lt_Stat_AR2_UB__01", 0); //1: enable; 0: disable
			@sysvar::CH_Nodes::CH_ESPWhl_Lt_Stat_AR2_UB__01 = 0;
			break;
	}

	CRC_Whl_Lt_Stat_Pr2 = 0;
	SQC_VAL_Whl_Lt_Stat_Pr2 = 0;
	SQC_Whl_Lt_Stat_Pr2 = 0;
	switch (@sysvar::CH_Nodes::CH_ESPWhl_Rt_Stat_AR2_UB_AUTO_01)
	{
		case (0):
			enableControl("Whl_Rt_Stat_AR2", "CH_ESPWhl_Rt_Stat_AR2_UB__01", 0); //1: enable; 0: disable
			@sysvar::CH_Nodes::CH_ESPWhl_Rt_Stat_AR2_UB__01 = 1;
			break;
		case (1):
			enableControl("Whl_Rt_Stat_AR2", "CH_ESPWhl_Rt_Stat_AR2_UB__01", 1); //1: enable; 0: disable
			break;
		case (2):
			enableControl("Whl_Rt_Stat_AR2", "CH_ESPWhl_Rt_Stat_AR2_UB__01", 0); //1: enable; 0: disable
			@sysvar::CH_Nodes::CH_ESPWhl_Rt_Stat_AR2_UB__01 = 1;
			break;
		case (3):
			enableControl("Whl_Rt_Stat_AR2", "CH_ESPWhl_Rt_Stat_AR2_UB__01", 0); //1: enable; 0: disable
			@sysvar::CH_Nodes::CH_ESPWhl_Rt_Stat_AR2_UB__01 = 0;
			break;
	}

	CRC_Whl_Rt_Stat_Pr2 = 0;
	SQC_VAL_Whl_Rt_Stat_Pr2 = 0;
	SQC_Whl_Rt_Stat_Pr2 = 0;
	switch (@sysvar::CH_Nodes::CH_ESPWhlPlsCnt_TPM_AR2_UB_AU_01)
	{
		case (0):
			enableControl("WhlPlsCnt_TPM_AR2", "CH_ESPWhlPlsCnt_TPM_AR2_UB__01", 0); //1: enable; 0: disable
			@sysvar::CH_Nodes::CH_ESPWhlPlsCnt_TPM_AR2_UB__01 = 1;
			break;
		case (1):
			enableControl("WhlPlsCnt_TPM_AR2", "CH_ESPWhlPlsCnt_TPM_AR2_UB__01", 1); //1: enable; 0: disable
			break;
		case (2):
			enableControl("WhlPlsCnt_TPM_AR2", "CH_ESPWhlPlsCnt_TPM_AR2_UB__01", 0); //1: enable; 0: disable
			@sysvar::CH_Nodes::CH_ESPWhlPlsCnt_TPM_AR2_UB__01 = 1;
			break;
		case (3):
			enableControl("WhlPlsCnt_TPM_AR2", "CH_ESPWhlPlsCnt_TPM_AR2_UB__01", 0); //1: enable; 0: disable
			@sysvar::CH_Nodes::CH_ESPWhlPlsCnt_TPM_AR2_UB__01 = 0;
			break;
	}

	CRC_WhlPlsCnt_TPM_Pr2 = 0;
	SQC_VAL_WhlPlsCnt_TPM_Pr2 = 0;
	SQC_WhlPlsCnt_TPM_Pr2 = 0;
	switch (@sysvar::CH_Nodes::CH_ESPYMAS_Rs_AR2_UB_AUTO_01)
	{
		case (0):
			enableControl("YMAS_Rs_AR2", "CH_ESPYMAS_Rs_AR2_UB__01", 0); //1: enable; 0: disable
			@sysvar::CH_Nodes::CH_ESPYMAS_Rs_AR2_UB__01 = 1;
			break;
		case (1):
			enableControl("YMAS_Rs_AR2", "CH_ESPYMAS_Rs_AR2_UB__01", 1); //1: enable; 0: disable
			break;
		case (2):
			enableControl("YMAS_Rs_AR2", "CH_ESPYMAS_Rs_AR2_UB__01", 0); //1: enable; 0: disable
			@sysvar::CH_Nodes::CH_ESPYMAS_Rs_AR2_UB__01 = 1;
			break;
		case (3):
			enableControl("YMAS_Rs_AR2", "CH_ESPYMAS_Rs_AR2_UB__01", 0); //1: enable; 0: disable
			@sysvar::CH_Nodes::CH_ESPYMAS_Rs_AR2_UB__01 = 0;
			break;
	}

	CRC_YMAS_Rs_Pr2 = 0;
	SQC_VAL_YMAS_Rs_Pr2 = 0;
	SQC_YMAS_Rs_Pr2 = 0;
}

StopSim()
{
}

on frPDU MsgChannel1.CHASSIS::AWD_TCASE_Rq_ESP_AR2
{
}

on frPDU MsgChannel1.CHASSIS::BrkSys_Stat_AR2
{
}

on frPDU MsgChannel1.CHASSIS::DPC_Disp_Rq_AR2
{
}

on frPDU MsgChannel1.CHASSIS::DPC_IndMd_Stat_AR2
{
}

on frPDU MsgChannel1.CHASSIS::DPC_IndMd_Style2_AR2
{
}

on frPDU MsgChannel1.CHASSIS::DPC_IndMd_Style_AR2
{
}

on frPDU MsgChannel1.CHASSIS::DPC_Master_Rq_AR2
{
}

on frPDU MsgChannel1.CHASSIS::Eng_Susp_Rq_AS_AR2
{
}

on frPDU MsgChannel1.CHASSIS::EPKB_Disp_IndLmp_Rq_2_AR2
{
}

on frPDU MsgChannel1.CHASSIS::EPKB_Stat_Gw_AR2
{
}

on frPDU MsgChannel1.CHASSIS::ESP_Disp_Rq2_AR2
{
}

on frPDU MsgChannel1.CHASSIS::ESP_Disp_Rq3_AR
{
}

on frPDU MsgChannel1.CHASSIS::ESP_Disp_Rq_AMG_AR2
{
}

on frPDU MsgChannel1.CHASSIS::ESP_Disp_Rq_AR2
{
}

on frPDU MsgChannel1.CHASSIS::ESP_OBD_Stat_AR
{
}

on frPDU MsgChannel1.CHASSIS::ESP_Stat1_AR2
{
}

on frPDU MsgChannel1.CHASSIS::LDC_Disp_Rq_ESP_AR
{
}

on frPDU MsgChannel1.CHASSIS::PARK_Brk_Rs_AR2
{
}

on frPDU MsgChannel1.CHASSIS::PARK_Drv_Rq_ESP_AR2
{
}

on frPDU MsgChannel1.CHASSIS::PresfCtrl_Rq_ESP_AR2
{
}

on frPDU MsgChannel1.CHASSIS::PT_Rq_ESP_AR2
{
}

on frPDU MsgChannel1.CHASSIS::ROE_ESP
{
}

on frPDU MsgChannel1.CHASSIS::SADR_Trgr_ESP_AR2
{
}

on frPDU MsgChannel1.CHASSIS::St_Rq_STA_AR2
{
}

on frPDU MsgChannel1.CHASSIS::TBCSC_ESP_DAC_AR2
{
}

on frPDU MsgChannel1.CHASSIS::TBCSC_Rs1_ESP_AR2
{
}

on frPDU MsgChannel1.CHASSIS::TBCSC_Rs2_ESP_AR2
{
}

on frPDU MsgChannel1.CHASSIS::VehAccel_X_Rs1_AR2
{
}

on frPDU MsgChannel1.CHASSIS::VehAccel_X_Rs2_AR2
{
}

on frPDU MsgChannel1.CHASSIS::VehDyn_Stat1_AR2
{
}

on frPDU MsgChannel1.CHASSIS::VehDyn_Stat2_AR2
{
}

on frPDU MsgChannel1.CHASSIS::VehSpd_X_AR2
{
}

on frPDU MsgChannel1.CHASSIS::Whl_Lt_Stat_AR2
{
}

on frPDU MsgChannel1.CHASSIS::Whl_Rt_Stat_AR2
{
}

on frPDU MsgChannel1.CHASSIS::WhlPlsCnt_TPM_AR2
{
}

on frPDU MsgChannel1.CHASSIS::WUDOP_ESP_FR
{
}

on frPDU MsgChannel1.CHASSIS::YMAS_Rs_AR2
{
}

