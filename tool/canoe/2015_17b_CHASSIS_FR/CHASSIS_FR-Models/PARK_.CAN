/*@@includes:*/
includes
{
	#include "ASR_FR_NM_IL.CIN"
}
/*@@end*/

/*@@var:*/
/*
|==========================================================================================|
|                                                                                          |
|                                                                                          |
|                                         COPYRIGHT                                        |
|                                                                                          |
|                   Copyright (c) by Daimler AG Abt. RD/EEV 2015                           |
|                                                                                          |
|                                                                                          |
|==========================================================================================|
|                                                                                          |
|                                   CAPL AUTHOR IDENTITY                                   |
|                                   --------------------                                   |
|                                                                                          |
| Initials   | Name                 | Company                                              |
| -----------+----------------------+----------------------------------------------------- |
| BH         | Björn Haßelkus       | Firma TZM (EXTERN im Auftrag der Daimler AG)         |
| RS         | Rainer Schulte       | Firma TZM (EXTERN im Auftrag der Daimler AG)         |
|            |                      |                                                      |
|                                                                                          |
|==========================================================================================|
|                                                                                          |
|                                     REVISION HISTORY                                     |
|                                     ----------------                                     |
|                                                                                          |
| Date       | Ver   | Author       | Description                                          |
| -----------+-------+--------------+----------------------------------------------------- |
| 27.04.15   | 1.0   | RS           | creation                                             |
|            |       |              |                                                      |
|                                                                                          |
|------------------------------------------------------------------------------------------|
*/

variables
{
	long ret_Register;
	// global variable for getting (showing) results auf dll-Functions
	long result;

	int CRC_Brk_Rq_PARK_Pr2;
	dword CounterValForCRC_Brk_Rq_PARK_Pr2;
	int SQC_VAL_Brk_Rq_PARK_Pr2;
	int SQC_Brk_Rq_PARK_Pr2;
	int CRC_Park_Disp_Rq_Pr2;
	dword CounterValForCRC_Park_Disp_Rq_Pr2;
	int SQC_VAL_Park_Disp_Rq_Pr2;
	int SQC_Park_Disp_Rq_Pr2;
	int CRC_ParkCfg_Stat_Pr2;
	dword CounterValForCRC_ParkCfg_Stat_Pr2;
	int SQC_VAL_ParkCfg_Stat_Pr2;
	int SQC_ParkCfg_Stat_Pr2;
	int CRC_ParkSensObj_Stat1_Pr2;
	dword CounterValForCRC_ParkSensObj_Stat1_Pr2;
	int SQC_VAL_ParkSensObj_Stat1_Pr2;
	int SQC_ParkSensObj_Stat1_Pr2;
	int CRC_ParkSensObj_Stat2_Pr2;
	dword CounterValForCRC_ParkSensObj_Stat2_Pr2;
	int SQC_VAL_ParkSensObj_Stat2_Pr2;
	int SQC_ParkSensObj_Stat2_Pr2;
	int CRC_RemPark_Rq_Pr2;
	dword CounterValForCRC_RemPark_Rq_Pr2;
	int SQC_VAL_RemPark_Rq_Pr2;
	int SQC_RemPark_Rq_Pr2;
	int CRC_SADR_Trgr_PARK_Pr2;
	dword CounterValForCRC_SADR_Trgr_PARK_Pr2;
	int SQC_VAL_SADR_Trgr_PARK_Pr2;
	int SQC_SADR_Trgr_PARK_Pr2;
	int CRC_St_Rq_PARK_Pr2;
	dword CounterValForCRC_St_Rq_PARK_Pr2;
	int SQC_VAL_St_Rq_PARK_Pr2;
	int SQC_St_Rq_PARK_Pr2;

	msTimer Timer_PARK_Brk_Rq_PARK_AR2;
	msTimer Timer_PARK_ECU_INFO_RVC_AR;
	msTimer Timer_PARK_Park_Disp_Rq_AR2;
	msTimer Timer_PARK_Park_Set_Stat_AR2;
	msTimer Timer_PARK_Park_Stat_AR2;
	msTimer Timer_PARK_ParkSensObj_Stat1_FR2;
	msTimer Timer_PARK_ParkSensObj_Stat2_FR2;
	msTimer Timer_PARK_ParkSpaceMeas_Stat_AR;
	msTimer Timer_PARK_ParkWarn_AR2;
	msTimer Timer_PARK_RemPark_Rq_AR2;
	msTimer Timer_PARK_ROE_PARK;
	msTimer Timer_PARK_RVC_SVS_Park_Stat_AR2;
	msTimer Timer_PARK_SADR_Trgr_PARK_AR2;
	msTimer Timer_PARK_St_Rq_PARK_AR2;

   byte  crctable[256] = {
      0x00, 0x1D, 0x3A, 0x27, 0x74, 0x69, 0x4E, 0x53,
      0xE8, 0xF5, 0xD2, 0xCF, 0x9C, 0x81, 0xA6, 0xBB,
      0xCD, 0xD0, 0xF7, 0xEA, 0xB9, 0xA4, 0x83, 0x9E,
      0x25, 0x38, 0x1F, 0x02, 0x51, 0x4C, 0x6B, 0x76,
      0x87, 0x9A, 0xBD, 0xA0, 0xF3, 0xEE, 0xC9, 0xD4,
      0x6F, 0x72, 0x55, 0x48, 0x1B, 0x06, 0x21, 0x3C,
      0x4A, 0x57, 0x70, 0x6D, 0x3E, 0x23, 0x04, 0x19,
      0xA2, 0xBF, 0x98, 0x85, 0xD6, 0xCB, 0xEC, 0xF1,
      0x13, 0x0E, 0x29, 0x34, 0x67, 0x7A, 0x5D, 0x40,
      0xFB, 0xE6, 0xC1, 0xDC, 0x8F, 0x92, 0xB5, 0xA8,
      0xDE, 0xC3, 0xE4, 0xF9, 0xAA, 0xB7, 0x90, 0x8D,
      0x36, 0x2B, 0x0C, 0x11, 0x42, 0x5F, 0x78, 0x65,
      0x94, 0x89, 0xAE, 0xB3, 0xE0, 0xFD, 0xDA, 0xC7,
      0x7C, 0x61, 0x46, 0x5B, 0x08, 0x15, 0x32, 0x2F,
      0x59, 0x44, 0x63, 0x7E, 0x2D, 0x30, 0x17, 0x0A,
      0xB1, 0xAC, 0x8B, 0x96, 0xC5, 0xD8, 0xFF, 0xE2,
      0x26, 0x3B, 0x1C, 0x01, 0x52, 0x4F, 0x68, 0x75,
      0xCE, 0xD3, 0xF4, 0xE9, 0xBA, 0xA7, 0x80, 0x9D,
      0xEB, 0xF6, 0xD1, 0xCC, 0x9F, 0x82, 0xA5, 0xB8,
      0x03, 0x1E, 0x39, 0x24, 0x77, 0x6A, 0x4D, 0x50,
      0xA1, 0xBC, 0x9B, 0x86, 0xD5, 0xC8, 0xEF, 0xF2,
      0x49, 0x54, 0x73, 0x6E, 0x3D, 0x20, 0x07, 0x1A,
      0x6C, 0x71, 0x56, 0x4B, 0x18, 0x05, 0x22, 0x3F,
      0x84, 0x99, 0xBE, 0xA3, 0xF0, 0xED, 0xCA, 0xD7,
      0x35, 0x28, 0x0F, 0x12, 0x41, 0x5C, 0x7B, 0x66,
      0xDD, 0xC0, 0xE7, 0xFA, 0xA9, 0xB4, 0x93, 0x8E,
      0xF8, 0xE5, 0xC2, 0xDF, 0x8C, 0x91, 0xB6, 0xAB,
      0x10, 0x0D, 0x2A, 0x37, 0x64, 0x79, 0x5E, 0x43,
      0xB2, 0xAF, 0x88, 0x95, 0xC6, 0xDB, 0xFC, 0xE1,
      0x5A, 0x47, 0x60, 0x7D, 0x2E, 0x33, 0x14, 0x09,
      0x7F, 0x62, 0x45, 0x58, 0x0B, 0x16, 0x31, 0x2C,
      0x97, 0x8A, 0xAD, 0xB0, 0xE3, 0xFE, 0xD9, 0xC4
   };

   byte  crctableProfTwo[256] = {
			0x00, 0x2F, 0x5E, 0x71, 0xBC, 0x93, 0xE2, 0xCD,
			0x57, 0x78, 0x09, 0x26, 0xEB, 0xC4, 0xB5, 0x9A,
			0xAE, 0x81, 0xF0, 0xDF, 0x12, 0x3D, 0x4C, 0x63,
			0xF9, 0xD6, 0xA7, 0x88, 0x45, 0x6A, 0x1B, 0x34,
			0x73, 0x5C, 0x2D, 0x02, 0xCF, 0xE0, 0x91, 0xBE,
			0x24, 0x0B, 0x7A, 0x55, 0x98, 0xB7, 0xC6, 0xE9,
			0xDD, 0xF2, 0x83, 0xAC, 0x61, 0x4E, 0x3F, 0x10,
			0x8A, 0xA5, 0xD4, 0xFB, 0x36, 0x19, 0x68, 0x47,
			0xE6, 0xC9, 0xB8, 0x97, 0x5A, 0x75, 0x04, 0x2B,
			0xB1, 0x9E, 0xEF, 0xC0, 0x0D, 0x22, 0x53, 0x7C,
			0x48, 0x67, 0x16, 0x39, 0xF4, 0xDB, 0xAA, 0x85,
			0x1F, 0x30, 0x41, 0x6E, 0xA3, 0x8C, 0xFD, 0xD2,
			0x95, 0xBA, 0xCB, 0xE4, 0x29, 0x06, 0x77, 0x58,
			0xC2, 0xED, 0x9C, 0xB3, 0x7E, 0x51, 0x20, 0x0F,
			0x3B, 0x14, 0x65, 0x4A, 0x87, 0xA8, 0xD9, 0xF6,
			0x6C, 0x43, 0x32, 0x1D, 0xD0, 0xFF, 0x8E, 0xA1,
			0xE3, 0xCC, 0xBD, 0x92, 0x5F, 0x70, 0x01, 0x2E,
			0xB4, 0x9B, 0xEA, 0xC5, 0x08, 0x27, 0x56, 0x79,
			0x4D, 0x62, 0x13, 0x3C, 0xF1, 0xDE, 0xAF, 0x80,
			0x1A, 0x35, 0x44, 0x6B, 0xA6, 0x89, 0xF8, 0xD7,
			0x90, 0xBF, 0xCE, 0xE1, 0x2C, 0x03, 0x72, 0x5D,
			0xC7, 0xE8, 0x99, 0xB6, 0x7B, 0x54, 0x25, 0x0A,
			0x3E, 0x11, 0x60, 0x4F, 0x82, 0xAD, 0xDC, 0xF3,
			0x69, 0x46, 0x37, 0x18, 0xD5, 0xFA, 0x8B, 0xA4,
			0x05, 0x2A, 0x5B, 0x74, 0xB9, 0x96, 0xE7, 0xC8,
			0x52, 0x7D, 0x0C, 0x23, 0xEE, 0xC1, 0xB0, 0x9F,
			0xAB, 0x84, 0xF5, 0xDA, 0x17, 0x38, 0x49, 0x66,
			0xFC, 0xD3, 0xA2, 0x8D, 0x40, 0x6F, 0x1E, 0x31,
			0x76, 0x59, 0x28, 0x07, 0xCA, 0xE5, 0x94, 0xBB,
			0x21, 0x0E, 0x7F, 0x50, 0x9D, 0xB2, 0xC3, 0xEC,
			0xD8, 0xF7, 0x86, 0xA9, 0x64, 0x4B, 0x3A, 0x15,
			0x8F, 0xA0, 0xD1, 0xFE, 0x33, 0x1C, 0x6D, 0x42
   };
}
/*@@end*/

/*@@startStart:Start:*/
on start
{
	result = EnableCRC("", 0); // 1 = on, 0 = off
	result = EnableTGL("", 0); // 1 = on, 0 = off 
	result = EnableSQC("", 0); // 1 = on, 0 = off 
	result = EnableMC("", 0); // 1 = on, 0 = off 

	if (@sysvar::CH_Nodes::CH_PARKCRC_Brk_Rq_PARK_Pr2B_AUTO == 0)
	{
		//Automatisch
		enableControl("Brk_Rq_PARK_AR2", "CH_PARKCRC_Brk_Rq_PARK_Pr2Brk_R_", 0); //1: enable; 0: disable
	}
	else
	{
		//Manuel
		enableControl("Brk_Rq_PARK_AR2", "CH_PARKCRC_Brk_Rq_PARK_Pr2Brk_R_", 1); //1: enable; 0: disable
	}
	if (@sysvar::CH_Nodes::CH_PARKSQC_Brk_Rq_PARK_Pr2B_AUTO == 0)
	{
		//Automatisch
		enableControl("Brk_Rq_PARK_AR2", "CH_PARKSQC_Brk_Rq_PARK_Pr2Brk_R_", 0); //1: enable; 0: disable
	}
	else
	{
		//Manuel
		enableControl("Brk_Rq_PARK_AR2", "CH_PARKSQC_Brk_Rq_PARK_Pr2Brk_R_", 1); //1: enable; 0: disable
	}
	@sysvar::CH_Nodes::CH__PDURECEIPT_SIM_PARK_Brk_Rq_PARK_AR2 = 1;
	@sysvar::CH_Nodes::CH__PDURECEIPT_SIM_PARK_ECU_INFO_RVC_AR = 1;
	if (@sysvar::CH_Nodes::CH_PARKCRC_Park_Disp_Rq_Pr2_AUTO == 0)
	{
		//Automatisch
		enableControl("Park_Disp_Rq_AR2", "CH_PARKCRC_Park_Disp_Rq_Pr2Park_", 0); //1: enable; 0: disable
	}
	else
	{
		//Manuel
		enableControl("Park_Disp_Rq_AR2", "CH_PARKCRC_Park_Disp_Rq_Pr2Park_", 1); //1: enable; 0: disable
	}
	if (@sysvar::CH_Nodes::CH_PARKSQC_Park_Disp_Rq_Pr2_AUTO == 0)
	{
		//Automatisch
		enableControl("Park_Disp_Rq_AR2", "CH_PARKSQC_Park_Disp_Rq_Pr2Park_", 0); //1: enable; 0: disable
	}
	else
	{
		//Manuel
		enableControl("Park_Disp_Rq_AR2", "CH_PARKSQC_Park_Disp_Rq_Pr2Park_", 1); //1: enable; 0: disable
	}
	@sysvar::CH_Nodes::CH__PDURECEIPT_SIM_PARK_Park_Disp_Rq_AR2 = 1;
	@sysvar::CH_Nodes::CH__PDURECEIPT_SIM_PARK_Park_Set_Stat_AR2 = 1;
	if (@sysvar::CH_Nodes::CH_PARKCRC_ParkCfg_Stat_Pr2_AUTO == 0)
	{
		//Automatisch
		enableControl("Park_Stat_AR2", "CH_PARKCRC_ParkCfg_Stat_Pr2Park_", 0); //1: enable; 0: disable
	}
	else
	{
		//Manuel
		enableControl("Park_Stat_AR2", "CH_PARKCRC_ParkCfg_Stat_Pr2Park_", 1); //1: enable; 0: disable
	}
	if (@sysvar::CH_Nodes::CH_PARKSQC_ParkCfg_Stat_Pr2_AUTO == 0)
	{
		//Automatisch
		enableControl("Park_Stat_AR2", "CH_PARKSQC_ParkCfg_Stat_Pr2Park_", 0); //1: enable; 0: disable
	}
	else
	{
		//Manuel
		enableControl("Park_Stat_AR2", "CH_PARKSQC_ParkCfg_Stat_Pr2Park_", 1); //1: enable; 0: disable
	}
	@sysvar::CH_Nodes::CH__PDURECEIPT_SIM_PARK_Park_Stat_AR2 = 1;
	if (@sysvar::CH_Nodes::CH_PARKCRC_ParkSensObj_Stat_AUTO == 0)
	{
		//Automatisch
		enableControl("ParkSensObj_Stat1_FR2", "CH_PARKCRC_ParkSensObj_Stat1_Pr_", 0); //1: enable; 0: disable
	}
	else
	{
		//Manuel
		enableControl("ParkSensObj_Stat1_FR2", "CH_PARKCRC_ParkSensObj_Stat1_Pr_", 1); //1: enable; 0: disable
	}
	if (@sysvar::CH_Nodes::CH_PARKSQC_ParkSensObj_Stat_AUTO == 0)
	{
		//Automatisch
		enableControl("ParkSensObj_Stat1_FR2", "CH_PARKSQC_ParkSensObj_Stat1_Pr_", 0); //1: enable; 0: disable
	}
	else
	{
		//Manuel
		enableControl("ParkSensObj_Stat1_FR2", "CH_PARKSQC_ParkSensObj_Stat1_Pr_", 1); //1: enable; 0: disable
	}
	@sysvar::CH_Nodes::CH__PDURECEIPT_SIM_PARK_ParkSensObj_Stat1_FR2 = 1;
	if (@sysvar::CH_Nodes::CH_PARKCRC_ParkSensObj_Stat_A_01 == 0)
	{
		//Automatisch
		enableControl("ParkSensObj_Stat2_FR2", "CH_PARKCRC_ParkSensObj_Stat2_Pr_", 0); //1: enable; 0: disable
	}
	else
	{
		//Manuel
		enableControl("ParkSensObj_Stat2_FR2", "CH_PARKCRC_ParkSensObj_Stat2_Pr_", 1); //1: enable; 0: disable
	}
	if (@sysvar::CH_Nodes::CH_PARKSQC_ParkSensObj_Stat_A_01 == 0)
	{
		//Automatisch
		enableControl("ParkSensObj_Stat2_FR2", "CH_PARKSQC_ParkSensObj_Stat2_Pr_", 0); //1: enable; 0: disable
	}
	else
	{
		//Manuel
		enableControl("ParkSensObj_Stat2_FR2", "CH_PARKSQC_ParkSensObj_Stat2_Pr_", 1); //1: enable; 0: disable
	}
	@sysvar::CH_Nodes::CH__PDURECEIPT_SIM_PARK_ParkSensObj_Stat2_FR2 = 1;
	@sysvar::CH_Nodes::CH__PDURECEIPT_SIM_PARK_ParkSpaceMeas_Stat_AR = 1;
	@sysvar::CH_Nodes::CH__PDURECEIPT_SIM_PARK_ParkWarn_AR2 = 1;
	if (@sysvar::CH_Nodes::CH_PARKCRC_RemPark_Rq_Pr2Re_AUTO == 0)
	{
		//Automatisch
		enableControl("RemPark_Rq_AR2", "CH_PARKCRC_RemPark_Rq_Pr2RemPar_", 0); //1: enable; 0: disable
	}
	else
	{
		//Manuel
		enableControl("RemPark_Rq_AR2", "CH_PARKCRC_RemPark_Rq_Pr2RemPar_", 1); //1: enable; 0: disable
	}
	if (@sysvar::CH_Nodes::CH_PARKSQC_RemPark_Rq_Pr2Re_AUTO == 0)
	{
		//Automatisch
		enableControl("RemPark_Rq_AR2", "CH_PARKSQC_RemPark_Rq_Pr2RemPar_", 0); //1: enable; 0: disable
	}
	else
	{
		//Manuel
		enableControl("RemPark_Rq_AR2", "CH_PARKSQC_RemPark_Rq_Pr2RemPar_", 1); //1: enable; 0: disable
	}
	@sysvar::CH_Nodes::CH__PDURECEIPT_SIM_PARK_RemPark_Rq_AR2 = 1;
	@sysvar::CH_Nodes::CH__PDURECEIPT_SIM_PARK_ROE_PARK = 1;
	@sysvar::CH_Nodes::CH__PDURECEIPT_SIM_PARK_RVC_SVS_Park_Stat_AR2 = 1;
	if (@sysvar::CH_Nodes::CH_PARKCRC_SADR_Trgr_PARK_P_AUTO == 0)
	{
		//Automatisch
		enableControl("SADR_Trgr_PARK_AR2", "CH_PARKCRC_SADR_Trgr_PARK_Pr2SA_", 0); //1: enable; 0: disable
	}
	else
	{
		//Manuel
		enableControl("SADR_Trgr_PARK_AR2", "CH_PARKCRC_SADR_Trgr_PARK_Pr2SA_", 1); //1: enable; 0: disable
	}
	if (@sysvar::CH_Nodes::CH_PARKSQC_SADR_Trgr_PARK_P_AUTO == 0)
	{
		//Automatisch
		enableControl("SADR_Trgr_PARK_AR2", "CH_PARKSQC_SADR_Trgr_PARK_Pr2SA_", 0); //1: enable; 0: disable
	}
	else
	{
		//Manuel
		enableControl("SADR_Trgr_PARK_AR2", "CH_PARKSQC_SADR_Trgr_PARK_Pr2SA_", 1); //1: enable; 0: disable
	}
	@sysvar::CH_Nodes::CH__PDURECEIPT_SIM_PARK_SADR_Trgr_PARK_AR2 = 1;
	if (@sysvar::CH_Nodes::CH_PARKCRC_St_Rq_PARK_Pr2St_AUTO == 0)
	{
		//Automatisch
		enableControl("St_Rq_PARK_AR2", "CH_PARKCRC_St_Rq_PARK_Pr2St_Rq__", 0); //1: enable; 0: disable
	}
	else
	{
		//Manuel
		enableControl("St_Rq_PARK_AR2", "CH_PARKCRC_St_Rq_PARK_Pr2St_Rq__", 1); //1: enable; 0: disable
	}
	if (@sysvar::CH_Nodes::CH_PARKSQC_St_Rq_PARK_Pr2St_AUTO == 0)
	{
		//Automatisch
		enableControl("St_Rq_PARK_AR2", "CH_PARKSQC_St_Rq_PARK_Pr2St_Rq__", 0); //1: enable; 0: disable
	}
	else
	{
		//Manuel
		enableControl("St_Rq_PARK_AR2", "CH_PARKSQC_St_Rq_PARK_Pr2St_Rq__", 1); //1: enable; 0: disable
	}
	@sysvar::CH_Nodes::CH__PDURECEIPT_SIM_PARK_St_Rq_PARK_AR2 = 1;
	// netzwerk management

	enableControl("CHASSIS_FR Netzmanagement", "CH__NMActive_PARK", 1);
}
/*@@end*/

/*@@preStart:PreStart:*/
on preStart
{


}
/*@@end*/

/*@@timer:Timer_PARK_Brk_Rq_PARK_AR2:*/
on timer Timer_PARK_Brk_Rq_PARK_AR2
{
	@sysvar::CH_Nodes::CH__STPDU_PARK_Brk_Rq_PARK_AR2 = 0;
}
/*@@end*/

/*@@timer:Timer_PARK_ECU_INFO_RVC_AR:*/
on timer Timer_PARK_ECU_INFO_RVC_AR
{
	@sysvar::CH_Nodes::CH__STPDU_PARK_ECU_INFO_RVC_AR = 0;
}
/*@@end*/

/*@@timer:Timer_PARK_Park_Disp_Rq_AR2:*/
on timer Timer_PARK_Park_Disp_Rq_AR2
{
	@sysvar::CH_Nodes::CH__STPDU_PARK_Park_Disp_Rq_AR2 = 0;
}
/*@@end*/

/*@@timer:Timer_PARK_Park_Set_Stat_AR2:*/
on timer Timer_PARK_Park_Set_Stat_AR2
{
	@sysvar::CH_Nodes::CH__STPDU_PARK_Park_Set_Stat_AR2 = 0;
}
/*@@end*/

/*@@timer:Timer_PARK_Park_Stat_AR2:*/
on timer Timer_PARK_Park_Stat_AR2
{
	@sysvar::CH_Nodes::CH__STPDU_PARK_Park_Stat_AR2 = 0;
}
/*@@end*/

/*@@timer:Timer_PARK_ParkSensObj_Stat1_FR2:*/
on timer Timer_PARK_ParkSensObj_Stat1_FR2
{
	@sysvar::CH_Nodes::CH__STPDU_PARK_ParkSensObj_Stat1_FR2 = 0;
}
/*@@end*/

/*@@timer:Timer_PARK_ParkSensObj_Stat2_FR2:*/
on timer Timer_PARK_ParkSensObj_Stat2_FR2
{
	@sysvar::CH_Nodes::CH__STPDU_PARK_ParkSensObj_Stat2_FR2 = 0;
}
/*@@end*/

/*@@timer:Timer_PARK_ParkSpaceMeas_Stat_AR:*/
on timer Timer_PARK_ParkSpaceMeas_Stat_AR
{
	@sysvar::CH_Nodes::CH__STPDU_PARK_ParkSpaceMeas_Stat_AR = 0;
}
/*@@end*/

/*@@timer:Timer_PARK_ParkWarn_AR2:*/
on timer Timer_PARK_ParkWarn_AR2
{
	@sysvar::CH_Nodes::CH__STPDU_PARK_ParkWarn_AR2 = 0;
}
/*@@end*/

/*@@timer:Timer_PARK_RemPark_Rq_AR2:*/
on timer Timer_PARK_RemPark_Rq_AR2
{
	@sysvar::CH_Nodes::CH__STPDU_PARK_RemPark_Rq_AR2 = 0;
}
/*@@end*/

/*@@timer:Timer_PARK_ROE_PARK:*/
on timer Timer_PARK_ROE_PARK
{
	@sysvar::CH_Nodes::CH__STPDU_PARK_ROE_PARK = 0;
}
/*@@end*/

/*@@timer:Timer_PARK_RVC_SVS_Park_Stat_AR2:*/
on timer Timer_PARK_RVC_SVS_Park_Stat_AR2
{
	@sysvar::CH_Nodes::CH__STPDU_PARK_RVC_SVS_Park_Stat_AR2 = 0;
}
/*@@end*/

/*@@timer:Timer_PARK_SADR_Trgr_PARK_AR2:*/
on timer Timer_PARK_SADR_Trgr_PARK_AR2
{
	@sysvar::CH_Nodes::CH__STPDU_PARK_SADR_Trgr_PARK_AR2 = 0;
}
/*@@end*/

/*@@timer:Timer_PARK_St_Rq_PARK_AR2:*/
on timer Timer_PARK_St_Rq_PARK_AR2
{
	@sysvar::CH_Nodes::CH__STPDU_PARK_St_Rq_PARK_AR2 = 0;
}
/*@@end*/



/*@@sysvarChange:CH_Nodes::CH__STPDU_PARK_Brk_Rq_PARK_AR2:*/
on sysvar sysvar::CH_Nodes::CH__STPDU_PARK_Brk_Rq_PARK_AR2
{
	long res;
	long tDelay;
	switch (@this)
	{
		case (0):
			res = ResetTimingCyclic("Brk_Rq_PARK_AR2");
			res = ResetTimingEvtTrg("Brk_Rq_PARK_AR2");
			res = EnableTimingCyclic("Brk_Rq_PARK_AR2", 1);
			res = EnableTimingEvtTrg("Brk_Rq_PARK_AR2", 1);
			break;
		case (1):
			tDelay = @sysvar::CH_Nodes::CH__STPDU_T_PARK_Brk_Rq_PARK_AR2;
			if (tDelay > 0)
			{
				if (isTimerActive(Timer_PARK_Brk_Rq_PARK_AR2) == 0)
				{
					res = SetTimingCyclic("Brk_Rq_PARK_AR2", 1, tDelay, 1);
					setTimer (Timer_PARK_Brk_Rq_PARK_AR2, tDelay);
					@sysvar::CH_Nodes::CH__STPDU_PARK_Brk_Rq_PARK_AR2 = 2;
				}
			}
			else if (tDelay == 0)
			{
				if (isTimerActive(Timer_PARK_Brk_Rq_PARK_AR2) == 0)
				{
					res = EnableTimingCyclic("Brk_Rq_PARK_AR2", 0);
					res = EnableTimingEvtTrg("Brk_Rq_PARK_AR2", 0);
				}
			}
			break;
		case (2):
			break;
		default:
			Write("error: wrong parameter (%d)", @this);
			stop();
			break;
	}
}
/*@@end*/

/*@@sysvarChange:CH_Nodes::CH__STPDU_PARK_ECU_INFO_RVC_AR:*/
on sysvar sysvar::CH_Nodes::CH__STPDU_PARK_ECU_INFO_RVC_AR
{
	long res;
	long tDelay;
	switch (@this)
	{
		case (0):
			res = ResetTimingCyclic("ECU_INFO_RVC_AR");
			res = ResetTimingEvtTrg("ECU_INFO_RVC_AR");
			res = EnableTimingCyclic("ECU_INFO_RVC_AR", 1);
			res = EnableTimingEvtTrg("ECU_INFO_RVC_AR", 1);
			break;
		case (1):
			tDelay = @sysvar::CH_Nodes::CH__STPDU_T_PARK_ECU_INFO_RVC_AR;
			if (tDelay > 0)
			{
				if (isTimerActive(Timer_PARK_ECU_INFO_RVC_AR) == 0)
				{
					res = SetTimingCyclic("ECU_INFO_RVC_AR", 1, tDelay, 1);
					setTimer (Timer_PARK_ECU_INFO_RVC_AR, tDelay);
					@sysvar::CH_Nodes::CH__STPDU_PARK_ECU_INFO_RVC_AR = 2;
				}
			}
			else if (tDelay == 0)
			{
				if (isTimerActive(Timer_PARK_ECU_INFO_RVC_AR) == 0)
				{
					res = EnableTimingCyclic("ECU_INFO_RVC_AR", 0);
					res = EnableTimingEvtTrg("ECU_INFO_RVC_AR", 0);
				}
			}
			break;
		case (2):
			break;
		default:
			Write("error: wrong parameter (%d)", @this);
			stop();
			break;
	}
}
/*@@end*/

/*@@sysvarChange:CH_Nodes::CH__STPDU_PARK_Park_Disp_Rq_AR2:*/
on sysvar sysvar::CH_Nodes::CH__STPDU_PARK_Park_Disp_Rq_AR2
{
	long res;
	long tDelay;
	switch (@this)
	{
		case (0):
			res = ResetTimingCyclic("Park_Disp_Rq_AR2");
			res = ResetTimingEvtTrg("Park_Disp_Rq_AR2");
			res = EnableTimingCyclic("Park_Disp_Rq_AR2", 1);
			res = EnableTimingEvtTrg("Park_Disp_Rq_AR2", 1);
			break;
		case (1):
			tDelay = @sysvar::CH_Nodes::CH__STPDU_T_PARK_Park_Disp_Rq_AR2;
			if (tDelay > 0)
			{
				if (isTimerActive(Timer_PARK_Park_Disp_Rq_AR2) == 0)
				{
					res = SetTimingCyclic("Park_Disp_Rq_AR2", 1, tDelay, 1);
					setTimer (Timer_PARK_Park_Disp_Rq_AR2, tDelay);
					@sysvar::CH_Nodes::CH__STPDU_PARK_Park_Disp_Rq_AR2 = 2;
				}
			}
			else if (tDelay == 0)
			{
				if (isTimerActive(Timer_PARK_Park_Disp_Rq_AR2) == 0)
				{
					res = EnableTimingCyclic("Park_Disp_Rq_AR2", 0);
					res = EnableTimingEvtTrg("Park_Disp_Rq_AR2", 0);
				}
			}
			break;
		case (2):
			break;
		default:
			Write("error: wrong parameter (%d)", @this);
			stop();
			break;
	}
}
/*@@end*/

/*@@sysvarChange:CH_Nodes::CH__STPDU_PARK_Park_Set_Stat_AR2:*/
on sysvar sysvar::CH_Nodes::CH__STPDU_PARK_Park_Set_Stat_AR2
{
	long res;
	long tDelay;
	switch (@this)
	{
		case (0):
			res = ResetTimingCyclic("Park_Set_Stat_AR2");
			res = ResetTimingEvtTrg("Park_Set_Stat_AR2");
			res = EnableTimingCyclic("Park_Set_Stat_AR2", 1);
			res = EnableTimingEvtTrg("Park_Set_Stat_AR2", 1);
			break;
		case (1):
			tDelay = @sysvar::CH_Nodes::CH__STPDU_T_PARK_Park_Set_Stat_AR2;
			if (tDelay > 0)
			{
				if (isTimerActive(Timer_PARK_Park_Set_Stat_AR2) == 0)
				{
					res = SetTimingCyclic("Park_Set_Stat_AR2", 1, tDelay, 1);
					setTimer (Timer_PARK_Park_Set_Stat_AR2, tDelay);
					@sysvar::CH_Nodes::CH__STPDU_PARK_Park_Set_Stat_AR2 = 2;
				}
			}
			else if (tDelay == 0)
			{
				if (isTimerActive(Timer_PARK_Park_Set_Stat_AR2) == 0)
				{
					res = EnableTimingCyclic("Park_Set_Stat_AR2", 0);
					res = EnableTimingEvtTrg("Park_Set_Stat_AR2", 0);
				}
			}
			break;
		case (2):
			break;
		default:
			Write("error: wrong parameter (%d)", @this);
			stop();
			break;
	}
}
/*@@end*/

/*@@sysvarChange:CH_Nodes::CH__STPDU_PARK_Park_Stat_AR2:*/
on sysvar sysvar::CH_Nodes::CH__STPDU_PARK_Park_Stat_AR2
{
	long res;
	long tDelay;
	switch (@this)
	{
		case (0):
			res = ResetTimingCyclic("Park_Stat_AR2");
			res = ResetTimingEvtTrg("Park_Stat_AR2");
			res = EnableTimingCyclic("Park_Stat_AR2", 1);
			res = EnableTimingEvtTrg("Park_Stat_AR2", 1);
			break;
		case (1):
			tDelay = @sysvar::CH_Nodes::CH__STPDU_T_PARK_Park_Stat_AR2;
			if (tDelay > 0)
			{
				if (isTimerActive(Timer_PARK_Park_Stat_AR2) == 0)
				{
					res = SetTimingCyclic("Park_Stat_AR2", 1, tDelay, 1);
					setTimer (Timer_PARK_Park_Stat_AR2, tDelay);
					@sysvar::CH_Nodes::CH__STPDU_PARK_Park_Stat_AR2 = 2;
				}
			}
			else if (tDelay == 0)
			{
				if (isTimerActive(Timer_PARK_Park_Stat_AR2) == 0)
				{
					res = EnableTimingCyclic("Park_Stat_AR2", 0);
					res = EnableTimingEvtTrg("Park_Stat_AR2", 0);
				}
			}
			break;
		case (2):
			break;
		default:
			Write("error: wrong parameter (%d)", @this);
			stop();
			break;
	}
}
/*@@end*/

/*@@sysvarChange:CH_Nodes::CH__STPDU_PARK_ParkSensObj_Stat1_FR2:*/
on sysvar sysvar::CH_Nodes::CH__STPDU_PARK_ParkSensObj_Stat1_FR2
{
	long res;
	long tDelay;
	switch (@this)
	{
		case (0):
			res = ResetTimingCyclic("ParkSensObj_Stat1_FR2");
			res = ResetTimingEvtTrg("ParkSensObj_Stat1_FR2");
			res = EnableTimingCyclic("ParkSensObj_Stat1_FR2", 1);
			res = EnableTimingEvtTrg("ParkSensObj_Stat1_FR2", 1);
			break;
		case (1):
			tDelay = @sysvar::CH_Nodes::CH__STPDU_T_PARK_ParkSensObj_Stat1_FR2;
			if (tDelay > 0)
			{
				if (isTimerActive(Timer_PARK_ParkSensObj_Stat1_FR2) == 0)
				{
					res = SetTimingCyclic("ParkSensObj_Stat1_FR2", 1, tDelay, 1);
					setTimer (Timer_PARK_ParkSensObj_Stat1_FR2, tDelay);
					@sysvar::CH_Nodes::CH__STPDU_PARK_ParkSensObj_Stat1_FR2 = 2;
				}
			}
			else if (tDelay == 0)
			{
				if (isTimerActive(Timer_PARK_ParkSensObj_Stat1_FR2) == 0)
				{
					res = EnableTimingCyclic("ParkSensObj_Stat1_FR2", 0);
					res = EnableTimingEvtTrg("ParkSensObj_Stat1_FR2", 0);
				}
			}
			break;
		case (2):
			break;
		default:
			Write("error: wrong parameter (%d)", @this);
			stop();
			break;
	}
}
/*@@end*/

/*@@sysvarChange:CH_Nodes::CH__STPDU_PARK_ParkSensObj_Stat2_FR2:*/
on sysvar sysvar::CH_Nodes::CH__STPDU_PARK_ParkSensObj_Stat2_FR2
{
	long res;
	long tDelay;
	switch (@this)
	{
		case (0):
			res = ResetTimingCyclic("ParkSensObj_Stat2_FR2");
			res = ResetTimingEvtTrg("ParkSensObj_Stat2_FR2");
			res = EnableTimingCyclic("ParkSensObj_Stat2_FR2", 1);
			res = EnableTimingEvtTrg("ParkSensObj_Stat2_FR2", 1);
			break;
		case (1):
			tDelay = @sysvar::CH_Nodes::CH__STPDU_T_PARK_ParkSensObj_Stat2_FR2;
			if (tDelay > 0)
			{
				if (isTimerActive(Timer_PARK_ParkSensObj_Stat2_FR2) == 0)
				{
					res = SetTimingCyclic("ParkSensObj_Stat2_FR2", 1, tDelay, 1);
					setTimer (Timer_PARK_ParkSensObj_Stat2_FR2, tDelay);
					@sysvar::CH_Nodes::CH__STPDU_PARK_ParkSensObj_Stat2_FR2 = 2;
				}
			}
			else if (tDelay == 0)
			{
				if (isTimerActive(Timer_PARK_ParkSensObj_Stat2_FR2) == 0)
				{
					res = EnableTimingCyclic("ParkSensObj_Stat2_FR2", 0);
					res = EnableTimingEvtTrg("ParkSensObj_Stat2_FR2", 0);
				}
			}
			break;
		case (2):
			break;
		default:
			Write("error: wrong parameter (%d)", @this);
			stop();
			break;
	}
}
/*@@end*/

/*@@sysvarChange:CH_Nodes::CH__STPDU_PARK_ParkSpaceMeas_Stat_AR:*/
on sysvar sysvar::CH_Nodes::CH__STPDU_PARK_ParkSpaceMeas_Stat_AR
{
	long res;
	long tDelay;
	switch (@this)
	{
		case (0):
			res = ResetTimingCyclic("ParkSpaceMeas_Stat_AR");
			res = ResetTimingEvtTrg("ParkSpaceMeas_Stat_AR");
			res = EnableTimingCyclic("ParkSpaceMeas_Stat_AR", 1);
			res = EnableTimingEvtTrg("ParkSpaceMeas_Stat_AR", 1);
			break;
		case (1):
			tDelay = @sysvar::CH_Nodes::CH__STPDU_T_PARK_ParkSpaceMeas_Stat_AR;
			if (tDelay > 0)
			{
				if (isTimerActive(Timer_PARK_ParkSpaceMeas_Stat_AR) == 0)
				{
					res = SetTimingCyclic("ParkSpaceMeas_Stat_AR", 1, tDelay, 1);
					setTimer (Timer_PARK_ParkSpaceMeas_Stat_AR, tDelay);
					@sysvar::CH_Nodes::CH__STPDU_PARK_ParkSpaceMeas_Stat_AR = 2;
				}
			}
			else if (tDelay == 0)
			{
				if (isTimerActive(Timer_PARK_ParkSpaceMeas_Stat_AR) == 0)
				{
					res = EnableTimingCyclic("ParkSpaceMeas_Stat_AR", 0);
					res = EnableTimingEvtTrg("ParkSpaceMeas_Stat_AR", 0);
				}
			}
			break;
		case (2):
			break;
		default:
			Write("error: wrong parameter (%d)", @this);
			stop();
			break;
	}
}
/*@@end*/

/*@@sysvarChange:CH_Nodes::CH__STPDU_PARK_ParkWarn_AR2:*/
on sysvar sysvar::CH_Nodes::CH__STPDU_PARK_ParkWarn_AR2
{
	long res;
	long tDelay;
	switch (@this)
	{
		case (0):
			res = ResetTimingCyclic("ParkWarn_AR2");
			res = ResetTimingEvtTrg("ParkWarn_AR2");
			res = EnableTimingCyclic("ParkWarn_AR2", 1);
			res = EnableTimingEvtTrg("ParkWarn_AR2", 1);
			break;
		case (1):
			tDelay = @sysvar::CH_Nodes::CH__STPDU_T_PARK_ParkWarn_AR2;
			if (tDelay > 0)
			{
				if (isTimerActive(Timer_PARK_ParkWarn_AR2) == 0)
				{
					res = SetTimingCyclic("ParkWarn_AR2", 1, tDelay, 1);
					setTimer (Timer_PARK_ParkWarn_AR2, tDelay);
					@sysvar::CH_Nodes::CH__STPDU_PARK_ParkWarn_AR2 = 2;
				}
			}
			else if (tDelay == 0)
			{
				if (isTimerActive(Timer_PARK_ParkWarn_AR2) == 0)
				{
					res = EnableTimingCyclic("ParkWarn_AR2", 0);
					res = EnableTimingEvtTrg("ParkWarn_AR2", 0);
				}
			}
			break;
		case (2):
			break;
		default:
			Write("error: wrong parameter (%d)", @this);
			stop();
			break;
	}
}
/*@@end*/

/*@@sysvarChange:CH_Nodes::CH__STPDU_PARK_RemPark_Rq_AR2:*/
on sysvar sysvar::CH_Nodes::CH__STPDU_PARK_RemPark_Rq_AR2
{
	long res;
	long tDelay;
	switch (@this)
	{
		case (0):
			res = ResetTimingCyclic("RemPark_Rq_AR2");
			res = ResetTimingEvtTrg("RemPark_Rq_AR2");
			res = EnableTimingCyclic("RemPark_Rq_AR2", 1);
			res = EnableTimingEvtTrg("RemPark_Rq_AR2", 1);
			break;
		case (1):
			tDelay = @sysvar::CH_Nodes::CH__STPDU_T_PARK_RemPark_Rq_AR2;
			if (tDelay > 0)
			{
				if (isTimerActive(Timer_PARK_RemPark_Rq_AR2) == 0)
				{
					res = SetTimingCyclic("RemPark_Rq_AR2", 1, tDelay, 1);
					setTimer (Timer_PARK_RemPark_Rq_AR2, tDelay);
					@sysvar::CH_Nodes::CH__STPDU_PARK_RemPark_Rq_AR2 = 2;
				}
			}
			else if (tDelay == 0)
			{
				if (isTimerActive(Timer_PARK_RemPark_Rq_AR2) == 0)
				{
					res = EnableTimingCyclic("RemPark_Rq_AR2", 0);
					res = EnableTimingEvtTrg("RemPark_Rq_AR2", 0);
				}
			}
			break;
		case (2):
			break;
		default:
			Write("error: wrong parameter (%d)", @this);
			stop();
			break;
	}
}
/*@@end*/

/*@@sysvarChange:CH_Nodes::CH__STPDU_PARK_ROE_PARK:*/
on sysvar sysvar::CH_Nodes::CH__STPDU_PARK_ROE_PARK
{
	long res;
	long tDelay;
	switch (@this)
	{
		case (0):
			res = ResetTimingCyclic("ROE_PARK");
			res = ResetTimingEvtTrg("ROE_PARK");
			res = EnableTimingCyclic("ROE_PARK", 1);
			res = EnableTimingEvtTrg("ROE_PARK", 1);
			break;
		case (1):
			tDelay = @sysvar::CH_Nodes::CH__STPDU_T_PARK_ROE_PARK;
			if (tDelay > 0)
			{
				if (isTimerActive(Timer_PARK_ROE_PARK) == 0)
				{
					res = SetTimingCyclic("ROE_PARK", 1, tDelay, 1);
					setTimer (Timer_PARK_ROE_PARK, tDelay);
					@sysvar::CH_Nodes::CH__STPDU_PARK_ROE_PARK = 2;
				}
			}
			else if (tDelay == 0)
			{
				if (isTimerActive(Timer_PARK_ROE_PARK) == 0)
				{
					res = EnableTimingCyclic("ROE_PARK", 0);
					res = EnableTimingEvtTrg("ROE_PARK", 0);
				}
			}
			break;
		case (2):
			break;
		default:
			Write("error: wrong parameter (%d)", @this);
			stop();
			break;
	}
}
/*@@end*/

/*@@sysvarChange:CH_Nodes::CH__STPDU_PARK_RVC_SVS_Park_Stat_AR2:*/
on sysvar sysvar::CH_Nodes::CH__STPDU_PARK_RVC_SVS_Park_Stat_AR2
{
	long res;
	long tDelay;
	switch (@this)
	{
		case (0):
			res = ResetTimingCyclic("RVC_SVS_Park_Stat_AR2");
			res = ResetTimingEvtTrg("RVC_SVS_Park_Stat_AR2");
			res = EnableTimingCyclic("RVC_SVS_Park_Stat_AR2", 1);
			res = EnableTimingEvtTrg("RVC_SVS_Park_Stat_AR2", 1);
			break;
		case (1):
			tDelay = @sysvar::CH_Nodes::CH__STPDU_T_PARK_RVC_SVS_Park_Stat_AR2;
			if (tDelay > 0)
			{
				if (isTimerActive(Timer_PARK_RVC_SVS_Park_Stat_AR2) == 0)
				{
					res = SetTimingCyclic("RVC_SVS_Park_Stat_AR2", 1, tDelay, 1);
					setTimer (Timer_PARK_RVC_SVS_Park_Stat_AR2, tDelay);
					@sysvar::CH_Nodes::CH__STPDU_PARK_RVC_SVS_Park_Stat_AR2 = 2;
				}
			}
			else if (tDelay == 0)
			{
				if (isTimerActive(Timer_PARK_RVC_SVS_Park_Stat_AR2) == 0)
				{
					res = EnableTimingCyclic("RVC_SVS_Park_Stat_AR2", 0);
					res = EnableTimingEvtTrg("RVC_SVS_Park_Stat_AR2", 0);
				}
			}
			break;
		case (2):
			break;
		default:
			Write("error: wrong parameter (%d)", @this);
			stop();
			break;
	}
}
/*@@end*/

/*@@sysvarChange:CH_Nodes::CH__STPDU_PARK_SADR_Trgr_PARK_AR2:*/
on sysvar sysvar::CH_Nodes::CH__STPDU_PARK_SADR_Trgr_PARK_AR2
{
	long res;
	long tDelay;
	switch (@this)
	{
		case (0):
			res = ResetTimingCyclic("SADR_Trgr_PARK_AR2");
			res = ResetTimingEvtTrg("SADR_Trgr_PARK_AR2");
			res = EnableTimingCyclic("SADR_Trgr_PARK_AR2", 1);
			res = EnableTimingEvtTrg("SADR_Trgr_PARK_AR2", 1);
			break;
		case (1):
			tDelay = @sysvar::CH_Nodes::CH__STPDU_T_PARK_SADR_Trgr_PARK_AR2;
			if (tDelay > 0)
			{
				if (isTimerActive(Timer_PARK_SADR_Trgr_PARK_AR2) == 0)
				{
					res = SetTimingCyclic("SADR_Trgr_PARK_AR2", 1, tDelay, 1);
					setTimer (Timer_PARK_SADR_Trgr_PARK_AR2, tDelay);
					@sysvar::CH_Nodes::CH__STPDU_PARK_SADR_Trgr_PARK_AR2 = 2;
				}
			}
			else if (tDelay == 0)
			{
				if (isTimerActive(Timer_PARK_SADR_Trgr_PARK_AR2) == 0)
				{
					res = EnableTimingCyclic("SADR_Trgr_PARK_AR2", 0);
					res = EnableTimingEvtTrg("SADR_Trgr_PARK_AR2", 0);
				}
			}
			break;
		case (2):
			break;
		default:
			Write("error: wrong parameter (%d)", @this);
			stop();
			break;
	}
}
/*@@end*/

/*@@sysvarChange:CH_Nodes::CH__STPDU_PARK_St_Rq_PARK_AR2:*/
on sysvar sysvar::CH_Nodes::CH__STPDU_PARK_St_Rq_PARK_AR2
{
	long res;
	long tDelay;
	switch (@this)
	{
		case (0):
			res = ResetTimingCyclic("St_Rq_PARK_AR2");
			res = ResetTimingEvtTrg("St_Rq_PARK_AR2");
			res = EnableTimingCyclic("St_Rq_PARK_AR2", 1);
			res = EnableTimingEvtTrg("St_Rq_PARK_AR2", 1);
			break;
		case (1):
			tDelay = @sysvar::CH_Nodes::CH__STPDU_T_PARK_St_Rq_PARK_AR2;
			if (tDelay > 0)
			{
				if (isTimerActive(Timer_PARK_St_Rq_PARK_AR2) == 0)
				{
					res = SetTimingCyclic("St_Rq_PARK_AR2", 1, tDelay, 1);
					setTimer (Timer_PARK_St_Rq_PARK_AR2, tDelay);
					@sysvar::CH_Nodes::CH__STPDU_PARK_St_Rq_PARK_AR2 = 2;
				}
			}
			else if (tDelay == 0)
			{
				if (isTimerActive(Timer_PARK_St_Rq_PARK_AR2) == 0)
				{
					res = EnableTimingCyclic("St_Rq_PARK_AR2", 0);
					res = EnableTimingEvtTrg("St_Rq_PARK_AR2", 0);
				}
			}
			break;
		case (2):
			break;
		default:
			Write("error: wrong parameter (%d)", @this);
			stop();
			break;
	}
}
/*@@end*/


/*@@sysvarChange:CH_Nodes::CH_PARKBrk_Rq_PARK_AR2_UB_AUT_01:*/
on sysvar sysvar::CH_Nodes::CH_PARKBrk_Rq_PARK_AR2_UB_AUT_01
{
	switch (@sysvar::CH_Nodes::CH_PARKBrk_Rq_PARK_AR2_UB_AUT_01)
	{
		case (0):
			enableControl("Brk_Rq_PARK_AR2", "CH_PARKBrk_Rq_PARK_AR2_UB__01", 0); //1: enable; 0: disable
			@sysvar::CH_Nodes::CH_PARKBrk_Rq_PARK_AR2_UB__01 = 1;
			break;
		case (1):
			enableControl("Brk_Rq_PARK_AR2", "CH_PARKBrk_Rq_PARK_AR2_UB__01", 1); //1: enable; 0: disable
			break;
		case (2):
			enableControl("Brk_Rq_PARK_AR2", "CH_PARKBrk_Rq_PARK_AR2_UB__01", 0); //1: enable; 0: disable
			@sysvar::CH_Nodes::CH_PARKBrk_Rq_PARK_AR2_UB__01 = 1;
			break;
		case (3):
			enableControl("Brk_Rq_PARK_AR2", "CH_PARKBrk_Rq_PARK_AR2_UB__01", 0); //1: enable; 0: disable
			@sysvar::CH_Nodes::CH_PARKBrk_Rq_PARK_AR2_UB__01 = 0;
			break;
	}
}
/*@@end*/

/*@@sysvarChange:CH_Nodes::CH_PARKCRC_Brk_Rq_PARK_Pr2B_AUTO:*/
on sysvar sysvar::CH_Nodes::CH_PARKCRC_Brk_Rq_PARK_Pr2B_AUTO
{
//	EnableCRC("Brk_Rq_PARK_AR2",  "Brk_Rq_PARK_Pr2", !@this); // 1 = on, 0 = off 
	enableControl("Brk_Rq_PARK_AR2", "CH_PARKCRC_Brk_Rq_PARK_Pr2Brk_R_", @this); //1: enable; 0: disable
	CRC_Brk_Rq_PARK_Pr2 = @sysvar::CH_Nodes::CH_PARKCRC_Brk_Rq_PARK_Pr2B_AUTO;
}
/*@@end*/

/*@@sysvarChange:CH_Nodes::CH_PARKSQC_Brk_Rq_PARK_Pr2B_AUTO:*/
on sysvar sysvar::CH_Nodes::CH_PARKSQC_Brk_Rq_PARK_Pr2B_AUTO
{
//	EnableSQC("Brk_Rq_PARK_AR2",  "Brk_Rq_PARK_Pr2", !@this); // 1 = on, 0 = off 
	enableControl("Brk_Rq_PARK_AR2", "CH_PARKSQC_Brk_Rq_PARK_Pr2Brk_R_", @this); //1: enable; 0: disable
	SQC_Brk_Rq_PARK_Pr2 = @sysvar::CH_Nodes::CH_PARKSQC_Brk_Rq_PARK_Pr2B_AUTO;
}
/*@@end*/

/*@@sysvarChange:CH_Nodes::CH_PARKECU_INFO_RVC_AR_UB_AUT_01:*/
on sysvar sysvar::CH_Nodes::CH_PARKECU_INFO_RVC_AR_UB_AUT_01
{
	switch (@sysvar::CH_Nodes::CH_PARKECU_INFO_RVC_AR_UB_AUT_01)
	{
		case (0):
			enableControl("ECU_INFO_RVC_AR", "CH_PARKECU_INFO_RVC_AR_UB__01", 0); //1: enable; 0: disable
			@sysvar::CH_Nodes::CH_PARKECU_INFO_RVC_AR_UB__01 = 1;
			break;
		case (1):
			enableControl("ECU_INFO_RVC_AR", "CH_PARKECU_INFO_RVC_AR_UB__01", 1); //1: enable; 0: disable
			break;
		case (2):
			enableControl("ECU_INFO_RVC_AR", "CH_PARKECU_INFO_RVC_AR_UB__01", 0); //1: enable; 0: disable
			@sysvar::CH_Nodes::CH_PARKECU_INFO_RVC_AR_UB__01 = 1;
			break;
		case (3):
			enableControl("ECU_INFO_RVC_AR", "CH_PARKECU_INFO_RVC_AR_UB__01", 0); //1: enable; 0: disable
			@sysvar::CH_Nodes::CH_PARKECU_INFO_RVC_AR_UB__01 = 0;
			break;
	}
}
/*@@end*/

/*@@sysvarChange:CH_Nodes::CH_PARKPark_Disp_Rq_AR2_UB_AU_01:*/
on sysvar sysvar::CH_Nodes::CH_PARKPark_Disp_Rq_AR2_UB_AU_01
{
	switch (@sysvar::CH_Nodes::CH_PARKPark_Disp_Rq_AR2_UB_AU_01)
	{
		case (0):
			enableControl("Park_Disp_Rq_AR2", "CH_PARKPark_Disp_Rq_AR2_UB__01", 0); //1: enable; 0: disable
			@sysvar::CH_Nodes::CH_PARKPark_Disp_Rq_AR2_UB__01 = 1;
			break;
		case (1):
			enableControl("Park_Disp_Rq_AR2", "CH_PARKPark_Disp_Rq_AR2_UB__01", 1); //1: enable; 0: disable
			break;
		case (2):
			enableControl("Park_Disp_Rq_AR2", "CH_PARKPark_Disp_Rq_AR2_UB__01", 0); //1: enable; 0: disable
			@sysvar::CH_Nodes::CH_PARKPark_Disp_Rq_AR2_UB__01 = 1;
			break;
		case (3):
			enableControl("Park_Disp_Rq_AR2", "CH_PARKPark_Disp_Rq_AR2_UB__01", 0); //1: enable; 0: disable
			@sysvar::CH_Nodes::CH_PARKPark_Disp_Rq_AR2_UB__01 = 0;
			break;
	}
}
/*@@end*/

/*@@sysvarChange:CH_Nodes::CH_PARKCRC_Park_Disp_Rq_Pr2_AUTO:*/
on sysvar sysvar::CH_Nodes::CH_PARKCRC_Park_Disp_Rq_Pr2_AUTO
{
//	EnableCRC("Park_Disp_Rq_AR2",  "Park_Disp_Rq_Pr2", !@this); // 1 = on, 0 = off 
	enableControl("Park_Disp_Rq_AR2", "CH_PARKCRC_Park_Disp_Rq_Pr2Park_", @this); //1: enable; 0: disable
	CRC_Park_Disp_Rq_Pr2 = @sysvar::CH_Nodes::CH_PARKCRC_Park_Disp_Rq_Pr2_AUTO;
}
/*@@end*/

/*@@sysvarChange:CH_Nodes::CH_PARKSQC_Park_Disp_Rq_Pr2_AUTO:*/
on sysvar sysvar::CH_Nodes::CH_PARKSQC_Park_Disp_Rq_Pr2_AUTO
{
//	EnableSQC("Park_Disp_Rq_AR2",  "Park_Disp_Rq_Pr2", !@this); // 1 = on, 0 = off 
	enableControl("Park_Disp_Rq_AR2", "CH_PARKSQC_Park_Disp_Rq_Pr2Park_", @this); //1: enable; 0: disable
	SQC_Park_Disp_Rq_Pr2 = @sysvar::CH_Nodes::CH_PARKSQC_Park_Disp_Rq_Pr2_AUTO;
}
/*@@end*/

/*@@sysvarChange:CH_Nodes::CH_PARKPark_Stat_AR2_UB_AUTO_01:*/
on sysvar sysvar::CH_Nodes::CH_PARKPark_Stat_AR2_UB_AUTO_01
{
	switch (@sysvar::CH_Nodes::CH_PARKPark_Stat_AR2_UB_AUTO_01)
	{
		case (0):
			enableControl("Park_Stat_AR2", "CH_PARKPark_Stat_AR2_UB__01", 0); //1: enable; 0: disable
			@sysvar::CH_Nodes::CH_PARKPark_Stat_AR2_UB__01 = 1;
			break;
		case (1):
			enableControl("Park_Stat_AR2", "CH_PARKPark_Stat_AR2_UB__01", 1); //1: enable; 0: disable
			break;
		case (2):
			enableControl("Park_Stat_AR2", "CH_PARKPark_Stat_AR2_UB__01", 0); //1: enable; 0: disable
			@sysvar::CH_Nodes::CH_PARKPark_Stat_AR2_UB__01 = 1;
			break;
		case (3):
			enableControl("Park_Stat_AR2", "CH_PARKPark_Stat_AR2_UB__01", 0); //1: enable; 0: disable
			@sysvar::CH_Nodes::CH_PARKPark_Stat_AR2_UB__01 = 0;
			break;
	}
}
/*@@end*/

/*@@sysvarChange:CH_Nodes::CH_PARKCRC_ParkCfg_Stat_Pr2_AUTO:*/
on sysvar sysvar::CH_Nodes::CH_PARKCRC_ParkCfg_Stat_Pr2_AUTO
{
//	EnableCRC("Park_Stat_AR2",  "ParkCfg_Stat_Pr2", !@this); // 1 = on, 0 = off 
	enableControl("Park_Stat_AR2", "CH_PARKCRC_ParkCfg_Stat_Pr2Park_", @this); //1: enable; 0: disable
	CRC_ParkCfg_Stat_Pr2 = @sysvar::CH_Nodes::CH_PARKCRC_ParkCfg_Stat_Pr2_AUTO;
}
/*@@end*/

/*@@sysvarChange:CH_Nodes::CH_PARKSQC_ParkCfg_Stat_Pr2_AUTO:*/
on sysvar sysvar::CH_Nodes::CH_PARKSQC_ParkCfg_Stat_Pr2_AUTO
{
//	EnableSQC("Park_Stat_AR2",  "ParkCfg_Stat_Pr2", !@this); // 1 = on, 0 = off 
	enableControl("Park_Stat_AR2", "CH_PARKSQC_ParkCfg_Stat_Pr2Park_", @this); //1: enable; 0: disable
	SQC_ParkCfg_Stat_Pr2 = @sysvar::CH_Nodes::CH_PARKSQC_ParkCfg_Stat_Pr2_AUTO;
}
/*@@end*/

/*@@sysvarChange:CH_Nodes::CH_PARKCRC_ParkSensObj_Stat_AUTO:*/
on sysvar sysvar::CH_Nodes::CH_PARKCRC_ParkSensObj_Stat_AUTO
{
//	EnableCRC("ParkSensObj_Stat1_FR2",  "ParkSensObj_Stat1_Pr2", !@this); // 1 = on, 0 = off 
	enableControl("ParkSensObj_Stat1_FR2", "CH_PARKCRC_ParkSensObj_Stat1_Pr_", @this); //1: enable; 0: disable
	CRC_ParkSensObj_Stat1_Pr2 = @sysvar::CH_Nodes::CH_PARKCRC_ParkSensObj_Stat_AUTO;
}
/*@@end*/

/*@@sysvarChange:CH_Nodes::CH_PARKSQC_ParkSensObj_Stat_AUTO:*/
on sysvar sysvar::CH_Nodes::CH_PARKSQC_ParkSensObj_Stat_AUTO
{
//	EnableSQC("ParkSensObj_Stat1_FR2",  "ParkSensObj_Stat1_Pr2", !@this); // 1 = on, 0 = off 
	enableControl("ParkSensObj_Stat1_FR2", "CH_PARKSQC_ParkSensObj_Stat1_Pr_", @this); //1: enable; 0: disable
	SQC_ParkSensObj_Stat1_Pr2 = @sysvar::CH_Nodes::CH_PARKSQC_ParkSensObj_Stat_AUTO;
}
/*@@end*/

/*@@sysvarChange:CH_Nodes::CH_PARKCRC_ParkSensObj_Stat_A_01:*/
on sysvar sysvar::CH_Nodes::CH_PARKCRC_ParkSensObj_Stat_A_01
{
//	EnableCRC("ParkSensObj_Stat2_FR2",  "ParkSensObj_Stat2_Pr2", !@this); // 1 = on, 0 = off 
	enableControl("ParkSensObj_Stat2_FR2", "CH_PARKCRC_ParkSensObj_Stat2_Pr_", @this); //1: enable; 0: disable
	CRC_ParkSensObj_Stat2_Pr2 = @sysvar::CH_Nodes::CH_PARKCRC_ParkSensObj_Stat_A_01;
}
/*@@end*/

/*@@sysvarChange:CH_Nodes::CH_PARKSQC_ParkSensObj_Stat_A_01:*/
on sysvar sysvar::CH_Nodes::CH_PARKSQC_ParkSensObj_Stat_A_01
{
//	EnableSQC("ParkSensObj_Stat2_FR2",  "ParkSensObj_Stat2_Pr2", !@this); // 1 = on, 0 = off 
	enableControl("ParkSensObj_Stat2_FR2", "CH_PARKSQC_ParkSensObj_Stat2_Pr_", @this); //1: enable; 0: disable
	SQC_ParkSensObj_Stat2_Pr2 = @sysvar::CH_Nodes::CH_PARKSQC_ParkSensObj_Stat_A_01;
}
/*@@end*/

/*@@sysvarChange:CH_Nodes::CH_PARKParkSpaceMeas_Sta_UB_A_01:*/
on sysvar sysvar::CH_Nodes::CH_PARKParkSpaceMeas_Sta_UB_A_01
{
	switch (@sysvar::CH_Nodes::CH_PARKParkSpaceMeas_Sta_UB_A_01)
	{
		case (0):
			enableControl("ParkSpaceMeas_Stat_AR", "CH_PARKParkSpaceMeas_Stat_AR__01", 0); //1: enable; 0: disable
			@sysvar::CH_Nodes::CH_PARKParkSpaceMeas_Stat_AR__01 = 1;
			break;
		case (1):
			enableControl("ParkSpaceMeas_Stat_AR", "CH_PARKParkSpaceMeas_Stat_AR__01", 1); //1: enable; 0: disable
			break;
		case (2):
			enableControl("ParkSpaceMeas_Stat_AR", "CH_PARKParkSpaceMeas_Stat_AR__01", 0); //1: enable; 0: disable
			@sysvar::CH_Nodes::CH_PARKParkSpaceMeas_Stat_AR__01 = 1;
			break;
		case (3):
			enableControl("ParkSpaceMeas_Stat_AR", "CH_PARKParkSpaceMeas_Stat_AR__01", 0); //1: enable; 0: disable
			@sysvar::CH_Nodes::CH_PARKParkSpaceMeas_Stat_AR__01 = 0;
			break;
	}
}
/*@@end*/

/*@@sysvarChange:CH_Nodes::CH_PARKParkWarn_AR2_UB_AUTO_01:*/
on sysvar sysvar::CH_Nodes::CH_PARKParkWarn_AR2_UB_AUTO_01
{
	switch (@sysvar::CH_Nodes::CH_PARKParkWarn_AR2_UB_AUTO_01)
	{
		case (0):
			enableControl("ParkWarn_AR2", "CH_PARKParkWarn_AR2_UB__01", 0); //1: enable; 0: disable
			@sysvar::CH_Nodes::CH_PARKParkWarn_AR2_UB__01 = 1;
			break;
		case (1):
			enableControl("ParkWarn_AR2", "CH_PARKParkWarn_AR2_UB__01", 1); //1: enable; 0: disable
			break;
		case (2):
			enableControl("ParkWarn_AR2", "CH_PARKParkWarn_AR2_UB__01", 0); //1: enable; 0: disable
			@sysvar::CH_Nodes::CH_PARKParkWarn_AR2_UB__01 = 1;
			break;
		case (3):
			enableControl("ParkWarn_AR2", "CH_PARKParkWarn_AR2_UB__01", 0); //1: enable; 0: disable
			@sysvar::CH_Nodes::CH_PARKParkWarn_AR2_UB__01 = 0;
			break;
	}
}
/*@@end*/

/*@@sysvarChange:CH_Nodes::CH_PARKRemPark_Rq_AR2_UB_AUTO:*/
on sysvar sysvar::CH_Nodes::CH_PARKRemPark_Rq_AR2_UB_AUTO
{
	switch (@sysvar::CH_Nodes::CH_PARKRemPark_Rq_AR2_UB_AUTO)
	{
		case (0):
			enableControl("RemPark_Rq_AR2", "CH_PARKRemPark_Rq_AR2_UB_", 0); //1: enable; 0: disable
			@sysvar::CH_Nodes::CH_PARKRemPark_Rq_AR2_UB_ = 1;
			break;
		case (1):
			enableControl("RemPark_Rq_AR2", "CH_PARKRemPark_Rq_AR2_UB_", 1); //1: enable; 0: disable
			break;
		case (2):
			enableControl("RemPark_Rq_AR2", "CH_PARKRemPark_Rq_AR2_UB_", 0); //1: enable; 0: disable
			@sysvar::CH_Nodes::CH_PARKRemPark_Rq_AR2_UB_ = 1;
			break;
		case (3):
			enableControl("RemPark_Rq_AR2", "CH_PARKRemPark_Rq_AR2_UB_", 0); //1: enable; 0: disable
			@sysvar::CH_Nodes::CH_PARKRemPark_Rq_AR2_UB_ = 0;
			break;
	}
}
/*@@end*/

/*@@sysvarChange:CH_Nodes::CH_PARKCRC_RemPark_Rq_Pr2Re_AUTO:*/
on sysvar sysvar::CH_Nodes::CH_PARKCRC_RemPark_Rq_Pr2Re_AUTO
{
//	EnableCRC("RemPark_Rq_AR2",  "RemPark_Rq_Pr2", !@this); // 1 = on, 0 = off 
	enableControl("RemPark_Rq_AR2", "CH_PARKCRC_RemPark_Rq_Pr2RemPar_", @this); //1: enable; 0: disable
	CRC_RemPark_Rq_Pr2 = @sysvar::CH_Nodes::CH_PARKCRC_RemPark_Rq_Pr2Re_AUTO;
}
/*@@end*/

/*@@sysvarChange:CH_Nodes::CH_PARKSQC_RemPark_Rq_Pr2Re_AUTO:*/
on sysvar sysvar::CH_Nodes::CH_PARKSQC_RemPark_Rq_Pr2Re_AUTO
{
//	EnableSQC("RemPark_Rq_AR2",  "RemPark_Rq_Pr2", !@this); // 1 = on, 0 = off 
	enableControl("RemPark_Rq_AR2", "CH_PARKSQC_RemPark_Rq_Pr2RemPar_", @this); //1: enable; 0: disable
	SQC_RemPark_Rq_Pr2 = @sysvar::CH_Nodes::CH_PARKSQC_RemPark_Rq_Pr2Re_AUTO;
}
/*@@end*/

/*@@sysvarChange:CH_Nodes::CH_PARKRVC_SVS_Park_Stat_UB_A_01:*/
on sysvar sysvar::CH_Nodes::CH_PARKRVC_SVS_Park_Stat_UB_A_01
{
	switch (@sysvar::CH_Nodes::CH_PARKRVC_SVS_Park_Stat_UB_A_01)
	{
		case (0):
			enableControl("RVC_SVS_Park_Stat_AR2", "CH_PARKRVC_SVS_Park_Stat_AR2__01", 0); //1: enable; 0: disable
			@sysvar::CH_Nodes::CH_PARKRVC_SVS_Park_Stat_AR2__01 = 1;
			break;
		case (1):
			enableControl("RVC_SVS_Park_Stat_AR2", "CH_PARKRVC_SVS_Park_Stat_AR2__01", 1); //1: enable; 0: disable
			break;
		case (2):
			enableControl("RVC_SVS_Park_Stat_AR2", "CH_PARKRVC_SVS_Park_Stat_AR2__01", 0); //1: enable; 0: disable
			@sysvar::CH_Nodes::CH_PARKRVC_SVS_Park_Stat_AR2__01 = 1;
			break;
		case (3):
			enableControl("RVC_SVS_Park_Stat_AR2", "CH_PARKRVC_SVS_Park_Stat_AR2__01", 0); //1: enable; 0: disable
			@sysvar::CH_Nodes::CH_PARKRVC_SVS_Park_Stat_AR2__01 = 0;
			break;
	}
}
/*@@end*/

/*@@sysvarChange:CH_Nodes::CH_PARKCRC_SADR_Trgr_PARK_P_AUTO:*/
on sysvar sysvar::CH_Nodes::CH_PARKCRC_SADR_Trgr_PARK_P_AUTO
{
//	EnableCRC("SADR_Trgr_PARK_AR2",  "SADR_Trgr_PARK_Pr2", !@this); // 1 = on, 0 = off 
	enableControl("SADR_Trgr_PARK_AR2", "CH_PARKCRC_SADR_Trgr_PARK_Pr2SA_", @this); //1: enable; 0: disable
	CRC_SADR_Trgr_PARK_Pr2 = @sysvar::CH_Nodes::CH_PARKCRC_SADR_Trgr_PARK_P_AUTO;
}
/*@@end*/

/*@@sysvarChange:CH_Nodes::CH_PARKSQC_SADR_Trgr_PARK_P_AUTO:*/
on sysvar sysvar::CH_Nodes::CH_PARKSQC_SADR_Trgr_PARK_P_AUTO
{
//	EnableSQC("SADR_Trgr_PARK_AR2",  "SADR_Trgr_PARK_Pr2", !@this); // 1 = on, 0 = off 
	enableControl("SADR_Trgr_PARK_AR2", "CH_PARKSQC_SADR_Trgr_PARK_Pr2SA_", @this); //1: enable; 0: disable
	SQC_SADR_Trgr_PARK_Pr2 = @sysvar::CH_Nodes::CH_PARKSQC_SADR_Trgr_PARK_P_AUTO;
}
/*@@end*/

/*@@sysvarChange:CH_Nodes::CH_PARKSt_Rq_PARK_AR2_UB_AUTO_01:*/
on sysvar sysvar::CH_Nodes::CH_PARKSt_Rq_PARK_AR2_UB_AUTO_01
{
	switch (@sysvar::CH_Nodes::CH_PARKSt_Rq_PARK_AR2_UB_AUTO_01)
	{
		case (0):
			enableControl("St_Rq_PARK_AR2", "CH_PARKSt_Rq_PARK_AR2_UB__01", 0); //1: enable; 0: disable
			@sysvar::CH_Nodes::CH_PARKSt_Rq_PARK_AR2_UB__01 = 1;
			break;
		case (1):
			enableControl("St_Rq_PARK_AR2", "CH_PARKSt_Rq_PARK_AR2_UB__01", 1); //1: enable; 0: disable
			break;
		case (2):
			enableControl("St_Rq_PARK_AR2", "CH_PARKSt_Rq_PARK_AR2_UB__01", 0); //1: enable; 0: disable
			@sysvar::CH_Nodes::CH_PARKSt_Rq_PARK_AR2_UB__01 = 1;
			break;
		case (3):
			enableControl("St_Rq_PARK_AR2", "CH_PARKSt_Rq_PARK_AR2_UB__01", 0); //1: enable; 0: disable
			@sysvar::CH_Nodes::CH_PARKSt_Rq_PARK_AR2_UB__01 = 0;
			break;
	}
}
/*@@end*/

/*@@sysvarChange:CH_Nodes::CH_PARKCRC_St_Rq_PARK_Pr2St_AUTO:*/
on sysvar sysvar::CH_Nodes::CH_PARKCRC_St_Rq_PARK_Pr2St_AUTO
{
//	EnableCRC("St_Rq_PARK_AR2",  "St_Rq_PARK_Pr2", !@this); // 1 = on, 0 = off 
	enableControl("St_Rq_PARK_AR2", "CH_PARKCRC_St_Rq_PARK_Pr2St_Rq__", @this); //1: enable; 0: disable
	CRC_St_Rq_PARK_Pr2 = @sysvar::CH_Nodes::CH_PARKCRC_St_Rq_PARK_Pr2St_AUTO;
}
/*@@end*/

/*@@sysvarChange:CH_Nodes::CH_PARKSQC_St_Rq_PARK_Pr2St_AUTO:*/
on sysvar sysvar::CH_Nodes::CH_PARKSQC_St_Rq_PARK_Pr2St_AUTO
{
//	EnableSQC("St_Rq_PARK_AR2",  "St_Rq_PARK_Pr2", !@this); // 1 = on, 0 = off 
	enableControl("St_Rq_PARK_AR2", "CH_PARKSQC_St_Rq_PARK_Pr2St_Rq__", @this); //1: enable; 0: disable
	SQC_St_Rq_PARK_Pr2 = @sysvar::CH_Nodes::CH_PARKSQC_St_Rq_PARK_Pr2St_AUTO;
}
/*@@end*/

/*@@caplFunc:CH_PARKBrk_Rq_PARK_AR2():*///function
CH_PARKBrk_Rq_PARK_AR2()
{
	switch (@sysvar::CH_Nodes::CH_PARKBrk_Rq_PARK_AR2_UB_AUT_01)
	{
		case (0):
			//Updatebit wird mit 1 gesendet; entspricht Standard
			break;
		case (1):
			//nur wenn manueller Wert gleich 0 ist, muss was gemacht werden
			if (@sysvar::CH_Nodes::CH_PARKBrk_Rq_PARK_AR2_UB_AUT_01 == 0)
				DisturbPDUUB("Brk_Rq_PARK_AR2", 1, 0); //Updatebit wird einmal auf Null gesetzt
			break;
		case (2):
			//Updatebit wird mit 1 gesendet; entspricht Standard
			break;
		case (3):
			DisturbPDUUB("Brk_Rq_PARK_AR2", 1, 0); //Updatebit wird einmal auf Null gesetzt
			break;
	}
}
/*@@end*/

/*@@caplFunc:CH_PARKECU_INFO_RVC_AR():*///function
CH_PARKECU_INFO_RVC_AR()
{
	switch (@sysvar::CH_Nodes::CH_PARKECU_INFO_RVC_AR_UB_AUT_01)
	{
		case (0):
			//Updatebit wird mit 1 gesendet; entspricht Standard
			break;
		case (1):
			//nur wenn manueller Wert gleich 0 ist, muss was gemacht werden
			if (@sysvar::CH_Nodes::CH_PARKECU_INFO_RVC_AR_UB_AUT_01 == 0)
				DisturbPDUUB("ECU_INFO_RVC_AR", 1, 0); //Updatebit wird einmal auf Null gesetzt
			break;
		case (2):
			//Updatebit wird mit 1 gesendet; entspricht Standard
			break;
		case (3):
			DisturbPDUUB("ECU_INFO_RVC_AR", 1, 0); //Updatebit wird einmal auf Null gesetzt
			break;
	}
}
/*@@end*/

/*@@caplFunc:CH_PARKPark_Disp_Rq_AR2():*///function
CH_PARKPark_Disp_Rq_AR2()
{
	switch (@sysvar::CH_Nodes::CH_PARKPark_Disp_Rq_AR2_UB_AU_01)
	{
		case (0):
			//Updatebit wird mit 1 gesendet; entspricht Standard
			break;
		case (1):
			//nur wenn manueller Wert gleich 0 ist, muss was gemacht werden
			if (@sysvar::CH_Nodes::CH_PARKPark_Disp_Rq_AR2_UB_AU_01 == 0)
				DisturbPDUUB("Park_Disp_Rq_AR2", 1, 0); //Updatebit wird einmal auf Null gesetzt
			break;
		case (2):
			//Updatebit wird mit 1 gesendet; entspricht Standard
			break;
		case (3):
			DisturbPDUUB("Park_Disp_Rq_AR2", 1, 0); //Updatebit wird einmal auf Null gesetzt
			break;
	}
}
/*@@end*/

/*@@caplFunc:CH_PARKPark_Stat_AR2():*///function
CH_PARKPark_Stat_AR2()
{
	switch (@sysvar::CH_Nodes::CH_PARKPark_Stat_AR2_UB_AUTO_01)
	{
		case (0):
			//Updatebit wird mit 1 gesendet; entspricht Standard
			break;
		case (1):
			//nur wenn manueller Wert gleich 0 ist, muss was gemacht werden
			if (@sysvar::CH_Nodes::CH_PARKPark_Stat_AR2_UB_AUTO_01 == 0)
				DisturbPDUUB("Park_Stat_AR2", 1, 0); //Updatebit wird einmal auf Null gesetzt
			break;
		case (2):
			//Updatebit wird mit 1 gesendet; entspricht Standard
			break;
		case (3):
			DisturbPDUUB("Park_Stat_AR2", 1, 0); //Updatebit wird einmal auf Null gesetzt
			break;
	}
}
/*@@end*/

/*@@caplFunc:CH_PARKParkSpaceMeas_Stat_AR():*///function
CH_PARKParkSpaceMeas_Stat_AR()
{
	switch (@sysvar::CH_Nodes::CH_PARKParkSpaceMeas_Sta_UB_A_01)
	{
		case (0):
			//Updatebit wird mit 1 gesendet; entspricht Standard
			break;
		case (1):
			//nur wenn manueller Wert gleich 0 ist, muss was gemacht werden
			if (@sysvar::CH_Nodes::CH_PARKParkSpaceMeas_Sta_UB_A_01 == 0)
				DisturbPDUUB("ParkSpaceMeas_Stat_AR", 1, 0); //Updatebit wird einmal auf Null gesetzt
			break;
		case (2):
			//Updatebit wird mit 1 gesendet; entspricht Standard
			break;
		case (3):
			DisturbPDUUB("ParkSpaceMeas_Stat_AR", 1, 0); //Updatebit wird einmal auf Null gesetzt
			break;
	}
}
/*@@end*/

/*@@caplFunc:CH_PARKParkWarn_AR2():*///function
CH_PARKParkWarn_AR2()
{
	switch (@sysvar::CH_Nodes::CH_PARKParkWarn_AR2_UB_AUTO_01)
	{
		case (0):
			//Updatebit wird mit 1 gesendet; entspricht Standard
			break;
		case (1):
			//nur wenn manueller Wert gleich 0 ist, muss was gemacht werden
			if (@sysvar::CH_Nodes::CH_PARKParkWarn_AR2_UB_AUTO_01 == 0)
				DisturbPDUUB("ParkWarn_AR2", 1, 0); //Updatebit wird einmal auf Null gesetzt
			break;
		case (2):
			//Updatebit wird mit 1 gesendet; entspricht Standard
			break;
		case (3):
			DisturbPDUUB("ParkWarn_AR2", 1, 0); //Updatebit wird einmal auf Null gesetzt
			break;
	}
}
/*@@end*/

/*@@caplFunc:CH_PARKRemPark_Rq_AR2():*///function
CH_PARKRemPark_Rq_AR2()
{
	switch (@sysvar::CH_Nodes::CH_PARKRemPark_Rq_AR2_UB_AUTO)
	{
		case (0):
			//Updatebit wird mit 1 gesendet; entspricht Standard
			break;
		case (1):
			//nur wenn manueller Wert gleich 0 ist, muss was gemacht werden
			if (@sysvar::CH_Nodes::CH_PARKRemPark_Rq_AR2_UB_AUTO == 0)
				DisturbPDUUB("RemPark_Rq_AR2", 1, 0); //Updatebit wird einmal auf Null gesetzt
			break;
		case (2):
			//Updatebit wird mit 1 gesendet; entspricht Standard
			break;
		case (3):
			DisturbPDUUB("RemPark_Rq_AR2", 1, 0); //Updatebit wird einmal auf Null gesetzt
			break;
	}
}
/*@@end*/

/*@@caplFunc:CH_PARKRVC_SVS_Park_Stat_AR2():*///function
CH_PARKRVC_SVS_Park_Stat_AR2()
{
	switch (@sysvar::CH_Nodes::CH_PARKRVC_SVS_Park_Stat_UB_A_01)
	{
		case (0):
			//Updatebit wird mit 1 gesendet; entspricht Standard
			break;
		case (1):
			//nur wenn manueller Wert gleich 0 ist, muss was gemacht werden
			if (@sysvar::CH_Nodes::CH_PARKRVC_SVS_Park_Stat_UB_A_01 == 0)
				DisturbPDUUB("RVC_SVS_Park_Stat_AR2", 1, 0); //Updatebit wird einmal auf Null gesetzt
			break;
		case (2):
			//Updatebit wird mit 1 gesendet; entspricht Standard
			break;
		case (3):
			DisturbPDUUB("RVC_SVS_Park_Stat_AR2", 1, 0); //Updatebit wird einmal auf Null gesetzt
			break;
	}
}
/*@@end*/

/*@@caplFunc:CH_PARKSt_Rq_PARK_AR2():*///function
CH_PARKSt_Rq_PARK_AR2()
{
	switch (@sysvar::CH_Nodes::CH_PARKSt_Rq_PARK_AR2_UB_AUTO_01)
	{
		case (0):
			//Updatebit wird mit 1 gesendet; entspricht Standard
			break;
		case (1):
			//nur wenn manueller Wert gleich 0 ist, muss was gemacht werden
			if (@sysvar::CH_Nodes::CH_PARKSt_Rq_PARK_AR2_UB_AUTO_01 == 0)
				DisturbPDUUB("St_Rq_PARK_AR2", 1, 0); //Updatebit wird einmal auf Null gesetzt
			break;
		case (2):
			//Updatebit wird mit 1 gesendet; entspricht Standard
			break;
		case (3):
			DisturbPDUUB("St_Rq_PARK_AR2", 1, 0); //Updatebit wird einmal auf Null gesetzt
			break;
	}
}
/*@@end*/

/*@@caplFunc:FrILTxPending(char[],long,byte[],long):*///callback
void FrILTxPending(char pduName[], long len, byte payload[], long TxAck)
{
	byte crc;
	dword SQC;
	dword MC;
	dword Tgl;
	dword i;

	if (strncmp (pduName, "Brk_Rq_PARK_AR2", strLen(pduName)+strLen("Brk_Rq_PARK_AR2")) == 0)
	{
		if (TxAck == 1)
		{
			if (@sysvar::CH_Nodes::CH_PARKSQC_Brk_Rq_PARK_Pr2B_AUTO == 0)
			{
				//SQC automatisch ändern
				SQC_VAL_Brk_Rq_PARK_Pr2 = (SQC_VAL_Brk_Rq_PARK_Pr2 + 1) % 16;
			}
			else
			{
				//SQC manuel veränderbar
			}

		}
		else
		{
			if (@sysvar::CH_Nodes::CH_PARKSQC_Brk_Rq_PARK_Pr2B_AUTO == 0)
			{
				//SQC automatisch ändern
				//SQC für CRC speichern
				CounterValForCRC_Brk_Rq_PARK_Pr2 = SQC_VAL_Brk_Rq_PARK_Pr2;
				//SQC in Byte schreiben
				payload[1] = (payload[1] & ~0x0F) |  SQC_VAL_Brk_Rq_PARK_Pr2;
			}
			else
			{
				//SQC manuel veränderbar
			}

			if (@sysvar::CH_Nodes::CH_PARKCRC_Brk_Rq_PARK_Pr2B_AUTO == 0)
			{
				//CRC automatisch berechnen
				crc = 0xFF;
				crc = crctableProfTwo[crc ^ payload[1]];
				crc = crctableProfTwo[crc ^ payload[2]];
				crc = crctableProfTwo[crc ^ payload[3]];
				crc = crctableProfTwo[crc ^ payload[4]];
				crc = crctableProfTwo[crc ^ payload[5]];
				crc = crctableProfTwo[crc ^ payload[6]];
				crc = crctableProfTwo[crc ^ payload[7]];
				switch (CounterValForCRC_Brk_Rq_PARK_Pr2)
				{
					case(0) :
						crc = crctableProfTwo[crc ^ 132];
						break;
					case(1) :
						crc = crctableProfTwo[crc ^ 162];
						break;
					case(2) :
						crc = crctableProfTwo[crc ^ 192];
						break;
					case(3) :
						crc = crctableProfTwo[crc ^ 222];
						break;
					case(4) :
						crc = crctableProfTwo[crc ^ 252];
						break;
					case(5) :
						crc = crctableProfTwo[crc ^ 31];
						break;
					case(6) :
						crc = crctableProfTwo[crc ^ 61];
						break;
					case(7) :
						crc = crctableProfTwo[crc ^ 91];
						break;
					case(8) :
						crc = crctableProfTwo[crc ^ 121];
						break;
					case(9) :
						crc = crctableProfTwo[crc ^ 151];
						break;
					case(10) :
						crc = crctableProfTwo[crc ^ 181];
						break;
					case(11) :
						crc = crctableProfTwo[crc ^ 211];
						break;
					case(12) :
						crc = crctableProfTwo[crc ^ 241];
						break;
					case(13) :
						crc = crctableProfTwo[crc ^ 20];
						break;
					case(14) :
						crc = crctableProfTwo[crc ^ 50];
						break;
					case(15) :
						crc = crctableProfTwo[crc ^ 80];
						break;
					default :
//						write("error: wrong parameter (%d)",CounterValForCRC_Brk_Rq_PARK_Pr2); stop();
						break;
				}
				crc = (crc ^ 0xFF);
				payload[0] = crc;
			}
			else
			{
				//CRC manuel veränderbar
			}

			CH_PARKSt_Rq_PARK_AR2();
			CH_PARKBrk_Rq_PARK_AR2();
		}
	}
	if (strncmp (pduName, "ECU_INFO_RVC_AR", strLen(pduName)+strLen("ECU_INFO_RVC_AR")) == 0)
	{
		if (TxAck == 1)
		{
		}
		else
		{
			CH_PARKECU_INFO_RVC_AR();
			CH_PARKRVC_SVS_Park_Stat_AR2();
		}
	}
	if (strncmp (pduName, "Park_Disp_Rq_AR2", strLen(pduName)+strLen("Park_Disp_Rq_AR2")) == 0)
	{
		if (TxAck == 1)
		{
			if (@sysvar::CH_Nodes::CH_PARKSQC_Park_Disp_Rq_Pr2_AUTO == 0)
			{
				//SQC automatisch ändern
				SQC_VAL_Park_Disp_Rq_Pr2 = (SQC_VAL_Park_Disp_Rq_Pr2 + 1) % 16;
			}
			else
			{
				//SQC manuel veränderbar
			}

		}
		else
		{
			if (@sysvar::CH_Nodes::CH_PARKSQC_Park_Disp_Rq_Pr2_AUTO == 0)
			{
				//SQC automatisch ändern
				//SQC für CRC speichern
				CounterValForCRC_Park_Disp_Rq_Pr2 = SQC_VAL_Park_Disp_Rq_Pr2;
				//SQC in Byte schreiben
				payload[1] = (payload[1] & ~0x0F) |  SQC_VAL_Park_Disp_Rq_Pr2;
			}
			else
			{
				//SQC manuel veränderbar
			}

			if (@sysvar::CH_Nodes::CH_PARKCRC_Park_Disp_Rq_Pr2_AUTO == 0)
			{
				//CRC automatisch berechnen
				crc = 0xFF;
				crc = crctableProfTwo[crc ^ payload[1]];
				crc = crctableProfTwo[crc ^ payload[2]];
				crc = crctableProfTwo[crc ^ payload[3]];
				crc = crctableProfTwo[crc ^ payload[4]];
				crc = crctableProfTwo[crc ^ payload[5]];
				crc = crctableProfTwo[crc ^ payload[6]];
				crc = crctableProfTwo[crc ^ payload[7]];
				switch (CounterValForCRC_Park_Disp_Rq_Pr2)
				{
					case(0) :
						crc = crctableProfTwo[crc ^ 216];
						break;
					case(1) :
						crc = crctableProfTwo[crc ^ 19];
						break;
					case(2) :
						crc = crctableProfTwo[crc ^ 73];
						break;
					case(3) :
						crc = crctableProfTwo[crc ^ 127];
						break;
					case(4) :
						crc = crctableProfTwo[crc ^ 181];
						break;
					case(5) :
						crc = crctableProfTwo[crc ^ 235];
						break;
					case(6) :
						crc = crctableProfTwo[crc ^ 38];
						break;
					case(7) :
						crc = crctableProfTwo[crc ^ 92];
						break;
					case(8) :
						crc = crctableProfTwo[crc ^ 146];
						break;
					case(9) :
						crc = crctableProfTwo[crc ^ 200];
						break;
					case(10) :
						crc = crctableProfTwo[crc ^ 3];
						break;
					case(11) :
						crc = crctableProfTwo[crc ^ 57];
						break;
					case(12) :
						crc = crctableProfTwo[crc ^ 111];
						break;
					case(13) :
						crc = crctableProfTwo[crc ^ 165];
						break;
					case(14) :
						crc = crctableProfTwo[crc ^ 219];
						break;
					case(15) :
						crc = crctableProfTwo[crc ^ 22];
						break;
					default :
//						write("error: wrong parameter (%d)",CounterValForCRC_Park_Disp_Rq_Pr2); stop();
						break;
				}
				crc = (crc ^ 0xFF);
				payload[0] = crc;
			}
			else
			{
				//CRC manuel veränderbar
			}

			CH_PARKPark_Stat_AR2();
			CH_PARKPark_Disp_Rq_AR2();
			CH_PARKRemPark_Rq_AR2();
			CH_PARKParkWarn_AR2();
			CH_PARKParkSpaceMeas_Stat_AR();
		}
	}
	if (strncmp (pduName, "Park_Set_Stat_AR2", strLen(pduName)+strLen("Park_Set_Stat_AR2")) == 0)
	{
		if (TxAck == 1)
		{
		}
		else
		{
		}
	}
	if (strncmp (pduName, "Park_Stat_AR2", strLen(pduName)+strLen("Park_Stat_AR2")) == 0)
	{
		if (TxAck == 1)
		{
			if (@sysvar::CH_Nodes::CH_PARKSQC_ParkCfg_Stat_Pr2_AUTO == 0)
			{
				//SQC automatisch ändern
				SQC_VAL_ParkCfg_Stat_Pr2 = (SQC_VAL_ParkCfg_Stat_Pr2 + 1) % 16;
			}
			else
			{
				//SQC manuel veränderbar
			}

		}
		else
		{
			if (@sysvar::CH_Nodes::CH_PARKSQC_ParkCfg_Stat_Pr2_AUTO == 0)
			{
				//SQC automatisch ändern
				//SQC für CRC speichern
				CounterValForCRC_ParkCfg_Stat_Pr2 = SQC_VAL_ParkCfg_Stat_Pr2;
				//SQC in Byte schreiben
				payload[1] = (payload[1] & ~0x0F) |  SQC_VAL_ParkCfg_Stat_Pr2;
			}
			else
			{
				//SQC manuel veränderbar
			}

			if (@sysvar::CH_Nodes::CH_PARKCRC_ParkCfg_Stat_Pr2_AUTO == 0)
			{
				//CRC automatisch berechnen
				crc = 0xFF;
				crc = crctableProfTwo[crc ^ payload[1]];
				crc = crctableProfTwo[crc ^ payload[2]];
				crc = crctableProfTwo[crc ^ payload[3]];
				switch (CounterValForCRC_ParkCfg_Stat_Pr2)
				{
					case(0) :
						crc = crctableProfTwo[crc ^ 39];
						break;
					case(1) :
						crc = crctableProfTwo[crc ^ 136];
						break;
					case(2) :
						crc = crctableProfTwo[crc ^ 233];
						break;
					case(3) :
						crc = crctableProfTwo[crc ^ 79];
						break;
					case(4) :
						crc = crctableProfTwo[crc ^ 176];
						break;
					case(5) :
						crc = crctableProfTwo[crc ^ 22];
						break;
					case(6) :
						crc = crctableProfTwo[crc ^ 119];
						break;
					case(7) :
						crc = crctableProfTwo[crc ^ 216];
						break;
					case(8) :
						crc = crctableProfTwo[crc ^ 62];
						break;
					case(9) :
						crc = crctableProfTwo[crc ^ 159];
						break;
					case(10) :
						crc = crctableProfTwo[crc ^ 5];
						break;
					case(11) :
						crc = crctableProfTwo[crc ^ 102];
						break;
					case(12) :
						crc = crctableProfTwo[crc ^ 199];
						break;
					case(13) :
						crc = crctableProfTwo[crc ^ 45];
						break;
					case(14) :
						crc = crctableProfTwo[crc ^ 142];
						break;
					case(15) :
						crc = crctableProfTwo[crc ^ 239];
						break;
					default :
//						write("error: wrong parameter (%d)",CounterValForCRC_ParkCfg_Stat_Pr2); stop();
						break;
				}
				crc = (crc ^ 0xFF);
				payload[0] = crc;
			}
			else
			{
				//CRC manuel veränderbar
			}

			CH_PARKPark_Stat_AR2();
			CH_PARKPark_Disp_Rq_AR2();
			CH_PARKRemPark_Rq_AR2();
			CH_PARKParkWarn_AR2();
			CH_PARKParkSpaceMeas_Stat_AR();
		}
	}
	if (strncmp (pduName, "ParkSensObj_Stat1_FR2", strLen(pduName)+strLen("ParkSensObj_Stat1_FR2")) == 0)
	{
		if (TxAck == 1)
		{
			if (@sysvar::CH_Nodes::CH_PARKSQC_ParkSensObj_Stat_AUTO == 0)
			{
				//SQC automatisch ändern
				SQC_VAL_ParkSensObj_Stat1_Pr2 = (SQC_VAL_ParkSensObj_Stat1_Pr2 + 1) % 16;
			}
			else
			{
				//SQC manuel veränderbar
			}

		}
		else
		{
			if (@sysvar::CH_Nodes::CH_PARKSQC_ParkSensObj_Stat_AUTO == 0)
			{
				//SQC automatisch ändern
				//SQC für CRC speichern
				CounterValForCRC_ParkSensObj_Stat1_Pr2 = SQC_VAL_ParkSensObj_Stat1_Pr2;
				//SQC in Byte schreiben
				payload[1] = (payload[1] & ~0x0F) |  SQC_VAL_ParkSensObj_Stat1_Pr2;
			}
			else
			{
				//SQC manuel veränderbar
			}

			if (@sysvar::CH_Nodes::CH_PARKCRC_ParkSensObj_Stat_AUTO == 0)
			{
				//CRC automatisch berechnen
				crc = 0xFF;
				crc = crctableProfTwo[crc ^ payload[1]];
				crc = crctableProfTwo[crc ^ payload[2]];
				crc = crctableProfTwo[crc ^ payload[3]];
				crc = crctableProfTwo[crc ^ payload[4]];
				crc = crctableProfTwo[crc ^ payload[5]];
				crc = crctableProfTwo[crc ^ payload[6]];
				crc = crctableProfTwo[crc ^ payload[7]];
				crc = crctableProfTwo[crc ^ payload[8]];
				crc = crctableProfTwo[crc ^ payload[9]];
				crc = crctableProfTwo[crc ^ payload[10]];
				crc = crctableProfTwo[crc ^ payload[11]];
				crc = crctableProfTwo[crc ^ payload[12]];
				crc = crctableProfTwo[crc ^ payload[13]];
				crc = crctableProfTwo[crc ^ payload[14]];
				crc = crctableProfTwo[crc ^ payload[15]];
				crc = crctableProfTwo[crc ^ payload[16]];
				crc = crctableProfTwo[crc ^ payload[17]];
				switch (CounterValForCRC_ParkSensObj_Stat1_Pr2)
				{
					case(0) :
						crc = crctableProfTwo[crc ^ 93];
						break;
					case(1) :
						crc = crctableProfTwo[crc ^ 137];
						break;
					case(2) :
						crc = crctableProfTwo[crc ^ 181];
						break;
					case(3) :
						crc = crctableProfTwo[crc ^ 225];
						break;
					case(4) :
						crc = crctableProfTwo[crc ^ 18];
						break;
					case(5) :
						crc = crctableProfTwo[crc ^ 62];
						break;
					case(6) :
						crc = crctableProfTwo[crc ^ 106];
						break;
					case(7) :
						crc = crctableProfTwo[crc ^ 150];
						break;
					case(8) :
						crc = crctableProfTwo[crc ^ 194];
						break;
					case(9) :
						crc = crctableProfTwo[crc ^ 238];
						break;
					case(10) :
						crc = crctableProfTwo[crc ^ 31];
						break;
					case(11) :
						crc = crctableProfTwo[crc ^ 75];
						break;
					case(12) :
						crc = crctableProfTwo[crc ^ 119];
						break;
					case(13) :
						crc = crctableProfTwo[crc ^ 163];
						break;
					case(14) :
						crc = crctableProfTwo[crc ^ 207];
						break;
					case(15) :
						crc = crctableProfTwo[crc ^ 251];
						break;
					default :
//						write("error: wrong parameter (%d)",CounterValForCRC_ParkSensObj_Stat1_Pr2); stop();
						break;
				}
				crc = (crc ^ 0xFF);
				payload[0] = crc;
			}
			else
			{
				//CRC manuel veränderbar
			}

		}
	}
	if (strncmp (pduName, "ParkSensObj_Stat2_FR2", strLen(pduName)+strLen("ParkSensObj_Stat2_FR2")) == 0)
	{
		if (TxAck == 1)
		{
			if (@sysvar::CH_Nodes::CH_PARKSQC_ParkSensObj_Stat_A_01 == 0)
			{
				//SQC automatisch ändern
				SQC_VAL_ParkSensObj_Stat2_Pr2 = (SQC_VAL_ParkSensObj_Stat2_Pr2 + 1) % 16;
			}
			else
			{
				//SQC manuel veränderbar
			}

		}
		else
		{
			if (@sysvar::CH_Nodes::CH_PARKSQC_ParkSensObj_Stat_A_01 == 0)
			{
				//SQC automatisch ändern
				//SQC für CRC speichern
				CounterValForCRC_ParkSensObj_Stat2_Pr2 = SQC_VAL_ParkSensObj_Stat2_Pr2;
				//SQC in Byte schreiben
				payload[1] = (payload[1] & ~0x0F) |  SQC_VAL_ParkSensObj_Stat2_Pr2;
			}
			else
			{
				//SQC manuel veränderbar
			}

			if (@sysvar::CH_Nodes::CH_PARKCRC_ParkSensObj_Stat_A_01 == 0)
			{
				//CRC automatisch berechnen
				crc = 0xFF;
				crc = crctableProfTwo[crc ^ payload[1]];
				crc = crctableProfTwo[crc ^ payload[2]];
				crc = crctableProfTwo[crc ^ payload[3]];
				crc = crctableProfTwo[crc ^ payload[4]];
				crc = crctableProfTwo[crc ^ payload[5]];
				crc = crctableProfTwo[crc ^ payload[6]];
				crc = crctableProfTwo[crc ^ payload[7]];
				crc = crctableProfTwo[crc ^ payload[8]];
				crc = crctableProfTwo[crc ^ payload[9]];
				crc = crctableProfTwo[crc ^ payload[10]];
				crc = crctableProfTwo[crc ^ payload[11]];
				crc = crctableProfTwo[crc ^ payload[12]];
				crc = crctableProfTwo[crc ^ payload[13]];
				crc = crctableProfTwo[crc ^ payload[14]];
				crc = crctableProfTwo[crc ^ payload[15]];
				crc = crctableProfTwo[crc ^ payload[16]];
				crc = crctableProfTwo[crc ^ payload[17]];
				switch (CounterValForCRC_ParkSensObj_Stat2_Pr2)
				{
					case(0) :
						crc = crctableProfTwo[crc ^ 198];
						break;
					case(1) :
						crc = crctableProfTwo[crc ^ 226];
						break;
					case(2) :
						crc = crctableProfTwo[crc ^ 3];
						break;
					case(3) :
						crc = crctableProfTwo[crc ^ 31];
						break;
					case(4) :
						crc = crctableProfTwo[crc ^ 59];
						break;
					case(5) :
						crc = crctableProfTwo[crc ^ 87];
						break;
					case(6) :
						crc = crctableProfTwo[crc ^ 115];
						break;
					case(7) :
						crc = crctableProfTwo[crc ^ 143];
						break;
					case(8) :
						crc = crctableProfTwo[crc ^ 171];
						break;
					case(9) :
						crc = crctableProfTwo[crc ^ 199];
						break;
					case(10) :
						crc = crctableProfTwo[crc ^ 227];
						break;
					case(11) :
						crc = crctableProfTwo[crc ^ 4];
						break;
					case(12) :
						crc = crctableProfTwo[crc ^ 32];
						break;
					case(13) :
						crc = crctableProfTwo[crc ^ 60];
						break;
					case(14) :
						crc = crctableProfTwo[crc ^ 88];
						break;
					case(15) :
						crc = crctableProfTwo[crc ^ 116];
						break;
					default :
//						write("error: wrong parameter (%d)",CounterValForCRC_ParkSensObj_Stat2_Pr2); stop();
						break;
				}
				crc = (crc ^ 0xFF);
				payload[0] = crc;
			}
			else
			{
				//CRC manuel veränderbar
			}

		}
	}
	if (strncmp (pduName, "ParkSpaceMeas_Stat_AR", strLen(pduName)+strLen("ParkSpaceMeas_Stat_AR")) == 0)
	{
		if (TxAck == 1)
		{
		}
		else
		{
			CH_PARKPark_Stat_AR2();
			CH_PARKPark_Disp_Rq_AR2();
			CH_PARKRemPark_Rq_AR2();
			CH_PARKParkWarn_AR2();
			CH_PARKParkSpaceMeas_Stat_AR();
		}
	}
	if (strncmp (pduName, "ParkWarn_AR2", strLen(pduName)+strLen("ParkWarn_AR2")) == 0)
	{
		if (TxAck == 1)
		{
		}
		else
		{
			CH_PARKPark_Stat_AR2();
			CH_PARKPark_Disp_Rq_AR2();
			CH_PARKRemPark_Rq_AR2();
			CH_PARKParkWarn_AR2();
			CH_PARKParkSpaceMeas_Stat_AR();
		}
	}
	if (strncmp (pduName, "RemPark_Rq_AR2", strLen(pduName)+strLen("RemPark_Rq_AR2")) == 0)
	{
		if (TxAck == 1)
		{
			if (@sysvar::CH_Nodes::CH_PARKSQC_RemPark_Rq_Pr2Re_AUTO == 0)
			{
				//SQC automatisch ändern
				SQC_VAL_RemPark_Rq_Pr2 = (SQC_VAL_RemPark_Rq_Pr2 + 1) % 16;
			}
			else
			{
				//SQC manuel veränderbar
			}

		}
		else
		{
			if (@sysvar::CH_Nodes::CH_PARKSQC_RemPark_Rq_Pr2Re_AUTO == 0)
			{
				//SQC automatisch ändern
				//SQC für CRC speichern
				CounterValForCRC_RemPark_Rq_Pr2 = SQC_VAL_RemPark_Rq_Pr2;
				//SQC in Byte schreiben
				payload[1] = (payload[1] & ~0x0F) |  SQC_VAL_RemPark_Rq_Pr2;
			}
			else
			{
				//SQC manuel veränderbar
			}

			if (@sysvar::CH_Nodes::CH_PARKCRC_RemPark_Rq_Pr2Re_AUTO == 0)
			{
				//CRC automatisch berechnen
				crc = 0xFF;
				crc = crctableProfTwo[crc ^ payload[1]];
				crc = crctableProfTwo[crc ^ payload[2]];
				crc = crctableProfTwo[crc ^ payload[3]];
				switch (CounterValForCRC_RemPark_Rq_Pr2)
				{
					case(0) :
						crc = crctableProfTwo[crc ^ 211];
						break;
					case(1) :
						crc = crctableProfTwo[crc ^ 103];
						break;
					case(2) :
						crc = crctableProfTwo[crc ^ 246];
						break;
					case(3) :
						crc = crctableProfTwo[crc ^ 138];
						break;
					case(4) :
						crc = crctableProfTwo[crc ^ 30];
						break;
					case(5) :
						crc = crctableProfTwo[crc ^ 173];
						break;
					case(6) :
						crc = crctableProfTwo[crc ^ 65];
						break;
					case(7) :
						crc = crctableProfTwo[crc ^ 208];
						break;
					case(8) :
						crc = crctableProfTwo[crc ^ 100];
						break;
					case(9) :
						crc = crctableProfTwo[crc ^ 243];
						break;
					case(10) :
						crc = crctableProfTwo[crc ^ 135];
						break;
					case(11) :
						crc = crctableProfTwo[crc ^ 27];
						break;
					case(12) :
						crc = crctableProfTwo[crc ^ 170];
						break;
					case(13) :
						crc = crctableProfTwo[crc ^ 62];
						break;
					case(14) :
						crc = crctableProfTwo[crc ^ 205];
						break;
					case(15) :
						crc = crctableProfTwo[crc ^ 97];
						break;
					default :
//						write("error: wrong parameter (%d)",CounterValForCRC_RemPark_Rq_Pr2); stop();
						break;
				}
				crc = (crc ^ 0xFF);
				payload[0] = crc;
			}
			else
			{
				//CRC manuel veränderbar
			}

			CH_PARKPark_Stat_AR2();
			CH_PARKPark_Disp_Rq_AR2();
			CH_PARKRemPark_Rq_AR2();
			CH_PARKParkWarn_AR2();
			CH_PARKParkSpaceMeas_Stat_AR();
		}
	}
	if (strncmp (pduName, "ROE_PARK", strLen(pduName)+strLen("ROE_PARK")) == 0)
	{
		if (TxAck == 1)
		{
		}
		else
		{
		}
	}
	if (strncmp (pduName, "RVC_SVS_Park_Stat_AR2", strLen(pduName)+strLen("RVC_SVS_Park_Stat_AR2")) == 0)
	{
		if (TxAck == 1)
		{
		}
		else
		{
			CH_PARKECU_INFO_RVC_AR();
			CH_PARKRVC_SVS_Park_Stat_AR2();
		}
	}
	if (strncmp (pduName, "SADR_Trgr_PARK_AR2", strLen(pduName)+strLen("SADR_Trgr_PARK_AR2")) == 0)
	{
		if (TxAck == 1)
		{
			if (@sysvar::CH_Nodes::CH_PARKSQC_SADR_Trgr_PARK_P_AUTO == 0)
			{
				//SQC automatisch ändern
				SQC_VAL_SADR_Trgr_PARK_Pr2 = (SQC_VAL_SADR_Trgr_PARK_Pr2 + 1) % 16;
			}
			else
			{
				//SQC manuel veränderbar
			}

		}
		else
		{
			if (@sysvar::CH_Nodes::CH_PARKSQC_SADR_Trgr_PARK_P_AUTO == 0)
			{
				//SQC automatisch ändern
				//SQC für CRC speichern
				CounterValForCRC_SADR_Trgr_PARK_Pr2 = SQC_VAL_SADR_Trgr_PARK_Pr2;
				//SQC in Byte schreiben
				payload[1] = (payload[1] & ~0x0F) |  SQC_VAL_SADR_Trgr_PARK_Pr2;
			}
			else
			{
				//SQC manuel veränderbar
			}

			if (@sysvar::CH_Nodes::CH_PARKCRC_SADR_Trgr_PARK_P_AUTO == 0)
			{
				//CRC automatisch berechnen
				crc = 0xFF;
				crc = crctableProfTwo[crc ^ payload[1]];
				crc = crctableProfTwo[crc ^ payload[2]];
				crc = crctableProfTwo[crc ^ payload[3]];
				switch (CounterValForCRC_SADR_Trgr_PARK_Pr2)
				{
					case(0) :
						crc = crctableProfTwo[crc ^ 141];
						break;
					case(1) :
						crc = crctableProfTwo[crc ^ 83];
						break;
					case(2) :
						crc = crctableProfTwo[crc ^ 25];
						break;
					case(3) :
						crc = crctableProfTwo[crc ^ 218];
						break;
					case(4) :
						crc = crctableProfTwo[crc ^ 160];
						break;
					case(5) :
						crc = crctableProfTwo[crc ^ 102];
						break;
					case(6) :
						crc = crctableProfTwo[crc ^ 44];
						break;
					case(7) :
						crc = crctableProfTwo[crc ^ 237];
						break;
					case(8) :
						crc = crctableProfTwo[crc ^ 179];
						break;
					case(9) :
						crc = crctableProfTwo[crc ^ 121];
						break;
					case(10) :
						crc = crctableProfTwo[crc ^ 63];
						break;
					case(11) :
						crc = crctableProfTwo[crc ^ 5];
						break;
					case(12) :
						crc = crctableProfTwo[crc ^ 198];
						break;
					case(13) :
						crc = crctableProfTwo[crc ^ 140];
						break;
					case(14) :
						crc = crctableProfTwo[crc ^ 82];
						break;
					case(15) :
						crc = crctableProfTwo[crc ^ 24];
						break;
					default :
//						write("error: wrong parameter (%d)",CounterValForCRC_SADR_Trgr_PARK_Pr2); stop();
						break;
				}
				crc = (crc ^ 0xFF);
				payload[0] = crc;
			}
			else
			{
				//CRC manuel veränderbar
			}

		}
	}
	if (strncmp (pduName, "St_Rq_PARK_AR2", strLen(pduName)+strLen("St_Rq_PARK_AR2")) == 0)
	{
		if (TxAck == 1)
		{
			if (@sysvar::CH_Nodes::CH_PARKSQC_St_Rq_PARK_Pr2St_AUTO == 0)
			{
				//SQC automatisch ändern
				SQC_VAL_St_Rq_PARK_Pr2 = (SQC_VAL_St_Rq_PARK_Pr2 + 1) % 16;
			}
			else
			{
				//SQC manuel veränderbar
			}

		}
		else
		{
			if (@sysvar::CH_Nodes::CH_PARKSQC_St_Rq_PARK_Pr2St_AUTO == 0)
			{
				//SQC automatisch ändern
				//SQC für CRC speichern
				CounterValForCRC_St_Rq_PARK_Pr2 = SQC_VAL_St_Rq_PARK_Pr2;
				//SQC in Byte schreiben
				payload[1] = (payload[1] & ~0x0F) |  SQC_VAL_St_Rq_PARK_Pr2;
			}
			else
			{
				//SQC manuel veränderbar
			}

			if (@sysvar::CH_Nodes::CH_PARKCRC_St_Rq_PARK_Pr2St_AUTO == 0)
			{
				//CRC automatisch berechnen
				crc = 0xFF;
				crc = crctableProfTwo[crc ^ payload[1]];
				crc = crctableProfTwo[crc ^ payload[2]];
				crc = crctableProfTwo[crc ^ payload[3]];
				crc = crctableProfTwo[crc ^ payload[4]];
				crc = crctableProfTwo[crc ^ payload[5]];
				crc = crctableProfTwo[crc ^ payload[6]];
				crc = crctableProfTwo[crc ^ payload[7]];
				switch (CounterValForCRC_St_Rq_PARK_Pr2)
				{
					case(0) :
						crc = crctableProfTwo[crc ^ 60];
						break;
					case(1) :
						crc = crctableProfTwo[crc ^ 91];
						break;
					case(2) :
						crc = crctableProfTwo[crc ^ 122];
						break;
					case(3) :
						crc = crctableProfTwo[crc ^ 153];
						break;
					case(4) :
						crc = crctableProfTwo[crc ^ 184];
						break;
					case(5) :
						crc = crctableProfTwo[crc ^ 215];
						break;
					case(6) :
						crc = crctableProfTwo[crc ^ 246];
						break;
					case(7) :
						crc = crctableProfTwo[crc ^ 26];
						break;
					case(8) :
						crc = crctableProfTwo[crc ^ 57];
						break;
					case(9) :
						crc = crctableProfTwo[crc ^ 88];
						break;
					case(10) :
						crc = crctableProfTwo[crc ^ 119];
						break;
					case(11) :
						crc = crctableProfTwo[crc ^ 150];
						break;
					case(12) :
						crc = crctableProfTwo[crc ^ 181];
						break;
					case(13) :
						crc = crctableProfTwo[crc ^ 212];
						break;
					case(14) :
						crc = crctableProfTwo[crc ^ 243];
						break;
					case(15) :
						crc = crctableProfTwo[crc ^ 23];
						break;
					default :
//						write("error: wrong parameter (%d)",CounterValForCRC_St_Rq_PARK_Pr2); stop();
						break;
				}
				crc = (crc ^ 0xFF);
				payload[0] = crc;
			}
			else
			{
				//CRC manuel veränderbar
			}

			CH_PARKSt_Rq_PARK_AR2();
			CH_PARKBrk_Rq_PARK_AR2();
		}
	}
}
/*@@end*/

/*@@caplFunc:StartSim(int):*/
StartSim(int BusAktiv)
{
	result = EnableCRC("", 0); // 1 = on, 0 = off
	result = EnableTGL("", 0); // 1 = on, 0 = off 
	result = EnableSQC("", 0); // 1 = on, 0 = off 
	result = EnableMC("", 0); // 1 = on, 0 = off 
	switch (@sysvar::CH_Nodes::CH_PARKBrk_Rq_PARK_AR2_UB_AUT_01)
	{
		case (0):
			enableControl("Brk_Rq_PARK_AR2", "CH_PARKBrk_Rq_PARK_AR2_UB__01", 0); //1: enable; 0: disable
			@sysvar::CH_Nodes::CH_PARKBrk_Rq_PARK_AR2_UB__01 = 1;
			break;
		case (1):
			enableControl("Brk_Rq_PARK_AR2", "CH_PARKBrk_Rq_PARK_AR2_UB__01", 1); //1: enable; 0: disable
			break;
		case (2):
			enableControl("Brk_Rq_PARK_AR2", "CH_PARKBrk_Rq_PARK_AR2_UB__01", 0); //1: enable; 0: disable
			@sysvar::CH_Nodes::CH_PARKBrk_Rq_PARK_AR2_UB__01 = 1;
			break;
		case (3):
			enableControl("Brk_Rq_PARK_AR2", "CH_PARKBrk_Rq_PARK_AR2_UB__01", 0); //1: enable; 0: disable
			@sysvar::CH_Nodes::CH_PARKBrk_Rq_PARK_AR2_UB__01 = 0;
			break;
	}

	CRC_Brk_Rq_PARK_Pr2 = 0;
	SQC_VAL_Brk_Rq_PARK_Pr2 = 0;
	SQC_Brk_Rq_PARK_Pr2 = 0;
	switch (@sysvar::CH_Nodes::CH_PARKECU_INFO_RVC_AR_UB_AUT_01)
	{
		case (0):
			enableControl("ECU_INFO_RVC_AR", "CH_PARKECU_INFO_RVC_AR_UB__01", 0); //1: enable; 0: disable
			@sysvar::CH_Nodes::CH_PARKECU_INFO_RVC_AR_UB__01 = 1;
			break;
		case (1):
			enableControl("ECU_INFO_RVC_AR", "CH_PARKECU_INFO_RVC_AR_UB__01", 1); //1: enable; 0: disable
			break;
		case (2):
			enableControl("ECU_INFO_RVC_AR", "CH_PARKECU_INFO_RVC_AR_UB__01", 0); //1: enable; 0: disable
			@sysvar::CH_Nodes::CH_PARKECU_INFO_RVC_AR_UB__01 = 1;
			break;
		case (3):
			enableControl("ECU_INFO_RVC_AR", "CH_PARKECU_INFO_RVC_AR_UB__01", 0); //1: enable; 0: disable
			@sysvar::CH_Nodes::CH_PARKECU_INFO_RVC_AR_UB__01 = 0;
			break;
	}

	switch (@sysvar::CH_Nodes::CH_PARKPark_Disp_Rq_AR2_UB_AU_01)
	{
		case (0):
			enableControl("Park_Disp_Rq_AR2", "CH_PARKPark_Disp_Rq_AR2_UB__01", 0); //1: enable; 0: disable
			@sysvar::CH_Nodes::CH_PARKPark_Disp_Rq_AR2_UB__01 = 1;
			break;
		case (1):
			enableControl("Park_Disp_Rq_AR2", "CH_PARKPark_Disp_Rq_AR2_UB__01", 1); //1: enable; 0: disable
			break;
		case (2):
			enableControl("Park_Disp_Rq_AR2", "CH_PARKPark_Disp_Rq_AR2_UB__01", 0); //1: enable; 0: disable
			@sysvar::CH_Nodes::CH_PARKPark_Disp_Rq_AR2_UB__01 = 1;
			break;
		case (3):
			enableControl("Park_Disp_Rq_AR2", "CH_PARKPark_Disp_Rq_AR2_UB__01", 0); //1: enable; 0: disable
			@sysvar::CH_Nodes::CH_PARKPark_Disp_Rq_AR2_UB__01 = 0;
			break;
	}

	CRC_Park_Disp_Rq_Pr2 = 0;
	SQC_VAL_Park_Disp_Rq_Pr2 = 0;
	SQC_Park_Disp_Rq_Pr2 = 0;
	switch (@sysvar::CH_Nodes::CH_PARKPark_Stat_AR2_UB_AUTO_01)
	{
		case (0):
			enableControl("Park_Stat_AR2", "CH_PARKPark_Stat_AR2_UB__01", 0); //1: enable; 0: disable
			@sysvar::CH_Nodes::CH_PARKPark_Stat_AR2_UB__01 = 1;
			break;
		case (1):
			enableControl("Park_Stat_AR2", "CH_PARKPark_Stat_AR2_UB__01", 1); //1: enable; 0: disable
			break;
		case (2):
			enableControl("Park_Stat_AR2", "CH_PARKPark_Stat_AR2_UB__01", 0); //1: enable; 0: disable
			@sysvar::CH_Nodes::CH_PARKPark_Stat_AR2_UB__01 = 1;
			break;
		case (3):
			enableControl("Park_Stat_AR2", "CH_PARKPark_Stat_AR2_UB__01", 0); //1: enable; 0: disable
			@sysvar::CH_Nodes::CH_PARKPark_Stat_AR2_UB__01 = 0;
			break;
	}

	CRC_ParkCfg_Stat_Pr2 = 0;
	SQC_VAL_ParkCfg_Stat_Pr2 = 0;
	SQC_ParkCfg_Stat_Pr2 = 0;
	CRC_ParkSensObj_Stat1_Pr2 = 0;
	SQC_VAL_ParkSensObj_Stat1_Pr2 = 0;
	SQC_ParkSensObj_Stat1_Pr2 = 0;
	CRC_ParkSensObj_Stat2_Pr2 = 0;
	SQC_VAL_ParkSensObj_Stat2_Pr2 = 0;
	SQC_ParkSensObj_Stat2_Pr2 = 0;
	switch (@sysvar::CH_Nodes::CH_PARKParkSpaceMeas_Sta_UB_A_01)
	{
		case (0):
			enableControl("ParkSpaceMeas_Stat_AR", "CH_PARKParkSpaceMeas_Stat_AR__01", 0); //1: enable; 0: disable
			@sysvar::CH_Nodes::CH_PARKParkSpaceMeas_Stat_AR__01 = 1;
			break;
		case (1):
			enableControl("ParkSpaceMeas_Stat_AR", "CH_PARKParkSpaceMeas_Stat_AR__01", 1); //1: enable; 0: disable
			break;
		case (2):
			enableControl("ParkSpaceMeas_Stat_AR", "CH_PARKParkSpaceMeas_Stat_AR__01", 0); //1: enable; 0: disable
			@sysvar::CH_Nodes::CH_PARKParkSpaceMeas_Stat_AR__01 = 1;
			break;
		case (3):
			enableControl("ParkSpaceMeas_Stat_AR", "CH_PARKParkSpaceMeas_Stat_AR__01", 0); //1: enable; 0: disable
			@sysvar::CH_Nodes::CH_PARKParkSpaceMeas_Stat_AR__01 = 0;
			break;
	}

	switch (@sysvar::CH_Nodes::CH_PARKParkWarn_AR2_UB_AUTO_01)
	{
		case (0):
			enableControl("ParkWarn_AR2", "CH_PARKParkWarn_AR2_UB__01", 0); //1: enable; 0: disable
			@sysvar::CH_Nodes::CH_PARKParkWarn_AR2_UB__01 = 1;
			break;
		case (1):
			enableControl("ParkWarn_AR2", "CH_PARKParkWarn_AR2_UB__01", 1); //1: enable; 0: disable
			break;
		case (2):
			enableControl("ParkWarn_AR2", "CH_PARKParkWarn_AR2_UB__01", 0); //1: enable; 0: disable
			@sysvar::CH_Nodes::CH_PARKParkWarn_AR2_UB__01 = 1;
			break;
		case (3):
			enableControl("ParkWarn_AR2", "CH_PARKParkWarn_AR2_UB__01", 0); //1: enable; 0: disable
			@sysvar::CH_Nodes::CH_PARKParkWarn_AR2_UB__01 = 0;
			break;
	}

	switch (@sysvar::CH_Nodes::CH_PARKRemPark_Rq_AR2_UB_AUTO)
	{
		case (0):
			enableControl("RemPark_Rq_AR2", "CH_PARKRemPark_Rq_AR2_UB_", 0); //1: enable; 0: disable
			@sysvar::CH_Nodes::CH_PARKRemPark_Rq_AR2_UB_ = 1;
			break;
		case (1):
			enableControl("RemPark_Rq_AR2", "CH_PARKRemPark_Rq_AR2_UB_", 1); //1: enable; 0: disable
			break;
		case (2):
			enableControl("RemPark_Rq_AR2", "CH_PARKRemPark_Rq_AR2_UB_", 0); //1: enable; 0: disable
			@sysvar::CH_Nodes::CH_PARKRemPark_Rq_AR2_UB_ = 1;
			break;
		case (3):
			enableControl("RemPark_Rq_AR2", "CH_PARKRemPark_Rq_AR2_UB_", 0); //1: enable; 0: disable
			@sysvar::CH_Nodes::CH_PARKRemPark_Rq_AR2_UB_ = 0;
			break;
	}

	CRC_RemPark_Rq_Pr2 = 0;
	SQC_VAL_RemPark_Rq_Pr2 = 0;
	SQC_RemPark_Rq_Pr2 = 0;
	switch (@sysvar::CH_Nodes::CH_PARKRVC_SVS_Park_Stat_UB_A_01)
	{
		case (0):
			enableControl("RVC_SVS_Park_Stat_AR2", "CH_PARKRVC_SVS_Park_Stat_AR2__01", 0); //1: enable; 0: disable
			@sysvar::CH_Nodes::CH_PARKRVC_SVS_Park_Stat_AR2__01 = 1;
			break;
		case (1):
			enableControl("RVC_SVS_Park_Stat_AR2", "CH_PARKRVC_SVS_Park_Stat_AR2__01", 1); //1: enable; 0: disable
			break;
		case (2):
			enableControl("RVC_SVS_Park_Stat_AR2", "CH_PARKRVC_SVS_Park_Stat_AR2__01", 0); //1: enable; 0: disable
			@sysvar::CH_Nodes::CH_PARKRVC_SVS_Park_Stat_AR2__01 = 1;
			break;
		case (3):
			enableControl("RVC_SVS_Park_Stat_AR2", "CH_PARKRVC_SVS_Park_Stat_AR2__01", 0); //1: enable; 0: disable
			@sysvar::CH_Nodes::CH_PARKRVC_SVS_Park_Stat_AR2__01 = 0;
			break;
	}

	CRC_SADR_Trgr_PARK_Pr2 = 0;
	SQC_VAL_SADR_Trgr_PARK_Pr2 = 0;
	SQC_SADR_Trgr_PARK_Pr2 = 0;
	switch (@sysvar::CH_Nodes::CH_PARKSt_Rq_PARK_AR2_UB_AUTO_01)
	{
		case (0):
			enableControl("St_Rq_PARK_AR2", "CH_PARKSt_Rq_PARK_AR2_UB__01", 0); //1: enable; 0: disable
			@sysvar::CH_Nodes::CH_PARKSt_Rq_PARK_AR2_UB__01 = 1;
			break;
		case (1):
			enableControl("St_Rq_PARK_AR2", "CH_PARKSt_Rq_PARK_AR2_UB__01", 1); //1: enable; 0: disable
			break;
		case (2):
			enableControl("St_Rq_PARK_AR2", "CH_PARKSt_Rq_PARK_AR2_UB__01", 0); //1: enable; 0: disable
			@sysvar::CH_Nodes::CH_PARKSt_Rq_PARK_AR2_UB__01 = 1;
			break;
		case (3):
			enableControl("St_Rq_PARK_AR2", "CH_PARKSt_Rq_PARK_AR2_UB__01", 0); //1: enable; 0: disable
			@sysvar::CH_Nodes::CH_PARKSt_Rq_PARK_AR2_UB__01 = 0;
			break;
	}

	CRC_St_Rq_PARK_Pr2 = 0;
	SQC_VAL_St_Rq_PARK_Pr2 = 0;
	SQC_St_Rq_PARK_Pr2 = 0;
}
/*@@end*/

/*@@caplFunc:StopSim():*/
StopSim()
{
}
/*@@end*/

/*@@frPDU:MsgChannel1.CHASSIS::Brk_Rq_PARK_AR2:*/
on frPDU MsgChannel1.CHASSIS::Brk_Rq_PARK_AR2
{
}
/*@@end*/

/*@@frPDU:MsgChannel1.CHASSIS::ECU_INFO_RVC_AR:*/
on frPDU MsgChannel1.CHASSIS::ECU_INFO_RVC_AR
{
}
/*@@end*/

/*@@frPDU:MsgChannel1.CHASSIS::Park_Disp_Rq_AR2:*/
on frPDU MsgChannel1.CHASSIS::Park_Disp_Rq_AR2
{
}
/*@@end*/

/*@@frPDU:MsgChannel1.CHASSIS::Park_Set_Stat_AR2:*/
on frPDU MsgChannel1.CHASSIS::Park_Set_Stat_AR2
{
}
/*@@end*/

/*@@frPDU:MsgChannel1.CHASSIS::Park_Stat_AR2:*/
on frPDU MsgChannel1.CHASSIS::Park_Stat_AR2
{
}
/*@@end*/

/*@@frPDU:MsgChannel1.CHASSIS::ParkSensObj_Stat1_FR2:*/
on frPDU MsgChannel1.CHASSIS::ParkSensObj_Stat1_FR2
{
}
/*@@end*/

/*@@frPDU:MsgChannel1.CHASSIS::ParkSensObj_Stat2_FR2:*/
on frPDU MsgChannel1.CHASSIS::ParkSensObj_Stat2_FR2
{
}
/*@@end*/

/*@@frPDU:MsgChannel1.CHASSIS::ParkSpaceMeas_Stat_AR:*/
on frPDU MsgChannel1.CHASSIS::ParkSpaceMeas_Stat_AR
{
}
/*@@end*/

/*@@frPDU:MsgChannel1.CHASSIS::ParkWarn_AR2:*/
on frPDU MsgChannel1.CHASSIS::ParkWarn_AR2
{
}
/*@@end*/

/*@@frPDU:MsgChannel1.CHASSIS::RemPark_Rq_AR2:*/
on frPDU MsgChannel1.CHASSIS::RemPark_Rq_AR2
{
}
/*@@end*/

/*@@frPDU:MsgChannel1.CHASSIS::ROE_PARK:*/
on frPDU MsgChannel1.CHASSIS::ROE_PARK
{
}
/*@@end*/

/*@@frPDU:MsgChannel1.CHASSIS::RVC_SVS_Park_Stat_AR2:*/
on frPDU MsgChannel1.CHASSIS::RVC_SVS_Park_Stat_AR2
{
}
/*@@end*/

/*@@frPDU:MsgChannel1.CHASSIS::SADR_Trgr_PARK_AR2:*/
on frPDU MsgChannel1.CHASSIS::SADR_Trgr_PARK_AR2
{
}
/*@@end*/

/*@@frPDU:MsgChannel1.CHASSIS::St_Rq_PARK_AR2:*/
on frPDU MsgChannel1.CHASSIS::St_Rq_PARK_AR2
{
}
/*@@end*/

