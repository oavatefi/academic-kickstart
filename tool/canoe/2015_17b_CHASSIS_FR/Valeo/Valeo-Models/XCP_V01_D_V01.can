/*@!Encoding:1252*/
variables
{
    const int none = 0;
    const int start_measuring = 1;
    const int stop_measuring = 2;

    int command_ctr;
    int initial_value = 0;

    FRPDU XCP_Rq_CMD_FR XcpPdu;

//Zum Speichern der erhaltenen Daten
    byte rxbuffer[128];
    int buffer_index;

//Zum löschen des Overheads beim umspeichern der empfangenen Bytes
    const int overhead = 3;

//Um einen Reconnect zu verhindern, wenn der command_ctr wieder auf 0 gesetzt wird
    int connect_flag;

/*ODT 1 und 4 werden mit der selben PDU "XCP_Rs_VARIABLE2_FR" übertragen. 
  Die ODT Nummer wird benötigt um Sie zu unterscheiden*/
    int ODT_number;
}

on preStart
{
    FRSetSendPdu(XcpPdu);
}

//Wird der Start oder Stop Button betätigt werden die Funktionen connect bzw. disconnect aufgerufen
on envVar EnvXCPStart_Stop_DAQ
{
    switch (getValue (this))
    {
        case start_measuring:

            
            connect();
        
        break;

        case stop_measuring:

            disconnect();
    
        break;
    }
}

//Die Connect Nachricht wird auf den Bus gesendet
connect ()
{
//Der command_ctr wird beim Verbindungsaufbau zurückgesetzt
    command_ctr = initial_value;                

    XcpPdu.byte(0) = 0x83;
    XcpPdu.byte(1) = command_ctr;
    XcpPdu.byte(2) = 0xff;

//Sendet die Nachrich auf den Bus
    FrUpdatePdu(XcpPdu,1,1);
    write("connect");

//Zeigt an, dass eine Verbindung hergestellt wird
    connect_flag = 1;
}

//Die Disconnect Nachricht wird auf den Bus gesendet
disconnect ()
{
    XcpPdu.byte(0) = 0x83;
    XcpPdu.byte(1) = 0x23;
    XcpPdu.byte(2) = 0xfe;

    FrUpdatePdu(XcpPdu,1,1);
    write("disconnect"); 
}

//Wird aufgerufen bei Antwort des Stuergeräts auf ein Befehl
on frPDU XCP_Rs_RES_ERR_FR
{
    if(connect_flag == 1)
    {
        //Command_ctr wird um eins erhöht um die nächste Nachricht zu indentifizieren
        command_ctr++;

        //Verhindert einen Überlauf des command_ctrs
        if (command_ctr >= 255)
        {
            command_ctr = initial_value;
            organize_connection();   
        }

        else
        {
            organize_connection();
        }
    }
}

//Regelt die Reihenfolge, für die für den Verbindungsaufbau notwendigen Befehle
organize_connection()
{

    if (command_ctr == 1)
    {
    //Get Comm Mode Info
        XcpPdu.byte(0) = 0x83;
        XcpPdu.byte(1) = command_ctr;
        XcpPdu.byte(2) = 0xFB;
        XcpPdu.byte(3) = 0x00;
        XcpPdu.byte(4) = 0x00;
        XcpPdu.byte(5) = 0x00;
        XcpPdu.byte(6) = 0x00;
        XcpPdu.byte(7) = 0x00;
        XcpPdu.byte(8) = 0x00;
        XcpPdu.byte(9) = 0x00;
        XcpPdu.byte(10) = 0x00;
        XcpPdu.byte(11) = 0x00;
        XcpPdu.byte(12) = 0x00;
        XcpPdu.byte(13) = 0x00;

        FrUpdatePdu(XcpPdu,1,1);     
    }
        
    else if (command_ctr == 2)
    {
    //Get Status
        XcpPdu.byte(0) = 0x83;
        XcpPdu.byte(1) = command_ctr;
        XcpPdu.byte(2) = 0xFD;
        XcpPdu.byte(3) = 0x00;
        XcpPdu.byte(4) = 0x00;
        XcpPdu.byte(5) = 0x00;
        XcpPdu.byte(6) = 0x00;
        XcpPdu.byte(7) = 0x00;
        XcpPdu.byte(8) = 0x00;
        XcpPdu.byte(9) = 0x00;
        XcpPdu.byte(10) = 0x00;
        XcpPdu.byte(11) = 0x00;
        XcpPdu.byte(12) = 0x00;
        XcpPdu.byte(13) = 0x00;

        FrUpdatePdu(XcpPdu,1,1);
    }

    else if (command_ctr == 3)
    {
    //Get DAQ Processor Info
        XcpPdu.byte(0) = 0x83;
        XcpPdu.byte(1) = command_ctr;
        XcpPdu.byte(2) = 0xDA;
        XcpPdu.byte(3) = 0x00;
        XcpPdu.byte(4) = 0x00;
        XcpPdu.byte(5) = 0x00;
        XcpPdu.byte(6) = 0x00;
        XcpPdu.byte(7) = 0x00;
        XcpPdu.byte(8) = 0x00;
        XcpPdu.byte(9) = 0x00;
        XcpPdu.byte(10) = 0x00;
        XcpPdu.byte(11) = 0x00;
        XcpPdu.byte(12) = 0x00;
        XcpPdu.byte(13) = 0x00;

        FrUpdatePdu(XcpPdu,1,1);
    }

    else if (command_ctr == 4)
    {
    //Get DAQ Resolution Info
        XcpPdu.byte(0) = 0x83;
        XcpPdu.byte(1) = command_ctr;
        XcpPdu.byte(2) = 0xD9;
        XcpPdu.byte(3) = 0x00;
        XcpPdu.byte(4) = 0x00;
        XcpPdu.byte(5) = 0x00;
        XcpPdu.byte(6) = 0x00;
        XcpPdu.byte(7) = 0x00;
        XcpPdu.byte(8) = 0x00;
        XcpPdu.byte(9) = 0x00;
        XcpPdu.byte(10) = 0x00;
        XcpPdu.byte(11) = 0x00;
        XcpPdu.byte(12) = 0x00;
        XcpPdu.byte(13) = 0x00;

        FrUpdatePdu(XcpPdu,1,1);
    }

    else if (command_ctr == 5)
    {
    //Free DAQ
        XcpPdu.byte(0) = 0x83;
        XcpPdu.byte(1) = command_ctr;
        XcpPdu.byte(2) = 0xD6;
        XcpPdu.byte(3) = 0x00;
        XcpPdu.byte(4) = 0x00;
        XcpPdu.byte(5) = 0x00;
        XcpPdu.byte(6) = 0x00;
        XcpPdu.byte(7) = 0x00;
        XcpPdu.byte(8) = 0x00;
        XcpPdu.byte(9) = 0x00;
        XcpPdu.byte(10) = 0x00;
        XcpPdu.byte(11) = 0x00;
        XcpPdu.byte(12) = 0x00;
        XcpPdu.byte(13) = 0x00;

        FrUpdatePdu(XcpPdu,1,1);
    }

    else if (command_ctr == 6)
    {
    //Alloc DAQ
        XcpPdu.byte(0) = 0x83;
        XcpPdu.byte(1) = command_ctr;
        XcpPdu.byte(2) = 0xD5;
        XcpPdu.byte(3) = 0x00;
        XcpPdu.byte(4) = 0x00;      //Anzahl zu resevierender DAQ Listen
        XcpPdu.byte(5) = 0x01;      //Anzahl zu resevierender DAQ Listen
        XcpPdu.byte(6) = 0x00;
        XcpPdu.byte(7) = 0x00;
        XcpPdu.byte(8) = 0x00;
        XcpPdu.byte(9) = 0x00;
        XcpPdu.byte(10) = 0x00;
        XcpPdu.byte(11) = 0x00;
        XcpPdu.byte(12) = 0x00;
        XcpPdu.byte(13) = 0x00;           

        FrUpdatePdu(XcpPdu,1,1);
    }

    else if (command_ctr == 7)
    {
    //Alloc ODT
        XcpPdu.byte(0) = 0x83;
        XcpPdu.byte(1) = command_ctr;
        XcpPdu.byte(2) = 0xD4;
        XcpPdu.byte(3) = 0x00;
        XcpPdu.byte(4) = 0x00;      //DAQ List Number
        XcpPdu.byte(5) = 0x00;      //DAQ List Number
        XcpPdu.byte(6) = 0x04;      //Anzahl der zugehörigen ODTs
        XcpPdu.byte(7) = 0x00;
        XcpPdu.byte(8) = 0x00;
        XcpPdu.byte(9) = 0x00;
        XcpPdu.byte(10) = 0x00;
        XcpPdu.byte(11) = 0x00;
        XcpPdu.byte(12) = 0x00;
        XcpPdu.byte(13) = 0x00;

        FrUpdatePdu(XcpPdu,1,1);
    }

    else if (command_ctr == 8)
    {
    //Alloc ODT Entry
        XcpPdu.byte(0) = 0x83;
        XcpPdu.byte(1) = command_ctr;
        XcpPdu.byte(2) = 0xD3;
        XcpPdu.byte(3) = 0x00;
        XcpPdu.byte(4) = 0x00;      //DAQ List Number
        XcpPdu.byte(5) = 0x00;      //DAQ List Number
        XcpPdu.byte(6) = 0x00;      //ODT Number
        XcpPdu.byte(7) = 0x01;      //Number of ODT entries
        XcpPdu.byte(8) = 0x00;
        XcpPdu.byte(9) = 0x00;
        XcpPdu.byte(10) = 0x00;
        XcpPdu.byte(11) = 0x00;
        XcpPdu.byte(12) = 0x00;
        XcpPdu.byte(13) = 0x00;
        
        FrUpdatePdu(XcpPdu,1,1);
    }
        
    else if (command_ctr == 9)
    {
    //Alloc ODT Entry
        XcpPdu.byte(0) = 0x83;
        XcpPdu.byte(1) = command_ctr;
        XcpPdu.byte(2) = 0xD3;
        XcpPdu.byte(3) = 0x00;
        XcpPdu.byte(4) = 0x00;      //DAQ List Number
        XcpPdu.byte(5) = 0x00;      //DAQ List Number
        XcpPdu.byte(6) = 0x01;      //ODT Number
        XcpPdu.byte(7) = 0x01;      //Number of ODT entries
        XcpPdu.byte(8) = 0x00;
        XcpPdu.byte(9) = 0x00;
        XcpPdu.byte(10) = 0x00;
        XcpPdu.byte(11) = 0x00;
        XcpPdu.byte(12) = 0x00;
        XcpPdu.byte(13) = 0x00;
        
        FrUpdatePdu(XcpPdu,1,1);
    }

    else if (command_ctr == 10)
    {
    //Alloc ODT Entry
        XcpPdu.byte(0) = 0x83;
        XcpPdu.byte(1) = command_ctr;
        XcpPdu.byte(2) = 0xD3;
        XcpPdu.byte(3) = 0x00;
        XcpPdu.byte(4) = 0x00;      //DAQ List Number
        XcpPdu.byte(5) = 0x00;      //DAQ List Number
        XcpPdu.byte(6) = 0x02;      //ODT Number
        XcpPdu.byte(7) = 0x01;      //Number of ODT entries
        XcpPdu.byte(8) = 0x00;
        XcpPdu.byte(9) = 0x00;
        XcpPdu.byte(10) = 0x00;
        XcpPdu.byte(11) = 0x00;
        XcpPdu.byte(12) = 0x00;
        XcpPdu.byte(13) = 0x00;
        
        FrUpdatePdu(XcpPdu,1,1);
    }

    else if (command_ctr == 11)
    {
    //Alloc ODT Entry
        XcpPdu.byte(0) = 0x83;
        XcpPdu.byte(1) = command_ctr;
        XcpPdu.byte(2) = 0xD3;
        XcpPdu.byte(3) = 0x00;
        XcpPdu.byte(4) = 0x00;      //DAQ List Number
        XcpPdu.byte(5) = 0x00;      //DAQ List Number
        XcpPdu.byte(6) = 0x03;      //ODT Number
        XcpPdu.byte(7) = 0x01;      //Number of ODT entries
        XcpPdu.byte(8) = 0x00;
        XcpPdu.byte(9) = 0x00;
        XcpPdu.byte(10) = 0x00;
        XcpPdu.byte(11) = 0x00;
        XcpPdu.byte(12) = 0x00;
        XcpPdu.byte(13) = 0x00;
        
        FrUpdatePdu(XcpPdu,1,1);
    }

    else if (command_ctr == 12)
   {
    //Set Daq Pointer
        XcpPdu.byte(0) = 0x83;
        XcpPdu.byte(1) = command_ctr;
        XcpPdu.byte(2) = 0xE2;
        XcpPdu.byte(3) = 0x00;
        XcpPdu.byte(4) = 0x00;      //DAQ List Number
        XcpPdu.byte(5) = 0x00;      //DAQ List Number
        XcpPdu.byte(6) = 0x00;      //ODT Number
        XcpPdu.byte(7) = 0x00;      //ODT Entry Number
        XcpPdu.byte(8) = 0x00;
        XcpPdu.byte(9) = 0x00;
        XcpPdu.byte(10) = 0x00;
        XcpPdu.byte(11) = 0x00;
        XcpPdu.byte(12) = 0x00;
        XcpPdu.byte(13) = 0x00;        

        FrUpdatePdu(XcpPdu,1,1);
    }

    else if (command_ctr == 13)
    {
    //Write DAQ
        XcpPdu.byte(0) = 0x83;
        XcpPdu.byte(1) = command_ctr;
        XcpPdu.byte(2) = 0xE1;
        XcpPdu.byte(3) = 0xFF;      //Bit Offset
        XcpPdu.byte(4) = 0x25;      //Size of DAQ Element
        XcpPdu.byte(5) = 0x00;      //Address extension of DAQ element
        XcpPdu.byte(6) = 0x40;      //Address of DAQ element
        XcpPdu.byte(7) = 0x00;      //Address of DAQ element
        XcpPdu.byte(8) = 0x0E;      //Address of DAQ element
        XcpPdu.byte(9) = 0x00;      //Address of DAQ element
        XcpPdu.byte(10) = 0x00;
        XcpPdu.byte(11) = 0x00;
        XcpPdu.byte(12) = 0x00;
        XcpPdu.byte(13) = 0x00;
            
        FrUpdatePdu(XcpPdu,1,1);
    }

    else if (command_ctr == 14)
   {
    //Set Daq Pointer
        XcpPdu.byte(0) = 0x83;
        XcpPdu.byte(1) = command_ctr;
        XcpPdu.byte(2) = 0xE2;
        XcpPdu.byte(3) = 0x00;
        XcpPdu.byte(4) = 0x00;      //DAQ List Number
        XcpPdu.byte(5) = 0x00;      //DAQ List Number
        XcpPdu.byte(6) = 0x01;      //ODT Number
        XcpPdu.byte(7) = 0x00;      //ODT Entry Number
        XcpPdu.byte(8) = 0x00;
        XcpPdu.byte(9) = 0x00;
        XcpPdu.byte(10) = 0x00;
        XcpPdu.byte(11) = 0x00;
        XcpPdu.byte(12) = 0x00;
        XcpPdu.byte(13) = 0x00;        

        FrUpdatePdu(XcpPdu,1,1);
    }
                
    else if (command_ctr == 15)
    {
    //Write DAQ
        XcpPdu.byte(0) = 0x83;
        XcpPdu.byte(1) = command_ctr;
        XcpPdu.byte(2) = 0xE1;
        XcpPdu.byte(3) = 0xFF;      //Bit Offset
        XcpPdu.byte(4) = 0x25;      //Size of DAQ Element
        XcpPdu.byte(5) = 0x00;      //Address extension of DAQ element
        XcpPdu.byte(6) = 0x40;      //Address of DAQ element
        XcpPdu.byte(7) = 0x00;      //Address of DAQ element
        XcpPdu.byte(8) = 0x0E;      //Address of DAQ element
        XcpPdu.byte(9) = 0x25;      //Address of DAQ element
        XcpPdu.byte(10) = 0x00;
        XcpPdu.byte(11) = 0x00;
        XcpPdu.byte(12) = 0x00;
        XcpPdu.byte(13) = 0x00;
            
        FrUpdatePdu(XcpPdu,1,1);
    }

    else if (command_ctr == 16)
   {
    //Set Daq Pointer
        XcpPdu.byte(0) = 0x83;
        XcpPdu.byte(1) = command_ctr;
        XcpPdu.byte(2) = 0xE2;
        XcpPdu.byte(3) = 0x00;
        XcpPdu.byte(4) = 0x00;      //DAQ List Number
        XcpPdu.byte(5) = 0x00;      //DAQ List Number
        XcpPdu.byte(6) = 0x02;      //ODT Number
        XcpPdu.byte(7) = 0x00;      //ODT Entry Number
        XcpPdu.byte(8) = 0x00;
        XcpPdu.byte(9) = 0x00;
        XcpPdu.byte(10) = 0x00;
        XcpPdu.byte(11) = 0x00;
        XcpPdu.byte(12) = 0x00;
        XcpPdu.byte(13) = 0x00;        

        FrUpdatePdu(XcpPdu,1,1);
    }

    else if (command_ctr == 17)
    {
    //Write DAQ
        XcpPdu.byte(0) = 0x83;
        XcpPdu.byte(1) = command_ctr;
        XcpPdu.byte(2) = 0xE1;
        XcpPdu.byte(3) = 0xFF;      //Bit Offset
        XcpPdu.byte(4) = 0x25;      //Size of DAQ Element
        XcpPdu.byte(5) = 0x00;      //Address extension of DAQ element
        XcpPdu.byte(6) = 0x40;      //Address of DAQ element
        XcpPdu.byte(7) = 0x00;      //Address of DAQ element
        XcpPdu.byte(8) = 0x0E;      //Address of DAQ element
        XcpPdu.byte(9) = 0x4A;      //Address of DAQ element
        XcpPdu.byte(10) = 0x00;
        XcpPdu.byte(11) = 0x00;
        XcpPdu.byte(12) = 0x00;
        XcpPdu.byte(13) = 0x00;
            
        FrUpdatePdu(XcpPdu,1,1);
    }

    else if (command_ctr == 18)
   {
    //Set Daq Pointer
        XcpPdu.byte(0) = 0x83;
        XcpPdu.byte(1) = command_ctr;
        XcpPdu.byte(2) = 0xE2;
        XcpPdu.byte(3) = 0x00;
        XcpPdu.byte(4) = 0x00;      //DAQ List Number
        XcpPdu.byte(5) = 0x00;      //DAQ List Number
        XcpPdu.byte(6) = 0x03;      //ODT Number
        XcpPdu.byte(7) = 0x00;      //ODT Entry Number
        XcpPdu.byte(8) = 0x00;
        XcpPdu.byte(9) = 0x00;
        XcpPdu.byte(10) = 0x00;
        XcpPdu.byte(11) = 0x00;
        XcpPdu.byte(12) = 0x00;
        XcpPdu.byte(13) = 0x00;        

        FrUpdatePdu(XcpPdu,1,1);
    }

    else if (command_ctr == 19)
    {
    //Write DAQ
        XcpPdu.byte(0) = 0x83;
        XcpPdu.byte(1) = command_ctr;
        XcpPdu.byte(2) = 0xE1;
        XcpPdu.byte(3) = 0xFF;      //Bit Offset
        XcpPdu.byte(4) = 0x11;      //Size of DAQ Element
        XcpPdu.byte(5) = 0x00;      //Address extension of DAQ element
        XcpPdu.byte(6) = 0x40;      //Address of DAQ element
        XcpPdu.byte(7) = 0x00;      //Address of DAQ element
        XcpPdu.byte(8) = 0x0E;      //Address of DAQ element
        XcpPdu.byte(9) = 0x6F;      //Address of DAQ element
        XcpPdu.byte(10) = 0x00;
        XcpPdu.byte(11) = 0x00;
        XcpPdu.byte(12) = 0x00;
        XcpPdu.byte(13) = 0x00;
            
        FrUpdatePdu(XcpPdu,1,1);
    }

    else if (command_ctr == 20)
    {
    //Set DAQ List mode
        XcpPdu.byte(0) = 0x83;
        XcpPdu.byte(1) = command_ctr;
        XcpPdu.byte(2) = 0xE0;
        XcpPdu.byte(3) = 0x00;      //Mode (siehe Bit Mask Table)
        XcpPdu.byte(4) = 0x00;      //DAQ List number
        XcpPdu.byte(5) = 0x00;      //DAQ List number
        XcpPdu.byte(6) = 0x00;      //Event channel number
        XcpPdu.byte(7) = 0x00;      //Event channel number
        XcpPdu.byte(8) = 0x01;      //Transmission rate prescaler (=>1)
        XcpPdu.byte(9) = 0x00;
        XcpPdu.byte(10) = 0x00;
        XcpPdu.byte(11) = 0x00;
        XcpPdu.byte(12) = 0x00;
        XcpPdu.byte(13) = 0x00;
            
        FrUpdatePdu(XcpPdu,1,1);
    }

    else if (command_ctr == 21)
   {
   //Start Stop DAQ List
        XcpPdu.byte(0) = 0x83;
        XcpPdu.byte(1) = command_ctr;
        XcpPdu.byte(2) = 0xDE;
        XcpPdu.byte(3) = 0x02;      //Mode (00 = stop, 01 = start, 02 = select)
        XcpPdu.byte(4) = 0x00;      //DAQ List number
        XcpPdu.byte(5) = 0x00;      //DAQ List number
        XcpPdu.byte(6) = 0x00;
        XcpPdu.byte(7) = 0x00;
        XcpPdu.byte(8) = 0x00;
        XcpPdu.byte(9) = 0x00;
        XcpPdu.byte(10) = 0x00;
        XcpPdu.byte(11) = 0x00;
        XcpPdu.byte(12) = 0x00;
        XcpPdu.byte(13) = 0x00;
             
        FrUpdatePdu(XcpPdu,1,1);
    }

/* 
!!!  Die Transport Layer Commands sind aus einer CANape Messung mit einer DAQ Liste und vier ODTs, welche in einem
     CANoe Trance aufgenommen worden ist, entnommen. Der genaue Aufbau muss noch verstanden werden   !!!
*/
    
    else if (command_ctr == 22)
    {
    //Transport_Layer_CMD
        XcpPdu.byte(0) = 0x83;
        XcpPdu.byte(1) = command_ctr;
        XcpPdu.byte(2) = 0xF2;
        XcpPdu.byte(3) = 0xFF;    
        XcpPdu.byte(4) = 0x01;      
        XcpPdu.byte(5) = 0x00;      
        XcpPdu.byte(6) = 0x00;
        XcpPdu.byte(7) = 0x90;
        XcpPdu.byte(8) = 0x00;
        XcpPdu.byte(9) = 0x01;
        XcpPdu.byte(10) = 0x00;
        XcpPdu.byte(11) = 0x2A;
        XcpPdu.byte(12) = 0x01;
        XcpPdu.byte(13) = 0x98;
             
        FrUpdatePdu(XcpPdu,1,1);
    }

    else if (command_ctr == 23)
    {
    //Transport_Layer_CMD
        XcpPdu.byte(0) = 0x83;
        XcpPdu.byte(1) = command_ctr;
        XcpPdu.byte(2) = 0xF2;
        XcpPdu.byte(3) = 0xFF;    
        XcpPdu.byte(4) = 0x02;      
        XcpPdu.byte(5) = 0x00;      
        XcpPdu.byte(6) = 0x00;
        XcpPdu.byte(7) = 0x92;
        XcpPdu.byte(8) = 0x00;
        XcpPdu.byte(9) = 0x01;
        XcpPdu.byte(10) = 0x00;
        XcpPdu.byte(11) = 0x2A;
        XcpPdu.byte(12) = 0x02;
        XcpPdu.byte(13) = 0x72;
             
        FrUpdatePdu(XcpPdu,1,1);
    }

    else if (command_ctr == 24)
    {
    //Transport_Layer_CMD
        XcpPdu.byte(0) = 0x83;
        XcpPdu.byte(1) = command_ctr;
        XcpPdu.byte(2) = 0xF2;
        XcpPdu.byte(3) = 0xFF;    
        XcpPdu.byte(4) = 0x03;      
        XcpPdu.byte(5) = 0x00;      
        XcpPdu.byte(6) = 0x00;
        XcpPdu.byte(7) = 0x93;
        XcpPdu.byte(8) = 0x00;
        XcpPdu.byte(9) = 0x01;
        XcpPdu.byte(10) = 0x00;
        XcpPdu.byte(11) = 0x2A;
        XcpPdu.byte(12) = 0x03;
        XcpPdu.byte(13) = 0x87;
             
        FrUpdatePdu(XcpPdu,1,1);
    }

    else if (command_ctr == 25)
    {
    //Transport_Layer_CMD
        XcpPdu.byte(0) = 0x83;
        XcpPdu.byte(1) = command_ctr;
        XcpPdu.byte(2) = 0xF2;
        XcpPdu.byte(3) = 0xFF;    
        XcpPdu.byte(4) = 0x04;      
        XcpPdu.byte(5) = 0x00;      
        XcpPdu.byte(6) = 0x00;
        XcpPdu.byte(7) = 0x94;
        XcpPdu.byte(8) = 0x00;
        XcpPdu.byte(9) = 0x01;
        XcpPdu.byte(10) = 0x00;
        XcpPdu.byte(11) = 0x2A;
        XcpPdu.byte(12) = 0x06;
        XcpPdu.byte(13) = 0x4C;
             
        FrUpdatePdu(XcpPdu,1,1);
    }

    else if (command_ctr == 26)
    {
    //Transport_Layer_CMD
        XcpPdu.byte(0) = 0x83;
        XcpPdu.byte(1) = command_ctr;
        XcpPdu.byte(2) = 0xF2;
        XcpPdu.byte(3) = 0xFF;    
        XcpPdu.byte(4) = 0x05;      
        XcpPdu.byte(5) = 0x10;      
        XcpPdu.byte(6) = 0x00;
        XcpPdu.byte(7) = 0x95;
        XcpPdu.byte(8) = 0x00;
        XcpPdu.byte(9) = 0x01;
        XcpPdu.byte(10) = 0x00;
        XcpPdu.byte(11) = 0x2A;
        XcpPdu.byte(12) = 0x07;
        XcpPdu.byte(13) = 0xB9;
             
        FrUpdatePdu(XcpPdu,1,1);
    }

    else if (command_ctr == 27)
    {
    //Transport_Layer_CMD
        XcpPdu.byte(0) = 0x83;
        XcpPdu.byte(1) = command_ctr;
        XcpPdu.byte(2) = 0xF2;
        XcpPdu.byte(3) = 0xFF;    
        XcpPdu.byte(4) = 0x06;      
        XcpPdu.byte(5) = 0x00;      
        XcpPdu.byte(6) = 0x00;
        XcpPdu.byte(7) = 0x8F;
        XcpPdu.byte(8) = 0x00;
        XcpPdu.byte(9) = 0x01;
        XcpPdu.byte(10) = 0x00;
        XcpPdu.byte(11) = 0x2A;
        XcpPdu.byte(12) = 0x03;
        XcpPdu.byte(13) = 0xA1;
             
        FrUpdatePdu(XcpPdu,1,1);
    }

    else if (command_ctr == 28)
    {
    //Transport_Layer_CMD
        XcpPdu.byte(0) = 0x83;
        XcpPdu.byte(1) = command_ctr;
        XcpPdu.byte(2) = 0xF2;
        XcpPdu.byte(3) = 0xFF;    
        XcpPdu.byte(4) = 0x01;      
        XcpPdu.byte(5) = 0x10;      
        XcpPdu.byte(6) = 0x00;
        XcpPdu.byte(7) = 0x90;
        XcpPdu.byte(8) = 0x00;
        XcpPdu.byte(9) = 0x01;
        XcpPdu.byte(10) = 0x00;
        XcpPdu.byte(11) = 0x2A;
        XcpPdu.byte(12) = 0x01;
        XcpPdu.byte(13) = 0x98;
             
        FrUpdatePdu(XcpPdu,1,1);
    }
      
    else if (command_ctr == 29)
    {
    //Transport_Layer_CMD
        XcpPdu.byte(0) = 0x83;
        XcpPdu.byte(1) = command_ctr;
        XcpPdu.byte(2) = 0xF2;
        XcpPdu.byte(3) = 0xFF;    
        XcpPdu.byte(4) = 0x02;      
        XcpPdu.byte(5) = 0x10;      
        XcpPdu.byte(6) = 0x00;
        XcpPdu.byte(7) = 0x92;
        XcpPdu.byte(8) = 0x00;
        XcpPdu.byte(9) = 0x01;
        XcpPdu.byte(10) = 0x00;
        XcpPdu.byte(11) = 0x2A;
        XcpPdu.byte(12) = 0x02;
        XcpPdu.byte(13) = 0x72;
             
        FrUpdatePdu(XcpPdu,1,1);
    }
    
    else if (command_ctr == 30)
    {
    //Transport_Layer_CMD
        XcpPdu.byte(0) = 0x83;
        XcpPdu.byte(1) = command_ctr;
        XcpPdu.byte(2) = 0xF2;
        XcpPdu.byte(3) = 0xFF;    
        XcpPdu.byte(4) = 0x03;      
        XcpPdu.byte(5) = 0x10;      
        XcpPdu.byte(6) = 0x00;
        XcpPdu.byte(7) = 0x93;
        XcpPdu.byte(8) = 0x00;
        XcpPdu.byte(9) = 0x01;
        XcpPdu.byte(10) = 0x00;
        XcpPdu.byte(11) = 0x2A;
        XcpPdu.byte(12) = 0x03;
        XcpPdu.byte(13) = 0x87;
             
        FrUpdatePdu(XcpPdu,1,1);
    }
    
    else if (command_ctr == 31)
    {
    //Transport_Layer_CMD
        XcpPdu.byte(0) = 0x83;
        XcpPdu.byte(1) = command_ctr;
        XcpPdu.byte(2) = 0xF2;
        XcpPdu.byte(3) = 0xFF;    
        XcpPdu.byte(4) = 0x01;      
        XcpPdu.byte(5) = 0x10;      
        XcpPdu.byte(6) = 0x00;
        XcpPdu.byte(7) = 0x90;
        XcpPdu.byte(8) = 0x00;
        XcpPdu.byte(9) = 0x01;
        XcpPdu.byte(10) = 0x00;
        XcpPdu.byte(11) = 0x2A;
        XcpPdu.byte(12) = 0x01;
        XcpPdu.byte(13) = 0x98;
             
        FrUpdatePdu(XcpPdu,1,1);
    }
        
    else if (command_ctr == 32)
    {
    //Transport_Layer_CMD
        XcpPdu.byte(0) = 0x83;
        XcpPdu.byte(1) = command_ctr;
        XcpPdu.byte(2) = 0xF2;
        XcpPdu.byte(3) = 0xFF;    
        XcpPdu.byte(4) = 0x04;      
        XcpPdu.byte(5) = 0x10;      
        XcpPdu.byte(6) = 0x00;
        XcpPdu.byte(7) = 0x94;
        XcpPdu.byte(8) = 0x00;
        XcpPdu.byte(9) = 0x01;
        XcpPdu.byte(10) = 0x00;
        XcpPdu.byte(11) = 0x2A;
        XcpPdu.byte(12) = 0x06;
        XcpPdu.byte(13) = 0x4C;
             
        FrUpdatePdu(XcpPdu,1,1);
    }
   
    else if (command_ctr == 33)
    {
    //Start Stop Synch
        XcpPdu.byte(0) = 0x83;
        XcpPdu.byte(1) = command_ctr;
        XcpPdu.byte(2) = 0xDD;
        XcpPdu.byte(3) = 0x01;      //Mode (00 = stop all, 01 = start selected, 02 = stop selected)
        XcpPdu.byte(4) = 0x00;
        XcpPdu.byte(5) = 0x00;
        XcpPdu.byte(6) = 0x00;
        XcpPdu.byte(7) = 0x00;
        XcpPdu.byte(8) = 0x00;
        XcpPdu.byte(9) = 0x00;            
        XcpPdu.byte(10) = 0x00;
        XcpPdu.byte(11) = 0x00;
        XcpPdu.byte(12) = 0x00;
        XcpPdu.byte(13) = 0x00;
    
        FrUpdatePdu(XcpPdu,1,1);

//Verbindungsaufbau abgeschlossen
        connect_flag = 0;
    }
}


//Übertragt ODT 0
on frPDU XCP_Rs_VARIABLE5_FR
{
    //Umspeichern der erhaltenen Daten
    for( buffer_index = 0; buffer_index <= 36; buffer_index++)
    {
        rxbuffer[buffer_index] = this.byte((buffer_index) + overhead);
    }  
}

//Übertragt ODT 1
on frPDU XCP_Rs_VARIABLE1_FR
{
    //Umspeichern der erhaltenen Daten
    for( buffer_index = 37; buffer_index <= 73; buffer_index++)
    {
        rxbuffer[buffer_index] = this.byte((buffer_index - 37) + overhead);
    }  
}

//Übertragt ODT 2
on frPDU XCP_Rs_VARIABLE2_FR
{
    //Umspeichern der erhaltenen Daten
    for( buffer_index = 74; buffer_index <= 110; buffer_index++)
    {
        rxbuffer[buffer_index] = this.byte((buffer_index - 74) + overhead);
    }  
}

//Übertragt ODT 3
on frPDU XCP_Rs_VARIABLE3_FR
{
    //Umspeichern der erhaltenen Daten
    for( buffer_index = 111; buffer_index <= 127; buffer_index++)
    {
        rxbuffer[buffer_index] = this.byte((buffer_index - 111) + overhead);
    }  
      
    //Ist der rxbuffer mit allen ODTs gefüllt wird er in die Umgebungsvariable EnvXCPValuesODT geschrieben
    putValue(EnvXCPValuesODT,rxbuffer);
}