/*@@var:*/
variables
{
//Enthält die Daten aus der DAQ Liste. Muss angepasst werden, wenn die Byteanzahl in der DAQ Liste verändert wird
    byte rxbuffer[128];

//Zum ermittlen der einzelnen Botschaften
    int byte_index;
    int buffer_index;

//Zum unterscheiden der einzelnen Botschaften
    int message_counter;
    int initial_value;

//Anzahl der Nachrichten welche auf den Bus gesendet werden sollen inkl. 0. D.h. 1 Nachricht entspricht number_messages=0
// Muss je nach Byteanzahl in der DAQ Liste angepasst werden    
    int number_messages = 14;

//Speichert die einzelnen Bytes der CAN Botschaften    
    byte message_byte[8];

//Nachrichten die auf den CAN gesendet werden. Muss angepasst werden je nach number_messages   
    message can1.0x65C message0;
    message can1.0x65D message1;
    message can1.0x65E message2;
    message can1.0x65F message3;
    message can1.0x68A message4;
    message can1.0x68B message5;
    message can1.0x68C message6;
    message can1.0x68D message7;
    message can1.0x63A message8;
    message can1.0x63B message9;
    message can1.0x63C message10;
    message can1.0x63D message11;
    message can1.0x63E message12;
    message can1.0x63F message13;	

//Benötigt für die Umgebungsvariable "EnvXCPValuesODT", um eine Werteänderung zu erreichen
    byte none[128];
}
/*@@end*/

/*@@envVar:EnvXCPValuesODT:*/
on envVar EnvXCPValuesODT
{
    if(isOfflineMode() == 0x01)
    {
      getValue(EnvXCPValuesODT,rxbuffer);
  
      message0.dlc = 8;
      message0.byte(0) = rxbuffer[ 0];
      message0.byte(1) = rxbuffer[ 1];
      message0.byte(2) = rxbuffer[ 2];
      message0.byte(3) = rxbuffer[ 3];
      message0.byte(4) = rxbuffer[ 4];
      message0.byte(5) = rxbuffer[ 5];
      message0.byte(6) = rxbuffer[ 6];
      message0.byte(7) = rxbuffer[ 7];

      output(message0);

      message1.dlc = 8;
      message1.byte(0) = rxbuffer[  8];
      message1.byte(1) = rxbuffer[  9];
      message1.byte(2) = rxbuffer[ 10];
      message1.byte(3) = rxbuffer[ 11];
      message1.byte(4) = rxbuffer[ 12];
      message1.byte(5) = rxbuffer[ 13];
      message1.byte(6) = rxbuffer[ 14];
      message1.byte(7) = rxbuffer[ 15];

      output(message1);
    
      message2.dlc = 8;
      message2.byte(0) = rxbuffer[16];
      message2.byte(1) = rxbuffer[17];
      message2.byte(2) = rxbuffer[18];
      message2.byte(3) = rxbuffer[19];
      message2.byte(4) = rxbuffer[20];
      message2.byte(5) = rxbuffer[21];
      message2.byte(6) = rxbuffer[22];
      message2.byte(7) = rxbuffer[23];

      output(message2);

      message3.dlc = 8;
      message3.byte(0) = rxbuffer[ 24];
      message3.byte(1) = rxbuffer[ 25];
      message3.byte(2) = rxbuffer[ 26];
      message3.byte(3) = rxbuffer[ 27];
      message3.byte(4) = rxbuffer[ 28];
      message3.byte(5) = rxbuffer[ 29];
      message3.byte(6) = rxbuffer[ 30];
      message3.byte(7) = rxbuffer[ 31];

      output(message3);

      message4.dlc = 8;
      message4.byte(0) = rxbuffer[ 32];
      message4.byte(1) = rxbuffer[ 33];
      message4.byte(2) = rxbuffer[ 34];
      message4.byte(3) = rxbuffer[ 35];
      message4.byte(4) = rxbuffer[ 36];
      message4.byte(5) = rxbuffer[ 37];
      message4.byte(6) = rxbuffer[ 38];
      message4.byte(7) = rxbuffer[ 39];

      output(message4);

      message5.dlc = 8;
      message5.byte(0) = rxbuffer[ 40];
      message5.byte(1) = rxbuffer[ 41];
      message5.byte(2) = rxbuffer[ 42];
      message5.byte(3) = rxbuffer[ 43];
      message5.byte(4) = rxbuffer[ 44];
      message5.byte(5) = rxbuffer[ 45];
      message5.byte(6) = rxbuffer[ 46];
      message5.byte(7) = rxbuffer[ 47];

      output(message5);

      message6.dlc = 8;
      message6.byte(0) = rxbuffer[ 48];
      message6.byte(1) = rxbuffer[ 49];
      message6.byte(2) = rxbuffer[ 50];
      message6.byte(3) = rxbuffer[ 51];
      message6.byte(4) = rxbuffer[ 52];
      message6.byte(5) = rxbuffer[ 53];
      message6.byte(6) = rxbuffer[ 54];
      message6.byte(7) = rxbuffer[ 55];

      output(message6);

      message7.dlc = 8;
      message7.byte(0) = rxbuffer[ 56];
      message7.byte(1) = rxbuffer[ 57];
      message7.byte(2) = rxbuffer[ 58];
      message7.byte(3) = rxbuffer[ 59];
      message7.byte(4) = rxbuffer[ 60];
      message7.byte(5) = rxbuffer[ 61];
      message7.byte(6) = rxbuffer[ 62];
      message7.byte(7) = rxbuffer[ 63];

      output(message7);

      message8.dlc = 8;
      message8.byte(0) = rxbuffer[ 64];
      message8.byte(1) = rxbuffer[ 65];
      message8.byte(2) = rxbuffer[ 66];
      message8.byte(3) = rxbuffer[ 67];
      message8.byte(4) = rxbuffer[ 68];
      message8.byte(5) = rxbuffer[ 69];
      message8.byte(6) = rxbuffer[ 70];
      message8.byte(7) = rxbuffer[ 71];

      output(message8);

      message9.dlc = 8;
      message9.byte(0) = rxbuffer[ 72];
      message9.byte(1) = rxbuffer[ 73];
      message9.byte(2) = rxbuffer[ 74];
      message9.byte(3) = rxbuffer[ 75];
      message9.byte(4) = rxbuffer[ 76];
      message9.byte(5) = rxbuffer[ 77];
      message9.byte(6) = rxbuffer[ 78];
      message9.byte(7) = rxbuffer[ 79];

      output(message9);

      message10.dlc = 8;
      message10.byte(0) = rxbuffer[ 80];
      message10.byte(1) = rxbuffer[ 81];
      message10.byte(2) = rxbuffer[ 82];
      message10.byte(3) = rxbuffer[ 83];
      message10.byte(4) = rxbuffer[ 84];
      message10.byte(5) = rxbuffer[ 85];
      message10.byte(6) = rxbuffer[ 86];
      message10.byte(7) = rxbuffer[ 87];

      output(message10);

      message11.dlc = 8;
      message11.byte(0) = rxbuffer[ 88];
      message11.byte(1) = rxbuffer[ 89];
      message11.byte(2) = rxbuffer[ 90];
      message11.byte(3) = rxbuffer[ 91];
      message11.byte(4) = rxbuffer[ 92];
      message11.byte(5) = rxbuffer[ 93];
      message11.byte(6) = rxbuffer[ 94];
      message11.byte(7) = rxbuffer[ 95];

      output(message11);

      message12.dlc = 8;
      message12.byte(0) = rxbuffer[ 96];
      message12.byte(1) = rxbuffer[ 97];
      message12.byte(2) = rxbuffer[ 98];
      message12.byte(3) = rxbuffer[ 99];
      message12.byte(4) = rxbuffer[ 100];
      message12.byte(5) = rxbuffer[ 101];
      message12.byte(6) = rxbuffer[ 102];
      message12.byte(7) = rxbuffer[ 103];

      output(message12);

      message13.dlc = 8;
      message13.byte(0) = rxbuffer[ 104];
      message13.byte(1) = rxbuffer[ 105];
      message13.byte(2) = rxbuffer[ 106];
      message13.byte(3) = rxbuffer[ 107];
      message13.byte(4) = rxbuffer[ 108];
      message13.byte(5) = rxbuffer[ 109];
      message13.byte(6) = rxbuffer[ 110];
      message13.byte(7) = rxbuffer[ 111];

      output(message13);
    }
}
/*@@end*/

/*@@frPDU:*:*/
on frPDU *
{
    output(this);
}
/*@@end*/

/*@@msg:*:*/
on message *
{
    output(this);
}
/*@@end*/

/*@@frFrame:*:*/
on frFrame *
{
    output(this);
}
/*@@end*/

