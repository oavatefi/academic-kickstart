/*@!Encoding:1252*/
variables
{
    // Timer to simulate GPS Time (Seconds, Minutes, Hours)
    msTimer gps_timer;

    msTimer MsgTimer;

    // messages from PEIKER ECU
    message PEIKER_gps_date        gps_date; 
    message PEIKER_gps_time        gps_time;
    message PEIKER_gps_properties  gps_properties;
    message PEIKER_gps_location    gps_location;
  
    int seconds;
    int minutes;
    int hours;
  
    double Latitude;
    double Longitude;  

}

on start
{
    setTimerCyclic(MsgTimer, 20); // set message timer to 20ms
    setTimerCyclic(gps_timer, 1000); // set gps timer to 1s
  
    Latitude = 108277041; // ~ 30 Degrees
    Longitude = -111654912; // ~ -31 Degrees
    
    seconds = 0;
    minutes = 0;
    hours = 0;
  
    gps_date.ATM_gps_day.phys = 4;
    gps_date.ATM_gps_mon.phys = 3;
    gps_date.ATM_gps_year.phys = 2018;
  
    gps_properties.ATM_gps_accuracy_horizontal.phys = 18;
    gps_properties.ATM_gps_error_lat_position.phys = 3;
    gps_properties.ATM_gps_error_long_position.phys = 6;
    gps_properties.ATM_gps_quantity_sat_usage.phys = 10;
    gps_properties.ATM_gps_speed_horizontal.phys = 55;
  
    gps_location.ATM_gps_latitude.phys = Latitude;
    gps_location.ATM_gps_longitude.phys = Longitude;
  
}

on timer gps_timer
{
    seconds++;
  
    if (seconds == 60)
    {
        seconds = 0;
        minutes++; 
    }
    
    if (minutes == 60)
    {
        minutes = 0;
        hours++; 
    }
}

on timer MsgTimer
{ 
   output(gps_date);
  
   gps_time.ATM_gps_sec.phys = seconds;
   gps_time.ATM_gps_min.phys = minutes;
   gps_time.ATM_gps_hour.phys = hours;
   output(gps_time);  
 
  
   output(gps_location);
   output(gps_properties);
   
}

on message VS6_06
{
    gps_location.ATM_gps_latitude.phys = Latitude + this.VehXmm.phys;
    gps_location.ATM_gps_longitude.phys = Longitude + this.VehYmm.phys;
}