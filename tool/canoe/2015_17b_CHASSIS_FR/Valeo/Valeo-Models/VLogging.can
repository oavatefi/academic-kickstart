/*@@var:*/
variables
{
    CONST word MAX_CHAR = 512;
    CONST byte RESET = 0x00;
    CONST byte SET = 0x01;

    long Logging_Counter = 0;
    char Logging_Filename[MAX_CHAR];
    char Logging_Dummy[MAX_CHAR];

    CONST byte START_MODE = 0x01;
    CONST byte STOP_MODE = 0x02;

    CONST word PRELOGGINGTIMING = 200;
    msTimer preLoggingTimer;

    byte VLog_Status = 0x00;
}
/*@@end*/

/*@@envVar:VLog_Start:*/
/*--------------------------------------------------------------------------------------------------
Start Logging
Erstellt: 19.03.2012        Geändert: 03.09.2012
Erstellt: Markus Potok      Geändert: Markus Potok
---------------------------------------------------------------------------------------------------*/

on envVar VLog_Start
{
    if(getValue(VLog_Start) == 0x01)
    {
        if(getValue(VLog_Status) == RESET)
        {
            putValue(VLog_Status, SET);

            getValue(VLog_Path, Logging_Filename);
            strncat(Logging_Filename, "\\", MAX_CHAR);
            getValue(VLog_File, Logging_Dummy);
            strncat(Logging_Filename, Logging_Dummy, MAX_CHAR);
            ltoa(getValue(VLog_File_Number), Logging_Dummy, 10);
            strncat(Logging_Filename, "_", MAX_CHAR);
            strncat(Logging_Filename, Logging_Dummy, MAX_CHAR);                
            
            setLogfilename(Logging_Filename);

            cancelTimer(preLoggingTimer);
            setTimer(preLoggingTimer, 20);
        }
    }
}
/*@@end*/

/*@@envVar:VLog_Stop:*/
/*--------------------------------------------------------------------------------------------------
Stop Logging
Erstellt: 19.03.2012        Geändert: 1.03.2012
Erstellt: Markus Potok      Geändert: Markus Potok
---------------------------------------------------------------------------------------------------*/

on envVar VLog_Stop
{
    if(getValue(VLog_Stop) == 0x01)
    {
        if(getValue(VLog_Status) == SET)
        {
            putValue(VLog_Status, RESET);
            if(getValue(VLog_Auto_Inc) == SET)
            {
                putValue(VLog_File_Number, getValue(VLog_File_Number)+1);
            }
            VLog_Start_Manager(STOP_MODE);
        }
    }
}
/*@@end*/

/*@@startStart:Start:*/
/*--------------------------------------------------------------------------------------------------
Action at the start of the measurements
Erstellt: 19.03.2012        Geändert: 19.03.2012
Erstellt: Markus Potok      Geändert: Markus Potok
---------------------------------------------------------------------------------------------------*/

on start
{
    putValue(VLog_Status, RESET);
    putValue(VLog_File, "LOG_FILE");
    putValue(VLog_Path, "D:\\workset\\CANoe_Traces");
}
/*@@end*/

/*@@envVar:VLog_File:*/
/*--------------------------------------------------------------------------------------------------
Action if the file-name will change
Erstellt: 19.03.2012        Geändert: 19.03.2012
Erstellt: Markus Potok      Geändert: Markus Potok
---------------------------------------------------------------------------------------------------*/

on envVar VLog_File
{
    putvalue(VLog_File_Number, RESET);
}
/*@@end*/

/*@@frFrame:*:*/
on frFrame *
{
    output(this);
}
/*@@end*/

/*@@frPDU:*:*/
on frPDU *
{
    output(this);
}
/*@@end*/

/*@@msg:*:*/
on message *
{
    output(this);
}
/*@@end*/

/*@@caplFunc:VLog_Start_Manager(byte):*///function
/*--------------------------------------------------------------------------------------------------
Start_Manager
Erstellt: 03.09.2012        Geändert: 03.09.2012
Erstellt: Markus Potok      Geändert: Markus Potok
---------------------------------------------------------------------------------------------------*/

VLog_Start_Manager(byte mode_p)
{
    if(mode_p == START_MODE)
    {
        startLogging("Logging");
        if(getValue(VLog_CAN) == 0x01)
        {
            startLogging("Logging CAN");
        }
        if(getValue(VLog_Flexray) == 0x01)
        {
            startLogging("Logging Flexray");
        }
    }
    else
    {
        stopLogging("Logging");
        stopLogging("Logging Flexray");
        stopLogging("Logging CAN");
    }     
}
/*@@end*/

/*@@frFrameError:*:*/
on frFrameError *
{
    output(this);
}
/*@@end*/

/*@@frError:FlexRay Error:*/
on frError
{
}
/*@@end*/

/*@@preStart:PreStart:*/
on preStart
{
    setLogfilename("D:\\workset\\CANoe_Traces\\dummy");
}
/*@@end*/

/*@@timer:preLoggingTimer:*/
on timer preLoggingTimer
{
    cancelTimer(preLoggingTimer);
    switch(VLog_Status)
    {
        case 0x00:
            VLog_Status++;
            VLog_Start_Manager(STOP_MODE);
            setTimer(preLoggingTimer, 100);
            break;
        case 0x01:
            VLog_Status++;
            VLog_Start_Manager(START_MODE);
            setTimer(preLoggingTimer, 100);
            break;
        case 0x02:
            VLog_Status++;
            VLog_Start_Manager(STOP_MODE);
            setTimer(preLoggingTimer, 100);
            break;
        case 0x03:
            VLog_Status = 0x00;
            VLog_Start_Manager(START_MODE);
            break;
        default:
            VLog_Status = 0x00;
            break;
    }
}
/*@@end*/

