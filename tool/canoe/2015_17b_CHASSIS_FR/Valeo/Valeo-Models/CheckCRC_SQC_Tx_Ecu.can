includes
{
  
}

variables
{
  
   int  sequenceArray[0x1000];
  
  byte  SQC_ParkSensObj1   = 0xff;
  byte  SQC_ParkSensObj2   = 0xff;
  byte  SQC_St_Rq_PARK     = 0xff;
  byte  SQC_RemPark_Rq     = 0xff;
  byte  SQC_Brk_Rq_PARK    = 0xff;
  byte  SQC_SADR_Trgr_PARK = 0xff;
  byte  SQC_ParkCfg_Stat    = 0xff;
  byte  SQC_Park_Disp_Rq   = 0xff;
  
  /* Merker ob sqc error aufgetreten*/
  int  SQC_ParkSensObj1_err   = 0;
  int  SQC_ParkSensObj2_err   = 0;
  int  SQC_St_Rq_PARK_err     = 0;
  int  SQC_RemPark_Rq_err     = 0;
  int  SQC_Brk_Rq_PARK_err    = 0;
  int  SQC_SADR_Trgr_PARK_err = 0;
  int  SQC_ParkCfg_Stat_err    = 0;
  int  SQC_Park_Disp_Rq_Pr2_err    =0;
  
  int  SQC_ParkSensObj1_errF   = 0;
  int  SQC_ParkSensObj2_errF   = 0;
  int  SQC_St_Rq_PARK_errF     = 0;
  int  SQC_RemPark_Rq_errF     = 0;
  int  SQC_Brk_Rq_PARK_errF    = 0;
  int  SQC_SADR_Trgr_PARK_errF = 0;
  int  SQC_ParkCfg_Stat_errF    = 0;
  int  SQC_Park_Disp_Rq_Pr2_errF    =0;
  
  /* Merker ob crc error aufgetreten*/
  int  CRC_ParkSensObj1_err   = 0;
  int  CRC_ParkSensObj2_err   = 0;
  int  CRC_St_Rq_PARK_err     = 0;
  int  CRC_RemPark_Rq_err     = 0;
  int  CRC_Brk_Rq_PARK_err    = 0;
  int  CRC_SADR_Trgr_PARK_err = 0;
  int  CRC_ParkCfg_Stat_err    = 0;  
  int  CRC_Park_Disp_Rq_Pr2_err    =0;
  
                                    /*   SQC Wert   0     1     2     3     4     5     6     7     8     9     A     B     C     D     E     F       */
   byte SQC_ParkSensObj_Stat1_Pr2[16]          = {0x5d, 0x89, 0xb5, 0xe1, 0x12, 0x3e, 0x6a, 0x96, 0xc2, 0xee, 0x1f, 0x4b, 0x77, 0xa3, 0xcf, 0xfb};
   byte SQC_ParkSensObj_Stat2_Pr2[16]          = {0xc6, 0xe2, 0x03, 0x1f, 0x3b, 0x57, 0x73, 0x8f, 0xab, 0xc7, 0xe3, 0x04, 0x20, 0x3c, 0x58, 0x74};
   byte SQC_St_Rq_PARK_Pr2[16]                 = {0x3c, 0x5b, 0x7a, 0x99, 0xb8, 0xd7, 0xf6, 0x1a, 0x39, 0x58, 0x77, 0x96, 0xb5, 0xd4, 0xf3, 0x17};
   byte SQC_RemPark_Rq_Pr2[16]                 = {0xd3, 0x67, 0xf6, 0x8a, 0x1e, 0xad, 0x41, 0xd0, 0x64, 0xf3, 0x87, 0x1b, 0xaa, 0x3e, 0xcd, 0x61};
   byte SQC_Brk_Rq_PARK_Pr2[16]                = {0x84, 0xa2, 0xc0, 0xde, 0xfc, 0x1f, 0x3d, 0x5b, 0x79, 0x97, 0xb5, 0xd3, 0xf1, 0x14, 0x32, 0x50};
   byte SQC_SADR_Trgr_PARK_Pr2[16]             = {0x8d, 0x53, 0x19, 0xda, 0xa0, 0x66, 0x2c, 0xed, 0xb3, 0x79, 0x3f, 0x05, 0xc6, 0x8c, 0x52, 0x18};
   byte SQC_Park_Disp_Rq_Pr2[16]               = {0xd8, 0x13, 0x49, 0x7f, 0xb5, 0xeb, 0x26, 0x5c, 0x92, 0xc8, 0x03, 0x39, 0x6f, 0xa5, 0xdb, 0x16};
   byte SQC_ParkCfg_Stat_Pr2[16]               = {0x27, 0x88, 0xe9, 0x4f, 0xb0, 0x16, 0x77, 0xd8, 0x3e, 0x9f, 0x05, 0x66, 0xc7, 0x2d, 0x8e, 0xef};

  
   byte  crctableProfTwo[256] = {
			0x00, 0x2F, 0x5E, 0x71, 0xBC, 0x93, 0xE2, 0xCD,
			0x57, 0x78, 0x09, 0x26, 0xEB, 0xC4, 0xB5, 0x9A,
			0xAE, 0x81, 0xF0, 0xDF, 0x12, 0x3D, 0x4C, 0x63,
			0xF9, 0xD6, 0xA7, 0x88, 0x45, 0x6A, 0x1B, 0x34,
			0x73, 0x5C, 0x2D, 0x02, 0xCF, 0xE0, 0x91, 0xBE,
			0x24, 0x0B, 0x7A, 0x55, 0x98, 0xB7, 0xC6, 0xE9,
			0xDD, 0xF2, 0x83, 0xAC, 0x61, 0x4E, 0x3F, 0x10,
			0x8A, 0xA5, 0xD4, 0xFB, 0x36, 0x19, 0x68, 0x47,
			0xE6, 0xC9, 0xB8, 0x97, 0x5A, 0x75, 0x04, 0x2B,
			0xB1, 0x9E, 0xEF, 0xC0, 0x0D, 0x22, 0x53, 0x7C,
			0x48, 0x67, 0x16, 0x39, 0xF4, 0xDB, 0xAA, 0x85,
			0x1F, 0x30, 0x41, 0x6E, 0xA3, 0x8C, 0xFD, 0xD2,
			0x95, 0xBA, 0xCB, 0xE4, 0x29, 0x06, 0x77, 0x58,
			0xC2, 0xED, 0x9C, 0xB3, 0x7E, 0x51, 0x20, 0x0F,
			0x3B, 0x14, 0x65, 0x4A, 0x87, 0xA8, 0xD9, 0xF6,
			0x6C, 0x43, 0x32, 0x1D, 0xD0, 0xFF, 0x8E, 0xA1,
			0xE3, 0xCC, 0xBD, 0x92, 0x5F, 0x70, 0x01, 0x2E,
			0xB4, 0x9B, 0xEA, 0xC5, 0x08, 0x27, 0x56, 0x79,
			0x4D, 0x62, 0x13, 0x3C, 0xF1, 0xDE, 0xAF, 0x80,
			0x1A, 0x35, 0x44, 0x6B, 0xA6, 0x89, 0xF8, 0xD7,
			0x90, 0xBF, 0xCE, 0xE1, 0x2C, 0x03, 0x72, 0x5D,
			0xC7, 0xE8, 0x99, 0xB6, 0x7B, 0x54, 0x25, 0x0A,
			0x3E, 0x11, 0x60, 0x4F, 0x82, 0xAD, 0xDC, 0xF3,
			0x69, 0x46, 0x37, 0x18, 0xD5, 0xFA, 0x8B, 0xA4,
			0x05, 0x2A, 0x5B, 0x74, 0xB9, 0x96, 0xE7, 0xC8,
			0x52, 0x7D, 0x0C, 0x23, 0xEE, 0xC1, 0xB0, 0x9F,
			0xAB, 0x84, 0xF5, 0xDA, 0x17, 0x38, 0x49, 0x66,
			0xFC, 0xD3, 0xA2, 0x8D, 0x40, 0x6F, 0x1E, 0x31,
			0x76, 0x59, 0x28, 0x07, 0xCA, 0xE5, 0x94, 0xBB,
			0x21, 0x0E, 0x7F, 0x50, 0x9D, 0xB2, 0xC3, 0xEC,
			0xD8, 0xF7, 0x86, 0xA9, 0x64, 0x4B, 0x3A, 0x15,
			0x8F, 0xA0, 0xD1, 0xFE, 0x33, 0x1C, 0x6D, 0x42
   }; 


}

on envVar Start_Check
{
     write("SQC Fehler:");
     write("           ");
     write("2er Schritt SQC_St_Rq_PARK = %x", SQC_St_Rq_PARK_err);
     write("2er Schritt SQC_Brk_Rq_PARK = %x", SQC_Brk_Rq_PARK_err);
     write("2er Schritt SQC_RemPark_Rq = %x", SQC_RemPark_Rq_err);
     write("          Schritt > 2 SQC_St_Rq_PARK = %x", SQC_St_Rq_PARK_errF);
     write("          Schritt > 2 SQC_Brk_Rq_PARK = %x", SQC_Brk_Rq_PARK_errF);
     write("          Schritt > 2 SQC_RemPark_Rq = %x", SQC_RemPark_Rq_errF);
     write("           ");
     write("           ");
 
     write("CRC Fehler:");
     write("           ");
     write("CRC_St_Rq_PARK = %x", CRC_St_Rq_PARK_err);
     write("CRC_Brk_Rq_PARK = %x", CRC_Brk_Rq_PARK_err);
     write("CRC_RemPark_Rq = %x", CRC_RemPark_Rq_err);
  
     SQC_ParkSensObj1_err   = 0;
     SQC_ParkSensObj2_err   = 0;
     SQC_St_Rq_PARK_err     = 0;
     SQC_RemPark_Rq_err     = 0;
     SQC_Brk_Rq_PARK_err    = 0;
     SQC_SADR_Trgr_PARK_err = 0;
     SQC_ParkCfg_Stat_err    = 0;
     SQC_Park_Disp_Rq_Pr2_err    =0;
  
     SQC_ParkSensObj1_errF   = 0;
     SQC_ParkSensObj2_errF   = 0;
     SQC_St_Rq_PARK_errF     = 0;
     SQC_RemPark_Rq_errF     = 0;
     SQC_Brk_Rq_PARK_errF    = 0;
     SQC_SADR_Trgr_PARK_errF = 0;
     SQC_ParkCfg_Stat_errF    = 0;
     SQC_Park_Disp_Rq_Pr2_errF    =0;
 
}

on frPDU St_Rq_PARK_AR2
{
        int CRC_FirstByte = 1;
        int CRC_LastByte = 7; 
        int mc_pos_in_byte;
        int MC_Pos = 1;
        int mc_pos_im_byte = 1;       //1 = unteren 4 Bit 0 = oberen 4 Bits
        int mc_mask =0x0f;
        int i;
        byte crc;
        int sqc_read;
        int crc_read;

  if(this.DIR == RX)
  {
 
        if(mc_pos_im_byte == 1)
        {
          sqc_read = (this.SQC_St_Rq_PARK_Pr2) & mc_mask;
        }
        else
        {
          sqc_read = ((this.SQC_St_Rq_PARK_Pr2) & 0xf0)>> 4;  
        }
        // Chech gerade gestartet
        if (SQC_St_Rq_PARK == 0xff)
        {
           SQC_St_Rq_PARK =  sqc_read;
        }
        else // check SQC Counter
        {
          SQC_St_Rq_PARK++;
          // If ReferenzCounter > 0x10 then set 0
          if (SQC_St_Rq_PARK == 0x10)
          {
            SQC_St_Rq_PARK = 0;
          }
          if (SQC_St_Rq_PARK != sqc_read)
          {
            SQC_St_Rq_PARK_err++;
            
            if ((SQC_St_Rq_PARK + 1) != sqc_read)
            {
              if ((SQC_St_Rq_PARK == 0x0F) && (sqc_read != 0))
              {
                write("ERROR SQC Jump St_Rq_PARK_Pr2 SQC should = %x  SQC is  =   %x   timestamp %4.6f",SQC_St_Rq_PARK,sqc_read, (timeNowFloat()/100000.0));
                SQC_St_Rq_PARK_errF++;
              }
              
            }
           SQC_St_Rq_PARK =  sqc_read;
          }
           
        }
        crc_read = this.CRC_St_Rq_PARK_Pr2;
        crc = 0xFF;
     //    write("Byte CRC %x",crc_read);
        for (i = CRC_FirstByte; i < CRC_LastByte+1;i++)
        { 
            crc = (byte)crctableProfTwo[crc ^ this.byte(i)];
       //     write(" i= %i byte= %x",i,this.byte(i)) ;
        }
        
        crc =  crctableProfTwo[crc ^ SQC_St_Rq_PARK_Pr2[sqc_read]];  
        crc = (byte)(crc ^ 0xFF);
        //write("SQC %x CRC = %x timestamp %4.6f",crc,sqc_read,(timeNowFloat()/100000.0));
        if ( crc != crc_read)
        {
          CRC_St_Rq_PARK_err++;
          write("ERROR CRC St_Rq_PARK_Pr2 %x CRC = %x timestamp %4.6f ",sqc_read,crc,(timeNowFloat()/100000.0));    
        }
  } 
}


on frPDU RemPark_Rq_AR2
{
  if(this.DIR == RX)
  {
        int CRC_FirstByte = 1;
        int CRC_LastByte = 3; 
        int mc_pos_in_byte;
        int MC_Pos = 1;
        int mc_pos_im_byte = 1;       //1 = unteren 4 Bit 0 = oberen 4 Bits
        int mc_mask =0x0f;
        int i;
        byte crc;
        int sqc_read;
        int crc_read;
 
        if(mc_pos_im_byte == 1)
        {
          sqc_read = (this.SQC_RemPark_Rq_Pr2) & mc_mask;
        }
        else
        {
          sqc_read = ((this.SQC_RemPark_Rq_Pr2) & 0xf0)>> 4;  
        }
        // Chech gerade gestartet
        if (SQC_RemPark_Rq == 0xff)
        {
           SQC_RemPark_Rq =  sqc_read;
        }
        else // check SQC Counter
        {
          SQC_RemPark_Rq++;
          // If ReferenzCounter > 0x10 then set 0
          if (SQC_RemPark_Rq == 0x10)
          {
            SQC_RemPark_Rq = 0;
          }
          if (SQC_RemPark_Rq != sqc_read)
          {
            SQC_RemPark_Rq_err++;
            
            if ((SQC_RemPark_Rq + 1) != sqc_read)
            {
              if ((SQC_RemPark_Rq == 0x0F) && (sqc_read != 0))
              {
                write("ERROR SQC Jump SQC_RemPark_Rq_Pr2 SQC should  =   %x  SQC is  =  %x  timestamp %4.6f", SQC_RemPark_Rq ,sqc_read, (timeNowFloat()/100000.0));
                SQC_RemPark_Rq_errF++;
              }
            }
            SQC_RemPark_Rq =  sqc_read;
          }
           
        }
        //write("sqc = %x und %x",sqc_read,this.SQC_RemPark_Rq_Pr2);
        crc_read = this.CRC_RemPark_Rq_Pr2;
        crc = 0xFF;
      //   write("Byte CRC %x",crc_read);
        for (i = CRC_FirstByte; i < CRC_LastByte+1;i++)
        { 
            crc = (byte)crctableProfTwo[crc ^ this.byte(i)];
        //    write(" i= %i byte= %x",i,this.byte(i)) ;
        }
        
        crc =  crctableProfTwo[crc ^ SQC_RemPark_Rq_Pr2[sqc_read]];  
        crc = (byte)(crc ^ 0xFF);
        //write("SQC %x CRC = %x timestamp %4.6f",crc,sqc_read,(timeNowFloat()/100000.0));
        if ( crc != crc_read)
        {
          CRC_ParkSensObj1_err++;
          write("ERROR CRC RemPark_Rq_Pr2 %x CRC = %x timestamp %4.6f ",sqc_read,crc,(timeNowFloat()/100000.0));    
        }
  }     
}

on frPDU Park_Disp_Rq_AR2
{
 if(this.DIR == RX)
  {
        int CRC_FirstByte = 1;
        int CRC_LastByte = 7; 
        int mc_pos_in_byte;
        int MC_Pos = 1;
        int mc_pos_im_byte = 1;       //1 = unteren 4 Bit 0 = oberen 4 Bits
        int mc_mask =0x0f;
        int i;
        byte crc;
        int sqc_read;
        int crc_read;
 
        if(mc_pos_im_byte == 1)
        {
          sqc_read = (this.SQC_Park_Disp_Rq_Pr2) & mc_mask;
        }
        else
        {
          sqc_read = ((this.SQC_Park_Disp_Rq_Pr2) & 0xf0)>> 4;  
        }
        // Chech gerade gestartet
        if (SQC_Park_Disp_Rq == 0xff)
        {
           SQC_Park_Disp_Rq =  sqc_read;
        }
        else // check SQC Counter
        {
          SQC_Park_Disp_Rq++;
          // If ReferenzCounter > 0x10 then set 0
          if (SQC_Park_Disp_Rq == 0x10)
          {
            SQC_Park_Disp_Rq = 0;
          }
          if (SQC_Park_Disp_Rq != sqc_read)
          {
            SQC_Park_Disp_Rq_Pr2_err++;
            if ((SQC_Park_Disp_Rq + 1) != sqc_read)
            {
              if ((SQC_Park_Disp_Rq == 0x0F) && (sqc_read != 0))
              {
                write("ERROR SQC Jump Park_Disp_Rq_Pr2 SQC should  =  %x  SQC is  =  %x   timestamp %4.6f", SQC_Park_Disp_Rq,sqc_read, (timeNowFloat()/100000.0));
                SQC_Park_Disp_Rq_Pr2_errF++;
              }
            }
            SQC_Park_Disp_Rq =  sqc_read;
          }
           
        }
        //write("sqc = %x und %x",sqc_read,this.SQC_Park_Disp_Rq_Pr2);
        crc_read = this.CRC_Park_Disp_Rq_Pr2;
        crc = 0xFF;
       //  write("Byte CRC %x",crc_read);
        for (i = CRC_FirstByte; i < CRC_LastByte+1;i++)
        { 
            crc = (byte)crctableProfTwo[crc ^ this.byte(i)];
          //  write(" i= %i byte= %x",i,this.byte(i)) ;
        }
        
        crc =  crctableProfTwo[crc ^ SQC_Park_Disp_Rq_Pr2[sqc_read]];  
        crc = (byte)(crc ^ 0xFF);
        //write("SQC %x CRC = %x timestamp %4.6f",crc,sqc_read,(timeNowFloat()/100000.0));
        if ( crc != crc_read)
        {
          CRC_ParkSensObj1_err++;
          write("ERROR CRC Park_Disp_Rq_Pr2 %x CRC = %x timestamp %4.6f ",sqc_read,crc,(timeNowFloat()/100000.0));    
        }
  }   
}

on frPDU Park_Stat_AR2
{
  if(this.DIR == RX)
  {
        int CRC_FirstByte = 1;
        int CRC_LastByte = 3; 
        int mc_pos_in_byte;
        int MC_Pos = 1;
        int mc_pos_im_byte = 1;       //1 = unteren 4 Bit 0 = oberen 4 Bits
        int mc_mask =0x0f;
        int i;
        byte crc;
        int sqc_read;
        int crc_read;
 
        if(mc_pos_im_byte == 1)
        {
          sqc_read = (this.SQC_ParkCfg_Stat_Pr2) & mc_mask;
        }
        else
        {
          sqc_read = ((this.SQC_ParkCfg_Stat_Pr2) & 0xf0)>> 4;  
        }
        // Chech gerade gestartet
        if (SQC_ParkCfg_Stat == 0xff)
        {
           SQC_ParkCfg_Stat =  sqc_read;
        }
        else // check SQC Counter
        {
          SQC_ParkCfg_Stat++;
          // If ReferenzCounter > 0x10 then set 0
          if (SQC_ParkCfg_Stat == 0x10){SQC_ParkCfg_Stat = 0;}
          if (SQC_ParkCfg_Stat != sqc_read)
          {
            SQC_ParkCfg_Stat_err++;
            if ((SQC_ParkCfg_Stat + 1) != sqc_read)
            {
              if ((SQC_ParkCfg_Stat == 0x0F) && (sqc_read != 0))
              {
                write("ERROR SQC Jump Park_Stat_AR2 SQC should   =   %x  SQC is   =  %x  timestamp %4.6f", SQC_ParkCfg_Stat,sqc_read, (timeNowFloat()/100000.0));
                SQC_ParkCfg_Stat_errF++;
              }
            }
            SQC_ParkCfg_Stat =  sqc_read;
          }
           
        }
        //write("sqc = %x und %x",sqc_read,this.SQC_ParkCfg_Stat_Pr2);
        crc_read = this.CRC_ParkCfg_Stat_Pr2;
        crc = 0xFF;
       //  write("Byte CRC %x",crc_read);
        for (i = CRC_FirstByte; i < CRC_LastByte+1;i++)
        { 
            crc = (byte)crctableProfTwo[crc ^ this.byte(i)];
          //  write(" i= %i byte= %x",i,this.byte(i)) ;
        }
        
        crc =  crctableProfTwo[crc ^ SQC_ParkCfg_Stat_Pr2[sqc_read]];  
        crc = (byte)(crc ^ 0xFF);
        //write("SQC %x CRC = %x timestamp %4.6f",crc,sqc_read,(timeNowFloat()/100000.0));
        if ( crc != crc_read)
        {
          CRC_ParkSensObj1_err++;
          write("ERROR CRC Park_Stat_AR2 SQC %x CRC = %x timestamp %4.6f ",sqc_read,crc,(timeNowFloat()/100000.0));    
        }
  }  
}



on frPDU ParkSensObj_Stat1_FR2
{
  if(this.DIR == RX)
  {
        byte _Data_In_Payload[18];
        int CRC_FirstByte = 1;
        int CRC_LastByte = 17; 
        int mc_pos_in_byte;
        int MC_Pos = 1;
        int mc_pos_im_byte = 1;       //1 = unteren 4 Bit 0 = oberen 4 Bits
        int mc_mask =0x0f;
        int i;
        byte crc;
        int sqc_read;
        int crc_read;
 
        if(mc_pos_im_byte == 1)
        {
          sqc_read = (this.SQC_ParkSensObj_Stat1_Pr2) & mc_mask;
        }
        else
        {
          sqc_read = ((this.SQC_ParkSensObj_Stat1_Pr2) & 0xf0)>> 4;  
        }
        // Chech gerade gestartet
        if (SQC_ParkSensObj1 == 0xff)
        {
           SQC_ParkSensObj1 =  sqc_read;
        }
        else // check SQC Counter
        {
          SQC_ParkSensObj1++;
          // If ReferenzCounter > 0x10 then set 0
          if (SQC_ParkSensObj1 == 0x10){SQC_ParkSensObj1 = 0;}
          if (SQC_ParkSensObj1 != sqc_read)
          {
            SQC_ParkSensObj1_err++;
            if ((SQC_ParkSensObj1 + 1) != sqc_read)
            {
              if ((SQC_ParkSensObj1 == 0x0F) && (sqc_read != 0))
              {
                write("ERROR SQC Jump ParkSensObj_Stat1_FR2 SQC should   = %x   SQC is  =   %x timestamp %4.6f", SQC_ParkSensObj1,sqc_read, (timeNowFloat()/100000.0));
                SQC_ParkSensObj1_errF++;
              }
            }
            SQC_ParkSensObj1 =  sqc_read;
          }
           
        }
        //write("sqc = %x und %x",sqc_read,this.SQC_ParkSensObj_Stat1_Pr2);
        crc_read = this.CRC_ParkSensObj_Stat1_Pr2;
        crc = 0xFF;
        for (i = CRC_FirstByte; i < CRC_LastByte+1;i++)
        { 
            crc = (byte)crctableProfTwo[crc ^ this.byte(i)];
           // write(" i= %i byte= %x",i,this.byte(i)) ;
        }
        
        crc =  crctableProfTwo[crc ^ SQC_ParkSensObj_Stat1_Pr2[sqc_read]];  
        crc = (byte)(crc ^ 0xFF);
        //write("SQC %x CRC = %x",crc,sqc_read,this.time);
        if ( crc != crc_read)
        {
          CRC_ParkSensObj1_err++;
          write("ERROR CRC ParkSensObj_Stat1_FR2SQC %x CRC = %x timestamp %4.6f ",sqc_read,crc,(timeNowFloat()/100000.0));    
        }
  }
 
}

on frPDU ParkSensObj_Stat2_FR2
{
  if(this.DIR == RX)
  {
        byte _Data_In_Payload[18];
        int CRC_FirstByte = 1;
        int CRC_LastByte = 17; 
        int mc_pos_in_byte;
        int MC_Pos = 1;
        int mc_pos_im_byte = 1;       //1 = unteren 4 Bit 0 = oberen 4 Bits
        int mc_mask =0x0f;
        int i;
        byte crc;
        int sqc_read;
        int crc_read;
 
        if(mc_pos_im_byte == 1)
        {
          sqc_read = (this.SQC_ParkSensObj_Stat2_Pr2) & mc_mask;
        }
        else
        {
          sqc_read = ((this.SQC_ParkSensObj_Stat2_Pr2) & 0xf0)>> 4;  
        }
        if (SQC_ParkSensObj2 == 0xff)
        {
           SQC_ParkSensObj2 =  sqc_read;
        }
        else // check SQC Counter
        {
          SQC_ParkSensObj2++;
          // If ReferenzCounter > 0x10 then set 0
          if (SQC_ParkSensObj2 == 0x10)
          {
            SQC_ParkSensObj2 = 0;
          }
          if (SQC_ParkSensObj2 != sqc_read)
          {
            SQC_ParkSensObj2_err++;
            if ((SQC_ParkSensObj2 + 1) != sqc_read)
            {
              if ((SQC_ParkSensObj2 == 0x0F) && (sqc_read != 0))
              {
                write("ERROR SQC Jump ParkSensObj_Stat2_FR2 SQC should  =  %x    SQC is   =  %x   timestamp %4.6f",SQC_ParkSensObj2,sqc_read, (timeNowFloat()/100000.0));
                SQC_ParkSensObj2_errF++;
              }
            }
            SQC_ParkSensObj2 =  sqc_read;
          }
           
        }
        
        //write("sqc = %x und %x",sqc_read,this.SQC_ParkSensObj_Stat2_Pr2);
        crc_read = this.CRC_ParkSensObj_Stat2_Pr2;
        crc = 0xFF;
        for (i = CRC_FirstByte; i < CRC_LastByte+1;i++)
        { 
            crc = (byte)crctableProfTwo[crc ^ this.byte(i)];
           // write(" i= %i byte= %x",i,this.byte(i)) ;
        }
        
        crc =  crctableProfTwo[crc ^ SQC_ParkSensObj_Stat2_Pr2[sqc_read]];  
        crc = (byte)(crc ^ 0xFF);
        //write("SQC %x CRC = %x",crc,sqc_read,this.time);
        if ( crc != crc_read)
        {
           CRC_ParkSensObj2_err++;
          write("ERROR CRC ParkSensObj_Stat2_FR2 SQC %x CRC = %x timestamp %4.6f ",sqc_read,crc,(timeNowFloat()/100000.0));    
        }
  }
 
}

on frPDU Brk_Rq_PARK_AR2
{
  if(this.DIR == RX)
  {
        byte _Data_In_Payload[18];
        int CRC_FirstByte = 1;
        int CRC_LastByte = 7; 
        int mc_pos_in_byte;
        int MC_Pos = 1;
        int mc_pos_im_byte = 1;       //1 = unteren 4 Bit 0 = oberen 4 Bits
        int mc_mask =0x0f;
        int i;
        byte crc;
        int sqc_read;
        int crc_read;
 
        if(mc_pos_im_byte == 1)
        {
          sqc_read = (this.SQC_Brk_Rq_PARK_Pr2) & mc_mask;
        }
        else
        {
          sqc_read = ((this.SQC_Brk_Rq_PARK_Pr2) & 0xf0)>> 4;  
        }
        if (SQC_Brk_Rq_PARK == 0xff)
        {
           SQC_Brk_Rq_PARK =  sqc_read;
        }
        else // check SQC Counter
        {
          SQC_Brk_Rq_PARK++;
          // If ReferenzCounter > 0x10 then set 0
          if (SQC_Brk_Rq_PARK == 0x10){SQC_Brk_Rq_PARK = 0;}
          if (SQC_Brk_Rq_PARK != sqc_read)
          {
            SQC_Brk_Rq_PARK_err++;
            
            if ((SQC_Brk_Rq_PARK + 1) != sqc_read) 
            {
              if (((SQC_Brk_Rq_PARK) == 0x0F) && (sqc_read != 0))
              {
                write("ERROR SQC Jump Brk_Rq_PARK_Pr2 SQC should = %x    SQC is  = %x   timestamp %4.6f",SQC_Brk_Rq_PARK,sqc_read, (timeNowFloat()/100000.0));
                SQC_Brk_Rq_PARK_errF++;
              }
            }
            SQC_Brk_Rq_PARK =  sqc_read;
          }
           
        }
        crc_read = this.CRC_Brk_Rq_PARK_Pr2;
        crc = 0xFF;
        for (i = CRC_FirstByte; i < CRC_LastByte+1;i++)
        { 
            crc = (byte)crctableProfTwo[crc ^ this.byte(i)];
           // write(" i= %i byte= %x",i,this.byte(i)) ;
        }
        
        crc =  crctableProfTwo[crc ^ SQC_Brk_Rq_PARK_Pr2[sqc_read]];  
        crc = (byte)(crc ^ 0xFF);
        //write("SQC %x CRC = %x",crc,sqc_read,this.time);
        if ( crc != crc_read)
        {
          write("ERROR CRC Brk_Rq_PARK_Pr2 SQC %x CRC = %x timestamp %4.6f ",sqc_read,crc,(timeNowFloat()/100000.0));    
        }
  }  
}


