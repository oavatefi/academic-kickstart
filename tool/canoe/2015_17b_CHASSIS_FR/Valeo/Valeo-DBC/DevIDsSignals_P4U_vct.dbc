VERSION "HINBNNNYNNNNNNNNNNNNNNNNNNNNNNNNNNNNNNNNNN/4/%%%/4/'%**4NNN///"

NS_ :

BS_:

BU_: ValeoDAS
VAL_TABLE_ VCTC_LotCtrlAction 7 "VCTC_LOT_CTRL_FULL_AUTOMATIC" 6 "VCTC_LOT_CTRL_SPEED_REGULATION" 5 "VCTC_LOT_CTRL_START_UP" 4 "VCTC_LOT_CTRL_HOLD_POSITION" 3 "VCTC_LOT_CTRL_COMFORT_BRAKING" 2 "VCTC_LOT_CTRL_EXTERNAL_BRAKING" 1 "VCTC_LOT_CTRL_EMERGENCY_BRAKING" 0 "VCTC_LOT_CTRL_NONE" ;
VAL_TABLE_ VCTC_AbortCriterion 5 "VCTC_ABORT_CRIT_GENERAL" 4 "VCTC_ABORT_CRIT_LOT_MODE" 3 "VCTC_ABORT_CRIT_NUM_BRAKES" 2 "VCTC_ABORT_CRIT_CONTROL_LAG" 1 "VCTC_ABORT_CRIT_TORQUE" 0 "VCTC_ABORT_CRIT_NONE" ;

BO_ 1597 P4UDev11_VctData_Rtm: 8 Vector__XXX
 SG_ DIDH_VCT_Runtime m1 : 56|8@1+ (64,0) [0|0] "탎" Vector__XXX
 SG_ DAPM_VCT_Runtime m1 : 40|8@1+ (64,0) [0|0] "탎" Vector__XXX
 SG_ DAPM_VCT_Calltime m1 : 32|8@1+ (256,0) [0|0] "탎" Vector__XXX
 SG_ VCTL_Runtime m1 : 48|8@1+ (64,0) [0|0] "탎" Vector__XXX
 SG_ VCTM_EncodedDataStarting m1 : 7|1@1+ (1,0) [0|0] "" Vector__XXX
 SG_ VCTM_EncodedVelocitySegments m1 : 8|16@1+ (1,0) [0|0] "" Vector__XXX
 SG_ VCTM_EncodedDynamicLotConfig m1 : 24|4@1+ (1,0) [0|0] "" Vector__XXX
 SG_ VCTM_LotCtrlAction m1 : 28|4@1+ (1,0) [0|15] "" Vector__XXX
 SG_ VCTM_IsGearChangeAllowed m1 : 6|1@1+ (1,0) [0|0] "" Vector__XXX
 SG_ VCTM_MaxVelocityExt m1 : 1|5@1+ (0.1,0) [0|3.1] "m/s" Vector__XXX
 SG_ VCTM_IsSteerBackEnabled m0 : 4|1@1+ (1,0) [0|0] "" Vector__XXX
 SG_ VCTM_IsWheelAngleLimitActive m0 : 3|1@1+ (1,0) [0|0] "" Vector__XXX
 SG_ VCTM_IsInitialSteeringLimited m0 : 2|1@1+ (1,0) [0|0] "" Vector__XXX
 SG_ DAPM_DistToHint m0 : 40|11@1- (1,0) [0|0] "cm" Vector__XXX
 SG_ DAPM_DistToCollision m0 : 51|11@1- (1,0) [0|0] "cm" Vector__XXX
 SG_ VCTL_AbortCriterion m0 : 5|3@1+ (1,0) [0|0] "" Vector__XXX
 SG_ VCTM_IsPosTrafoValid m0 : 63|1@1+ (1,0) [0|0] "" Vector__XXX
 SG_ VCTM_IsPathNewToggle m0 : 1|1@1+ (1,0) [0|0] "" Vector__XXX
 SG_ VCTM_IsOperatorPosInBuffer m0 : 62|1@1+ (1,0) [0|0] "" Vector__XXX
 SG_ VCTM_OperatorTimestampDelay m0 : 32|8@1- (4,0) [0|0] "ms" Vector__XXX
 SG_ VCTM_OperatorPosTrafo_y m0 : 16|8@1- (2,0) [-256|254] "mm" Vector__XXX
 SG_ VCTM_OperatorPosTrafo_x m0 : 8|8@1- (2,0) [-256|254] "mm" Vector__XXX
 SG_ VCTM_OperatorPosTrafo_theta m0 : 24|8@1- (0.0054931640625,0) [-0.703125|0.6976318359375] "Deg" Vector__XXX
 SG_ DevID11_Mux M : 0|1@1+ (1,0) [0|1] "" Vector__XXX

BO_ 1677 P4UDev08_VctData: 8 ValeoDAS
 SG_ DAPM_VctIsSafetyFaultDetected m1 : 53|1@1+ (1,0) [0|0] "" Vector__XXX
 SG_ VCTM_IsReadyForAcc m0 : 59|1@1+ (1,0) [0|0] "" Vector__XXX
 SG_ VCTM_CtrlLagPosition m1 : 37|8@1- (2,0) [-256|254] "mm" Vector__XXX
 SG_ VCTM_CtrlLagAngle m1 : 45|8@1- (0.0439453125,0) [0|0] "deg" Vector__XXX
 SG_ DAPM_VctState m0 : 25|2@1+ (1,0) [0|3] "-" Vector__XXX
 SG_ VCTM_TargetWheelAngle m0 : 29|12@1- (0.02197265625,0) [-45|44.97802734375] "deg" Vector__XXX
 SG_ VCTM_LotCtrlMode m0 : 56|3@1+ (1,0) [0|7] "" Vector__XXX
 SG_ VCTM_LatCtrlMode m0 : 53|3@1+ (1,0) [0|7] "" Vector__XXX
 SG_ PIPO_ReqWheelAngVel m1 : 25|12@1- (0.02197265625,0) [-45|44.97802734375] "deg/s" Vector__XXX
 SG_ PACO_CmdWheelAngVel m0 : 41|12@1- (0.02197265625,0) [-45|44.97802734375] "deg/s" Vector__XXX
 SG_ DAPM_VctErrtCharacter : 1|7@1+ (1,0) [0|127] "" Vector__XXX
 SG_ DAPM_VctError m0 : 27|2@1+ (1,0) [0|3] "-" Vector__XXX
 SG_ DAPM_IsLotCtrlRequired m0 : 63|1@1+ (1,0) [0|0] "" Vector__XXX
 SG_ DAPM_IsLotCtrlActive m0 : 62|1@1+ (1,0) [0|0] "" Vector__XXX
 SG_ DAPM_IsLatCtrlRequired m0 : 61|1@1+ (1,0) [0|0] "" Vector__XXX
 SG_ DAPM_IsLatCtrlActive m0 : 60|1@1+ (1,0) [0|0] "" Vector__XXX
 SG_ PIPO_PathDataStarting : 24|1@1+ (1,0) [0|0] "" Vector__XXX
 SG_ PIPO_PathData : 8|16@1+ (1,0) [0|0] "" Vector__XXX
 SG_ DevID8_Mux M : 0|1@1+ (1,0) [0|1] "" Vector__XXX

BO_ 1676 P4UDev07_VctData: 8 ValeoDAS
 SG_ DAPM_IsEmergencyBrakeRequired m0 : 63|1@1+ (1,0) [0|0] "" Vector__XXX
 SG_ ODOM_IsOdometrieCorrect m0 : 61|1@1+ (1,0) [0|0] "-" Vector__XXX
 SG_ DAPM_IsSteerToTargetActive m0 : 62|1@1+ (1,0) [0|0] "-" Vector__XXX
 SG_ STRF_FilteredCmdWheelAng m1 : 51|12@1- (0.02197265625,0) [-45|44.97802734375] "deg" Vector__XXX
 SG_ VCTM_IsSteerBackActive m1 : 63|1@1+ (1,0) [0|0] "" Vector__XXX
 SG_ ODOM_UnfilteredWheelAngle m0 : 49|12@1- (0.02197265625,0) [-45|44.97802734375] "deg" Vector__XXX
 SG_ VCTM_FrenetFrameYPos m0 : 17|16@1- (1,0) [-32768|32767] "mm" Vector__XXX
 SG_ VCTM_FrenetFrameXPos m0 : 1|16@1- (1,0) [-32768|32767] "mm" Vector__XXX
 SG_ VCTM_FrenetFrameTPos m0 : 33|16@1- (0.0054931640625,0) [-180|179.994506835938] "Deg" Vector__XXX
 SG_ VPEX_DistToStop m1 : 29|11@1- (1,800) [0|0] "cm" Vector__XXX
 SG_ VPEX_CmdGear m1 : 25|2@1+ (1,0) [0|0] "" Vector__XXX
 SG_ VPEX_InternalState m1 : 27|2@1+ (1,0) [0|0] "" Vector__XXX
 SG_ VPEX_CmdAcc m1 : 40|11@1- (0.01,-5) [0|0] "m/s^2" Vector__XXX
 SG_ PIPO_SegWheelAng m1 : 13|12@1- (0.02197265625,0) [-45|44.97802734375] "deg" Vector__XXX
 SG_ PIPO_ReqWheelAng m1 : 1|12@1- (0.02197265625,0) [-45|44.97802734375] "deg" Vector__XXX
 SG_ DevID7_Mux M : 0|1@1+ (1,0) [0|0] "-" Vector__XXX

CM_ SG_ 1597 DIDH_VCT_Runtime "current runtime of DIDH_VCT";
CM_ SG_ 1597 DAPM_VCT_Runtime "current runtime of DAPM_VCT";
CM_ SG_ 1597 DAPM_VCT_Calltime "current calltime of DAPM_VCT";
CM_ SG_ 1597 VCTL_Runtime "current runtime of VCTL subsystem";
CM_ SG_ 1597 VCTM_EncodedDataStarting "If set the encoded data transmission starts";
CM_ SG_ 1597 VCTM_EncodedVelocitySegments "Sequential output of the encoded velocity segments.
";
CM_ SG_ 1597 VCTM_EncodedDynamicLotConfig "Sequential output of the encoded dynamic lot config.
";
CM_ SG_ 1597 VCTM_LotCtrlAction "currently executed longitudinal control action

--> lot_ctrl_action";
CM_ SG_ 1597 VCTM_IsGearChangeAllowed "Indicates if a gear change is allowed

-> is_gear_change_allowed

";
CM_ SG_ 1597 VCTM_MaxVelocityExt "--> dynamic_max_velocity";
CM_ SG_ 1597 VCTM_IsSteerBackEnabled "Indicates if steer back is enabled (steer_back_offset_mm != 0)

-> steer_back_offset_mm

";
CM_ SG_ 1597 VCTM_IsWheelAngleLimitActive "Indicates if left or right wheel angle is limited ((wheel_ang_limit_left_si16f < SI16_MAX) || (wheel_ang_limit_right_si16f < SI16_MAX))

-> wheel_ang_limit_left_si16f/wheel_ang_limit_right_si16f

";
CM_ SG_ 1597 VCTM_IsInitialSteeringLimited "Indicates if maximal allowed initial steering is limited (max_allowed_initial_steering < U16_MAX)

->max_allowed_initial_steering 

";
CM_ SG_ 1597 DAPM_DistToHint "Current distance to hint calculated by VCTL

--> dist_to_hint_mm";
CM_ SG_ 1597 DAPM_DistToCollision "Current distance to collision calculated by VCTM.

--> dist_to_coll_comf_mm";
CM_ SG_ 1597 VCTL_AbortCriterion "Current abort criterion sent by VCTL

--> abort_criterion";
CM_ SG_ 1597 VCTM_IsPosTrafoValid "Indicates if the position transformation is valid.

is_pos_trafo_valid

";
CM_ SG_ 1597 VCTM_IsPathNewToggle "Indicates if a new path is received by VCTL

is_path_new_toggle

";
CM_ SG_ 1597 VCTM_IsOperatorPosInBuffer "Indicates if the position provided by the operator is found in the VMCL buffer used by VCTL

is_operator_pos_in_buffer

";
CM_ SG_ 1597 VCTM_OperatorTimestampDelay "Delay of the operator timestamp compared to the timestamp of the current position used in VCTL.
--> operator_timestamp_delay_ms / 4";
CM_ SG_ 1597 VCTM_OperatorPosTrafo_y "Current delta between the position provided by the operator and the updated position used in VCTL for the current cycle.

--> operator_pos_trafo.trans.vy";
CM_ SG_ 1597 VCTM_OperatorPosTrafo_x "Current delta between the position provided by the operator and the updated position used in VCTL for the current cycle.

--> operator_pos_trafo.trans.vx";
CM_ SG_ 1597 VCTM_OperatorPosTrafo_theta "Current delta between the position provided by the operator and the updated position used in VCTL for the current cycle.

--> operator_pos_trafo.rot.ang_u16f";
CM_ SG_ 1597 DevID11_Mux "Multiplexor of P4U Dev-ID 11";
CM_ SG_ 1677 DAPM_VctIsSafetyFaultDetected "--> DAPM_IsSafetyFaultDetected(DAPM_EXEC_DAPM_VCT)";
CM_ SG_ 1677 VCTM_IsReadyForAcc "Indicates if system is ready for acceleration

-> is_ready_for_acceleration

";
CM_ SG_ 1677 VCTM_CtrlLagPosition "current control lag regarding the vehicle position (x/y)

";
CM_ SG_ 1677 VCTM_CtrlLagAngle "current control lag regarding the vehicle orientation

";
CM_ SG_ 1677 DAPM_VctState "--> DAPM_GetState";
CM_ SG_ 1677 VCTM_TargetWheelAngle "--> VCTM_GetTargetWheelAngle";
CM_ SG_ 1677 VCTM_LotCtrlMode "longitudinal control mode defined by the operator received in VCTL.";
CM_ SG_ 1677 VCTM_LatCtrlMode "lateral control mode defined by the operator received in VCTL.";
CM_ SG_ 1677 PIPO_ReqWheelAngVel "--> VCTM_GetReqWheelAngVel";
CM_ SG_ 1677 PACO_CmdWheelAngVel "--> VCTM_GetCmdWheelAngVel";
CM_ SG_ 1677 DAPM_VctErrtCharacter "characterwise output of the error trace in the format xxxx yyyy zzz (x: module name; y: line number; z: missed error traces) terminated with '\0'
if no error trace is available '\0' is sent.

--> ERRT_GetNextCharCurrErrMsg
";
CM_ SG_ 1677 DAPM_VctError "--> DAPM_GetError";
CM_ SG_ 1677 DAPM_IsLotCtrlRequired "Indicates if longitudinal control is requests by the active operator

--> DAPM_IsLotCtrlRequired";
CM_ SG_ 1677 DAPM_IsLotCtrlActive "Indicates if lateral control is active (received in DAPM_veh_input_S)

";
CM_ SG_ 1677 DAPM_IsLatCtrlRequired "Indicates if lateral control is requests by the active operator

--> DAPM_IsLatCtrlRequired";
CM_ SG_ 1677 DAPM_IsLatCtrlActive "Indicates if lateral control is active (received in DAPM_veh_input_S)

";
CM_ SG_ 1677 PIPO_PathDataStarting "If set a new path starts in PIPO_PathData";
CM_ SG_ 1677 PIPO_PathData "Sequential output of the path data from VCTL.
--> PIPO_GetSeqPathData";
CM_ SG_ 1677 DevID8_Mux "Multiplexor of P4U Dev-ID 8";
CM_ SG_ 1676 DAPM_IsEmergencyBrakeRequired "--> DAPM_IsEmergencyBrakeRequired()";
CM_ SG_ 1676 ODOM_IsOdometrieCorrect "--> ODOM_IsOdometrieCorrect";
CM_ SG_ 1676 DAPM_IsSteerToTargetActive "--> DAPM_IsSteerToTargetActive";
CM_ SG_ 1676 STRF_FilteredCmdWheelAng "--> VCTM_GetFilteredWheelAng";
CM_ SG_ 1676 VCTM_IsSteerBackActive "Indicates whether we are currently steering back to 0 (triggered by operator shortly before hint)

";
CM_ SG_ 1676 ODOM_UnfilteredWheelAngle "current wheel angle

--> ODOM_GetUnfilteredWheelAngle";
CM_ SG_ 1676 VCTM_FrenetFrameYPos "Current position on the planned trajectory

--> VCTM_GetFrenetFrame (frame.p.y)";
CM_ SG_ 1676 VCTM_FrenetFrameXPos "Current position on the planned trajectory

--> VCTM_GetFrenetFrame (frame.p.x)";
CM_ SG_ 1676 VCTM_FrenetFrameTPos "Current position on the planned trajectory

--> VCTM_GetFrenetFrame (frame.ang_u16f)";
CM_ SG_ 1676 VPEX_DistToStop "--> VPEX_GetUsedDistToStop";
CM_ SG_ 1676 VPEX_CmdGear "--> DAPM_GetCmdTransmissionDir";
CM_ SG_ 1676 VPEX_InternalState "--> VPEX_GetInternalState";
CM_ SG_ 1676 VPEX_CmdAcc "--> DAPM_GetCmdAcceleration";
CM_ SG_ 1676 PIPO_SegWheelAng "wheel angle of the current path segment

--> VCTM_GetSegWheelAng";
CM_ SG_ 1676 PIPO_ReqWheelAng "desired wheel angle to keep the vehicle on the path

--> VCTM_GetReqWheelAng";
CM_ SG_ 1676 DevID7_Mux "Multiplexor of P4U Dev-ID 7";
BA_DEF_  "BusType" STRING ;
BA_DEF_ SG_  "KCHECKAKTI" STRING ;
BA_DEF_ SG_  "INIT" STRING ;
BA_DEF_ BO_  "VAGTP20_API" HEX 0 255;
BA_DEF_ BO_  "VAGTP20_StatConnection" ENUM  "nein","ja";
BA_DEF_ SG_  "GenSigTimeoutTime_<ECU>" HEX 0 2047;
BA_DEF_ SG_  "GenSigTimeoutMsg_<ECU>" HEX 0 2047;
BA_DEF_ SG_  "GenSigInactiveValue" HEX 0 134217727;
BA_DEF_ SG_  "GenSigSendType" ENUM  "Cyclic","OnWrite","OnWriteWithRepetition","OnChange","OnChangeWithRepetition","IfActive","IfActiveWithRepetition","NoSigSendType";
BA_DEF_ BO_  "GenMsgTimeoutTime" INT 0 100000;
BA_DEF_ BO_  "GenMsgNoIalSupport" ENUM  "No","Yes";
BA_DEF_ BO_  "GenMsgStartDelayTime" INT 0 100000;
BA_DEF_ BO_  "GenMsgCycleTimeFast" INT 0 65535;
BA_DEF_ BO_  "GenMsgDelayTime" INT 0 100000;
BA_DEF_ BU_  "MessageManagerUsed" ENUM  "No","Yes";
BA_DEF_ BO_  "VAGTP20_DynConnection" ENUM  "nein","ja";
BA_DEF_ BO_  "VAGTP20_DynSetup" ENUM  "nein","ja";
BA_DEF_ BU_  "VAGTP20_TargetAddress" HEX 0 127;
BA_DEF_ BU_  "GenNodAutoGenDsp" ENUM  "Yes","No";
BA_DEF_ BU_  "GenNodAutoGenSnd" ENUM  "Yes","No";
BA_DEF_ BU_  "GenNodSleepTime" INT 0 1000000;
BA_DEF_ BU_  "NodeLayerModules" STRING ;
BA_DEF_  "NWMMessageCount" INT 0 64;
BA_DEF_ BO_  "xVWTP_Channel" ENUM  "nein","ja";
BA_DEF_ BO_  "xVWTP_Setup" ENUM  "nein","ja";
BA_DEF_ BO_  "GenMsgSendType" ENUM  "cyclicX","spontanX","cyclicIfActiveX","spontanWithDelay","cyclicAndSpontanX","cyclicAndSpontanWithDelay","spontanWithRepitition","cyclicIfActiveAndSpontanWD","cyclicIfActiveFast";
BA_DEF_  "Manufacturer" ENUM  "DBAG","VAG","BMWAG","PAG","GM";
BA_DEF_ BU_  "NWM-Stationsadresse" HEX 0 63;
BA_DEF_ BU_  "NWM-Knoten" ENUM  "nein","ja";
BA_DEF_ BO_  "GenMsgCycleTime" INT 0 65535;
BA_DEF_ BO_  "NWM-Botschaft" ENUM  "nein","ja";
BA_DEF_  "NWM-Basisadresse" HEX 0 2032;
BA_DEF_  "NWM-Typ" ENUM  "zentral (MB-W210)","dezentral (MB-OSAN)","keines","VAG-OSEK","BMW-OSEK","PAG-OSEK","DBAG-OSEK";
BA_DEF_DEF_  "BusType" "";
BA_DEF_DEF_  "KCHECKAKTI" "";
BA_DEF_DEF_  "INIT" "";
BA_DEF_DEF_  "VAGTP20_API" 0;
BA_DEF_DEF_  "VAGTP20_StatConnection" "";
BA_DEF_DEF_  "GenSigTimeoutTime_<ECU>" 0;
BA_DEF_DEF_  "GenSigTimeoutMsg_<ECU>" 0;
BA_DEF_DEF_  "GenSigInactiveValue" 0;
BA_DEF_DEF_  "GenSigSendType" "";
BA_DEF_DEF_  "GenMsgTimeoutTime" 0;
BA_DEF_DEF_  "GenMsgNoIalSupport" "";
BA_DEF_DEF_  "GenMsgStartDelayTime" 0;
BA_DEF_DEF_  "GenMsgCycleTimeFast" 0;
BA_DEF_DEF_  "GenMsgDelayTime" 0;
BA_DEF_DEF_  "MessageManagerUsed" "";
BA_DEF_DEF_  "VAGTP20_DynConnection" "";
BA_DEF_DEF_  "VAGTP20_DynSetup" "";
BA_DEF_DEF_  "VAGTP20_TargetAddress" 0;
BA_DEF_DEF_  "GenNodAutoGenDsp" "";
BA_DEF_DEF_  "GenNodAutoGenSnd" "";
BA_DEF_DEF_  "GenNodSleepTime" 0;
BA_DEF_DEF_  "NodeLayerModules" "";
BA_DEF_DEF_  "NWMMessageCount" 64;
BA_DEF_DEF_  "xVWTP_Channel" "";
BA_DEF_DEF_  "xVWTP_Setup" "";
BA_DEF_DEF_  "GenMsgSendType" "";
BA_DEF_DEF_  "Manufacturer" "VAG";
BA_DEF_DEF_  "NWM-Stationsadresse" 0;
BA_DEF_DEF_  "NWM-Knoten" "";
BA_DEF_DEF_  "GenMsgCycleTime" 0;
BA_DEF_DEF_  "NWM-Botschaft" "";
BA_DEF_DEF_  "NWM-Basisadresse" 1024;
BA_DEF_DEF_  "NWM-Typ" "VAG-OSEK";
BA_ "BusType" "CAN";
BA_ "NodeLayerModules" BU_ ValeoDAS "Vagnm01.dll";
BA_ "GenNodSleepTime" BU_ ValeoDAS 5000;
BA_ "GenNodAutoGenSnd" BU_ ValeoDAS 0;
BA_ "GenNodAutoGenDsp" BU_ ValeoDAS 0;
BA_ "VAGTP20_TargetAddress" BU_ ValeoDAS 255;
BA_ "MessageManagerUsed" BU_ ValeoDAS 0;
BA_ "NWM-Knoten" BU_ ValeoDAS 0;
BA_ "NWM-Botschaft" BO_ 1677 0;
BA_ "xVWTP_Setup" BO_ 1677 0;
BA_ "xVWTP_Channel" BO_ 1677 1;
BA_ "VAGTP20_DynSetup" BO_ 1677 0;
BA_ "VAGTP20_DynConnection" BO_ 1677 0;
BA_ "GenMsgNoIalSupport" BO_ 1677 0;
BA_ "GenMsgCycleTime" BO_ 1677 20;
BA_ "GenMsgSendType" BO_ 1677 0;
BA_ "VAGTP20_StatConnection" BO_ 1677 0;
BA_ "NWM-Botschaft" BO_ 1676 0;
BA_ "GenMsgCycleTime" BO_ 1676 20;
BA_ "GenMsgSendType" BO_ 1676 0;
BA_ "xVWTP_Setup" BO_ 1676 0;
BA_ "xVWTP_Channel" BO_ 1676 1;
BA_ "VAGTP20_DynSetup" BO_ 1676 0;
BA_ "VAGTP20_DynConnection" BO_ 1676 0;
BA_ "GenMsgNoIalSupport" BO_ 1676 0;
BA_ "VAGTP20_StatConnection" BO_ 1676 0;
BA_ "KCHECKAKTI" SG_ 1597 VCTM_OperatorPosTrafo_y "SJ---";
BA_ "INIT" SG_ 1597 VCTM_OperatorPosTrafo_y "0";
BA_ "GenSigSendType" SG_ 1597 VCTM_OperatorPosTrafo_y 7;
BA_ "KCHECKAKTI" SG_ 1597 VCTM_OperatorPosTrafo_x "SJ---";
BA_ "INIT" SG_ 1597 VCTM_OperatorPosTrafo_x "0";
BA_ "GenSigSendType" SG_ 1597 VCTM_OperatorPosTrafo_x 7;
BA_ "KCHECKAKTI" SG_ 1597 VCTM_OperatorPosTrafo_theta "SJ---";
BA_ "INIT" SG_ 1597 VCTM_OperatorPosTrafo_theta "0";
BA_ "GenSigSendType" SG_ 1597 VCTM_OperatorPosTrafo_theta 7;
BA_ "GenSigSendType" SG_ 1676 VCTM_FrenetFrameYPos 7;
BA_ "INIT" SG_ 1676 VCTM_FrenetFrameYPos "0";
BA_ "KCHECKAKTI" SG_ 1676 VCTM_FrenetFrameYPos "SJ---";
BA_ "KCHECKAKTI" SG_ 1676 VCTM_FrenetFrameXPos "SJ---";
BA_ "INIT" SG_ 1676 VCTM_FrenetFrameXPos "0";
BA_ "GenSigSendType" SG_ 1676 VCTM_FrenetFrameXPos 7;
BA_ "GenSigSendType" SG_ 1676 VCTM_FrenetFrameTPos 7;
BA_ "INIT" SG_ 1676 VCTM_FrenetFrameTPos "0";
BA_ "KCHECKAKTI" SG_ 1676 VCTM_FrenetFrameTPos "SJ---";
VAL_ 1597 VCTM_LotCtrlAction 7 "VCTC_LOT_CTRL_FULL_AUTOMATIC" 6 "VCTC_LOT_CTRL_SPEED_REGULATION" 5 "VCTC_LOT_CTRL_START_UP" 4 "VCTC_LOT_CTRL_HOLD_POSITION" 3 "VCTC_LOT_CTRL_COMFORT_BRAKING" 2 "VCTC_LOT_CTRL_EXTERNAL_BRAKING" 1 "VCTC_LOT_CTRL_EMERGENCY_BRAKING" 0 "VCTC_LOT_CTRL_NONE" ;
VAL_ 1597 VCTL_AbortCriterion 5 "VCTC_ABORT_CRIT_GENERAL" 4 "VCTC_ABORT_CRIT_LOT_MODE" 3 "VCTC_ABORT_CRIT_NUM_BRAKES" 2 "VCTC_ABORT_CRIT_CONTROL_LAG" 1 "VCTC_ABORT_CRIT_TORQUE" 0 "VCTC_ABORT_CRIT_NONE" ;
VAL_ 1597 DevID11_Mux 1 "DIDH cycle 2" 0 "DIDH cycle 1" ;
VAL_ 1677 DAPM_VctState 3 "DAPM_STATE_SHUTDOWN" 2 "DAPM_STATE_UPDATING" 1 "DAPM_STATE_STANDBY" 0 "DAPM_STATE_ERROR" ;
VAL_ 1677 VCTM_LotCtrlMode 4 "VCTC_LOT_CM_FULL_AUTOMATIC" 3 "VCTC_LOT_CM_COMFORT_BRAKING" 2 "VCTC_LOT_CM_SPEED_BRAKING" 1 "VCTC_LOT_CM_EMERGENCY_BRAKING" 0 "VCTC_LOT_CM_NONE" ;
VAL_ 1677 VCTM_LatCtrlMode 5 "VCTC_LAT_CM_TARGET_WA" 4 "VCTC_LAT_CM_OPEN_LOOP_WA" 3 "VCTC_LAT_CM_TRAJ_IPO" 2 "VCTC_LAT_CM_PATH_CLOTHOID" 1 "VCTC_LAT_CM_PATH" 0 "VCTC_LAT_CM_NONE" ;
VAL_ 1677 DAPM_VctError 3 "DAPM_ERR_CRITICAL" 2 "DAPM_ERR_CFG_FAILED" 1 "DAPM_ERR_CFG_INCOMPLETE" 0 "DAPM_ERR_NONE" ;
VAL_ 1677 DevID8_Mux 1 "DIDH cycle 2" 0 "DIDH cycle 1" ;
VAL_ 1676 VPEX_CmdGear 2 "unknown" 1 "forward" 0 "backward" ;
VAL_ 1676 VPEX_InternalState 4 "VPEX_STATE_INIT_PROFILE" 3 "VPEX_STATE_GEAR_CHANGE" 2 "VPEX_STATE_HOLD_VEHICLE" 1 "VPEX_STATE_EXEC_PROFILE" 0 "VPEX_STATE_WAITING" ;
VAL_ 1676 DevID7_Mux 1 "DIDH cycle 2" 0 "DIDH cycle 1" ;
