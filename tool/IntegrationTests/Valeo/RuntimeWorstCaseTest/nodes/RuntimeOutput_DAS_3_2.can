/*@@var:*/
variables
{
    struct RuntimeData
    {
        dword average;
        dword max;
        dword min;
        qword sum;
        dword count;
    };

    const NUMBER_OF_RTM = 18;
    const NUMBER_OF_REACTION_MEASURE = 20;

    const TRUE = 1;
    const FALSE = 0;

    long TimeLastReceptionDevId;

    /* variables to store current values of runtime measurement results */
    struct RuntimeData dapm_uls_calltime[NUMBER_OF_RTM];
    struct RuntimeData dapm_uls_runtime[NUMBER_OF_RTM];
    struct RuntimeData uls_driver_update_10ms_calltime[NUMBER_OF_RTM];
    struct RuntimeData uls_driver_update_10ms_runtime[NUMBER_OF_RTM];
    struct RuntimeData ulsd_runtime[NUMBER_OF_RTM];
    struct RuntimeData ulfx_runtime[NUMBER_OF_RTM];
    struct RuntimeData didh_uls_runtime[NUMBER_OF_RTM];

    struct RuntimeData dapm_fun_calltime[NUMBER_OF_RTM];
    struct RuntimeData dapm_fun_runtime[NUMBER_OF_RTM];
    struct RuntimeData objd_runtime[NUMBER_OF_RTM];
    struct RuntimeData fila_runtime[NUMBER_OF_RTM];
    struct RuntimeData vdil_runtime[NUMBER_OF_RTM];
    struct RuntimeData cola_runtime[NUMBER_OF_RTM];
    struct RuntimeData mopl_runtime[NUMBER_OF_RTM];
    struct RuntimeData odot_runtime[NUMBER_OF_RTM];
    struct RuntimeData didh_fun_runtime[NUMBER_OF_RTM];

    struct RuntimeData dapm_vct_calltime[NUMBER_OF_RTM];
    struct RuntimeData dapm_vct_runtime[NUMBER_OF_RTM];
    struct RuntimeData vctl_runtime[NUMBER_OF_RTM];
    struct RuntimeData didh_vct_runtime[NUMBER_OF_RTM];

    /* arrays to store the reaction time measurement results */
    long RTM_ReactionTime_FW_SS[NUMBER_OF_REACTION_MEASURE];
    long RTM_ReactionTime_FW[NUMBER_OF_REACTION_MEASURE];
    long RTM_ReactionTime_BW_SS[NUMBER_OF_REACTION_MEASURE];
    long RTM_ReactionTime_BW[NUMBER_OF_REACTION_MEASURE];
}
/*@@end*/

/*@@testfunction:TS_InitializeRuntimeMeasurement():*/
testfunction TS_InitializeRuntimeMeasurement ()
{
    int array_index;

    for (array_index = 0; array_index < NUMBER_OF_RTM; array_index++)
    {
        InitializeRuntimeData(dapm_uls_calltime[array_index]);
        InitializeRuntimeData(dapm_uls_runtime[array_index]);
        InitializeRuntimeData(uls_driver_update_10ms_calltime[array_index]);
        InitializeRuntimeData(uls_driver_update_10ms_runtime[array_index]);
        InitializeRuntimeData(ulsd_runtime[array_index]);
        InitializeRuntimeData(ulfx_runtime[array_index]);
        InitializeRuntimeData(didh_uls_runtime[array_index]);

        InitializeRuntimeData(dapm_fun_calltime[array_index]);
        InitializeRuntimeData(dapm_fun_runtime[array_index]);
        InitializeRuntimeData(objd_runtime[array_index]);
        InitializeRuntimeData(fila_runtime[array_index]);
        InitializeRuntimeData(vdil_runtime[array_index]);
        InitializeRuntimeData(cola_runtime[array_index]);
        InitializeRuntimeData(mopl_runtime[array_index]);
        InitializeRuntimeData(odot_runtime[array_index]);
        InitializeRuntimeData(didh_fun_runtime[array_index]);

        InitializeRuntimeData(dapm_vct_calltime[array_index]);
        InitializeRuntimeData(dapm_vct_runtime[array_index]);
        InitializeRuntimeData(vctl_runtime[array_index]);
        InitializeRuntimeData(didh_vct_runtime[array_index]);
    }

    for (array_index = 0; array_index < NUMBER_OF_REACTION_MEASURE; array_index++)
    {
        RTM_ReactionTime_FW_SS[array_index] = 0;
        RTM_ReactionTime_FW[array_index] = 0;
        RTM_ReactionTime_BW_SS[array_index] = 0;
        RTM_ReactionTime_BW[array_index] = 0;
    }
}
/*@@end*/

/*@@testfunction:TS_OutputOfRtmResults(char[]):*/
testfunction TS_OutputOfRtmResults (char filename[])
{
    dword output_file;
    int array_index;

    setWritePath(".");
    output_file = openFileWrite(filename, 0);

    /* runtime of ULSD */
    OutputOfRuntimeResult(ulsd_runtime, TRUE, output_file);
    /* runtime of ULFX */
    OutputOfRuntimeResult(ulfx_runtime, TRUE, output_file);
    /* runtime of DIDH_ULS */
    OutputOfRuntimeResult(didh_uls_runtime, TRUE, output_file);
    /* runtime of DAPM_ULS */
    OutputOfRuntimeResult(dapm_uls_runtime, TRUE, output_file);
    /* calltime of DAPM_ULS */
    OutputOfRuntimeResult(dapm_uls_calltime, FALSE, output_file);
    /* runtime of ULS driver update */
    OutputOfRuntimeResult(uls_driver_update_10ms_runtime, TRUE, output_file);
    /* calltime of ULS driver update */
    OutputOfRuntimeResult(uls_driver_update_10ms_calltime, FALSE, output_file);
    filePutString("\n", 1, output_file);

    /* runtime of OBJD */
    OutputOfRuntimeResult(objd_runtime, TRUE, output_file);
    /* runtime of FILA */
    OutputOfRuntimeResult(fila_runtime, TRUE, output_file);
    /* runtime of VDIL */
    OutputOfRuntimeResult(vdil_runtime, TRUE, output_file);
    /* runtime of COLA */
    OutputOfRuntimeResult(cola_runtime, TRUE, output_file);
    /* runtime of MOPL */
    OutputOfRuntimeResult(mopl_runtime, TRUE, output_file);
    /* runtime of ODOT */
    OutputOfRuntimeResult(odot_runtime, TRUE, output_file);
    /* runtime of DIDH_FUN */
    OutputOfRuntimeResult(didh_fun_runtime, TRUE, output_file);
    /* runtime of DAPM_FUN */
    OutputOfRuntimeResult(dapm_fun_runtime, TRUE, output_file);
    /* calltime of DAPM_FUN */
    OutputOfRuntimeResult(dapm_fun_calltime, FALSE, output_file);
    filePutString("\n", 1, output_file);

    /* runtime of VCTL */
    OutputOfRuntimeResult(vctl_runtime, TRUE, output_file);
    /* runtime of DIDH_VCT */
    OutputOfRuntimeResult(didh_vct_runtime, TRUE, output_file);
    /* runtime of DAPM_VCT */
    OutputOfRuntimeResult(dapm_vct_runtime, TRUE, output_file);
    /* calltime of DAPM_VCT */
    OutputOfRuntimeResult(dapm_vct_calltime, FALSE, output_file);
    filePutString("\n", 1, output_file);

    filePutString("\n", 1, output_file);

    /* reaction time measurements forward standstill */
    OutputOfReactionMeasurementResult(RTM_ReactionTime_FW_SS, output_file);
    /* reaction time measurements forward */
    OutputOfReactionMeasurementResult(RTM_ReactionTime_FW, output_file);
    /* reaction time measurements backward standstill */
    OutputOfReactionMeasurementResult(RTM_ReactionTime_BW_SS, output_file);
    /* reaction time measurements backward */
    OutputOfReactionMeasurementResult(RTM_ReactionTime_BW, output_file);

    fileClose(output_file);
}
/*@@end*/

/*@@caplFunc:OutputOfReactionMeasurementResult(long[],dword):*///function
OutputOfReactionMeasurementResult (long reaction_time_measurement[], dword output_file)
{
    const int COMMENT_LENGTH = 1000;
    char test_case_comment[COMMENT_LENGTH];
    const int RESULT_LENGTH = 20;
    char rtm_result[RESULT_LENGTH];
    int array_index;

    snprintf(test_case_comment, COMMENT_LENGTH, "");
    for (array_index = 0; array_index < NUMBER_OF_REACTION_MEASURE; array_index++)
    {
        snprintf(rtm_result, RESULT_LENGTH, "%d\t", reaction_time_measurement[array_index]);
        strncat(test_case_comment, rtm_result, COMMENT_LENGTH);
    }
    str_replace(test_case_comment, strlen(test_case_comment)-1, "\n", 2);
    filePutString(test_case_comment, strlen(test_case_comment), output_file);
}
/*@@end*/

/*@@caplFunc:OutputOfRuntimeResult(RuntimeData[],byte,dword):*///function
OutputOfRuntimeResult (struct RuntimeData runtime_data[], byte is_runtime, dword output_file)
{
    const int COMMENT_LENGTH = 1000;
    char test_case_comment[COMMENT_LENGTH];
    const int RESULT_LENGTH = 20;
    char rtm_result[RESULT_LENGTH];
    int array_index;

    snprintf(test_case_comment, COMMENT_LENGTH, "");
    for (array_index = 0; array_index < NUMBER_OF_RTM; array_index++)
    {
        if (TRUE == is_runtime)
        {
            snprintf(rtm_result, RESULT_LENGTH, "%d\t%d\t", runtime_data[array_index].average, runtime_data[array_index].max);
        }
        else
        {
            if (runtime_data[array_index].min == 0xffffffff)
            {
                runtime_data[array_index].min = 0;
            }
            snprintf(rtm_result, RESULT_LENGTH, "%d\t%d\t", runtime_data[array_index].average, runtime_data[array_index].max);
        }
        strncat(test_case_comment, rtm_result, COMMENT_LENGTH);
    }
    str_replace(test_case_comment, strlen(test_case_comment)-1, "\n", 2);
    filePutString(test_case_comment, strlen(test_case_comment), output_file);
}
/*@@end*/

/*@@testfunction:TS_StoreRtmValues():*/
testfunction TS_StoreRtmValues ()
{
    /* function is needed for compatibility reasons to DAS 2.50 */
}
/*@@end*/

/*@@testfunction:TS_MeasureReactionTime(int,int,int):*/
testfunction TS_MeasureReactionTime (int speed, int reverse_gear, int measurement)
{
    dword start_time_ms;
    dword reaction_time_ms;

    start_time_ms = timeNow() / 100;
    if(testWaitForSignalInRange(MeasuredDistance, 0, 253, 5000) != 1)
    {
        TestStepFail("No object detected.");
    }
    reaction_time_ms = (timeNow() / 100) - start_time_ms;

    if(measurement <= NUMBER_OF_REACTION_MEASURE)
    {
        if(reverse_gear == 1)
        {
            if(speed == 0)
            {
                RTM_ReactionTime_BW_SS[measurement - 1] = reaction_time_ms;
            }
            else
            {
                RTM_ReactionTime_BW[measurement - 1] = reaction_time_ms;
            }
        }
        else
        {
            if(speed == 0)
            {
                RTM_ReactionTime_FW_SS[measurement - 1] = reaction_time_ms;
            }
            else
            {
                RTM_ReactionTime_FW[measurement - 1] = reaction_time_ms;
            }
        }
    }
    else
    {
        TestStepFail("Number of measurements increased.");
    }
}
/*@@end*/

/*@@testfunction:TS_CheckRtmReception():*/
testfunction TS_CheckRtmReception ()
{
    if((timeNow()- TimeLastReceptionDevId) > 100000)
    {
        TestStepFail("ECU has stopped during test or runtime data is not available in Dev-IDs!");
    }

}
/*@@end*/

/*@@caplFunc:UpdateRuntime(RuntimeData,dword):*///function
UpdateRuntime (struct RuntimeData runtime_data, dword current_time)
{
    if (((runtime_data.sum + current_time) >= runtime_data.sum) && (runtime_data.count < (qword) 0xffffffff))
    {
        runtime_data.sum += current_time;
        runtime_data.count++;
    }
    else
    {
        runtime_data.sum = runtime_data.average;
        runtime_data.count = 1;
    }

    runtime_data.average = runtime_data.sum / runtime_data.count;

    if (runtime_data.max < current_time)
    {
        runtime_data.max = current_time;
    }

    if (runtime_data.min > current_time)
    {
        runtime_data.min = current_time;
    }
}
/*@@end*/

/*@@caplFunc:InitializeRuntimeData(RuntimeData):*///function
InitializeRuntimeData (struct RuntimeData runtime_data)
{
    runtime_data.average = 0;
    runtime_data.max = 0;
    runtime_data.min = 0xffffffff;
    runtime_data.sum = 0;
    runtime_data.count = 0;
}
/*@@end*/

/*@@msg:CAN3.DevIDsSignals_x2_P4U_uls::P4UDev09_UlsRtm (0x63D):*/
on message P4UDev09_UlsRtm
{
    byte array_index;

    array_index = GetArrayIndex();

    if (array_index != 255)
    {
        if (this.DevID9_Mux == 0)
        {
            UpdateRuntime (dapm_uls_calltime[array_index], this.DAPM_ULS_Calltime.phys);
            UpdateRuntime (dapm_uls_runtime[array_index], this.DAPM_ULS_Runtime.phys);
            UpdateRuntime (uls_driver_update_10ms_calltime[array_index], this.ULS_DriverUpdate10ms_Calltime.phys);
            UpdateRuntime (uls_driver_update_10ms_runtime[array_index], this.ULS_DriverUpdate10ms_Runtime.phys);
            UpdateRuntime (ulsd_runtime[array_index], this.ULSD_Runtime.phys);
            UpdateRuntime (ulfx_runtime[array_index], this.ULFX_Runtime.phys);
            UpdateRuntime (didh_uls_runtime[array_index], this.DIDH_ULS_Runtime.phys);
       }

    }

    TimeLastReceptionDevId = this.TIME;
}
/*@@end*/

/*@@msg:CAN3.DevIDsSignals_x2_P4U_fun::P4UDev10_FunRtm (0x63E):*/
on message P4UDev10_FunRtm
{
    byte array_index;

    array_index = GetArrayIndex();

    if (array_index != 255)
    {
        if (this.DevID10_Mux == 0)
        {
            UpdateRuntime (dapm_fun_calltime[array_index], this.DAPM_FUN_Calltime.phys);
            UpdateRuntime (dapm_fun_runtime[array_index], this.DAPM_FUN_Runtime.phys);
            UpdateRuntime (objd_runtime[array_index], this.OBJD_Runtime.phys);
            UpdateRuntime (fila_runtime[array_index], this.FILA_Runtime.phys);
            UpdateRuntime (vdil_runtime[array_index], this.VDIL_Runtime.phys);
            UpdateRuntime (cola_runtime[array_index], this.COLA_Runtime.phys);
            UpdateRuntime (mopl_runtime[array_index], this.MOPL_Runtime.phys);
        }

        if (this.DevID10_Mux == 1)
        {
            UpdateRuntime (odot_runtime[array_index], this.ODOT_Runtime.phys);
            UpdateRuntime (didh_fun_runtime[array_index], this.DIDH_FUN_Runtime.phys);
        }
    }
}
/*@@end*/

/*@@caplFunc:GetArrayIndex():*///function
byte GetArrayIndex ()
{
    byte array_index = 255;

    switch (getValue(CurrentTestCase))
    {
    case 1: //TC1
        array_index = 0;
        break;
    case 2: //TC2
        switch (getValue(RuntimeWorstCaseTest::CurrentTestCase_Speed))
        {
        case 50:
            array_index = 1;
            break;
        case 100:
            array_index = 2;
            break;
        case 150:
            array_index = 3;
            break;
        case 200:
            array_index = 4;
            break;
        case 250:
            array_index = 5;
            break;
        }
        break;
    case 3: //TC3
        switch (getValue(RuntimeWorstCaseTest::CurrentTestCase_Speed))
        {
        case 50:
            array_index = 6;
            break;
        case 100:
            array_index = 7;
            break;
        case 150:
            array_index = 8;
            break;
        case 200:
            array_index = 9;
            break;
        case 250:
            array_index = 10;
            break;
        }
        break;
    case 4: //TC4
        array_index = 11;
        break;
    case 5: //TC5
        array_index = 12;
        break;
    case 6: //TC6
        array_index = 13;
        break;
    case 7: //TC7
        array_index = 14;
        break;
    case 8: //TC8
        array_index = 15;
        break;
    case 9: // TC9
        array_index = 16;
        break;
    case 10: // TC10
        array_index = 17;
        break;
    }

    return array_index;
}
/*@@end*/

/*@@msg:CAN3.DevIDsSignals_x2_P4U_vct::P4UDev11_VctData_Rtm (0x63F):*/
on message P4UDev11_VctData_Rtm
{
    byte array_index;

    array_index = GetArrayIndex();

    if (array_index != 255)
    {
        if (this.DevID11_Mux == 1)
        {
            UpdateRuntime (dapm_vct_calltime[array_index], this.DAPM_VCT_Calltime.phys);
            UpdateRuntime (dapm_vct_runtime[array_index], this.DAPM_VCT_Runtime.phys);
            UpdateRuntime (vctl_runtime[array_index], this.VCTL_Runtime.phys);
            UpdateRuntime (didh_vct_runtime[array_index], this.DIDH_VCT_Runtime.phys);
        }

    }
}
/*@@end*/

