/*@@var:*/
variables
{   
    // A2PLA_2_6_053
    // Touran 368
    // vehicle geometry
    int length_mm = 4391;
	int width_mm = 1794;
    int rearaxis2end_mm = 836; 
    	
    // carconfig
	//mpla
	int tol_veh_ang_u16f = 546;
	int tol_veh_pos_x_mm = 120;	
	// trpe		
	int safety_distance_cm = 10;	
	// past
    int min_sl_offset_par_cm = 70;
	int max_offset_ps_cm = 40;
	int max_offset_l_cm = 50;
	int distance_to_curb_cm = 15;
	int distance_to_wall_cm = 30;
	int tyre_safety_distance_cm = 50;
	int min_sl_offset_lat_cm = 50;
	int dist_to_align_to_object_cm = 75;
	int sl_to_align_to_object_end_mm = 4200;
	int distance_to_obj_side_sec_cm = 20;
    
}
/*@@end*/

